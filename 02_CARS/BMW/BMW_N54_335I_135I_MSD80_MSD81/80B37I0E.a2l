ASAP2_VERSION 1 41
/begin PROJECT MSD70 "Spray Guided DI-System with Piezo Injectors for 6-Cylinder"
/begin HEADER "_default_HeaderComment" PROJECT_NO _0B /end HEADER
/begin MODULE _default_ModuleName "_default_ModuleLongIdentifier"
/begin MOD_COMMON "_default_ModCommonComment" DEPOSIT ABSOLUTE BYTE_ORDER MSB_LAST ALIGNMENT_BYTE 1 ALIGNMENT_WORD 2 ALIGNMENT_LONG 2 ALIGNMENT_FLOAT32_IEEE 2 ALIGNMENT_FLOAT64_IEEE 4 /end MOD_COMMON
/begin MEASUREMENT delta_crk_dif_max_er "Limitation of adaptation range (mech. Tolerance)" UWORD _CNV_A_R_ENRD_LINEA_397_CM 1 100. 0. 1001.899 DISPLAY_IDENTIFIER DELTA_CRK_DIF_MAX_ER ECU_ADDRESS 0xc0001ba4 FORMAT "%8.3" /end MEASUREMENT
/begin MEASUREMENT seg_ad_mmv_er[0] "ER Filtered adaptive values used for learning process (for each segment)" SWORD _CNV_A_R_ENRD_LINEA_398_CM 1 100. -7.8125 7.8123 DISPLAY_IDENTIFIER SEG_AD_MMV_ER[0] ECU_ADDRESS 0xd0002560 FORMAT "%7.4" /end MEASUREMENT
/begin MEASUREMENT seg_ad_mmv_er[1] "ER Filtered adaptive values used for learning process (for each segment)" SWORD _CNV_A_R_ENRD_LINEA_398_CM 1 100. -7.8125 7.8123 DISPLAY_IDENTIFIER SEG_AD_MMV_ER[1] ECU_ADDRESS 0xd0002562 FORMAT "%7.4" /end MEASUREMENT
/begin MEASUREMENT seg_ad_mmv_er[2] "ER Filtered adaptive values used for learning process (for each segment)" SWORD _CNV_A_R_ENRD_LINEA_398_CM 1 100. -7.8125 7.8123 DISPLAY_IDENTIFIER SEG_AD_MMV_ER[2] ECU_ADDRESS 0xd0002564 FORMAT "%7.4" /end MEASUREMENT
/begin MEASUREMENT seg_ad_mmv_er[3] "ER Filtered adaptive values used for learning process (for each segment)" SWORD _CNV_A_R_ENRD_LINEA_398_CM 1 100. -7.8125 7.8123 DISPLAY_IDENTIFIER SEG_AD_MMV_ER[3] ECU_ADDRESS 0xd0002566 FORMAT "%7.4" /end MEASUREMENT
/begin MEASUREMENT seg_ad_mmv_er[4] "ER Filtered adaptive values used for learning process (for each segment)" SWORD _CNV_A_R_ENRD_LINEA_398_CM 1 100. -7.8125 7.8123 DISPLAY_IDENTIFIER SEG_AD_MMV_ER[4] ECU_ADDRESS 0xd0002568 FORMAT "%7.4" /end MEASUREMENT
/begin MEASUREMENT seg_ad_mmv_er[5] "ER Filtered adaptive values used for learning process (for each segment)" SWORD _CNV_A_R_ENRD_LINEA_398_CM 1 100. -7.8125 7.8123 DISPLAY_IDENTIFIER SEG_AD_MMV_ER[5] ECU_ADDRESS 0xd000256a FORMAT "%7.4" /end MEASUREMENT
/begin MEASUREMENT seg_ad_raw_mmv_er[0] "ER Filtered adaptive values used for learning process monitoring (for each segment)" SWORD _CNV_A_R_ENRD_LINEA_398_CM 1 100. -7.8125 7.8123 DISPLAY_IDENTIFIER SEG_AD_RAW_MMV_ER[0] ECU_ADDRESS 0xc0001bc8 FORMAT "%7.4" /end MEASUREMENT
/begin MEASUREMENT seg_ad_raw_mmv_er[1] "ER Filtered adaptive values used for learning process monitoring (for each segment)" SWORD _CNV_A_R_ENRD_LINEA_398_CM 1 100. -7.8125 7.8123 DISPLAY_IDENTIFIER SEG_AD_RAW_MMV_ER[1] ECU_ADDRESS 0xc0001bca FORMAT "%7.4" /end MEASUREMENT
/begin MEASUREMENT seg_ad_raw_mmv_er[2] "ER Filtered adaptive values used for learning process monitoring (for each segment)" SWORD _CNV_A_R_ENRD_LINEA_398_CM 1 100. -7.8125 7.8123 DISPLAY_IDENTIFIER SEG_AD_RAW_MMV_ER[2] ECU_ADDRESS 0xc0001bcc FORMAT "%7.4" /end MEASUREMENT
/begin MEASUREMENT seg_ad_raw_mmv_er[3] "ER Filtered adaptive values used for learning process monitoring (for each segment)" SWORD _CNV_A_R_ENRD_LINEA_398_CM 1 100. -7.8125 7.8123 DISPLAY_IDENTIFIER SEG_AD_RAW_MMV_ER[3] ECU_ADDRESS 0xc0001bce FORMAT "%7.4" /end MEASUREMENT
/begin MEASUREMENT seg_ad_raw_mmv_er[4] "ER Filtered adaptive values used for learning process monitoring (for each segment)" SWORD _CNV_A_R_ENRD_LINEA_398_CM 1 100. -7.8125 7.8123 DISPLAY_IDENTIFIER SEG_AD_RAW_MMV_ER[4] ECU_ADDRESS 0xc0001bd0 FORMAT "%7.4" /end MEASUREMENT
/begin MEASUREMENT seg_ad_raw_mmv_er[5] "ER Filtered adaptive values used for learning process monitoring (for each segment)" SWORD _CNV_A_R_ENRD_LINEA_398_CM 1 100. -7.8125 7.8123 DISPLAY_IDENTIFIER SEG_AD_RAW_MMV_ER[5] ECU_ADDRESS 0xc0001bd2 FORMAT "%7.4" /end MEASUREMENT
/begin CHARACTERISTIC c_crk_dif_max_er "Limitation of adaptation range ( mechanical tolerance)" VALUE 0xa100302e _REC_VAL_20_u2 7.8125 _CNV_A_R_ENRD_LINEA_399_CM 0. 7.8125 DISPLAY_IDENTIFIER C_CRK_DIF_MAX_ER FORMAT "%6.4" /end CHARACTERISTIC
/begin CHARACTERISTIC c_seg_ad_max_er "Limitation of ER segment adaptation range ( mechanical tolerance)" VALUE 0xa100305c _REC_VAL_20_u2 7.8123 _CNV_A_R_ENRD_LINEA_400_CM 0. 7.8123 DISPLAY_IDENTIFIER C_SEG_AD_MAX_ER FORMAT "%6.4" /end CHARACTERISTIC
/begin MEASUREMENT seg_ad_dif_er_0 "ER adaptive values difference on same physical segment (Segment 0 & identical)" UWORD _CNV_A_R_ENRD_LINEA_400_CM 1 100. 0. 7.8123 DISPLAY_IDENTIFIER SEG_AD_DIF_ER_0 ECU_ADDRESS 0xc0001bc4 FORMAT "%6.4" /end MEASUREMENT
/begin MEASUREMENT seg_ad_dif_er_1 "ER adaptive values difference on same physical segment (Segment 1 & identical)" UWORD _CNV_A_R_ENRD_LINEA_400_CM 1 100. 0. 7.8123 DISPLAY_IDENTIFIER SEG_AD_DIF_ER_1 ECU_ADDRESS 0xc0001bc6 FORMAT "%6.4" /end MEASUREMENT
/begin MEASUREMENT seg_ad_dif_er_2 "ER adaptive values difference on same physical segment (Segment 2 & identical)" UWORD _CNV_A_R_ENRD_LINEA_400_CM 1 100. 0. 7.8123 DISPLAY_IDENTIFIER SEG_AD_DIF_ER_2 ECU_ADDRESS 0xc0001b94 FORMAT "%6.4" /end MEASUREMENT
/begin CHARACTERISTIC c_seg_ad_dif_max_er "Maximum range for difference between same physical segment adaptive values" VALUE 0xa100305a _REC_VAL_20_u2 7.8123 _CNV_A_R_ENRD_LINEA_400_CM 0. 7.8123 DISPLAY_IDENTIFIER C_SEG_AD_DIF_MAX_ER FORMAT "%6.4" /end CHARACTERISTIC
/begin MEASUREMENT thd_ad_er "Engine roughness threshold correction factor during segment adaptation learning process" UWORD _CNV_A_R_LINEAR_____401_CM 1 100. 0. 65535. DISPLAY_IDENTIFIER THD_AD_ER ECU_ADDRESS 0xd0002590 FORMAT "%5.0" /end MEASUREMENT
/begin MEASUREMENT lv_seg_ad_fdout_er "Boolean for segment adaptation fade out condition" UBYTE _CNV_S_2_RANGE__0___1_CM 1 100. 0. 1. DISPLAY_IDENTIFIER LV_SEG_AD_FDOUT_ER ECU_ADDRESS 0xc0001bf4 BIT_MASK 0x1 /end MEASUREMENT
/begin MEASUREMENT lv_seg_ad_dif_max_er "Boolean for maximum ER adaptive values difference on same physical segment  allowed" UBYTE _CNV_S_2_RANGE__0___1_CM 1 100. 0. 1. DISPLAY_IDENTIFIER LV_SEG_AD_DIF_MAX_ER ECU_ADDRESS 0xd0002dd4 BIT_MASK 0x1 /end MEASUREMENT
/begin AXIS_PTS ldp_maf_ip_maf_dif_max_er_ad "" 0xa1002d88 maf _REC_AXS_20_u2 1389. _CNV_A_R_LINEAR_____108_CM 6 0. 1389. FORMAT "%7.2" /end AXIS_PTS
/begin AXIS_PTS ldp_load_mis_ip_load_grd_er_ad "" 0xa1002d78 load_mis _REC_AXS_20_u2 99.9969482421875 _CNV_A_R_LINEAR_____201_CM 6 0. 99.9969482421875 FORMAT "%7.3" /end AXIS_PTS
/begin AXIS_PTS ldp_tps_av_ip_tps_grd_max_er "" 0xa1002ee0 tps_av _REC_AXS_20_u2 119.5 _CNV_A_R_LINEAR_____221_CM 6 0. 119.5 FORMAT "%7.3" /end AXIS_PTS
/begin CHARACTERISTIC c_t_maf_dif_dly_er_ad "Fade out duration when maximum air-mass gradient has been detected" VALUE 0xa100306a _REC_VAL_20_u2 655.35 _CNV_A_R_LINEAR_____3_CM 0. 655.35 DISPLAY_IDENTIFIER C_T_MAF_DIF_DLY_ER_AD FORMAT "%6.2" /end CHARACTERISTIC
/begin CHARACTERISTIC c_t_load_grd_dly_er_ad "Fade out duration when maximum actual torque gradient has been detected" VALUE 0xa1003068 _REC_VAL_20_u2 655.35 _CNV_A_R_LINEAR_____3_CM 0. 655.35 DISPLAY_IDENTIFIER C_T_LOAD_GRD_DLY_ER_AD FORMAT "%6.2" /end CHARACTERISTIC
/begin CHARACTERISTIC c_t_tps_grd_dly_er_ad "Fade out duration when maximum throttle gradient has been detected" VALUE 0xa100306c _REC_VAL_20_u2 655.34 _CNV_A_R_LINEAR_____3_CM 1.e-002 655.35 DISPLAY_IDENTIFIER C_T_TPS_GRD_DLY_ER_AD FORMAT "%6.2" /end CHARACTERISTIC
/begin CHARACTERISTIC c_t_accout_dly_er_ad "Fade out duration when air-conditioning compressor has been switched on or off" VALUE 0xa1003064 _REC_VAL_20_u2 655.35 _CNV_A_R_LINEAR_____3_CM 0. 655.35 DISPLAY_IDENTIFIER C_T_ACCOUT_DLY_ER_AD FORMAT "%6.2" /end CHARACTERISTIC
/begin MEASUREMENT lv_seg_ad_fdout_er_eol "EOL specific request for ER segment adaptive learning process" UBYTE _CNV_S_2_RANGE__0___1_CM 1 100. 0. 1. DISPLAY_IDENTIFIER LV_SEG_AD_FDOUT_ER_EOL ECU_ADDRESS 0xc0001bf5 BIT_MASK 0x1 /end MEASUREMENT
/begin CHARACTERISTIC c_drv1_max_seg_ad_er_eol "Maximum value of DRV1_ER (dynamic part of engine roughness) for crankshaft target wheel learning for EOL request mode" VALUE 0xa100303c _REC_VAL_20_u2 32767. _CNV_A_R_LINEAR_____401_CM 0. 32767. DISPLAY_IDENTIFIER C_DRV1_MAX_SEG_AD_ER_EOL FORMAT "%5.0" /end CHARACTERISTIC
/begin CHARACTERISTIC c_nr_seg_ad_act_min_er_eol "Minimum segments number in fuel cut-off mode before triggering ER segment adaptive learning process for EOL request mode" VALUE 0xa1003055 _REC_VAL_20_u1 255. _CNV_A_R_LINEAR_____0_CM 0. 255. DISPLAY_IDENTIFIER C_NR_SEG_AD_ACT_MIN_ER_EOL FORMAT "%3.0" /end CHARACTERISTIC
/begin CHARACTERISTIC c_nr_seg_drv1_min_er_eol "Minimum number of segments for engine roughness dynamic part for EOL request mode" VALUE 0xa1003059 _REC_VAL_20_u1 255. _CNV_A_R_LINEAR_____0_CM 0. 255. DISPLAY_IDENTIFIER C_NR_SEG_DRV1_MIN_ER_EOL FORMAT "%3.0" /end CHARACTERISTIC
/begin CHARACTERISTIC lc_seg_ad_er_req_eol "Specific EOL request enable flag for ER segment adaptive value learning process" VALUE 0xa100306f _REC_VAL_20_u1 1. _CNV_S_2_RANGE__0___1_CM 0. 1. DISPLAY_IDENTIFIER LC_SEG_AD_ER_REQ_EOL BIT_MASK 0x1 /end CHARACTERISTIC
/begin MEASUREMENT crlc_seg_ad_er "ER segment adaptive values filtering coefficient" UWORD _CNV_A_R_LINEAR_____68_CM 1 100. 0. 0.9999847412109381 DISPLAY_IDENTIFIER CRLC_SEG_AD_ER ECU_ADDRESS 0xc0001ba0 FORMAT "%7.5" /end MEASUREMENT
/begin MEASUREMENT ctr_seg_ad_er "Counter of ER segment adaptation learning process" UWORD _CNV_A_R_LINEAR_____0_CM 1 100. 0. 65535. DISPLAY_IDENTIFIER CTR_SEG_AD_ER ECU_ADDRESS 0xc0001ba2 FORMAT "%5.0" /end MEASUREMENT
/begin MEASUREMENT lv_seg_ad_avl_er "Segment adaptation process state : no adaptive process executed (=0) fast adaptive process executed (=1)" UBYTE _CNV_S_2_RANGE__0___1_CM 1 100. 0. 1. DISPLAY_IDENTIFIER LV_SEG_AD_AVL_ER ECU_ADDRESS 0xd0002dd3 BIT_MASK 0x1 /end MEASUREMENT
/begin MEASUREMENT lv_seg_ad_er "ER segment adaptation process enable" UBYTE _CNV_S_2_RANGE__0___1_CM 1 100. 0. 1. DISPLAY_IDENTIFIER LV_SEG_AD_ER ECU_ADDRESS 0xd0002dd5 BIT_MASK 0x1 /end MEASUREMENT
/begin MEASUREMENT lv_seg_ad_raw_er "ER segment adaptation process monitoring enable" UBYTE _CNV_S_2_RANGE__0___1_CM 1 100. 0. 1. DISPLAY_IDENTIFIER LV_SEG_AD_RAW_ER ECU_ADDRESS 0xc0001bf6 BIT_MASK 0x1 /end MEASUREMENT
/begin CHARACTERISTIC c_n_seg_t_ad_raw_max_er "Maximum engine speed threshold for crankshaft target wheel monitoring" VALUE 0xa1003052 _REC_VAL_20_u1 8160. _CNV_A_R_LINEAR_____9_CM 0. 8160. DISPLAY_IDENTIFIER C_N_SEG_T_AD_RAW_MAX_ER FORMAT "%4.0" /end CHARACTERISTIC
/begin CHARACTERISTIC c_n_seg_t_ad_raw_min_er "Minimum engine speed threshold for crankshaft target wheel monitoring" VALUE 0xa1003053 _REC_VAL_20_u1 8160. _CNV_A_R_LINEAR_____9_CM 0. 8160. DISPLAY_IDENTIFIER C_N_SEG_T_AD_RAW_MIN_ER FORMAT "%4.0" /end CHARACTERISTIC
/begin CHARACTERISTIC c_drv1_max_seg_ad_er "Maximum value of DRV1_ER (dynamic part of engine roughness) for crankshaft target wheel learning" VALUE 0xa100303a _REC_VAL_20_u2 32767. _CNV_A_R_LINEAR_____401_CM 0. 32767. DISPLAY_IDENTIFIER C_DRV1_MAX_SEG_AD_ER FORMAT "%5.0" /end CHARACTERISTIC
/begin CHARACTERISTIC c_nr_seg_ad_act_min_er "Minimum segments number in fuel cut-off mode before triggering ER segment adaptive learning process" VALUE 0xa1003054 _REC_VAL_20_u1 255. _CNV_A_R_LINEAR_____0_CM 0. 255. DISPLAY_IDENTIFIER C_NR_SEG_AD_ACT_MIN_ER FORMAT "%3.0" /end CHARACTERISTIC
/begin CHARACTERISTIC c_nr_seg_drv1_min_er "Minimum number of segments for engine roughness dynamic part" VALUE 0xa1003058 _REC_VAL_20_u1 255. _CNV_A_R_LINEAR_____0_CM 0. 255. DISPLAY_IDENTIFIER C_NR_SEG_DRV1_MIN_ER FORMAT "%3.0" /end CHARACTERISTIC
/begin CHARACTERISTIC c_crlc_seg_ad_er "Nominal ER segment adaptive values filtering coefficient" VALUE 0xa1003034 _REC_VAL_20_u2 0.9999847412109381 _CNV_A_R_LINEAR_____68_CM 0. 0.9999847412109381 DISPLAY_IDENTIFIER C_CRLC_SEG_AD_ER FORMAT "%7.5" /end CHARACTERISTIC
/begin CHARACTERISTIC c_crlc_seg_ad_er_eol "EOL specific filtering coefficient for ER segment adaptive values learning process" VALUE 0xa1003036 _REC_VAL_20_u2 0.9999847412109381 _CNV_A_R_LINEAR_____68_CM 0. 0.9999847412109381 DISPLAY_IDENTIFIER C_CRLC_SEG_AD_ER_EOL FORMAT "%7.5" /end CHARACTERISTIC
/begin CHARACTERISTIC c_nr_seg_ad_avl_er "Number of engine cycle (720°Crk) to achieve the fast ER adaptive learning process stage" VALUE 0xa1003056 _REC_VAL_20_u2 65535. _CNV_A_R_LINEAR_____0_CM 0. 65535. DISPLAY_IDENTIFIER C_NR_SEG_AD_AVL_ER FORMAT "%5.0" /end CHARACTERISTIC
/begin MEASUREMENT lv_seg_ad_lim_er "ER filtered adaptative values out of range" UBYTE _CNV_S_2_RANGE__0___1_CM 1 100. 0. 1. DISPLAY_IDENTIFIER LV_SEG_AD_LIM_ER ECU_ADDRESS 0xd0002dd6 BIT_MASK 0x1 /end MEASUREMENT
/begin CHARACTERISTIC lc_seg_ad_lim_reac_er "Reactivation  of the ER segment adaptation range check at each learning phase" VALUE 0xa1003070 _REC_VAL_20_u1 1. _CNV_S_2_RANGE__0___1_CM 0. 1. DISPLAY_IDENTIFIER LC_SEG_AD_LIM_REAC_ER BIT_MASK 0x1 /end CHARACTERISTIC
/begin CHARACTERISTIC c_crlc_fast_seg_ad_er "Fast ER segment adaptive values filtering coefficient (fast learning phase)" VALUE 0xa1003032 _REC_VAL_20_u2 0.9999847412109381 _CNV_A_R_LINEAR_____68_CM 0. 0.9999847412109381 DISPLAY_IDENTIFIER C_CRLC_FAST_SEG_AD_ER FORMAT "%7.5" /end CHARACTERISTIC
/begin CHARACTERISTIC c_crlc_seg_ad_raw_er "" VALUE 0xa1003038 _REC_VAL_20_u2 0.9999847412109381 _CNV_A_R_LINEAR_____68_CM 0. 0.9999847412109381 DISPLAY_IDENTIFIER C_CRLC_SEG_AD_RAW_ER FORMAT "%7.5" /end CHARACTERISTIC
/begin CHARACTERISTIC ip_maf_dif_max_er_ad "Maximum air-mass gradient per SEG for fade out condition" CURVE 0xa1003000 _REC_CUR_20_u2_u2 1389. _CNV_A_R_LINEAR_____108_CM 0. 1389. DISPLAY_IDENTIFIER IP_MAF_DIF_MAX_ER_AD FORMAT "%7.2"
 /begin AXIS_DESCR COM_AXIS maf _CNV_A_R_LINEAR_____108_CM 6 0. 1389. FORMAT "%7.2" AXIS_PTS_REF ldp_maf_ip_maf_dif_max_er_ad /end AXIS_DESCR
/end CHARACTERISTIC
/begin CHARACTERISTIC ip_load_grd_er_ad "Maximum actual torque gradient fade out condition" CURVE 0xa1002ff4 _REC_CUR_20_u2_u2 99.9969482421875 _CNV_A_R_LINEAR_____201_CM 0. 99.9969482421875 DISPLAY_IDENTIFIER IP_LOAD_GRD_ER_AD FORMAT "%7.3"
 /begin AXIS_DESCR COM_AXIS load_mis _CNV_A_R_LINEAR_____201_CM 6 0. 99.9969482421875 FORMAT "%7.3" AXIS_PTS_REF ldp_load_mis_ip_load_grd_er_ad /end AXIS_DESCR
/end CHARACTERISTIC
/begin CHARACTERISTIC ip_tps_grd_max_er_ad "Maximum throttle gradient threshold for fade out condition" CURVE 0xa1003024 _REC_CUR_20_u1_u2 2987.5 _CNV_A_R_LINEAR_____260_CM 0. 2987.5 DISPLAY_IDENTIFIER IP_TPS_GRD_MAX_ER_AD FORMAT "%6.1"
 /begin AXIS_DESCR COM_AXIS tps_av _CNV_A_R_LINEAR_____221_CM 6 0. 119.5 FORMAT "%7.3" AXIS_PTS_REF ldp_tps_av_ip_tps_grd_max_er /end AXIS_DESCR
/end CHARACTERISTIC
/begin MEASUREMENT seg_ad_fdout_er_cdn "Segment adaptation fade out conditions carrier byte (before masking)" UBYTE _CNV_A_R_LINEAR_____0_CM 1 100. 0. 255. DISPLAY_IDENTIFIER SEG_AD_FDOUT_ER_CDN ECU_ADDRESS 0xc0001bf1 FORMAT "%3.0" /end MEASUREMENT
/begin MEASUREMENT seg_ad_fdout_er_cdn.lv_inh_maf_dif_er_ad "ER adaptive process fade out request flag due to MAF transient condition" UBYTE _CNV_A_R_LINEAR_____0_CM 1 100. 0. 255. DISPLAY_IDENTIFIER LV_INH_MAF_DIF_ER_AD ECU_ADDRESS 0xc0001bf1 FORMAT "%3.0" BIT_MASK 0x1 /end MEASUREMENT
/begin MEASUREMENT seg_ad_fdout_er_cdn.lv_inh_load_grd_max_er_ad "ER adaptive process fade out request flag due to engine load transient condition" UBYTE _CNV_A_R_LINEAR_____0_CM 1 100. 0. 255. DISPLAY_IDENTIFIER LV_INH_LOAD_GRD_MAX_ER_AD ECU_ADDRESS 0xc0001bf1 FORMAT "%3.0" BIT_MASK 0x2 /end MEASUREMENT
/begin MEASUREMENT seg_ad_fdout_er_cdn.lv_inh_tps_grd_er_ad "ER adaptive process fade out request flag due to TPS transient condition" UBYTE _CNV_A_R_LINEAR_____0_CM 1 100. 0. 255. DISPLAY_IDENTIFIER LV_INH_TPS_GRD_ER_AD ECU_ADDRESS 0xc0001bf1 FORMAT "%3.0" BIT_MASK 0x4 /end MEASUREMENT
/begin MEASUREMENT seg_ad_fdout_er_cdn.lv_inh_acc_er_ad "ER adaptive process fade out request flag due to air conditioner activation" UBYTE _CNV_A_R_LINEAR_____0_CM 1 100. 0. 255. DISPLAY_IDENTIFIER LV_INH_ACC_ER_AD ECU_ADDRESS 0xc0001bf1 FORMAT "%3.0" BIT_MASK 0x8 /end MEASUREMENT
/begin MEASUREMENT seg_ad_fdout_er_cdn_nr "Segment adaptation fade out conditions number (after masking)" UBYTE _CNV_A_R_LINEAR_____0_CM 1 100. 0. 8. DISPLAY_IDENTIFIER SEG_AD_FDOUT_ER_CDN_NR ECU_ADDRESS 0xc0001bf2 FORMAT "%3.0" /end MEASUREMENT
/begin CHARACTERISTIC c_mask_seg_ad_fdout_er "Configuration mask for SEG_AD_FDOUT_ER_CDN fade out carrier structure" VALUE 0xa1003041 _REC_VAL_20_u1 255. _CNV_A_R_LINEAR_____0_CM 0. 255. DISPLAY_IDENTIFIER C_MASK_SEG_AD_FDOUT_ER FORMAT "%3.0" /end CHARACTERISTIC
/begin CHARACTERISTIC c_n_max_seg_ad_er_eol_mt "Maximum engine speed threshold for crankshaft target wheel learning for EOL request mode im MT" VALUE 0xa100304a _REC_VAL_20_u1 8160. _CNV_A_R_LINEAR_____9_CM 0. 8160. DISPLAY_IDENTIFIER C_N_MAX_SEG_AD_ER_EOL_MT FORMAT "%4.0" /end CHARACTERISTIC
/begin CHARACTERISTIC c_n_max_seg_ad_er_eol_at "Maximum engine speed threshold for crankshaft target wheel learning for EOL request mode im AT" VALUE 0xa1003049 _REC_VAL_20_u1 8160. _CNV_A_R_LINEAR_____9_CM 0. 8160. DISPLAY_IDENTIFIER C_N_MAX_SEG_AD_ER_EOL_AT FORMAT "%4.0" /end CHARACTERISTIC
/begin CHARACTERISTIC c_n_min_seg_ad_er_eol_mt "Minimum engine speed threshold for crankshaft target wheel learning for EOL request mode im MT" VALUE 0xa1003050 _REC_VAL_20_u1 8160. _CNV_A_R_LINEAR_____9_CM 0. 8160. DISPLAY_IDENTIFIER C_N_MIN_SEG_AD_ER_EOL_MT FORMAT "%4.0" /end CHARACTERISTIC
/begin CHARACTERISTIC c_n_min_seg_ad_er_eol_at "Minimum engine speed threshold for crankshaft target wheel learning for EOL request mode im AT" VALUE 0xa100304f _REC_VAL_20_u1 8160. _CNV_A_R_LINEAR_____9_CM 0. 8160. DISPLAY_IDENTIFIER C_N_MIN_SEG_AD_ER_EOL_AT FORMAT "%4.0" /end CHARACTERISTIC
/begin CHARACTERISTIC c_n_max_seg_ad_er_mt "Maximum engine speed threshold for crankshaft target wheel learning with MT" VALUE 0xa100304b _REC_VAL_20_u1 8160. _CNV_A_R_LINEAR_____9_CM 0. 8160. DISPLAY_IDENTIFIER C_N_MAX_SEG_AD_ER_MT FORMAT "%4.0" /end CHARACTERISTIC
/begin CHARACTERISTIC c_n_max_seg_ad_er_at "Maximum engine speed threshold for crankshaft target wheel learning with AT" VALUE 0xa1003048 _REC_VAL_20_u1 8160. _CNV_A_R_LINEAR_____9_CM 0. 8160. DISPLAY_IDENTIFIER C_N_MAX_SEG_AD_ER_AT FORMAT "%4.0" /end CHARACTERISTIC
/begin CHARACTERISTIC c_n_min_seg_ad_er_mt "Minimum engine speed threshold for crankshaft target wheel learning with MT" VALUE 0xa1003051 _REC_VAL_20_u1 8160. _CNV_A_R_LINEAR_____9_CM 0. 8160. DISPLAY_IDENTIFIER C_N_MIN_SEG_AD_ER_MT FORMAT "%4.0" /end CHARACTERISTIC
/begin CHARACTERISTIC c_n_min_seg_ad_er_at "Minimum engine speed threshold for crankshaft target wheel learning with AT" VALUE 0xa100304e _REC_VAL_20_u1 8160. _CNV_A_R_LINEAR_____9_CM 0. 8160. DISPLAY_IDENTIFIER C_N_MIN_SEG_AD_ER_AT FORMAT "%4.0" /end CHARACTERISTIC
/begin MEASUREMENT lv_inh_app_er_ad "ER segment adaptive process inhibition flag relative application specific conditions" UBYTE _CNV_S_2_RANGE__0___1_CM 1 100. 0. 1. DISPLAY_IDENTIFIER LV_INH_APP_ER_AD ECU_ADDRESS 0xd0002dce BIT_MASK 0x1 /end MEASUREMENT
/begin MEASUREMENT lv_inh_obd_er_ad "ER segment adaptive process inhibition flag linked to OBD I errors" UBYTE _CNV_S_2_RANGE__0___1_CM 1 100. 0. 1. DISPLAY_IDENTIFIER LV_INH_OBD_ER_AD ECU_ADDRESS 0xd0002dd1 BIT_MASK 0x1 /end MEASUREMENT
/begin MEASUREMENT lv_seg_ad_rst_er_eol "EOL specific request to reset ER segment adaptive values" UBYTE _CNV_S_2_RANGE__0___1_CM 1 100. 0. 1. DISPLAY_IDENTIFIER LV_SEG_AD_RST_ER_EOL ECU_ADDRESS 0xd0002dd7 BIT_MASK 0x1 /end MEASUREMENT
/begin CHARACTERISTIC lc_seg_ad_rst_ena_eol "Specific EOL request enable flag to reset ER segment adaptive values & learning process" VALUE 0xa1003071 _REC_VAL_20_u1 1. _CNV_S_2_RANGE__0___1_CM 0. 1. DISPLAY_IDENTIFIER LC_SEG_AD_RST_ENA_EOL BIT_MASK 0x1 /end CHARACTERISTIC
/begin CHARACTERISTIC c_gr_inh_er_ad_at "Bitfield used to inhibit engine roughness adaptive according current AT gear ratio " VALUE 0xa100303f _REC_VAL_20_u1 255. _CNV_A_R_LINEAR_____0_CM 0. 255. DISPLAY_IDENTIFIER C_GR_INH_ER_AD_AT FORMAT "%3.0" /end CHARACTERISTIC
/begin CHARACTERISTIC c_gr_inh_er_ad_mt "Bitfield used to inhabit engine roughness adaptive according current MT gear ratio " VALUE 0xa1003040 _REC_VAL_20_u1 255. _CNV_A_R_LINEAR_____0_CM 0. 255. DISPLAY_IDENTIFIER C_GR_INH_ER_AD_MT FORMAT "%3.0" /end CHARACTERISTIC
/begin MEASUREMENT lv_req_seg_ad_mmv_er_app "Flag indicating request to reload stored segment adaptive values" UBYTE _CNV_S_2_RANGE__0___1_CM 1 100. 0. 1. DISPLAY_IDENTIFIER LV_REQ_SEG_AD_MMV_ER_APP ECU_ADDRESS 0xd0002dd2 BIT_MASK 0x1 /end MEASUREMENT
/begin MEASUREMENT seg_ad_mmv_er_app[0] "ER filtered adaptive values used for reload (for each segment) if segment adaptive process not valid" UBYTE _CNV_A_R_LINEAR_____404_CM 1 100. 0. 2.55 DISPLAY_IDENTIFIER SEG_AD_MMV_ER_APP[0] ECU_ADDRESS 0xd000256c /end MEASUREMENT
/begin MEASUREMENT seg_ad_mmv_er_app[1] "ER filtered adaptive values used for reload (for each segment) if segment adaptive process not valid" UBYTE _CNV_A_R_LINEAR_____404_CM 1 100. 0. 2.55 DISPLAY_IDENTIFIER SEG_AD_MMV_ER_APP[1] ECU_ADDRESS 0xd000256d /end MEASUREMENT
/begin MEASUREMENT seg_ad_mmv_er_app[2] "ER filtered adaptive values used for reload (for each segment) if segment adaptive process not valid" UBYTE _CNV_A_R_LINEAR_____404_CM 1 100. 0. 2.55 DISPLAY_IDENTIFIER SEG_AD_MMV_ER_APP[2] ECU_ADDRESS 0xd000256e /end MEASUREMENT
/begin MEASUREMENT seg_ad_mmv_er_app[3] "ER filtered adaptive values used for reload (for each segment) if segment adaptive process not valid" UBYTE _CNV_A_R_LINEAR_____404_CM 1 100. 0. 2.55 DISPLAY_IDENTIFIER SEG_AD_MMV_ER_APP[3] ECU_ADDRESS 0xd000256f /end MEASUREMENT
/begin MEASUREMENT seg_ad_mmv_er_app[4] "ER filtered adaptive values used for reload (for each segment) if segment adaptive process not valid" UBYTE _CNV_A_R_LINEAR_____404_CM 1 100. 0. 2.55 DISPLAY_IDENTIFIER SEG_AD_MMV_ER_APP[4] ECU_ADDRESS 0xd0002570 /end MEASUREMENT
/begin MEASUREMENT seg_ad_mmv_er_app[5] "ER filtered adaptive values used for reload (for each segment) if segment adaptive process not valid" UBYTE _CNV_A_R_LINEAR_____404_CM 1 100. 0. 2.55 DISPLAY_IDENTIFIER SEG_AD_MMV_ER_APP[5] ECU_ADDRESS 0xd0002571 /end MEASUREMENT
/begin MEASUREMENT er_av_quo "Quotient ofER/ZHD_ER (to simply calibration and testing)" UBYTE _CNV_A_R_LINEAR_____404_CM 1 100. 0. 2.55 DISPLAY_IDENTIFIER ER_AV_QUO ECU_ADDRESS 0xd0002dc8 /end MEASUREMENT
/begin MEASUREMENT seg_ad_cor_er "ER segment adaptive values correction versus engine speed (for each segment)" SWORD _CNV_A_R_ENRD_LINEA_398_CM 1 100. -7.8125 7.8123 DISPLAY_IDENTIFIER SEG_AD_COR_ER ECU_ADDRESS 0xc0001bc2 FORMAT "%7.4" /end MEASUREMENT
/begin MEASUREMENT seg_nr_mes "Phasing reference of ER segment acquisition" UBYTE _CNV_A_R_LINEAR_____0_CM 1 100. 0. 7. DISPLAY_IDENTIFIER SEG_NR_MES ECU_ADDRESS 0xd0002dca FORMAT "%3.0" /end MEASUREMENT
/begin MEASUREMENT seg_t_mes "Engine roughness raw segment time relative to former TDC" UWORD _CNV_A_R_LINEAR_____401_CM 1 100. 0. 65535. DISPLAY_IDENTIFIER SEG_T_MES ECU_ADDRESS 0xc0001bd4 FORMAT "%5.0" /end MEASUREMENT
/begin CHARACTERISTIC c_seg_t_mes_max "ER maximum valid segment time" VALUE 0xa1003060 _REC_VAL_20_u2 65535. _CNV_A_R_LINEAR_____401_CM 0. 65535. DISPLAY_IDENTIFIER C_SEG_T_MES_MAX FORMAT "%5.0" /end CHARACTERISTIC
/begin CHARACTERISTIC c_seg_t_mes_min "ER minimum valid segment time" VALUE 0xa1003062 _REC_VAL_20_u2 65535. _CNV_A_R_LINEAR_____401_CM 0. 65535. DISPLAY_IDENTIFIER C_SEG_T_MES_MIN FORMAT "%5.0" /end CHARACTERISTIC
/begin AXIS_PTS ldpm_n_32_1_enrd "" 0xa1002eee n_32 _REC_AXS_20_u1 8160. _CNV_A_R_LINEAR_____9_CM 6 0. 8160. FORMAT "%4.0" /end AXIS_PTS
/begin MEASUREMENT seg_t_cor_buf[0] "ER corrected segment times buffer (after adaptation)" UWORD _CNV_A_R_LINEAR_____401_CM 1 100. 0. 65535. DISPLAY_IDENTIFIER SEG_T_COR_BUF[0] ECU_ADDRESS 0xd0002574 FORMAT "%5.0" /end MEASUREMENT
/begin MEASUREMENT seg_t_cor_buf[1] "ER corrected segment times buffer (after adaptation)" UWORD _CNV_A_R_LINEAR_____401_CM 1 100. 0. 65535. DISPLAY_IDENTIFIER SEG_T_COR_BUF[1] ECU_ADDRESS 0xd0002576 FORMAT "%5.0" /end MEASUREMENT
/begin MEASUREMENT seg_t_cor_buf[2] "ER corrected segment times buffer (after adaptation)" UWORD _CNV_A_R_LINEAR_____401_CM 1 100. 0. 65535. DISPLAY_IDENTIFIER SEG_T_COR_BUF[2] ECU_ADDRESS 0xd0002578 FORMAT "%5.0" /end MEASUREMENT
/begin MEASUREMENT seg_t_cor_buf[3] "ER corrected segment times buffer (after adaptation)" UWORD _CNV_A_R_LINEAR_____401_CM 1 100. 0. 65535. DISPLAY_IDENTIFIER SEG_T_COR_BUF[3] ECU_ADDRESS 0xd000257a FORMAT "%5.0" /end MEASUREMENT
/begin MEASUREMENT seg_t_cor_buf[4] "ER corrected segment times buffer (after adaptation)" UWORD _CNV_A_R_LINEAR_____401_CM 1 100. 0. 65535. DISPLAY_IDENTIFIER SEG_T_COR_BUF[4] ECU_ADDRESS 0xd000257c FORMAT "%5.0" /end MEASUREMENT
/begin MEASUREMENT seg_t_cor_buf[5] "ER corrected segment times buffer (after adaptation)" UWORD _CNV_A_R_LINEAR_____401_CM 1 100. 0. 65535. DISPLAY_IDENTIFIER SEG_T_COR_BUF[5] ECU_ADDRESS 0xd000257e FORMAT "%5.0" /end MEASUREMENT
/begin MEASUREMENT seg_t_cor_buf[6] "ER corrected segment times buffer (after adaptation)" UWORD _CNV_A_R_LINEAR_____401_CM 1 100. 0. 65535. DISPLAY_IDENTIFIER SEG_T_COR_BUF[6] ECU_ADDRESS 0xd0002580 FORMAT "%5.0" /end MEASUREMENT
/begin MEASUREMENT seg_t_cor "Current ER corrected segment time" UWORD _CNV_A_R_LINEAR_____401_CM 1 100. 0. 65535. DISPLAY_IDENTIFIER SEG_T_COR ECU_ADDRESS 0xd0002572 FORMAT "%5.0" /end MEASUREMENT
/begin MEASUREMENT lv_ena_seg_t_mes "Engine roughness segment time validity flag" UBYTE _CNV_S_2_RANGE__0___1_CM 1 100. 0. 1. DISPLAY_IDENTIFIER LV_ENA_SEG_T_MES ECU_ADDRESS 0xd0002dcd BIT_MASK 0x1 /end MEASUREMENT
/begin MEASUREMENT seg_t_mes_cyl[0] "Buffer of cylinder engine roughness raw segment times" UWORD _CNV_A_R_LINEAR_____401_CM 1 100. 0. 65535. DISPLAY_IDENTIFIER SEG_T_MES_CYL[0] ECU_ADDRESS 0xd0002584 FORMAT "%5.0" /end MEASUREMENT
/begin MEASUREMENT seg_t_mes_cyl[1] "Buffer of cylinder engine roughness raw segment times" UWORD _CNV_A_R_LINEAR_____401_CM 1 100. 0. 65535. DISPLAY_IDENTIFIER SEG_T_MES_CYL[1] ECU_ADDRESS 0xd0002586 FORMAT "%5.0" /end MEASUREMENT
/begin MEASUREMENT seg_t_mes_cyl[2] "Buffer of cylinder engine roughness raw segment times" UWORD _CNV_A_R_LINEAR_____401_CM 1 100. 0. 65535. DISPLAY_IDENTIFIER SEG_T_MES_CYL[2] ECU_ADDRESS 0xd0002588 FORMAT "%5.0" /end MEASUREMENT
/begin MEASUREMENT seg_t_mes_cyl[3] "Buffer of cylinder engine roughness raw segment times" UWORD _CNV_A_R_LINEAR_____401_CM 1 100. 0. 65535. DISPLAY_IDENTIFIER SEG_T_MES_CYL[3] ECU_ADDRESS 0xd000258a FORMAT "%5.0" /end MEASUREMENT
/begin MEASUREMENT seg_t_mes_cyl[4] "Buffer of cylinder engine roughness raw segment times" UWORD _CNV_A_R_LINEAR_____401_CM 1 100. 0. 65535. DISPLAY_IDENTIFIER SEG_T_MES_CYL[4] ECU_ADDRESS 0xd000258c FORMAT "%5.0" /end MEASUREMENT
/begin MEASUREMENT seg_t_mes_cyl[5] "Buffer of cylinder engine roughness raw segment times" UWORD _CNV_A_R_LINEAR_____401_CM 1 100. 0. 65535. DISPLAY_IDENTIFIER SEG_T_MES_CYL[5] ECU_ADDRESS 0xd000258e FORMAT "%5.0" /end MEASUREMENT
/begin AXIS_PTS ldpm_n_32_6_enrd "" 0xa1002ef6 n_32 _REC_AXS_20_u1 8160. _CNV_A_R_LINEAR_____9_CM 6 0. 8160. FORMAT "%4.0" /end AXIS_PTS
/begin CHARACTERISTIC ip_seg_ad_cor_er_mt_1 "Adaptive value correction versus engine speed in MT for segment 1" CURVE 0xa1003018 _REC_CUR_20_u2_u1 15.6248 _CNV_A_R_ENRD_LINEA_405_CM -7.8125 7.8123 DISPLAY_IDENTIFIER IP_SEG_AD_COR_ER_MT_1 FORMAT "%7.4"
 /begin AXIS_DESCR COM_AXIS n_32 _CNV_A_R_LINEAR_____9_CM 6 0. 8160. FORMAT "%4.0" AXIS_PTS_REF ldpm_n_32_1_enrd /end AXIS_DESCR
/end CHARACTERISTIC
/begin CHARACTERISTIC ip_seg_ad_cor_er_at_1 "Adaptive value correction versus engine speed in AT for segment 1" CURVE 0xa100300c _REC_CUR_20_u2_u1 15.6248 _CNV_A_R_ENRD_LINEA_405_CM -7.8125 7.8123 DISPLAY_IDENTIFIER IP_SEG_AD_COR_ER_AT_1 FORMAT "%7.4"
 /begin AXIS_DESCR COM_AXIS n_32 _CNV_A_R_LINEAR_____9_CM 6 0. 8160. FORMAT "%4.0" AXIS_PTS_REF ldpm_n_32_6_enrd /end AXIS_DESCR
/end CHARACTERISTIC
/begin CHARACTERISTIC ip_seg_ad_cor_er_mt_2 "Adaptive value correction versus engine speed in MT for segment 2" CURVE 0xa1003080 _REC_CUR_20_u2_u1 15.6248 _CNV_A_R_ENRD_LINEA_405_CM -7.8125 7.8123 DISPLAY_IDENTIFIER IP_SEG_AD_COR_ER_MT_2 FORMAT "%7.4"
 /begin AXIS_DESCR COM_AXIS n_32 _CNV_A_R_LINEAR_____9_CM 6 0. 8160. FORMAT "%4.0" AXIS_PTS_REF ldpm_n_32_1_enrd /end AXIS_DESCR
/end CHARACTERISTIC
/begin CHARACTERISTIC ip_seg_ad_cor_er_at_2 "Adaptive value correction versus engine speed in AT for segment 2" CURVE 0xa1003074 _REC_CUR_20_u2_u1 15.6248 _CNV_A_R_ENRD_LINEA_405_CM -7.8125 7.8123 DISPLAY_IDENTIFIER IP_SEG_AD_COR_ER_AT_2 FORMAT "%7.4"
 /begin AXIS_DESCR COM_AXIS n_32 _CNV_A_R_LINEAR_____9_CM 6 0. 8160. FORMAT "%4.0" AXIS_PTS_REF ldpm_n_32_6_enrd /end AXIS_DESCR
/end CHARACTERISTIC
/begin MEASUREMENT lv_err_t_seg_er "Present failure for segment time adaptive values" UBYTE _CNV_S_2_RANGE__0___1_CM 1 100. 0. 1. DISPLAY_IDENTIFIER LV_ERR_T_SEG_ER ECU_ADDRESS 0xd0003485 BIT_MASK 0x1 /end MEASUREMENT
/begin MEASUREMENT lv_err_seg_ad_er "Present failure for segment time adaptive values" UBYTE _CNV_S_2_RANGE__0___1_CM 1 100. 0. 1. DISPLAY_IDENTIFIER LV_ERR_SEG_AD_ER ECU_ADDRESS 0xd0003486 BIT_MASK 0x1 /end MEASUREMENT
/begin CHARACTERISTIC lc_cdn_diag_seg_ad_er "Diagnosis co,dition mode of ER segment time adaptive  values" VALUE 0xa100306e _REC_VAL_20_u1 1. _CNV_S_2_RANGE__0___1_CM 0. 1. DISPLAY_IDENTIFIER LC_CDN_DIAG_SEG_AD_ER BIT_MASK 0x1 /end CHARACTERISTIC
/begin CHARACTERISTIC c_abc_inc_seg_ad_er "Antibounce counter increment" VALUE 0xa100302a _REC_VAL_20_u1 255. _CNV_A_R_LINEAR_____0_CM 0. 255. DISPLAY_IDENTIFIER C_ABC_INC_SEG_AD_ER FORMAT "%3.0" /end CHARACTERISTIC
/begin CHARACTERISTIC c_abc_inc_t_seg_er "Antibounce counter increment" VALUE 0xa100302b _REC_VAL_20_u1 255. _CNV_A_R_LINEAR_____0_CM 0. 255. DISPLAY_IDENTIFIER C_ABC_INC_T_SEG_ER FORMAT "%3.0" /end CHARACTERISTIC
/begin CHARACTERISTIC c_abc_max_seg_ad_er "Maximum value of the antibounce counter" VALUE 0xa100302c _REC_VAL_20_u1 254. _CNV_A_R_LINEAR_____0_CM 1. 255. DISPLAY_IDENTIFIER C_ABC_MAX_SEG_AD_ER FORMAT "%3.0" /end CHARACTERISTIC
/begin CHARACTERISTIC c_abc_max_t_seg_er "Maximum value of the antibounce counter" VALUE 0xa100302d _REC_VAL_20_u1 254. _CNV_A_R_LINEAR_____0_CM 1. 255. DISPLAY_IDENTIFIER C_ABC_MAX_T_SEG_ER FORMAT "%3.0" /end CHARACTERISTIC
/begin AXIS_PTS ldpm_n_32_1_ensd "" 0xa10034a4 n_32 _REC_AXS_20_u1 8160. _CNV_A_R_LINEAR_____9_CM 16 0. 8160. FORMAT "%4.0" /end AXIS_PTS
/begin AXIS_PTS ldpm_n_32_2_ensd "" 0xa10034b6 n_32 _REC_AXS_20_u1 8160. _CNV_A_R_LINEAR_____9_CM 6 0. 8160. FORMAT "%4.0" /end AXIS_PTS
/begin MEASUREMENT n_grd_h_res "High resolution engine speed gradient" SWORD _CNV_A_R_ENSD_LINEA_406_CM 1 100. -4096. 4095. DISPLAY_IDENTIFIER N_GRD_H_RES ECU_ADDRESS 0xd000259a FORMAT "%6.2" /end MEASUREMENT
/begin MEASUREMENT n_mmv "Engine speed- moving mean value" UWORD _CNV_A_R_LINEAR_____13_CM 1 100. 0. 8160. DISPLAY_IDENTIFIER N_MMV ECU_ADDRESS 0xd000259c FORMAT "%4.0" /end MEASUREMENT
/begin MEASUREMENT n_grd "Engine speed gradient" SBYTE _CNV_A_R_LINEAR_____29_CM 1 100. -4096. 4064. DISPLAY_IDENTIFIER N_GRD ECU_ADDRESS 0xd0002ddf FORMAT "%5.0" /end MEASUREMENT
/begin MEASUREMENT seg_ctr "Continuous segment counter (saturated at maximum value)" UWORD _CNV_A_R_LINEAR_____0_CM 1 100. 0. 65535. DISPLAY_IDENTIFIER SEG_CTR ECU_ADDRESS 0xd00025ae FORMAT "%5.0" /end MEASUREMENT
/begin MEASUREMENT psn_eng_syn_min "Minimum engine position during crankshaft synchronization phase" UWORD _CNV_A_R_LINEAR_____168_CM 1 100. 0. 719.625 DISPLAY_IDENTIFIER PSN_ENG_SYN_MIN ECU_ADDRESS 0xd00025ac FORMAT "%8.3" /end MEASUREMENT
/begin MEASUREMENT psn_eng_syn_max "Maximum engine position during crankshaft synchronization phase" UWORD _CNV_A_R_LINEAR_____168_CM 1 100. 0. 719.625 DISPLAY_IDENTIFIER PSN_ENG_SYN_MAX ECU_ADDRESS 0xd00025aa FORMAT "%8.3" /end MEASUREMENT
/begin AXIS_PTS ldp_n_32_id_crk_pha_cor "" 0xa1003490 n_32 _REC_AXS_20_u1 8160. _CNV_A_R_LINEAR_____9_CM 16 0. 8160. FORMAT "%4.0" /end AXIS_PTS
/begin MEASUREMENT n_32 "Engine speed- resolution 32rpm" UBYTE _CNV_A_R_LINEAR_____9_CM 1 100. 0. 8160. DISPLAY_IDENTIFIER N_32 ECU_ADDRESS 0xd0002dde FORMAT "%4.0" /end MEASUREMENT
/begin MEASUREMENT n_tooth "Engine speed calculated on last crankshaft tooth period (update rate 10ms)" UWORD _CNV_A_R_LINEAR_____13_CM 1 100. 0. 8160. DISPLAY_IDENTIFIER N_TOOTH ECU_ADDRESS 0xd000259e FORMAT "%4.0" /end MEASUREMENT
/begin MEASUREMENT t_seg_half_av "Half-segment period" UWORD _CNV_A_R_LINEAR_____407_CM 1 100. 0. 0.26214 DISPLAY_IDENTIFIER T_SEG_HALF_AV ECU_ADDRESS 0xd00025b4 FORMAT "%8.6" /end MEASUREMENT
/begin MEASUREMENT t_crk_win "Crankshaft tooth window at end of segment" UWORD _CNV_A_R_LINEAR_____407_CM 1 100. 0. 0.26214 DISPLAY_IDENTIFIER T_CRK_WIN ECU_ADDRESS 0xd00025b0 FORMAT "%8.6" /end MEASUREMENT
/begin MEASUREMENT seg_nr "Actual segment number (from 0 to NC_CYL_NR-1)" UBYTE _CNV_A_R_LINEAR_____0_CM 1 100. 0. 7. DISPLAY_IDENTIFIER SEG_NR ECU_ADDRESS 0xd0002de0 FORMAT "%3.0" /end MEASUREMENT
/begin MEASUREMENT n "Engine speed- resolution 1rpm" UWORD _CNV_A_R_LINEAR_____13_CM 1 100. 0. 8160. DISPLAY_IDENTIFIER N ECU_ADDRESS 0xd0002596 FORMAT "%4.0" /end MEASUREMENT
/begin MEASUREMENT n_fast "Fast engine speed- resolution 1rpm" UWORD _CNV_A_R_LINEAR_____13_CM 1 100. 0. 8160. DISPLAY_IDENTIFIER N_FAST ECU_ADDRESS 0xd0002598 FORMAT "%4.0" /end MEASUREMENT
/begin CHARACTERISTIC c_n_tooth_end "Engine speed threshold for N_TOOTH calculation (engine start)" VALUE 0xa1003501 _REC_VAL_20_u1 8160. _CNV_A_R_LINEAR_____9_CM 0. 8160. DISPLAY_IDENTIFIER C_N_TOOTH_END FORMAT "%4.0" /end CHARACTERISTIC
/begin CHARACTERISTIC c_n_fast_swi "Switch case choice for N_FAST calculation mode" VALUE 0xa10034ff _REC_VAL_20_u1 4. _CNV_A_R_LINEAR_____0_CM 0. 4. DISPLAY_IDENTIFIER C_N_FAST_SWI FORMAT "%3.0" /end CHARACTERISTIC
/begin CHARACTERISTIC c_fac_n_fast "Factor for fast speed prediction" VALUE 0xa10034fd _REC_VAL_20_u1 0.99609375 _CNV_A_R_LINEAR_____27_CM 0. 0.99609375 DISPLAY_IDENTIFIER C_FAC_N_FAST FORMAT "%5.3" /end CHARACTERISTIC
/begin MEASUREMENT t_seg_av "Exported segment period" UWORD _CNV_A_R_LINEAR_____407_CM 1 100. 0. 0.26214 DISPLAY_IDENTIFIER T_SEG_AV ECU_ADDRESS 0xd00025b2 FORMAT "%8.6" /end MEASUREMENT
/begin MEASUREMENT id_seg_nr[0] "Segment number array" UBYTE _CNV_A_R_LINEAR_____0_CM 1 100. 0. 255. DISPLAY_IDENTIFIER id_seg_nr_0 ECU_ADDRESS 0xd0002dd8 FORMAT "%3.0" /end MEASUREMENT
/begin MEASUREMENT id_seg_nr[1] "Segment number array" UBYTE _CNV_A_R_LINEAR_____0_CM 1 100. 0. 255. DISPLAY_IDENTIFIER id_seg_nr_1 ECU_ADDRESS 0xd0002dd9 FORMAT "%3.0" /end MEASUREMENT
/begin MEASUREMENT id_seg_nr[2] "Segment number array" UBYTE _CNV_A_R_LINEAR_____0_CM 1 100. 0. 255. DISPLAY_IDENTIFIER id_seg_nr_2 ECU_ADDRESS 0xd0002dda FORMAT "%3.0" /end MEASUREMENT
/begin MEASUREMENT id_seg_nr[3] "Segment number array" UBYTE _CNV_A_R_LINEAR_____0_CM 1 100. 0. 255. DISPLAY_IDENTIFIER id_seg_nr_3 ECU_ADDRESS 0xd0002ddb FORMAT "%3.0" /end MEASUREMENT
/begin MEASUREMENT id_seg_nr[4] "Segment number array" UBYTE _CNV_A_R_LINEAR_____0_CM 1 100. 0. 255. DISPLAY_IDENTIFIER id_seg_nr_4 ECU_ADDRESS 0xd0002ddc FORMAT "%3.0" /end MEASUREMENT
/begin MEASUREMENT id_seg_nr[5] "Segment number array" UBYTE _CNV_A_R_LINEAR_____0_CM 1 100. 0. 255. DISPLAY_IDENTIFIER id_seg_nr_5 ECU_ADDRESS 0xd0002ddd FORMAT "%3.0" /end MEASUREMENT
/begin CHARACTERISTIC id_crk_pha_cor "Table for crankshaft transmitter phase offset correction" CURVE 0xa10034e0 _REC_CUR_20_u1_u1 15.9375 _CNV_A_R_LINEAR_____166_CM 0. 15.9375 DISPLAY_IDENTIFIER ID_CRK_PHA_COR FORMAT "%7.4"
 /begin AXIS_DESCR COM_AXIS n_32 _CNV_A_R_LINEAR_____9_CM 16 0. 8160. FORMAT "%4.0" AXIS_PTS_REF ldp_n_32_id_crk_pha_cor /end AXIS_DESCR
/end CHARACTERISTIC
/begin CHARACTERISTIC c_grd_ad_max_cam_in "Max permissible drift of reference edge position for continuous adaptation" VALUE 0xa100353a _REC_VAL_20_u1 15.9375 _CNV_A_R_LINEAR_____166_CM 0. 15.9375 DISPLAY_IDENTIFIER C_GRD_AD_MAX_CAM_IN FORMAT "%7.4" /end CHARACTERISTIC
/begin CHARACTERISTIC c_grd_ad_max_cam_ex "Max permissible drift of reference edge position for continuous adaptation" VALUE 0xa1003562 _REC_VAL_20_u1 15.9375 _CNV_A_R_LINEAR_____166_CM 0. 15.9375 DISPLAY_IDENTIFIER C_GRD_AD_MAX_CAM_EX FORMAT "%7.4" /end CHARACTERISTIC
/begin CHARACTERISTIC c_grd_ad_ref_max_cam_in "Max permissible drift of reference edge position for reference position adaptation" VALUE 0xa100353b _REC_VAL_20_u1 15.9375 _CNV_A_R_LINEAR_____166_CM 0. 15.9375 DISPLAY_IDENTIFIER C_GRD_AD_REF_MAX_CAM_IN FORMAT "%7.4" /end CHARACTERISTIC
/begin CHARACTERISTIC c_grd_ad_ref_max_cam_ex "Max permissible drift of reference edge position for reference position adaptation" VALUE 0xa1003563 _REC_VAL_20_u1 15.9375 _CNV_A_R_LINEAR_____166_CM 0. 15.9375 DISPLAY_IDENTIFIER C_GRD_AD_REF_MAX_CAM_EX FORMAT "%7.4" /end CHARACTERISTIC
/begin MEASUREMENT idx_psn_edge_ad_cam_ex_1[0] "adapted exhaust camshaft i signal z position" UWORD _CNV_A_R_ENSD_LINEA_408_CM 1 100. -32. 31.9375 DISPLAY_IDENTIFIER PSN_EDGE_1_AD_CAM_EX_1 ECU_ADDRESS 0xd00025d0 FORMAT "%7.4" /end MEASUREMENT
/begin MEASUREMENT idx_psn_edge_ad_cam_ex_1[1] "adapted exhaust camshaft i signal z position" UWORD _CNV_A_R_ENSD_LINEA_408_CM 1 100. -32. 31.9375 DISPLAY_IDENTIFIER PSN_EDGE_2_AD_CAM_EX_1 ECU_ADDRESS 0xd00025d2 FORMAT "%7.4" /end MEASUREMENT
/begin MEASUREMENT idx_psn_edge_ad_cam_ex_1[2] "adapted exhaust camshaft i signal z position" UWORD _CNV_A_R_ENSD_LINEA_408_CM 1 100. -32. 31.9375 DISPLAY_IDENTIFIER PSN_EDGE_3_AD_CAM_EX_1 ECU_ADDRESS 0xd00025d4 FORMAT "%7.4" /end MEASUREMENT
/begin MEASUREMENT idx_psn_edge_ad_cam_ex_1[3] "adapted exhaust camshaft i signal z position" UWORD _CNV_A_R_ENSD_LINEA_408_CM 1 100. -32. 31.9375 DISPLAY_IDENTIFIER PSN_EDGE_4_AD_CAM_EX_1 ECU_ADDRESS 0xd00025d6 FORMAT "%7.4" /end MEASUREMENT
/begin MEASUREMENT idx_psn_edge_ad_cam_ex_1[4] "adapted exhaust camshaft i signal z position" UWORD _CNV_A_R_ENSD_LINEA_408_CM 1 100. -32. 31.9375 DISPLAY_IDENTIFIER PSN_EDGE_5_AD_CAM_EX_1 ECU_ADDRESS 0xd00025d8 FORMAT "%7.4" /end MEASUREMENT
/begin MEASUREMENT idx_psn_edge_ad_cam_ex_1[5] "adapted exhaust camshaft i signal z position" UWORD _CNV_A_R_ENSD_LINEA_408_CM 1 100. -32. 31.9375 DISPLAY_IDENTIFIER PSN_EDGE_6_AD_CAM_EX_1 ECU_ADDRESS 0xd00025da FORMAT "%7.4" /end MEASUREMENT
/begin MEASUREMENT idx_psn_edge_ad_cam_in_1[0] "adapted intake camshaft i signal z position" UWORD _CNV_A_R_ENSD_LINEA_408_CM 1 100. -32. 31.9375 DISPLAY_IDENTIFIER PSN_EDGE_1_AD_CAM_IN_1 ECU_ADDRESS 0xd00025b8 FORMAT "%7.4" /end MEASUREMENT
/begin MEASUREMENT idx_psn_edge_ad_cam_in_1[1] "adapted intake camshaft i signal z position" UWORD _CNV_A_R_ENSD_LINEA_408_CM 1 100. -32. 31.9375 DISPLAY_IDENTIFIER PSN_EDGE_2_AD_CAM_IN_1 ECU_ADDRESS 0xd00025ba FORMAT "%7.4" /end MEASUREMENT
/begin MEASUREMENT idx_psn_edge_ad_cam_in_1[2] "adapted intake camshaft i signal z position" UWORD _CNV_A_R_ENSD_LINEA_408_CM 1 100. -32. 31.9375 DISPLAY_IDENTIFIER PSN_EDGE_3_AD_CAM_IN_1 ECU_ADDRESS 0xd00025bc FORMAT "%7.4" /end MEASUREMENT
/begin MEASUREMENT idx_psn_edge_ad_cam_in_1[3] "adapted intake camshaft i signal z position" UWORD _CNV_A_R_ENSD_LINEA_408_CM 1 100. -32. 31.9375 DISPLAY_IDENTIFIER PSN_EDGE_4_AD_CAM_IN_1 ECU_ADDRESS 0xd00025be FORMAT "%7.4" /end MEASUREMENT
/begin MEASUREMENT idx_psn_edge_ad_cam_in_1[4] "adapted intake camshaft i signal z position" UWORD _CNV_A_R_ENSD_LINEA_408_CM 1 100. -32. 31.9375 DISPLAY_IDENTIFIER PSN_EDGE_5_AD_CAM_IN_1 ECU_ADDRESS 0xd00025c0 FORMAT "%7.4" /end MEASUREMENT
/begin MEASUREMENT idx_psn_edge_ad_cam_in_1[5] "adapted intake camshaft i signal z position" UWORD _CNV_A_R_ENSD_LINEA_408_CM 1 100. -32. 31.9375 DISPLAY_IDENTIFIER PSN_EDGE_6_AD_CAM_IN_1 ECU_ADDRESS 0xd00025c2 FORMAT "%7.4" /end MEASUREMENT
/begin MEASUREMENT idx_psn_edge_cam_ex_1[0] "" UWORD _CNV_A_R_LINEAR_____50_CM 1 100. 0. 65535. DISPLAY_IDENTIFIER IDX_PSN_EDGE_CAM_EX_1[0] ECU_ADDRESS 0xd00025dc /end MEASUREMENT
/begin MEASUREMENT idx_psn_edge_cam_ex_1[1] "" UWORD _CNV_A_R_LINEAR_____50_CM 1 100. 0. 65535. DISPLAY_IDENTIFIER IDX_PSN_EDGE_CAM_EX_1[1] ECU_ADDRESS 0xd00025de /end MEASUREMENT
/begin MEASUREMENT idx_psn_edge_cam_ex_1[2] "" UWORD _CNV_A_R_LINEAR_____50_CM 1 100. 0. 65535. DISPLAY_IDENTIFIER IDX_PSN_EDGE_CAM_EX_1[2] ECU_ADDRESS 0xd00025e0 /end MEASUREMENT
/begin MEASUREMENT idx_psn_edge_cam_ex_1[3] "" UWORD _CNV_A_R_LINEAR_____50_CM 1 100. 0. 65535. DISPLAY_IDENTIFIER IDX_PSN_EDGE_CAM_EX_1[3] ECU_ADDRESS 0xd00025e2 /end MEASUREMENT
/begin MEASUREMENT idx_psn_edge_cam_ex_1[4] "" UWORD _CNV_A_R_LINEAR_____50_CM 1 100. 0. 65535. DISPLAY_IDENTIFIER IDX_PSN_EDGE_CAM_EX_1[4] ECU_ADDRESS 0xd00025e4 /end MEASUREMENT
/begin MEASUREMENT idx_psn_edge_cam_ex_1[5] "" UWORD _CNV_A_R_LINEAR_____50_CM 1 100. 0. 65535. DISPLAY_IDENTIFIER IDX_PSN_EDGE_CAM_EX_1[5] ECU_ADDRESS 0xd00025e6 /end MEASUREMENT
/begin MEASUREMENT idx_psn_edge_cam_in_1[0] "" UWORD _CNV_A_R_LINEAR_____50_CM 1 100. 0. 65535. DISPLAY_IDENTIFIER IDX_PSN_EDGE_CAM_IN_1[0] ECU_ADDRESS 0xd00025c4 /end MEASUREMENT
/begin MEASUREMENT idx_psn_edge_cam_in_1[1] "" UWORD _CNV_A_R_LINEAR_____50_CM 1 100. 0. 65535. DISPLAY_IDENTIFIER IDX_PSN_EDGE_CAM_IN_1[1] ECU_ADDRESS 0xd00025c6 /end MEASUREMENT
/begin MEASUREMENT idx_psn_edge_cam_in_1[2] "" UWORD _CNV_A_R_LINEAR_____50_CM 1 100. 0. 65535. DISPLAY_IDENTIFIER IDX_PSN_EDGE_CAM_IN_1[2] ECU_ADDRESS 0xd00025c8 /end MEASUREMENT
/begin MEASUREMENT idx_psn_edge_cam_in_1[3] "" UWORD _CNV_A_R_LINEAR_____50_CM 1 100. 0. 65535. DISPLAY_IDENTIFIER IDX_PSN_EDGE_CAM_IN_1[3] ECU_ADDRESS 0xd00025ca /end MEASUREMENT
/begin MEASUREMENT idx_psn_edge_cam_in_1[4] "" UWORD _CNV_A_R_LINEAR_____50_CM 1 100. 0. 65535. DISPLAY_IDENTIFIER IDX_PSN_EDGE_CAM_IN_1[4] ECU_ADDRESS 0xd00025cc /end MEASUREMENT
/begin MEASUREMENT idx_psn_edge_cam_in_1[5] "" UWORD _CNV_A_R_LINEAR_____50_CM 1 100. 0. 65535. DISPLAY_IDENTIFIER IDX_PSN_EDGE_CAM_IN_1[5] ECU_ADDRESS 0xd00025ce /end MEASUREMENT
/begin CHARACTERISTIC c_crlc_ad_cam_in "Averaging constant for continuous adaptation" VALUE 0xa1003532 _REC_VAL_20_u1 0.99609375 _CNV_A_R_LINEAR_____27_CM 0. 0.99609375 DISPLAY_IDENTIFIER C_CRLC_AD_CAM_IN FORMAT "%5.3" /end CHARACTERISTIC
/begin CHARACTERISTIC c_crlc_ad_cam_ex "Averaging constant for continuous adaptation" VALUE 0xa100355a _REC_VAL_20_u1 0.99609375 _CNV_A_R_LINEAR_____27_CM 0. 0.99609375 DISPLAY_IDENTIFIER C_CRLC_AD_CAM_EX FORMAT "%5.3" /end CHARACTERISTIC
/begin CHARACTERISTIC c_crlc_ad_ref_cam_ex "Averaging constant for reference position adaptation" VALUE 0xa100355b _REC_VAL_20_u1 0.99609375 _CNV_A_R_LINEAR_____27_CM 0. 0.99609375 DISPLAY_IDENTIFIER C_CRLC_AD_REF_CAM_EX FORMAT "%5.3" /end CHARACTERISTIC
/begin CHARACTERISTIC c_crlc_ad_ref_cam_in "Averaging constant for reference position adaptation" VALUE 0xa1003533 _REC_VAL_20_u1 0.99609375 _CNV_A_R_LINEAR_____27_CM 0. 0.99609375 DISPLAY_IDENTIFIER C_CRLC_AD_REF_CAM_IN FORMAT "%5.3" /end CHARACTERISTIC
/begin CHARACTERISTIC c_nr_rev_ad_ref_cam_ex "Number of camshaft revolutions for reference position adaptation" VALUE 0xa1003565 _REC_VAL_20_u1 255. _CNV_A_R_LINEAR_____0_CM 0. 255. DISPLAY_IDENTIFIER C_NR_REV_AD_REF_CAM_EX FORMAT "%3.0" /end CHARACTERISTIC
/begin CHARACTERISTIC c_nr_rev_ad_ref_cam_in "Number of camshaft revolutions for reference position adaptation" VALUE 0xa100353d _REC_VAL_20_u1 255. _CNV_A_R_LINEAR_____0_CM 0. 255. DISPLAY_IDENTIFIER C_NR_REV_AD_REF_CAM_IN FORMAT "%3.0" /end CHARACTERISTIC
/begin MEASUREMENT idx_cam_ad_ex[0].psn_ad_cam "adapted exhaust camshaft position relative to designed passive position" UBYTE _CNV_A_R_LINEAR_____171_CM 1 100. -48. 47.625 DISPLAY_IDENTIFIER PSN_AD_CAM_EX_1 ECU_ADDRESS 0xd00054ee FORMAT "%7.3" /end MEASUREMENT
/begin MEASUREMENT idx_cam_ad_ex[0].ctr_rev_ad_ref_cam "Exhaust camshaft reference position adaptation revolution counter" UBYTE _CNV_A_R_LINEAR_____0_CM 1 100. 0. 255. DISPLAY_IDENTIFIER CTR_REV_AD_REF_CAM_EX_1 ECU_ADDRESS 0xd00054ef FORMAT "%3.0" /end MEASUREMENT
/begin MEASUREMENT idx_cam_ad_ex[0].psn_cam "Actual exhaust camshaft position relative to adapted passive position" UWORD _CNV_A_R_LINEAR_____409_CM 1 100. -96. 95.625 DISPLAY_IDENTIFIER PSN_CAM_EX_1 ECU_ADDRESS 0xd00054ec FORMAT "%7.3" /end MEASUREMENT
/begin MEASUREMENT idx_cam_ad_ex[0].psn_dif_edge_cam "crankshaft angle between the previous and the current exhaust camshaft position determination" UWORD _CNV_A_R_LINEAR_____168_CM 1 100. 0. 1535.625 DISPLAY_IDENTIFIER PSN_DIF_EDGE_CAM_EX_1 ECU_ADDRESS 0xd00054e0 FORMAT "%8.3" /end MEASUREMENT
/begin MEASUREMENT idx_cam_ad_ex[0].psn_edge_cam_old "" UWORD _CNV_A_R_ENSD_LINEA_410_CM 1 100. -128. 127.9375 DISPLAY_IDENTIFIER psn_edge_cam_old_ex_1 ECU_ADDRESS 0xd00054e2 FORMAT "%9.4" /end MEASUREMENT
/begin MEASUREMENT idx_cam_ad_ex[0].ptr_psn_edge_cam "" UWORD _CNV_A_R_LINEAR_____50_CM 1 100. 0. 65535. DISPLAY_IDENTIFIER PTR_PSN_EDGE_CAM ECU_ADDRESS 0xd00054e4 /end MEASUREMENT
/begin MEASUREMENT idx_cam_ad_ex[0].ptr_psn_edge_ad_cam "" UWORD _CNV_A_R_LINEAR_____50_CM 1 100. 0. 65535. DISPLAY_IDENTIFIER PTR_PSN_EDGE_AD_CAM ECU_ADDRESS 0xd00054e8 /end MEASUREMENT
/begin MEASUREMENT idx_cam_ad_ex[0].t_dif_edge_cam "Time between the previous and current camshaft signal edge" ULONG _CNV_A_R_LINEAR_____407_CM 1 100. 0. 17179.86918 DISPLAY_IDENTIFIER T_DIF_EDGE_CAM_EX_1 ECU_ADDRESS 0xd00054dc FORMAT "%12.6" /end MEASUREMENT
/begin MEASUREMENT idx_cam_ad_ex[0].lv_ad_end_cam "Exhaust camshaft reference position adaptation successful" UBYTE _CNV_S_2_RANGE__0___1_CM 1 100. 0. 1. DISPLAY_IDENTIFIER LV_AD_END_CAM_EX_1 ECU_ADDRESS 0xd00054f0 BIT_MASK 0x1 /end MEASUREMENT
/begin MEASUREMENT idx_cam_ad_in[0].psn_ad_cam "adapted intake camshaft position relative to designed passive position" UBYTE _CNV_A_R_LINEAR_____171_CM 1 100. -48. 47.625 DISPLAY_IDENTIFIER PSN_AD_CAM_IN_1 ECU_ADDRESS 0xd00054d6 FORMAT "%7.3" /end MEASUREMENT
/begin MEASUREMENT idx_cam_ad_in[0].ctr_rev_ad_ref_cam "Intake camshaft reference position adaptation revolution counter" UBYTE _CNV_A_R_LINEAR_____0_CM 1 100. 0. 255. DISPLAY_IDENTIFIER CTR_REV_AD_REF_CAM_IN_1 ECU_ADDRESS 0xd00054d7 FORMAT "%3.0" /end MEASUREMENT
/begin MEASUREMENT idx_cam_ad_in[0].psn_cam "Actual intake camshaft position relative to adapted passive position" UWORD _CNV_A_R_LINEAR_____409_CM 1 100. -96. 95.625 DISPLAY_IDENTIFIER PSN_CAM_IN_1 ECU_ADDRESS 0xd00054d4 FORMAT "%7.3" /end MEASUREMENT
/begin MEASUREMENT idx_cam_ad_in[0].psn_dif_edge_cam "crankshaft angle between the previous and the current intake camshaft position determination" UWORD _CNV_A_R_LINEAR_____168_CM 1 100. 0. 1535.625 DISPLAY_IDENTIFIER PSN_DIF_EDGE_CAM_IN_1 ECU_ADDRESS 0xd00054c8 FORMAT "%8.3" /end MEASUREMENT
/begin MEASUREMENT idx_cam_ad_in[0].psn_edge_cam_old "" UWORD _CNV_A_R_ENSD_LINEA_410_CM 1 100. -128. 127.9375 DISPLAY_IDENTIFIER psn_edge_cam_old_in_1 ECU_ADDRESS 0xd00054ca FORMAT "%9.4" /end MEASUREMENT
/begin MEASUREMENT idx_cam_ad_in[0].ptr_psn_edge_cam "" UWORD _CNV_A_R_LINEAR_____50_CM 1 100. 0. 65535. DISPLAY_IDENTIFIER PTR_PSN_EDGE_CAM ECU_ADDRESS 0xd00054cc /end MEASUREMENT
/begin MEASUREMENT idx_cam_ad_in[0].ptr_psn_edge_ad_cam "" UWORD _CNV_A_R_LINEAR_____50_CM 1 100. 0. 65535. DISPLAY_IDENTIFIER PTR_PSN_EDGE_AD_CAM ECU_ADDRESS 0xd00054d0 /end MEASUREMENT
/begin MEASUREMENT idx_cam_ad_in[0].t_dif_edge_cam "Time between the previous and current camshaft signal edge" ULONG _CNV_A_R_LINEAR_____407_CM 1 100. 0. 17179.86918 DISPLAY_IDENTIFIER T_DIF_EDGE_CAM_IN_1 ECU_ADDRESS 0xd00054c4 FORMAT "%12.6" /end MEASUREMENT
/begin MEASUREMENT idx_cam_ad_in[0].lv_ad_end_cam "Intake camshaft reference position adaptation successful" UBYTE _CNV_S_2_RANGE__0___1_CM 1 100. 0. 1. DISPLAY_IDENTIFIER LV_AD_END_CAM_IN_1 ECU_ADDRESS 0xd00054d8 BIT_MASK 0x1 /end MEASUREMENT
/begin AXIS_PTS ldp_n_32_id_cam_pha_cor "" 0xa100347c n_32 _REC_AXS_20_u1 8160. _CNV_A_R_LINEAR_____9_CM 16 0. 8160. FORMAT "%4.0" /end AXIS_PTS
/begin CHARACTERISTIC id_cam_pha_cor "Table for camshaft transmitter phase offset correction" CURVE 0xa10034c0 _REC_CUR_20_u2_u1 95.9375 _CNV_A_R_ENSD_LINEA_411_CM -48. 47.9375 DISPLAY_IDENTIFIER ID_CAM_PHA_COR FORMAT "%8.4"
 /begin AXIS_DESCR COM_AXIS n_32 _CNV_A_R_LINEAR_____9_CM 16 0. 8160. FORMAT "%4.0" AXIS_PTS_REF ldp_n_32_id_cam_pha_cor /end AXIS_DESCR
/end CHARACTERISTIC
/begin CHARACTERISTIC c_tol_ref_crk_cam_in "Reference position tolerance range for intake camshaft" VALUE 0xa100353e _REC_VAL_20_u2 31.9375 _CNV_A_R_LINEAR_____166_CM 0. 31.9375 DISPLAY_IDENTIFIER C_TOL_REF_CRK_CAM_IN FORMAT "%7.4" /end CHARACTERISTIC
/begin CHARACTERISTIC c_tol_ref_crk_cam_ex "Reference position tolerance range for exhaust camshaft" VALUE 0xa1003566 _REC_VAL_20_u2 31.9375 _CNV_A_R_LINEAR_____166_CM 0. 31.9375 DISPLAY_IDENTIFIER C_TOL_REF_CRK_CAM_EX FORMAT "%7.4" /end CHARACTERISTIC
/begin MEASUREMENT lv_err_ref_crk_cam_ex_1 "Present exhaust camshaft 1 failure reference violation" UBYTE _CNV_S_2_RANGE__0___1_CM 1 100. 0. 1. DISPLAY_IDENTIFIER LV_ERR_REF_CRK_CAM_EX_1 ECU_ADDRESS 0xd000340f BIT_MASK 0x1 /end MEASUREMENT
/begin MEASUREMENT lv_err_ref_crk_cam_in_1 "Present intake camshaft 1 failure reference violation" UBYTE _CNV_S_2_RANGE__0___1_CM 1 100. 0. 1. DISPLAY_IDENTIFIER LV_ERR_REF_CRK_CAM_IN_1 ECU_ADDRESS 0xd000340e BIT_MASK 0x1 /end MEASUREMENT
/begin CHARACTERISTIC c_abc_inc_diag_ref_crk_cam_in "Anti-bounce counter increment for intake camshaft position diagnosis" VALUE 0xa1003529 _REC_VAL_20_u1 255. _CNV_A_R_LINEAR_____0_CM 0. 255. DISPLAY_IDENTIFIER C_ABC_INC_DIAG_REF_CRK_CAM_IN FORMAT "%3.0" /end CHARACTERISTIC
/begin CHARACTERISTIC c_abc_inc_diag_ref_crk_cam_ex "Anti-bounce counter increment for exhaust camshaft position diagnosis" VALUE 0xa1003551 _REC_VAL_20_u1 255. _CNV_A_R_LINEAR_____0_CM 0. 255. DISPLAY_IDENTIFIER C_ABC_INC_DIAG_REF_CRK_CAM_EX FORMAT "%3.0" /end CHARACTERISTIC
/begin CHARACTERISTIC c_abc_max_diag_ref_crk_cam_in "Anti-bounce counter maximum for intake camshaft position diagnosis" VALUE 0xa100352c _REC_VAL_20_u1 254. _CNV_A_R_LINEAR_____0_CM 1. 255. DISPLAY_IDENTIFIER C_ABC_MAX_DIAG_REF_CRK_CAM_IN FORMAT "%3.0" /end CHARACTERISTIC
/begin CHARACTERISTIC c_abc_max_diag_ref_crk_cam_ex "Anti-bounce counter maximum for exhaust camshaft position diagnosis" VALUE 0xa1003554 _REC_VAL_20_u1 254. _CNV_A_R_LINEAR_____0_CM 1. 255. DISPLAY_IDENTIFIER C_ABC_MAX_DIAG_REF_CRK_CAM_EX FORMAT "%3.0" /end CHARACTERISTIC
/begin MEASUREMENT lv_err_crk_plaus "Present crankshaft failure synchronization impossible" UBYTE _CNV_S_2_RANGE__0___1_CM 1 100. 0. 1. DISPLAY_IDENTIFIER LV_ERR_CRK_PLAUS ECU_ADDRESS 0xd0003413 BIT_MASK 0x1 /end MEASUREMENT
/begin MEASUREMENT lv_err_plaus_cam_ex_1 "Present camshaft failure synchronization impossible" UBYTE _CNV_S_2_RANGE__0___1_CM 1 100. 0. 1. DISPLAY_IDENTIFIER LV_ERR_PLAUS_CAM_EX_1 ECU_ADDRESS 0xd0003415 BIT_MASK 0x1 /end MEASUREMENT
/begin MEASUREMENT lv_err_plaus_cam_in_1 "Present camshaft failure synchronization impossible" UBYTE _CNV_S_2_RANGE__0___1_CM 1 100. 0. 1. DISPLAY_IDENTIFIER LV_ERR_PLAUS_CAM_IN_1 ECU_ADDRESS 0xd0003414 BIT_MASK 0x1 /end MEASUREMENT
/begin MEASUREMENT ctr_cyc_eng_plaus_cam_ex_1 "Engine cycle counter for camshaft signal plausibility diagnosis" UBYTE _CNV_A_R_LINEAR_____0_CM 1 100. 0. 255. DISPLAY_IDENTIFIER CTR_CYC_ENG_PLAUS_CAM_EX_1 ECU_ADDRESS 0xd0002e18 FORMAT "%3.0" /end MEASUREMENT
/begin MEASUREMENT ctr_cyc_eng_plaus_cam_in_1 "Engine cycle counter for camshaft signal plausibility diagnosis" UBYTE _CNV_A_R_LINEAR_____0_CM 1 100. 0. 255. DISPLAY_IDENTIFIER CTR_CYC_ENG_PLAUS_CAM_IN_1 ECU_ADDRESS 0xd0002e08 FORMAT "%3.0" /end MEASUREMENT
/begin MEASUREMENT lv_err_syn_crk_cam_ex_1 "Present exhaust camshaft failure for crankshaft synchronization" UBYTE _CNV_S_2_RANGE__0___1_CM 1 100. 0. 1. DISPLAY_IDENTIFIER LV_ERR_SYN_CRK_CAM_EX_1 ECU_ADDRESS 0xd0003417 BIT_MASK 0x1 /end MEASUREMENT
/begin MEASUREMENT lv_err_syn_crk_cam_in_1 "Present intake camshaft failure for crankshaft synchronization" UBYTE _CNV_S_2_RANGE__0___1_CM 1 100. 0. 1. DISPLAY_IDENTIFIER LV_ERR_SYN_CRK_CAM_IN_1 ECU_ADDRESS 0xd0003416 BIT_MASK 0x1 /end MEASUREMENT
/begin MEASUREMENT ctr_orng_cam_syn_crk "failure counter to detect camshaft error for crankshaft synchronization" UBYTE _CNV_A_R_LINEAR_____0_CM 1 100. 0. 255. DISPLAY_IDENTIFIER CTR_ORNG_CAM_SYN_CRK ECU_ADDRESS 0xc0001c00 FORMAT "%3.0" /end MEASUREMENT
/begin CHARACTERISTIC c_nr_edge_cam_ex_syn_crk_max "Number of exhaust camshaft signal edges to detect crankshaft plausibility error before synchronization" VALUE 0xa1003503 _REC_VAL_20_u1 254. _CNV_A_R_LINEAR_____0_CM 1. 255. DISPLAY_IDENTIFIER C_NR_EDGE_CAM_EX_SYN_CRK_MAX FORMAT "%3.0" /end CHARACTERISTIC
/begin CHARACTERISTIC c_nr_edge_cam_in_syn_crk_max "Number of intake camshaft signal edges to detect crankshaft plausibility error before synchronization" VALUE 0xa1003504 _REC_VAL_20_u1 254. _CNV_A_R_LINEAR_____0_CM 1. 255. DISPLAY_IDENTIFIER C_NR_EDGE_CAM_IN_SYN_CRK_MAX FORMAT "%3.0" /end CHARACTERISTIC
/begin CHARACTERISTIC c_nr_cyc_eng_plaus_cam_max "Number of engine cycles to detect camshaft plausibility error" VALUE 0xa1003502 _REC_VAL_20_u1 127. _CNV_A_R_LINEAR_____0_CM 0. 127. DISPLAY_IDENTIFIER C_NR_CYC_ENG_PLAUS_CAM_MAX FORMAT "%3.0" /end CHARACTERISTIC
/begin CHARACTERISTIC c_ctr_orng_cam_syn_crk_max "Failure count to detect camshaft error for crankshaft synchronization" VALUE 0xa10034fc _REC_VAL_20_u1 255. _CNV_A_R_LINEAR_____0_CM 0. 255. DISPLAY_IDENTIFIER C_CTR_ORNG_CAM_SYN_CRK_MAX FORMAT "%3.0" /end CHARACTERISTIC
/begin CHARACTERISTIC lc_cam_err_ena_vvt "Switch to enable camshaft error debouncing for VVT reactivation" VALUE 0xa1003514 _REC_VAL_20_u1 1. _CNV_S_2_RANGE__0___1_CM 0. 1. DISPLAY_IDENTIFIER LC_CAM_ERR_ENA_VVT /end CHARACTERISTIC
/begin MEASUREMENT lv_err_cam_tot "Failure of at least one camshaft sensor on a camshaft with IVVT actuator" UBYTE _CNV_S_2_RANGE__0___1_CM 1 100. 0. 1. DISPLAY_IDENTIFIER LV_ERR_CAM_TOT ECU_ADDRESS 0xd0002df0 BIT_MASK 0x1 /end MEASUREMENT
/begin MEASUREMENT lv_err_crk "Crankshaft sensor failure" UBYTE _CNV_S_2_RANGE__0___1_CM 1 100. 0. 1. DISPLAY_IDENTIFIER LV_ERR_CRK ECU_ADDRESS 0xd0002df1 BIT_MASK 0x1 /end MEASUREMENT
/begin MEASUREMENT lv_inh_diag_crk_syn "Inhibition of crankshaft sensor synchronization diagnosis" UBYTE _CNV_S_2_RANGE__0___1_CM 1 100. 0. 1. DISPLAY_IDENTIFIER LV_INH_DIAG_CRK_SYN ECU_ADDRESS 0xd0002df6 BIT_MASK 0x1 /end MEASUREMENT
/begin MEASUREMENT lv_inh_diag_crk_tooth "Inhibition of crankshaft sensor tooth number diagnosis" UBYTE _CNV_S_2_RANGE__0___1_CM 1 100. 0. 1. DISPLAY_IDENTIFIER LV_INH_DIAG_CRK_TOOTH ECU_ADDRESS 0xd0002df7 BIT_MASK 0x1 /end MEASUREMENT
/begin MEASUREMENT lv_inh_diag_crk_tooth_per "Inhibition of crankshaft sensor tooth peirod diagnosis" UBYTE _CNV_S_2_RANGE__0___1_CM 1 100. 0. 1. DISPLAY_IDENTIFIER LV_INH_DIAG_CRK_TOOTH_PER ECU_ADDRESS 0xd0002df8 BIT_MASK 0x1 /end MEASUREMENT
/begin MEASUREMENT lv_inh_diag_crk_plaus "Inhibition of crankshaft sensor plausibility diagnosis" UBYTE _CNV_S_2_RANGE__0___1_CM 1 100. 0. 1. DISPLAY_IDENTIFIER LV_INH_DIAG_CRK_PLAUS ECU_ADDRESS 0xd0002df5 BIT_MASK 0x1 /end MEASUREMENT
/begin MEASUREMENT lv_inh_diag_crk_oc "Inhibition of crankshaft sensor circuit diagnosis" UBYTE _CNV_S_2_RANGE__0___1_CM 1 100. 0. 1. DISPLAY_IDENTIFIER LV_INH_DIAG_CRK_OC ECU_ADDRESS 0xd0002df4 BIT_MASK 0x1 /end MEASUREMENT
/begin MEASUREMENT lv_inh_diag_ensd "Inhibition of cam/crk diagnosis during fail safe delay" UBYTE _CNV_S_2_RANGE__0___1_CM 1 100. 0. 1. DISPLAY_IDENTIFIER LV_INH_DIAG_ENSD ECU_ADDRESS 0xd0002df9 BIT_MASK 0x1 /end MEASUREMENT
/begin CHARACTERISTIC c_t_dly_rest_igk "Delay time for diagnosis reactivation after key-off at low engine speed" VALUE 0xa100350a _REC_VAL_20_u1 2.55 _CNV_A_R_LINEAR_____3_CM 0. 2.55 DISPLAY_IDENTIFIER C_T_DLY_REST_IGK FORMAT "%4.2" /end CHARACTERISTIC
/begin CHARACTERISTIC c_t_dly_rest_stall "Delay time for diagnosis reactivation after engine stalling" VALUE 0xa100350c _REC_VAL_20_u2 655.35 _CNV_A_R_LINEAR_____3_CM 0. 655.35 DISPLAY_IDENTIFIER C_T_DLY_REST_STALL FORMAT "%6.2" /end CHARACTERISTIC
/begin MEASUREMENT idx_diag_mng_ex[0].lv_err_cam "Failure of exhaust camshaft sensor 1" UBYTE _CNV_S_2_RANGE__0___1_CM 1 100. 0. 1. DISPLAY_IDENTIFIER LV_ERR_CAM_EX_1 ECU_ADDRESS 0xd0002e1c BIT_MASK 0x1 /end MEASUREMENT
/begin MEASUREMENT idx_diag_mng_ex[0].lv_inh_diag_syn_cam "Inhibition of exhaust camshaft 2 synchronization diagnosis" UBYTE _CNV_S_2_RANGE__0___1_CM 1 100. 0. 1. DISPLAY_IDENTIFIER LV_INH_DIAG_SYN_CAM_EX_1 ECU_ADDRESS 0xd0002e1d BIT_MASK 0x1 /end MEASUREMENT
/begin MEASUREMENT idx_diag_mng_ex[0].lv_inh_diag_per_cam "Inhibition of exhaust camshaft 1 period diagnosis" UBYTE _CNV_S_2_RANGE__0___1_CM 1 100. 0. 1. DISPLAY_IDENTIFIER LV_INH_DIAG_PER_CAM_EX_1 ECU_ADDRESS 0xd0002e1e BIT_MASK 0x1 /end MEASUREMENT
/begin MEASUREMENT idx_diag_mng_ex[0].lv_inh_diag_plaus_cam "Inhibition of exhaust camshaft 2 plausibility diagnosis" UBYTE _CNV_S_2_RANGE__0___1_CM 1 100. 0. 1. DISPLAY_IDENTIFIER LV_INH_DIAG_PLAUS_CAM_EX_1 ECU_ADDRESS 0xd0002e1f BIT_MASK 0x1 /end MEASUREMENT
/begin MEASUREMENT idx_diag_mng_ex[0].lv_inh_diag_ref_crk_cam "Inhibition of exhaust camshaft 2 position diagnosis" UBYTE _CNV_S_2_RANGE__0___1_CM 1 100. 0. 1. DISPLAY_IDENTIFIER LV_INH_DIAG_REF_CRK_CAM_EX_1 ECU_ADDRESS 0xd0002e20 BIT_MASK 0x1 /end MEASUREMENT
/begin MEASUREMENT idx_diag_mng_ex[0].lv_inh_diag_syn_crk_cam "Inhibition of exhaust camshaft sensor diagnosis for crankshaft synchronization" UBYTE _CNV_S_2_RANGE__0___1_CM 1 100. 0. 1. DISPLAY_IDENTIFIER LV_INH_DIAG_SYN_CRK_CAM_EX_1 ECU_ADDRESS 0xd0002e21 BIT_MASK 0x1 /end MEASUREMENT
/begin MEASUREMENT idx_diag_mng_in[0].lv_err_cam "Failure of intake camshaft sensor 1" UBYTE _CNV_S_2_RANGE__0___1_CM 1 100. 0. 1. DISPLAY_IDENTIFIER LV_ERR_CAM_IN_1 ECU_ADDRESS 0xd0002e0c BIT_MASK 0x1 /end MEASUREMENT
/begin MEASUREMENT idx_diag_mng_in[0].lv_inh_diag_syn_cam "Inhibition of intake camshaft 1 synchronization diagnosis" UBYTE _CNV_S_2_RANGE__0___1_CM 1 100. 0. 1. DISPLAY_IDENTIFIER LV_INH_DIAG_SYN_CAM_IN_1 ECU_ADDRESS 0xd0002e0d BIT_MASK 0x1 /end MEASUREMENT
/begin MEASUREMENT idx_diag_mng_in[0].lv_inh_diag_per_cam "Inhibition of intake camshaft 1 period diagnosis" UBYTE _CNV_S_2_RANGE__0___1_CM 1 100. 0. 1. DISPLAY_IDENTIFIER LV_INH_DIAG_PER_CAM_IN_1 ECU_ADDRESS 0xd0002e0e BIT_MASK 0x1 /end MEASUREMENT
/begin MEASUREMENT idx_diag_mng_in[0].lv_inh_diag_plaus_cam "Inhibition of intake camshaft 1 plausibility diagnosis" UBYTE _CNV_S_2_RANGE__0___1_CM 1 100. 0. 1. DISPLAY_IDENTIFIER LV_INH_DIAG_PLAUS_CAM_IN_1 ECU_ADDRESS 0xd0002e0f BIT_MASK 0x1 /end MEASUREMENT
/begin MEASUREMENT idx_diag_mng_in[0].lv_inh_diag_ref_crk_cam "Inhibition of intake camshaft 1 position diagnosis" UBYTE _CNV_S_2_RANGE__0___1_CM 1 100. 0. 1. DISPLAY_IDENTIFIER LV_INH_DIAG_REF_CRK_CAM_IN_1 ECU_ADDRESS 0xd0002e10 BIT_MASK 0x1 /end MEASUREMENT
/begin MEASUREMENT idx_diag_mng_in[0].lv_inh_diag_syn_crk_cam "Inhibition of intake camshaft sensor diagnosis for crankshaft synchronization" UBYTE _CNV_S_2_RANGE__0___1_CM 1 100. 0. 1. DISPLAY_IDENTIFIER LV_INH_DIAG_SYN_CRK_CAM_IN_1 ECU_ADDRESS 0xd0002e11 BIT_MASK 0x1 /end MEASUREMENT
/begin CHARACTERISTIC c_n_not_rest "Engine speed threshold for cam/crk diagnosis deactivation" VALUE 0xa1003500 _REC_VAL_20_u1 8160. _CNV_A_R_LINEAR_____9_CM 0. 8160. DISPLAY_IDENTIFIER C_N_NOT_REST FORMAT "%4.0" /end CHARACTERISTIC
/begin CHARACTERISTIC lc_eng_back_inh "Inhibition of engine backwards rotation detection" VALUE 0xa1003515 _REC_VAL_20_u1 1. _CNV_A_R_LINEAR_____0_CM 0. 1. DISPLAY_IDENTIFIER LC_ENG_BACK_INH FORMAT "%1.0" /end CHARACTERISTIC
/begin CHARACTERISTIC c_t_min_inh_diag_ensd "Minimum delay before reactivating diagnosis in case of key off to on after engine backwards rotation confirmation" VALUE 0xa1003512 _REC_VAL_20_u2 655.35 _CNV_A_R_LINEAR_____3_CM 0. 655.35 DISPLAY_IDENTIFIER C_T_MIN_INH_DIAG_ENSD FORMAT "%6.2" /end CHARACTERISTIC
/begin CHARACTERISTIC c_t_max_inh_diag_ensd "Maximum delay before reactivating diagnosis after engine backwards rotation confirmation" VALUE 0xa1003510 _REC_VAL_20_u2 655.35 _CNV_A_R_LINEAR_____3_CM 0. 655.35 DISPLAY_IDENTIFIER C_T_MAX_INH_DIAG_ENSD FORMAT "%6.2" /end CHARACTERISTIC
/begin MEASUREMENT lv_ign_inj_lock_req "Request to lock ignition and/or injection due to backwards rotation detection" UBYTE _CNV_S_2_RANGE__0___1_CM 1 100. 0. 1. DISPLAY_IDENTIFIER LV_IGN_INJ_LOCK_REQ ECU_ADDRESS 0xd0002df3 BIT_MASK 0x1 /end MEASUREMENT
/begin MEASUREMENT lv_run_eng "Boolean information for engine running detection" UBYTE _CNV_S_2_RANGE__0___1_CM 1 100. 0. 1. DISPLAY_IDENTIFIER LV_RUN_ENG ECU_ADDRESS 0xd0002dff BIT_MASK 0x1 /end MEASUREMENT
/begin MEASUREMENT lv_syn_eng "Boolean information for engine synchronization completed" UBYTE _CNV_S_2_RANGE__0___1_CM 1 100. 0. 1. DISPLAY_IDENTIFIER LV_SYN_ENG ECU_ADDRESS 0xd0002e02 BIT_MASK 0x1 /end MEASUREMENT
/begin MEASUREMENT lv_syn_vld "Boolean information for engine synchronization validated" UBYTE _CNV_S_2_RANGE__0___1_CM 1 100. 0. 1. DISPLAY_IDENTIFIER LV_SYN_VLD ECU_ADDRESS 0xd0002e03 BIT_MASK 0x1 /end MEASUREMENT
/begin MEASUREMENT lv_lih_err_crk "Boolean information for limp home mode with crankshaft sensor failure" UBYTE _CNV_S_2_RANGE__0___1_CM 1 100. 0. 1. DISPLAY_IDENTIFIER LV_LIH_ERR_CRK ECU_ADDRESS 0xd0002dfb BIT_MASK 0x1 /end MEASUREMENT
/begin MEASUREMENT lv_lih_err_cam "Camshaft limp-home mode (failure on all camshaft sensors)" UBYTE _CNV_S_2_RANGE__0___1_CM 1 100. 0. 1. DISPLAY_IDENTIFIER LV_LIH_ERR_CAM ECU_ADDRESS 0xc0001c06 BIT_MASK 0x1 /end MEASUREMENT
/begin MEASUREMENT lv_act_crk "Crankshaft acquisition active" UBYTE _CNV_S_2_RANGE__0___1_CM 1 100. 0. 1. DISPLAY_IDENTIFIER LV_ACT_CRK ECU_ADDRESS 0xd0002de4 BIT_MASK 0x1 /end MEASUREMENT
/begin MEASUREMENT lv_err_lih_crk_cam "No more camshaft sensor available for crankshaft limp-home mode" UBYTE _CNV_S_2_RANGE__0___1_CM 1 100. 0. 1. DISPLAY_IDENTIFIER LV_ERR_LIH_CRK_CAM ECU_ADDRESS 0xc0001c05 BIT_MASK 0x1 /end MEASUREMENT
/begin MEASUREMENT ctr_vld_cam_syn_crk "Counter for validation of camshaft signal for crankshaft synchronization" UBYTE _CNV_A_R_LINEAR_____0_CM 1 100. 0. 255. DISPLAY_IDENTIFIER CTR_VLD_CAM_SYN_CRK ECU_ADDRESS 0xc0001c01 FORMAT "%3.0" /end MEASUREMENT
/begin CHARACTERISTIC lc_inh_lih_crk "Inhibition of crankshaft limp-home mode" VALUE 0xa1003517 _REC_VAL_20_u1 1. _CNV_A_R_LINEAR_____0_CM 0. 1. DISPLAY_IDENTIFIER LC_INH_LIH_CRK FORMAT "%1.0" /end CHARACTERISTIC
/begin CHARACTERISTIC lc_inh_lih_cam "Inhibition of camshaft limp-home mode" VALUE 0xa1003516 _REC_VAL_20_u1 1. _CNV_A_R_LINEAR_____0_CM 0. 1. DISPLAY_IDENTIFIER LC_INH_LIH_CAM FORMAT "%1.0" /end CHARACTERISTIC
/begin MEASUREMENT lv_first_vld_tooth "Boolean information for detection of first tooth after engine stop" UBYTE _CNV_S_2_RANGE__0___1_CM 1 100. 0. 1. DISPLAY_IDENTIFIER LV_FIRST_VLD_TOOTH ECU_ADDRESS 0xd0002df2 BIT_MASK 0x1 /end MEASUREMENT
/begin MEASUREMENT lv_timeout_cam_syn_crk "Boolean information for time-out detection on the camshaft selected for the CRK/CAM synchronization" UBYTE _CNV_S_2_RANGE__0___1_CM 1 100. 0. 1. DISPLAY_IDENTIFIER LV_TIMEOUT_CAM_SYN_CRK ECU_ADDRESS 0xd0002e05 BIT_MASK 0x1 /end MEASUREMENT
/begin MEASUREMENT idx_n_ctl_ex[0].lv_act_cam "self synchronization activated on exhaust camshaft 1" UBYTE _CNV_S_2_RANGE__0___1_CM 1 100. 0. 1. DISPLAY_IDENTIFIER LV_ACT_CAM_EX_1 ECU_ADDRESS 0xd0002e22 BIT_MASK 0x1 /end MEASUREMENT
/begin MEASUREMENT idx_n_ctl_ex[0].lv_act_lih_crk_cam "crankshaft limp home operating mode activated on exhaust camshaft 1" UBYTE _CNV_S_2_RANGE__0___1_CM 1 100. 0. 1. DISPLAY_IDENTIFIER LV_ACT_LIH_CRK_CAM_EX_1 ECU_ADDRESS 0xd0002e23 BIT_MASK 0x1 /end MEASUREMENT
/begin MEASUREMENT idx_n_ctl_ex[0].lv_act_syn_crk_cam "crankshaft synchronization operating mode activated on exhaust camshaft 1" UBYTE _CNV_S_2_RANGE__0___1_CM 1 100. 0. 1. DISPLAY_IDENTIFIER LV_ACT_SYN_CRK_CAM_EX_1 ECU_ADDRESS 0xd0002e24 BIT_MASK 0x1 /end MEASUREMENT
/begin MEASUREMENT idx_n_ctl_in[0].lv_act_cam "self synchronization activated on intake camshaft 1" UBYTE _CNV_S_2_RANGE__0___1_CM 1 100. 0. 1. DISPLAY_IDENTIFIER LV_ACT_CAM_IN_1 ECU_ADDRESS 0xd0002e12 BIT_MASK 0x1 /end MEASUREMENT
/begin MEASUREMENT idx_n_ctl_in[0].lv_act_lih_crk_cam "crankshaft limp home operating mode activated on intake camshaft 1" UBYTE _CNV_S_2_RANGE__0___1_CM 1 100. 0. 1. DISPLAY_IDENTIFIER LV_ACT_LIH_CRK_CAM_IN_1 ECU_ADDRESS 0xd0002e13 BIT_MASK 0x1 /end MEASUREMENT
/begin MEASUREMENT idx_n_ctl_in[0].lv_act_syn_crk_cam "crankshaft synchronization operating mode activated on intake camshaft 1" UBYTE _CNV_S_2_RANGE__0___1_CM 1 100. 0. 1. DISPLAY_IDENTIFIER LV_ACT_SYN_CRK_CAM_IN_1 ECU_ADDRESS 0xd0002e14 BIT_MASK 0x1 /end MEASUREMENT
/begin MEASUREMENT lv_err_cam "Failure on all camshaft sensor signals in normal mode" UBYTE _CNV_S_2_RANGE__0___1_CM 1 100. 0. 1. DISPLAY_IDENTIFIER LV_ERR_CAM ECU_ADDRESS 0xd0002dee BIT_MASK 0x1 /end MEASUREMENT
/begin MEASUREMENT lv_eng_back_det "Engine backwards rotation detected" UBYTE _CNV_S_2_RANGE__0___1_CM 1 100. 0. 1. DISPLAY_IDENTIFIER LV_ENG_BACK_DET ECU_ADDRESS 0xd0002ded BIT_MASK 0x1 /end MEASUREMENT
/begin MEASUREMENT lv_eng_back_cfm "Engine backwards rotation confirmed" UBYTE _CNV_S_2_RANGE__0___1_CM 1 100. 0. 1. DISPLAY_IDENTIFIER LV_ENG_BACK_CFM ECU_ADDRESS 0xd0002dec BIT_MASK 0x1 /end MEASUREMENT
/begin MEASUREMENT lv_crk_miss_run_eng "Boolean information engine running after engine stop request" UBYTE _CNV_S_2_RANGE__0___1_CM 1 100. 0. 1. DISPLAY_IDENTIFIER LV_CRK_MISS_RUN_ENG ECU_ADDRESS 0xd0002de7 BIT_MASK 0x1 /end MEASUREMENT
/begin CHARACTERISTIC c_nr_vld_cam_syn_crk "Number of camshaft signal edges to validate cam/crk synchronization" VALUE 0xa1003505 _REC_VAL_20_u1 255. _CNV_A_R_LINEAR_____0_CM 0. 255. DISPLAY_IDENTIFIER C_NR_VLD_CAM_SYN_CRK FORMAT "%3.0" /end CHARACTERISTIC
/begin CHARACTERISTIC c_t_dly_stop_eng "Delay time for engine running after engine stop request" VALUE 0xa100350e _REC_VAL_20_u1 2.55 _CNV_A_R_LINEAR_____3_CM 0. 2.55 DISPLAY_IDENTIFIER C_T_DLY_STOP_ENG FORMAT "%4.2" /end CHARACTERISTIC
/begin CHARACTERISTIC c_dyw_cam_crk_syn_adc_ex "Tolerance window advance for exhaust camshaft to crankshaft reference in crankshaft synchronization mode" VALUE 0xa100355c _REC_VAL_20_u2 127.9375 _CNV_A_R_LINEAR_____166_CM 0. 127.9375 DISPLAY_IDENTIFIER C_DYW_CAM_CRK_SYN_ADC_EX FORMAT "%8.4" /end CHARACTERISTIC
/begin CHARACTERISTIC c_dyw_cam_crk_syn_rtd_ex "Tolerance window retard for exhaust camshaft to crankshaft reference in crankshaft synchronization mode" VALUE 0xa100355e _REC_VAL_20_u2 127.9375 _CNV_A_R_LINEAR_____166_CM 0. 127.9375 DISPLAY_IDENTIFIER C_DYW_CAM_CRK_SYN_RTD_EX FORMAT "%8.4" /end CHARACTERISTIC
/begin CHARACTERISTIC c_dyw_cam_crk_syn_rtd_in "Tolerance window retard for intake camshaft to crankshaft reference in crankshaft synchronization mode" VALUE 0xa1003536 _REC_VAL_20_u2 127.9375 _CNV_A_R_LINEAR_____166_CM 0. 127.9375 DISPLAY_IDENTIFIER C_DYW_CAM_CRK_SYN_RTD_IN FORMAT "%8.4" /end CHARACTERISTIC
/begin CHARACTERISTIC c_dyw_cam_syn_ex "Tolerance window for angle between exhaust camshaft signal edges in crankshaft synchronization mode" VALUE 0xa1003560 _REC_VAL_20_u2 31.9375 _CNV_A_R_LINEAR_____166_CM 0. 31.9375 DISPLAY_IDENTIFIER C_DYW_CAM_SYN_EX FORMAT "%7.4" /end CHARACTERISTIC
/begin CHARACTERISTIC c_dyw_cam_syn_in "Tolerance window for angle between intake camshaft signal edges in crankshaft synchronization mode" VALUE 0xa1003538 _REC_VAL_20_u2 31.9375 _CNV_A_R_LINEAR_____166_CM 0. 31.9375 DISPLAY_IDENTIFIER C_DYW_CAM_SYN_IN FORMAT "%7.4" /end CHARACTERISTIC
/begin CHARACTERISTIC c_dyw_cam_crk_syn_adc_in "Tolerance window advance for intake camshaft to crankshaft reference in crankshaft synchronization mode" VALUE 0xa1003534 _REC_VAL_20_u2 127.9375 _CNV_A_R_LINEAR_____166_CM 0. 127.9375 DISPLAY_IDENTIFIER C_DYW_CAM_CRK_SYN_ADC_IN FORMAT "%8.4" /end CHARACTERISTIC
/begin MEASUREMENT lv_cam_syn_crk "Camshaft acquisition ready for crankshaft synchronization" UBYTE _CNV_S_2_RANGE__0___1_CM 1 100. 0. 1. DISPLAY_IDENTIFIER LV_CAM_SYN_CRK ECU_ADDRESS 0xc0001c04 BIT_MASK 0x1 /end MEASUREMENT
/begin MEASUREMENT lv_orng_cam_syn_crk "Camshaft signal for crankshaft synchronization out of range" UBYTE _CNV_S_2_RANGE__0___1_CM 1 100. 0. 1. DISPLAY_IDENTIFIER LV_ORNG_CAM_SYN_CRK ECU_ADDRESS 0xc0001c07 BIT_MASK 0x1 /end MEASUREMENT
/begin MEASUREMENT idx_cam_acq_ex[0].idx_edge_cam "Index of the last camshaft signal edge" UBYTE _CNV_A_R_LINEAR_____412_CM 1 100. 1. 16. DISPLAY_IDENTIFIER IDX_EDGE_CAM_EX_1 ECU_ADDRESS 0xd00020d0 FORMAT "%3.0" /end MEASUREMENT
/begin MEASUREMENT idx_cam_acq_ex[0].ctr_edge_cam "Continuous camshaft signal edge counter" UBYTE _CNV_A_R_LINEAR_____0_CM 1 100. 0. 255. DISPLAY_IDENTIFIER CTR_EDGE_CAM_EX_1 ECU_ADDRESS 0xd00020d1 FORMAT "%3.0" /end MEASUREMENT
/begin MEASUREMENT idx_cam_acq_ex[0].lv_vld_psn_cam "Exhaust camshaft position measurement valid" UBYTE _CNV_S_2_RANGE__0___1_CM 1 100. 0. 1. DISPLAY_IDENTIFIER LV_VLD_PSN_CAM_EX_1 ECU_ADDRESS 0xd00020d2 BIT_MASK 0x1 /end MEASUREMENT
/begin MEASUREMENT idx_cam_acq_ex[0].lv_syn_cam "Exhaust camshaft synchronized" UBYTE _CNV_S_2_RANGE__0___1_CM 1 100. 0. 1. DISPLAY_IDENTIFIER LV_SYN_CAM_EX_1 ECU_ADDRESS 0xd00020d3 BIT_MASK 0x1 /end MEASUREMENT
/begin MEASUREMENT idx_cam_acq_ex[0].lv_orng_per_cam "Exhaust camshaft segment period out of range" UBYTE _CNV_S_2_RANGE__0___1_CM 1 100. 0. 1. DISPLAY_IDENTIFIER LV_ORNG_PER_CAM_EX_1 ECU_ADDRESS 0xd00020d4 BIT_MASK 0x1 /end MEASUREMENT
/begin MEASUREMENT idx_cam_acq_ex[0].lv_orng_ratio_cam "Exhaust camshaft segment ratio out of range" UBYTE _CNV_S_2_RANGE__0___1_CM 1 100. 0. 1. DISPLAY_IDENTIFIER LV_ORNG_RATIO_CAM_EX_1 ECU_ADDRESS 0xd00020d5 BIT_MASK 0x1 /end MEASUREMENT
/begin MEASUREMENT idx_cam_acq_ex[0].psn_eng_cam "" UWORD _CNV_A_R_LINEAR_____166_CM 1 100. 0. 719.9375 DISPLAY_IDENTIFIER PSN_ENG_CAM_EX_1 ECU_ADDRESS 0xd00020d6 FORMAT "%8.4" /end MEASUREMENT
/begin MEASUREMENT idx_cam_acq_ex[0].t_seg_cam "Camshaft segment period" ULONG _CNV_A_R_LINEAR_____413_CM 1 100. 0. 1.9965 DISPLAY_IDENTIFIER T_SEG_CAM_EX_1 ECU_ADDRESS 0xd00020d8 FORMAT "%8.6" /end MEASUREMENT
/begin MEASUREMENT idx_cam_acq_in[0].idx_edge_cam "Index of the last camshaft signal edge" UBYTE _CNV_A_R_LINEAR_____412_CM 1 100. 1. 16. DISPLAY_IDENTIFIER IDX_EDGE_CAM_IN_1 ECU_ADDRESS 0xd00020c4 FORMAT "%3.0" /end MEASUREMENT
/begin MEASUREMENT idx_cam_acq_in[0].ctr_edge_cam "Continuous camshaft signal edge counter" UBYTE _CNV_A_R_LINEAR_____0_CM 1 100. 0. 255. DISPLAY_IDENTIFIER CTR_EDGE_CAM_IN_1 ECU_ADDRESS 0xd00020c5 FORMAT "%3.0" /end MEASUREMENT
/begin MEASUREMENT idx_cam_acq_in[0].lv_vld_psn_cam "Intake camshaft position measurement valid" UBYTE _CNV_S_2_RANGE__0___1_CM 1 100. 0. 1. DISPLAY_IDENTIFIER LV_VLD_PSN_CAM_IN_1 ECU_ADDRESS 0xd00020c6 BIT_MASK 0x1 /end MEASUREMENT
/begin MEASUREMENT idx_cam_acq_in[0].lv_syn_cam "intake camshaft synchronized" UBYTE _CNV_S_2_RANGE__0___1_CM 1 100. 0. 1. DISPLAY_IDENTIFIER LV_SYN_CAM_IN_1 ECU_ADDRESS 0xd00020c7 BIT_MASK 0x1 /end MEASUREMENT
/begin MEASUREMENT idx_cam_acq_in[0].lv_orng_per_cam "intake camshaft segment period out of range" UBYTE _CNV_S_2_RANGE__0___1_CM 1 100. 0. 1. DISPLAY_IDENTIFIER LV_ORNG_PER_CAM_IN_1 ECU_ADDRESS 0xd00020c8 BIT_MASK 0x1 /end MEASUREMENT
/begin MEASUREMENT idx_cam_acq_in[0].lv_orng_ratio_cam "Intake camshaft segment ratio out of range" UBYTE _CNV_S_2_RANGE__0___1_CM 1 100. 0. 1. DISPLAY_IDENTIFIER LV_ORNG_RATIO_CAM_IN_1 ECU_ADDRESS 0xd00020c9 BIT_MASK 0x1 /end MEASUREMENT
/begin MEASUREMENT idx_cam_acq_in[0].psn_eng_cam "" UWORD _CNV_A_R_LINEAR_____166_CM 1 100. 0. 719.9375 DISPLAY_IDENTIFIER PSN_ENG_CAM_IN_1 ECU_ADDRESS 0xd00020ca FORMAT "%8.4" /end MEASUREMENT
/begin MEASUREMENT idx_cam_acq_in[0].t_seg_cam "Camshaft segment period" ULONG _CNV_A_R_LINEAR_____413_CM 1 100. 0. 1.9965 DISPLAY_IDENTIFIER T_SEG_CAM_IN_1 ECU_ADDRESS 0xd00020cc FORMAT "%8.6" /end MEASUREMENT
/begin CHARACTERISTIC id_fac_cam_ex "Period ratio tolerance factor for exhaust camshaft" CURVE 0xa1003540 _REC_CUR_20_u1_u1 14.9375 _CNV_A_R_EVAC_LINEA_314_CM 1. 15.9375 DISPLAY_IDENTIFIER ID_FAC_CAM_EX FORMAT "%7.4"
 /begin AXIS_DESCR COM_AXIS n_32 _CNV_A_R_LINEAR_____9_CM 16 0. 8160. FORMAT "%4.0" AXIS_PTS_REF ldpm_n_32_1_ensd /end AXIS_DESCR
/end CHARACTERISTIC
/begin CHARACTERISTIC id_fac_cam_in "Period ratio tolerance factor for intake camshaft" CURVE 0xa1003518 _REC_CUR_20_u1_u1 14.9375 _CNV_A_R_EVAC_LINEA_314_CM 1. 15.9375 DISPLAY_IDENTIFIER ID_FAC_CAM_IN FORMAT "%7.4"
 /begin AXIS_DESCR COM_AXIS n_32 _CNV_A_R_LINEAR_____9_CM 16 0. 8160. FORMAT "%4.0" AXIS_PTS_REF ldpm_n_32_1_ensd /end AXIS_DESCR
/end CHARACTERISTIC
/begin CHARACTERISTIC c_nr_edge_min_vld_cam_ex "Number of exhaust camshaft signal edges for valid position output" VALUE 0xa1003564 _REC_VAL_20_u1 255. _CNV_A_R_LINEAR_____0_CM 0. 255. DISPLAY_IDENTIFIER C_NR_EDGE_MIN_VLD_CAM_EX FORMAT "%3.0" /end CHARACTERISTIC
/begin CHARACTERISTIC c_nr_edge_min_vld_cam_in "Number of intake camshaft signal edges for valid position output" VALUE 0xa100353c _REC_VAL_20_u1 255. _CNV_A_R_LINEAR_____0_CM 0. 255. DISPLAY_IDENTIFIER C_NR_EDGE_MIN_VLD_CAM_IN FORMAT "%3.0" /end CHARACTERISTIC
/begin CHARACTERISTIC c_cam_adj_vvt_syn_in "Extension of  tolerance window CAM_DYW_SYN_IN  when VVT is not in locked position at start" VALUE 0xa1003530 _REC_VAL_20_u2 127.9375 _CNV_A_R_LINEAR_____166_CM 0. 127.9375 DISPLAY_IDENTIFIER C_CAM_ADJ_VVT_SYN_IN FORMAT "%8.4" /end CHARACTERISTIC
/begin CHARACTERISTIC c_cam_adj_vvt_syn_ex "Extension of  tolerance window CAM_DYW_SYN_EX  when VVT is not in locked position at start" VALUE 0xa1003558 _REC_VAL_20_u2 127.9375 _CNV_A_R_LINEAR_____166_CM 0. 127.9375 DISPLAY_IDENTIFIER C_CAM_ADJ_VVT_SYN_EX FORMAT "%8.4" /end CHARACTERISTIC
/begin CHARACTERISTIC c_cam_adj_vvt_syn_crk_adc_in "Extension of  tolerance window CAM_DYW_CRK_SYN_ADC_IN  when VVT is not in locked position at start" VALUE 0xa100352e _REC_VAL_20_u2 127.9375 _CNV_A_R_LINEAR_____166_CM 0. 127.9375 DISPLAY_IDENTIFIER C_CAM_ADJ_VVT_SYN_CRK_ADC_IN FORMAT "%8.4" /end CHARACTERISTIC
/begin CHARACTERISTIC c_cam_adj_vvt_syn_crk_rtd_ex "Extension of  tolerance window CAM_DYW_CRK_SYN_RTD_EX  when VVT is not in locked position at start" VALUE 0xa1003556 _REC_VAL_20_u2 127.9375 _CNV_A_R_LINEAR_____166_CM 0. 127.9375 DISPLAY_IDENTIFIER C_CAM_ADJ_VVT_SYN_CRK_RTD_EX FORMAT "%8.4" /end CHARACTERISTIC
/begin CHARACTERISTIC c_t_crk_dly "Sensing delay time after first active crankshaft signal edge" VALUE 0xa1003506 _REC_VAL_20_u4 3.9999946e-002 _CNV_A_R_ENSD_LINEA_414_CM 0. 3.9999946e-002 DISPLAY_IDENTIFIER C_T_CRK_DLY FORMAT "%8.6" /end CHARACTERISTIC
/begin MEASUREMENT lv_orng_tooth_per_crk "Invalid crankshaft tooth period" UBYTE _CNV_S_2_RANGE__0___1_CM 1 100. 0. 1. DISPLAY_IDENTIFIER LV_ORNG_TOOTH_PER_CRK ECU_ADDRESS 0xd0002dfe BIT_MASK 0x1 /end MEASUREMENT
/begin MEASUREMENT lv_orng_nr_tooth_crk "Crankshaft tooth count incorrect at reference gap" UBYTE _CNV_S_2_RANGE__0___1_CM 1 100. 0. 1. DISPLAY_IDENTIFIER LV_ORNG_NR_TOOTH_CRK ECU_ADDRESS 0xd0002dfd BIT_MASK 0x1 /end MEASUREMENT
/begin MEASUREMENT lv_lost_syn_crk "Crankshaft synchronization lost" UBYTE _CNV_S_2_RANGE__0___1_CM 1 100. 0. 1. DISPLAY_IDENTIFIER LV_LOST_SYN_CRK ECU_ADDRESS 0xd0002dfc BIT_MASK 0x1 /end MEASUREMENT
/begin MEASUREMENT lv_crk_syn "Flag for crankshaft acquisition synchronized" UBYTE _CNV_S_2_RANGE__0___1_CM 1 100. 0. 1. DISPLAY_IDENTIFIER LV_CRK_SYN ECU_ADDRESS 0xd0002deb BIT_MASK 0x1 /end MEASUREMENT
/begin CHARACTERISTIC id_fac_tol_crk_tooth "Factor for calculation of expected tooth period" CURVE 0xa10034f0 _REC_CUR_20_u1_u1 0.9375 _CNV_A_R_EVAC_LINEA_314_CM 0. 0.9375 DISPLAY_IDENTIFIER ID_FAC_TOL_CRK_TOOTH FORMAT "%6.4"
 /begin AXIS_DESCR COM_AXIS n_32 _CNV_A_R_LINEAR_____9_CM 6 0. 8160. FORMAT "%4.0" AXIS_PTS_REF ldpm_n_32_2_ensd /end AXIS_DESCR
/end CHARACTERISTIC
/begin MEASUREMENT t_crk_win_ensd "Crankshaft tooth window at end of segment" ULONG _CNV_A_R_LINEAR_____413_CM 1 100. 0. 1.9965 DISPLAY_IDENTIFIER T_CRK_WIN_ENSD ECU_ADDRESS 0xd00020ac FORMAT "%8.6" /end MEASUREMENT
/begin MEASUREMENT t_seg_er "Crankshaft segment period for misfire detection (ER algorithm)" ULONG _CNV_A_R_LINEAR_____413_CM 1 100. 0. 1.9965 DISPLAY_IDENTIFIER T_SEG_ER ECU_ADDRESS 0xd00020b8 FORMAT "%8.6" /end MEASUREMENT
/begin MEASUREMENT lv_crk_miss_tooth "At least one missing tooth has been simulated" UBYTE _CNV_S_2_RANGE__0___1_CM 1 100. 0. 1. DISPLAY_IDENTIFIER LV_CRK_MISS_TOOTH ECU_ADDRESS 0xd0002de8 BIT_MASK 0x1 /end MEASUREMENT
/begin CHARACTERISTIC c_abc_inc_diag_per_cam_in "Anti-bounce counter increment for intake camshaft segment period diagnosis" VALUE 0xa1003528 _REC_VAL_20_u1 255. _CNV_A_R_LINEAR_____0_CM 0. 255. DISPLAY_IDENTIFIER C_ABC_INC_DIAG_PER_CAM_IN FORMAT "%3.0" /end CHARACTERISTIC
/begin CHARACTERISTIC c_abc_inc_diag_per_cam_ex "Anti-bounce counter increment for exhaust camshaft segment period diagnosis" VALUE 0xa1003550 _REC_VAL_20_u1 255. _CNV_A_R_LINEAR_____0_CM 0. 255. DISPLAY_IDENTIFIER C_ABC_INC_DIAG_PER_CAM_EX FORMAT "%3.0" /end CHARACTERISTIC
/begin CHARACTERISTIC c_abc_max_diag_per_cam_ex "Anti-bounce counter maximum for exhaust camshaft segment period diagnosis" VALUE 0xa1003553 _REC_VAL_20_u1 254. _CNV_A_R_LINEAR_____0_CM 1. 255. DISPLAY_IDENTIFIER C_ABC_MAX_DIAG_PER_CAM_EX FORMAT "%3.0" /end CHARACTERISTIC
/begin CHARACTERISTIC c_abc_max_diag_per_cam_in "Anti-bounce counter maximum for intake camshaft segment period diagnosis" VALUE 0xa100352b _REC_VAL_20_u1 254. _CNV_A_R_LINEAR_____0_CM 1. 255. DISPLAY_IDENTIFIER C_ABC_MAX_DIAG_PER_CAM_IN FORMAT "%3.0" /end CHARACTERISTIC
/begin CHARACTERISTIC c_abc_inc_diag_syn_cam_ex "Anti-bounce counter increment for exhaust camshaft synchronization diagnosis" VALUE 0xa1003552 _REC_VAL_20_u1 255. _CNV_A_R_LINEAR_____0_CM 0. 255. DISPLAY_IDENTIFIER C_ABC_INC_DIAG_SYN_CAM_EX FORMAT "%3.0" /end CHARACTERISTIC
/begin CHARACTERISTIC c_abc_inc_diag_syn_cam_in "Anti-bounce counter increment for intake camshaft synchronization diagnosis" VALUE 0xa100352a _REC_VAL_20_u1 255. _CNV_A_R_LINEAR_____0_CM 0. 255. DISPLAY_IDENTIFIER C_ABC_INC_DIAG_SYN_CAM_IN FORMAT "%3.0" /end CHARACTERISTIC
/begin CHARACTERISTIC c_abc_max_diag_syn_cam_ex "Anti-bounce counter maximum for exhaust camshaft synchronization diagnosis" VALUE 0xa1003555 _REC_VAL_20_u1 254. _CNV_A_R_LINEAR_____0_CM 1. 255. DISPLAY_IDENTIFIER C_ABC_MAX_DIAG_SYN_CAM_EX FORMAT "%3.0" /end CHARACTERISTIC
/begin CHARACTERISTIC c_abc_max_diag_syn_cam_in "Anti-bounce counter maximum for intake camshaft synchronization diagnosis" VALUE 0xa100352d _REC_VAL_20_u1 254. _CNV_A_R_LINEAR_____0_CM 1. 255. DISPLAY_IDENTIFIER C_ABC_MAX_DIAG_SYN_CAM_IN FORMAT "%3.0" /end CHARACTERISTIC
/begin MEASUREMENT lv_err_per_cam_ex_1 "Present failure camshaft period too short" UBYTE _CNV_S_2_RANGE__0___1_CM 1 100. 0. 1. DISPLAY_IDENTIFIER LV_ERR_PER_CAM_EX_1 ECU_ADDRESS 0xd000340b BIT_MASK 0x1 /end MEASUREMENT
/begin MEASUREMENT lv_err_per_cam_in_1 "Present failure camshaft period too short" UBYTE _CNV_S_2_RANGE__0___1_CM 1 100. 0. 1. DISPLAY_IDENTIFIER LV_ERR_PER_CAM_IN_1 ECU_ADDRESS 0xd000340a BIT_MASK 0x1 /end MEASUREMENT
/begin MEASUREMENT lv_err_syn_cam_ex_1 "Present failure camshaft period too short" UBYTE _CNV_S_2_RANGE__0___1_CM 1 100. 0. 1. DISPLAY_IDENTIFIER LV_ERR_SYN_CAM_EX_1 ECU_ADDRESS 0xd000340d BIT_MASK 0x1 /end MEASUREMENT
/begin MEASUREMENT lv_err_syn_cam_in_1 "Present intake camshaft sensor failure" UBYTE _CNV_S_2_RANGE__0___1_CM 1 100. 0. 1. DISPLAY_IDENTIFIER LV_ERR_SYN_CAM_IN_1 ECU_ADDRESS 0xd000340c BIT_MASK 0x1 /end MEASUREMENT
/begin MEASUREMENT lv_inh_mis_crk "Inhibition of misfire detection with crankshaft tooth number error" UBYTE _CNV_S_2_RANGE__0___1_CM 1 100. 0. 1. DISPLAY_IDENTIFIER LV_INH_MIS_CRK ECU_ADDRESS 0xd0002dfa BIT_MASK 0x1 /end MEASUREMENT
/begin MEASUREMENT lv_err_crk_tooth "Present crankshaft failure tooth number error" UBYTE _CNV_S_2_RANGE__0___1_CM 1 100. 0. 1. DISPLAY_IDENTIFIER LV_ERR_CRK_TOOTH ECU_ADDRESS 0xd0003410 BIT_MASK 0x1 /end MEASUREMENT
/begin MEASUREMENT lv_err_crk_tooth_per "Present crankshaft failure tooth number error" UBYTE _CNV_S_2_RANGE__0___1_CM 1 100. 0. 1. DISPLAY_IDENTIFIER LV_ERR_CRK_TOOTH_PER ECU_ADDRESS 0xd0003411 BIT_MASK 0x1 /end MEASUREMENT
/begin MEASUREMENT lv_err_crk_syn "Present crankshaft failure with loss of synchronization" UBYTE _CNV_S_2_RANGE__0___1_CM 1 100. 0. 1. DISPLAY_IDENTIFIER LV_ERR_CRK_SYN ECU_ADDRESS 0xd0003412 BIT_MASK 0x1 /end MEASUREMENT
/begin CHARACTERISTIC c_abc_inc_diag_crk_tooth_per "Anti-bounce counter increment for crankshaft  tooth period diagnosis" VALUE 0xa10034f8 _REC_VAL_20_u1 255. _CNV_A_R_LINEAR_____0_CM 0. 255. DISPLAY_IDENTIFIER C_ABC_INC_DIAG_CRK_TOOTH_PER FORMAT "%3.0" /end CHARACTERISTIC
/begin CHARACTERISTIC c_abc_inc_diag_crk_tooth "Anti-bounce counter increment for crankshaft tooth number diagnosis" VALUE 0xa10034f7 _REC_VAL_20_u1 255. _CNV_A_R_LINEAR_____0_CM 0. 255. DISPLAY_IDENTIFIER C_ABC_INC_DIAG_CRK_TOOTH FORMAT "%3.0" /end CHARACTERISTIC
/begin CHARACTERISTIC c_abc_max_diag_crk_tooth "Anti-bounce counter maximum for crankshaft tooth number diagnosis" VALUE 0xa10034fa _REC_VAL_20_u1 254. _CNV_A_R_LINEAR_____0_CM 1. 255. DISPLAY_IDENTIFIER C_ABC_MAX_DIAG_CRK_TOOTH FORMAT "%3.0" /end CHARACTERISTIC
/begin CHARACTERISTIC c_abc_max_diag_crk_tooth_per "Anti-bounce counter maximum for crankshaft tooth period diagnosis " VALUE 0xa10034fb _REC_VAL_20_u1 254. _CNV_A_R_LINEAR_____0_CM 1. 255. DISPLAY_IDENTIFIER C_ABC_MAX_DIAG_CRK_TOOTH_PER FORMAT "%3.0" /end CHARACTERISTIC
/begin CHARACTERISTIC c_abc_max_diag_crk_syn "Anti-bounce counter maximum for crankshaft sensor diagnosis with loss of synchronization" VALUE 0xa10034f9 _REC_VAL_20_u1 254. _CNV_A_R_LINEAR_____0_CM 1. 255. DISPLAY_IDENTIFIER C_ABC_MAX_DIAG_CRK_SYN FORMAT "%3.0" /end CHARACTERISTIC
/begin CHARACTERISTIC c_abc_inc_diag_crk_syn "Anti-bounce counter increment for crankshaft sensor diagnosis with loss of synchronization" VALUE 0xa10034f6 _REC_VAL_20_u1 255. _CNV_A_R_LINEAR_____0_CM 0. 255. DISPLAY_IDENTIFIER C_ABC_INC_DIAG_CRK_SYN FORMAT "%3.0" /end CHARACTERISTIC
/begin CHARACTERISTIC c_n_32_max_diag_crk_tooth "Maximum engine speed to enable tooth number diagnosis" VALUE 0xa10034fe _REC_VAL_20_u1 8160. _CNV_A_R_LINEAR_____9_CM 0. 8160. DISPLAY_IDENTIFIER C_N_32_MAX_DIAG_CRK_TOOTH FORMAT "%4.0" /end CHARACTERISTIC
/begin MEASUREMENT lv_cam_lih_ext_ena "" UBYTE _CNV_S_2_RANGE__0___1_CM 1 100. 0. 1. DISPLAY_IDENTIFIER LV_CAM_LIH_EXT_ENA ECU_ADDRESS 0xd0002de5 BIT_MASK 0x1 /end MEASUREMENT
/begin MEASUREMENT lv_seg_nr_upd_req "" UBYTE _CNV_S_2_RANGE__0___1_CM 1 100. 0. 1. DISPLAY_IDENTIFIER LV_SEG_NR_UPD_REQ ECU_ADDRESS 0xd0002e00 BIT_MASK 0x1 /end MEASUREMENT
/begin MEASUREMENT lv_syn_vld_cam_lih "" UBYTE _CNV_S_2_RANGE__0___1_CM 1 100. 0. 1. DISPLAY_IDENTIFIER LV_SYN_VLD_CAM_LIH ECU_ADDRESS 0xd0002e04 BIT_MASK 0x1 /end MEASUREMENT
/begin MEASUREMENT tco_cmn "coolant temperature ( ENSD internal )" UBYTE _CNV_A_R_ENSD_LINEA_415_CM 1 100. -50. 205. DISPLAY_IDENTIFIER TCO_CMN ECU_ADDRESS 0xd0002de1 FORMAT "%3.0" /end MEASUREMENT
/begin MEASUREMENT vb_cmn "Battery voltage ( ENSD internal )" UBYTE _CNV_A_R_ENSD_LINEA_416_CM 1 100. 0. 28.8 DISPLAY_IDENTIFIER VB_CMN ECU_ADDRESS 0xd0002de2 FORMAT "%5.3" /end MEASUREMENT
/begin MEASUREMENT load_mis "Normalised engine load for misfire detection - sampled at current misfire segment" UWORD _CNV_A_R_LINEAR_____201_CM 1 100. 0. 99.9969482421875 DISPLAY_IDENTIFIER LOAD_MIS ECU_ADDRESS 0xd0002bc6 FORMAT "%7.3" /end MEASUREMENT
/begin MEASUREMENT load_mis_1 "Normalised engine load for misfire detection - 1 misfire segment before" UWORD _CNV_A_R_LINEAR_____201_CM 1 100. 0. 99.9969482421875 DISPLAY_IDENTIFIER LOAD_MIS_1 ECU_ADDRESS 0xd0002bc8 FORMAT "%7.3" /end MEASUREMENT
/begin MEASUREMENT load_mis_2 "Normalised engine load for misfire detection - 2 misfire segment before" UWORD _CNV_A_R_LINEAR_____201_CM 1 100. 0. 99.9969482421875 DISPLAY_IDENTIFIER LOAD_MIS_2 ECU_ADDRESS 0xd0002bca FORMAT "%7.3" /end MEASUREMENT
/begin MEASUREMENT load_mis_3 "Normalised engine load for misfire detection - 3 misfire segment before" UWORD _CNV_A_R_LINEAR_____201_CM 1 100. 0. 99.9969482421875 DISPLAY_IDENTIFIER LOAD_MIS_3 ECU_ADDRESS 0xd0002bcc FORMAT "%7.3" /end MEASUREMENT
/begin MEASUREMENT load_grd_mis "Normalised engine load gradient for misfire detection " UWORD _CNV_A_R_LINEAR_____201_CM 1 100. 0. 99.9969482421875 DISPLAY_IDENTIFIER LOAD_GRD_MIS ECU_ADDRESS 0xd0002bc2 FORMAT "%7.3" /end MEASUREMENT
/begin MEASUREMENT load_min_mis "Normalised engine \"zero\" load for misfire detection" UWORD _CNV_A_R_LINEAR_____201_CM 1 100. 0. 99.9969482421875 DISPLAY_IDENTIFIER LOAD_MIN_MIS ECU_ADDRESS 0xd0002bc4 FORMAT "%7.3" /end MEASUREMENT
/begin AXIS_PTS ldp_n_32_ip_tqi_av_max_mis "" 0xa10099c0 n_32 _REC_AXS_20_u1 8160. _CNV_A_R_LINEAR_____9_CM 8 0. 8160. FORMAT "%4.0" /end AXIS_PTS
/begin MEASUREMENT mis_det_cdn_app_inh "Misfiring APP INC detection fade out requests carrier word (before masking)" UWORD _CNV_A_R_LINEAR_____0_CM 1 100. 0. 65535. DISPLAY_IDENTIFIER MIS_DET_CDN_APP_INH ECU_ADDRESS 0xd0002be8 FORMAT "%5.0" /end MEASUREMENT
/begin MEASUREMENT mis_det_cdn_app_inh.lv_inh_map_dif_det_mis "Misfire detection fade out request flag due to MAP_DIF condition" UWORD _CNV_A_R_LINEAR_____0_CM 1 100. 0. 65535. DISPLAY_IDENTIFIER LV_INH_MAP_DIF_DET_MIS ECU_ADDRESS 0xd0002be8 FORMAT "%5.0" BIT_MASK 0x1 /end MEASUREMENT
/begin MEASUREMENT mis_det_cdn_app_inh.lv_inh_tps_grd_det_mis "Misfire detection fade out request flag due to TPS gradient condition" UWORD _CNV_A_R_LINEAR_____0_CM 1 100. 0. 65535. DISPLAY_IDENTIFIER LV_INH_TPS_GRD_DET_MIS ECU_ADDRESS 0xd0002be8 FORMAT "%5.0" BIT_MASK 0x2 /end MEASUREMENT
/begin MEASUREMENT mis_det_cdn_app_inh.lv_inh_load_grd_det_mis "Misfire detection fade out request flag due to LOAD_GRD_MIS condition" UWORD _CNV_A_R_LINEAR_____0_CM 1 100. 0. 65535. DISPLAY_IDENTIFIER LV_INH_LOAD_GRD_DET_MIS ECU_ADDRESS 0xd0002be8 FORMAT "%5.0" BIT_MASK 0x4 /end MEASUREMENT
/begin MEASUREMENT mis_det_cdn_app_inh.lv_inh_iga_dif_det_mis "Misfire detection fade out request flag due to IGA_DIF condition" UWORD _CNV_A_R_LINEAR_____0_CM 1 100. 0. 65535. DISPLAY_IDENTIFIER LV_INH_IGA_DIF_DET_MIS ECU_ADDRESS 0xd0002be8 FORMAT "%5.0" BIT_MASK 0x8 /end MEASUREMENT
/begin MEASUREMENT mis_det_cdn_app_inh.lv_inh_cmb_tra_mis "Misfire detection fade out request flag due to combustion mode transients" UWORD _CNV_A_R_LINEAR_____0_CM 1 100. 0. 65535. DISPLAY_IDENTIFIER LV_INH_CMB_TRA_MIS ECU_ADDRESS 0xd0002be8 FORMAT "%5.0" BIT_MASK 0x10 /end MEASUREMENT
/begin MEASUREMENT mis_det_cdn_app_inh.lv_inh_acc_det_mis "Misfire detection fade out request flag due to Air conditionner transient condition" UWORD _CNV_A_R_LINEAR_____0_CM 1 100. 0. 65535. DISPLAY_IDENTIFIER LV_INH_ACC_DET_MIS ECU_ADDRESS 0xd0002be8 FORMAT "%5.0" BIT_MASK 0x20 /end MEASUREMENT
/begin MEASUREMENT mis_det_cdn_app_inh_nr "Misfiring APP INC detection fade out requests number  (after masking)" UBYTE _CNV_A_R_LINEAR_____0_CM 1 100. 0. 255. DISPLAY_IDENTIFIER MIS_DET_CDN_APP_INH_NR ECU_ADDRESS 0xd0002f44 FORMAT "%3.0" /end MEASUREMENT
/begin MEASUREMENT map_dif_mis "Manifold air pressure difference between 2 misfire segment tasks" UWORD _CNV_A_R_LINEAR_____26_CM 1 100. 0. 5434. DISPLAY_IDENTIFIER MAP_DIF_MIS ECU_ADDRESS 0xd0002bce FORMAT "%7.2" /end MEASUREMENT
/begin MEASUREMENT iga_dif_mis "Absolute Ignition angle difference between 2 misfire segment tasks" UBYTE _CNV_A_R_LINEAR_____168_CM 1 100. 0. 95.625 DISPLAY_IDENTIFIER IGA_DIF_MIS ECU_ADDRESS 0xd0002f34 /end MEASUREMENT
/begin MEASUREMENT iga_mis_2 "Ignition angle 2 misfire segment before" UBYTE _CNV_A_R_LINEAR_____167_CM 1 100. -35.625 60. DISPLAY_IDENTIFIER IGA_MIS_2 ECU_ADDRESS 0xd0002f37 FORMAT "%7.3" /end MEASUREMENT
/begin MEASUREMENT iga_mis_1 "Ignition angle 1 misfire segment before" UBYTE _CNV_A_R_LINEAR_____167_CM 1 100. -35.625 60. DISPLAY_IDENTIFIER IGA_MIS_1 ECU_ADDRESS 0xd0002f36 FORMAT "%7.3" /end MEASUREMENT
/begin MEASUREMENT iga_mis "Ignition angle at current misfire segment" UBYTE _CNV_A_R_LINEAR_____167_CM 1 100. -35.625 60. DISPLAY_IDENTIFIER IGA_MIS ECU_ADDRESS 0xd0002f35 FORMAT "%7.3" /end MEASUREMENT
/begin MEASUREMENT lv_req_app_inh_mis "Misfire detection APP INC fade out request flag" UBYTE _CNV_S_2_RANGE__0___1_CM 1 100. 0. 1. DISPLAY_IDENTIFIER LV_REQ_APP_INH_MIS ECU_ADDRESS 0xd0002f6e BIT_MASK 0x1 /end MEASUREMENT
/begin CHARACTERISTIC c_mask_app_inh_det_zdly_mis "MIS_DET_CDN_APP_INH carrier structure fade out configuration mask (misfire detection in zero delay phase)" VALUE 0xa1009d10 _REC_VAL_20_u2 65535. _CNV_A_R_LINEAR_____0_CM 0. 65535. DISPLAY_IDENTIFIER C_MASK_APP_INH_DET_ZDLY_MIS FORMAT "%5.0" /end CHARACTERISTIC
/begin CHARACTERISTIC c_t_map_dif_dly_mis "Fade out duration when manifold air pressure gradient has been detected" VALUE 0xa1009d52 _REC_VAL_20_u2 655.35 _CNV_A_R_LINEAR_____3_CM 0. 655.35 DISPLAY_IDENTIFIER C_T_MAP_DIF_DLY_MIS FORMAT "%6.2" /end CHARACTERISTIC
/begin CHARACTERISTIC c_t_tps_grd_dly_mis "Fade out duration when maximum throttle gradient has been detected" VALUE 0xa1009d56 _REC_VAL_20_u2 655.35 _CNV_A_R_LINEAR_____3_CM 0. 655.35 DISPLAY_IDENTIFIER C_T_TPS_GRD_DLY_MIS FORMAT "%6.2" /end CHARACTERISTIC
/begin CHARACTERISTIC c_t_tps_grd_dly_zdly_mis "Fade out duration when maximum throttle gradient has been detected during zero delay starting phase" VALUE 0xa1009d58 _REC_VAL_20_u2 655.35 _CNV_A_R_LINEAR_____3_CM 0. 655.35 DISPLAY_IDENTIFIER C_T_TPS_GRD_DLY_ZDLY_MIS FORMAT "%6.2" /end CHARACTERISTIC
/begin CHARACTERISTIC c_nr_tdc_iga_dif_mis "Fade out duration when IGA difference per TDC has been detected" VALUE 0xa1009d42 _REC_VAL_20_u1 255. _CNV_A_R_LINEAR_____0_CM 0. 255. DISPLAY_IDENTIFIER C_NR_TDC_IGA_DIF_MIS FORMAT "%3.0" /end CHARACTERISTIC
/begin CHARACTERISTIC c_t_load_grd_hom_dly_mis "Fade out duration when maximum LOAD_GRD_MIS has been detected in homogeneous combustion  modes" VALUE 0xa1009d50 _REC_VAL_20_u2 655.35 _CNV_A_R_LINEAR_____3_CM 0. 655.35 DISPLAY_IDENTIFIER C_T_LOAD_GRD_HOM_DLY_MIS FORMAT "%6.2" /end CHARACTERISTIC
/begin CHARACTERISTIC c_t_accout_dly_mis "Fade out duration when air-conditioning compressor has been switched on" VALUE 0xa1009d48 _REC_VAL_20_u2 655.35 _CNV_A_R_LINEAR_____3_CM 0. 655.35 DISPLAY_IDENTIFIER C_T_ACCOUT_DLY_MIS FORMAT "%6.2" /end CHARACTERISTIC
/begin AXIS_PTS ldp_tps_av_ip_tps_grd_max_mis "" 0xa10099f8 tps_av _REC_AXS_20_u2 119.5 _CNV_A_R_LINEAR_____221_CM 10 0. 119.5 FORMAT "%7.3" /end AXIS_PTS
/begin AXIS_PTS ldp_tps_av_ip_tps_grd_zdly_er "" 0xa1009a10 tps_av _REC_AXS_20_u2 119.5 _CNV_A_R_LINEAR_____221_CM 6 0. 119.5 FORMAT "%7.3" /end AXIS_PTS
/begin AXIS_PTS ldp_load_mis_ip_load_grd_mis "" 0xa10098ec load_mis _REC_AXS_20_u2 99.9969482421875 _CNV_A_R_LINEAR_____201_CM 12 0. 99.9969482421875 FORMAT "%7.3" /end AXIS_PTS
/begin AXIS_PTS ldp_map_ip_map_dif_max_mis "" 0xa1009930 map _REC_AXS_20_u2 5434. _CNV_A_R_LINEAR_____26_CM 12 0. 5434. FORMAT "%7.2" /end AXIS_PTS
/begin AXIS_PTS ldp_n_32_ip_delta_iga_mis "" 0xa100994c n_32 _REC_AXS_20_u1 8160. _CNV_A_R_LINEAR_____9_CM 8 0. 8160. FORMAT "%4.0" /end AXIS_PTS
/begin AXIS_PTS ldp_load_mis_ip_delta_iga_mis "" 0xa10098b8 load_mis _REC_AXS_20_u2 99.9969482421875 _CNV_A_R_LINEAR_____201_CM 8 0. 99.9969482421875 FORMAT "%7.3" /end AXIS_PTS
/begin AXIS_PTS ldp_load_mis_ip_load_grd_s_mis "" 0xa1009db8 load_mis _REC_AXS_20_u2 99.9969482421875 _CNV_A_R_LINEAR_____201_CM 12 0. 99.9969482421875 FORMAT "%7.3" /end AXIS_PTS
/begin CHARACTERISTIC c_t_load_grd_s_dly_mis "Fade out duration when maximum LOAD_GRD_MIS has been detected in stratified combustion  mode" VALUE 0xa1009fca _REC_VAL_20_u2 655.35 _CNV_A_R_LINEAR_____3_CM 0. 655.35 DISPLAY_IDENTIFIER C_T_LOAD_GRD_S_DLY_MIS FORMAT "%6.2" /end CHARACTERISTIC
/begin CHARACTERISTIC c_map_max_mis "Maximum manifold air pressure value to determine engine load ratio scale for misfire detection" VALUE 0xa1009d0a _REC_VAL_20_u2 5434. _CNV_A_R_LINEAR_____26_CM 0. 5434. DISPLAY_IDENTIFIER C_MAP_MAX_MIS FORMAT "%7.2" /end CHARACTERISTIC
/begin CHARACTERISTIC c_conf_load_mis "LOAD_MIS switch configuration versus engine combustion mode : " VALUE 0xa1009d04 _REC_VAL_20_u1 2. _CNV_A_R_LINEAR_____0_CM 0. 2. DISPLAY_IDENTIFIER C_CONF_LOAD_MIS FORMAT "%3.0" /end CHARACTERISTIC
/begin CHARACTERISTIC ip_tps_grd_max_mis "Maximum throttle gradient threshold for fade out condition" CURVE 0xa1009cbc _REC_CUR_20_u1_u2 2987.5 _CNV_A_R_LINEAR_____260_CM 0. 2987.5 DISPLAY_IDENTIFIER IP_TPS_GRD_MAX_MIS FORMAT "%6.1"
 /begin AXIS_DESCR COM_AXIS tps_av _CNV_A_R_LINEAR_____221_CM 10 0. 119.5 FORMAT "%7.3" AXIS_PTS_REF ldp_tps_av_ip_tps_grd_max_mis /end AXIS_DESCR
/end CHARACTERISTIC
/begin CHARACTERISTIC ip_tps_grd_zdly_mis "Maximum throttle gradient threshold for fade out condition during zero delay misfire monitoring activation" CURVE 0xa1009cc6 _REC_CUR_20_u1_u2 2987.5 _CNV_A_R_LINEAR_____260_CM 0. 2987.5 DISPLAY_IDENTIFIER IP_TPS_GRD_ZDLY_MIS FORMAT "%6.1"
 /begin AXIS_DESCR COM_AXIS tps_av _CNV_A_R_LINEAR_____221_CM 6 0. 119.5 FORMAT "%7.3" AXIS_PTS_REF ldp_tps_av_ip_tps_grd_zdly_er /end AXIS_DESCR
/end CHARACTERISTIC
/begin CHARACTERISTIC ip_load_grd_mis "Maximum LOAD_MIS gradient for fade out condition in homogeneous combustion modes" CURVE 0xa1009b24 _REC_CUR_20_u2_u2 99.9969482421875 _CNV_A_R_LINEAR_____201_CM 0. 99.9969482421875 DISPLAY_IDENTIFIER IP_LOAD_GRD_MIS FORMAT "%7.3"
 /begin AXIS_DESCR COM_AXIS load_mis _CNV_A_R_LINEAR_____201_CM 12 0. 99.9969482421875 FORMAT "%7.3" AXIS_PTS_REF ldp_load_mis_ip_load_grd_mis /end AXIS_DESCR
/end CHARACTERISTIC
/begin CHARACTERISTIC ip_map_dif_max_mis "Maximum MAP gradient for fade out condition" CURVE 0xa1009c80 _REC_CUR_20_u2_u2 5434. _CNV_A_R_LINEAR_____26_CM 0. 5434. DISPLAY_IDENTIFIER IP_MAP_DIF_MAX_MIS FORMAT "%7.2"
 /begin AXIS_DESCR COM_AXIS map _CNV_A_R_LINEAR_____26_CM 12 0. 5434. FORMAT "%7.2" AXIS_PTS_REF ldp_map_ip_map_dif_max_mis /end AXIS_DESCR
/end CHARACTERISTIC
/begin CHARACTERISTIC ip_delta_iga_mis "Spark advance angle difference at part load for misfire inhibition" MAP 0xa1009a54 _REC_MAP_20_u1_u1_u2 95.625 _CNV_A_R_LINEAR_____168_CM 0. 95.625 DISPLAY_IDENTIFIER IP_DELTA_IGA_MIS
 /begin AXIS_DESCR COM_AXIS n_32 _CNV_A_R_LINEAR_____9_CM 8 0. 8160. FORMAT "%4.0" AXIS_PTS_REF ldp_n_32_ip_delta_iga_mis /end AXIS_DESCR
 /begin AXIS_DESCR COM_AXIS load_mis _CNV_A_R_LINEAR_____201_CM 8 0. 99.9969482421875 FORMAT "%7.3" AXIS_PTS_REF ldp_load_mis_ip_delta_iga_mis /end AXIS_DESCR
/end CHARACTERISTIC
/begin CHARACTERISTIC ip_load_grd_s_mis "Maximum LOAD_MIS gradient for fade out condition in stratified combustion mode" CURVE 0xa1009e54 _REC_CUR_20_u2_u2 99.9969482421875 _CNV_A_R_LINEAR_____201_CM 0. 99.9969482421875 DISPLAY_IDENTIFIER IP_LOAD_GRD_S_MIS FORMAT "%7.3"
 /begin AXIS_DESCR COM_AXIS load_mis _CNV_A_R_LINEAR_____201_CM 12 0. 99.9969482421875 FORMAT "%7.3" AXIS_PTS_REF ldp_load_mis_ip_load_grd_s_mis /end AXIS_DESCR
/end CHARACTERISTIC
/begin CHARACTERISTIC c_nr_tdc_cmb_tra_s_mis "Fade out TDC's duration when engine combustion manager enter or leave stratified combustion mode" VALUE 0xa1009fc8 _REC_VAL_20_u1 255. _CNV_A_R_LINEAR_____425_CM 0. 255. DISPLAY_IDENTIFIER C_NR_TDC_CMB_TRA_S_MIS FORMAT "%3.0" /end CHARACTERISTIC
/begin CHARACTERISTIC c_nr_tdc_cmb_tra_afl_mis "Fade out TDC's duration when engine combustion manager enter or leave air/fuel lean combustion mode" VALUE 0xa100a1d4 _REC_VAL_20_u1 255. _CNV_A_R_LINEAR_____425_CM 0. 255. DISPLAY_IDENTIFIER C_NR_TDC_CMB_TRA_AFL_MIS FORMAT "%3.0" /end CHARACTERISTIC
/begin CHARACTERISTIC ip_tqi_av_max_mis "Maximum torque value to determine engine load ratio scale for misfire detection" CURVE 0xa1009ccc _REC_CUR_20_u2_u1 1023.96875 _CNV_A_R_LINEAR_____30_CM 0. 1023.96875 DISPLAY_IDENTIFIER IP_TQI_AV_MAX_MIS FORMAT "%7.2"
 /begin AXIS_DESCR COM_AXIS n_32 _CNV_A_R_LINEAR_____9_CM 8 0. 8160. FORMAT "%4.0" AXIS_PTS_REF ldp_n_32_ip_tqi_av_max_mis /end AXIS_DESCR
/end CHARACTERISTIC
/begin CHARACTERISTIC c_mask_app_inh_det_mis "MIS_DET_CDN_APP_INH carrier structure fade out configuration mask (detection in nominal phase out of IS)" VALUE 0xa1009d0c _REC_VAL_20_u2 65535. _CNV_A_R_LINEAR_____0_CM 0. 65535. DISPLAY_IDENTIFIER C_MASK_APP_INH_DET_MIS FORMAT "%5.0" /end CHARACTERISTIC
/begin CHARACTERISTIC c_mask_app_inh_det_mis_is "MIS_DET_CDN_APP_INH carrier structure fade out configuration mask (detection in nominal phase & in IS)" VALUE 0xa1009d0e _REC_VAL_20_u2 65535. _CNV_A_R_LINEAR_____0_CM 0. 65535. DISPLAY_IDENTIFIER C_MASK_APP_INH_DET_MIS_IS FORMAT "%5.0" /end CHARACTERISTIC
/begin AXIS_PTS ldp_n_32_ip_maf_max_mis "" 0xa1009996 n_32 _REC_AXS_20_u1 8160. _CNV_A_R_LINEAR_____9_CM 6 0. 8160. FORMAT "%4.0" /end AXIS_PTS
/begin AXIS_PTS ldp_n_32_ip_load_min_mis_afs_mt "" 0xa100998e n_32 _REC_AXS_20_u1 8160. _CNV_A_R_LINEAR_____9_CM 6 0. 8160. FORMAT "%4.0" /end AXIS_PTS
/begin AXIS_PTS ldp_n_32_ip_load_amp_mis_afs_at "" 0xa1009976 n_32 _REC_AXS_20_u1 8160. _CNV_A_R_LINEAR_____9_CM 6 0. 8160. FORMAT "%4.0" /end AXIS_PTS
/begin AXIS_PTS ldp_n_32_ip_load_amp_mis_afs_mt "" 0xa100997e n_32 _REC_AXS_20_u1 8160. _CNV_A_R_LINEAR_____9_CM 6 0. 8160. FORMAT "%4.0" /end AXIS_PTS
/begin AXIS_PTS ldp_n_32_ip_load_min_mis_afl_mt "" 0xa100a02a n_32 _REC_AXS_20_u1 8160. _CNV_A_R_LINEAR_____9_CM 6 0. 8160. FORMAT "%4.0" /end AXIS_PTS
/begin AXIS_PTS ldp_n_32_ip_load_min_mis_afl_at "" 0xa100a022 n_32 _REC_AXS_20_u1 8160. _CNV_A_R_LINEAR_____9_CM 6 0. 8160. FORMAT "%4.0" /end AXIS_PTS
/begin AXIS_PTS ldp_n_32_ip_load_amp_mis_afl_mt "" 0xa100a01a n_32 _REC_AXS_20_u1 8160. _CNV_A_R_LINEAR_____9_CM 6 0. 8160. FORMAT "%4.0" /end AXIS_PTS
/begin AXIS_PTS ldp_n_32_ip_load_amp_mis_afl_at "" 0xa100a012 n_32 _REC_AXS_20_u1 8160. _CNV_A_R_LINEAR_____9_CM 6 0. 8160. FORMAT "%4.0" /end AXIS_PTS
/begin AXIS_PTS ldp_n_32_ip_load_min_mis_s_at "" 0xa1009df2 n_32 _REC_AXS_20_u1 8160. _CNV_A_R_LINEAR_____9_CM 6 0. 8160. FORMAT "%4.0" /end AXIS_PTS
/begin AXIS_PTS ldp_n_32_ip_load_min_mis_s_mt "" 0xa1009dfa n_32 _REC_AXS_20_u1 8160. _CNV_A_R_LINEAR_____9_CM 6 0. 8160. FORMAT "%4.0" /end AXIS_PTS
/begin AXIS_PTS ldp_n_32_ip_load_amp_mis_s_mt "" 0xa1009dea n_32 _REC_AXS_20_u1 8160. _CNV_A_R_LINEAR_____9_CM 6 0. 8160. FORMAT "%4.0" /end AXIS_PTS
/begin AXIS_PTS ldp_n_32_ip_load_amp_mis_s_at "" 0xa1009de2 n_32 _REC_AXS_20_u1 8160. _CNV_A_R_LINEAR_____9_CM 6 0. 8160. FORMAT "%4.0" /end AXIS_PTS
/begin AXIS_PTS ldp_n_32_ip_load_min_mis_afs_at "" 0xa1009986 n_32 _REC_AXS_20_u1 8160. _CNV_A_R_LINEAR_____9_CM 6 0. 8160. FORMAT "%4.0" /end AXIS_PTS
/begin AXIS_PTS ldp_tco_ip_load_min_mis_afs_mt "" 0xa10099ee tco _REC_AXS_20_u1 190.5 _CNV_A_R_LINEAR_____16_CM 6 -48. 142.5 FORMAT "%6.2" /end AXIS_PTS
/begin AXIS_PTS ldp_amp_ip_load_amp_mis_afs_mt "" 0xa1009888 amp _REC_AXS_20_u2 5434. _CNV_A_R_LINEAR_____26_CM 7 0. 5434. FORMAT "%8.3" /end AXIS_PTS
/begin AXIS_PTS ldp_amp_ip_load_amp_mis_afs_at "" 0xa1009878 amp _REC_AXS_20_u2 5434. _CNV_A_R_LINEAR_____26_CM 7 0. 5434. FORMAT "%8.3" /end AXIS_PTS
/begin AXIS_PTS ldp_amp_ip_load_amp_mis_afl_at "" 0xa1009fcc amp _REC_AXS_20_u2 5434. _CNV_A_R_LINEAR_____26_CM 7 0. 5434. FORMAT "%8.3" /end AXIS_PTS
/begin AXIS_PTS ldp_amp_ip_load_amp_mis_afl_mt "" 0xa1009fdc amp _REC_AXS_20_u2 5434. _CNV_A_R_LINEAR_____26_CM 7 0. 5434. FORMAT "%8.3" /end AXIS_PTS
/begin AXIS_PTS ldp_amp_ip_load_amp_mis_s_mt "" 0xa1009d88 amp _REC_AXS_20_u2 5434. _CNV_A_R_LINEAR_____26_CM 7 0. 5434. FORMAT "%8.3" /end AXIS_PTS
/begin AXIS_PTS ldp_amp_ip_load_amp_mis_s_at "" 0xa1009d78 amp _REC_AXS_20_u2 5434. _CNV_A_R_LINEAR_____26_CM 7 0. 5434. FORMAT "%8.3" /end AXIS_PTS
/begin AXIS_PTS ldp_tco_ip_load_min_mis_afs_at "" 0xa10099e6 tco _REC_AXS_20_u1 190.5 _CNV_A_R_LINEAR_____16_CM 6 -48. 142.5 FORMAT "%6.2" /end AXIS_PTS
/begin AXIS_PTS ldp_tco_ip_load_min_mis_afl_at "" 0xa100a042 tco _REC_AXS_20_u1 190.5 _CNV_A_R_LINEAR_____16_CM 6 -48. 142.5 FORMAT "%6.2" /end AXIS_PTS
/begin AXIS_PTS ldp_tco_ip_load_min_mis_afl_mt "" 0xa100a04a tco _REC_AXS_20_u1 190.5 _CNV_A_R_LINEAR_____16_CM 6 -48. 142.5 FORMAT "%6.2" /end AXIS_PTS
/begin AXIS_PTS ldp_tco_ip_load_min_mis_s_mt "" 0xa1009e1a tco _REC_AXS_20_u1 190.5 _CNV_A_R_LINEAR_____16_CM 6 -48. 142.5 FORMAT "%6.2" /end AXIS_PTS
/begin AXIS_PTS ldp_tco_ip_load_min_mis_s_at "" 0xa1009e12 tco _REC_AXS_20_u1 190.5 _CNV_A_R_LINEAR_____16_CM 6 -48. 142.5 FORMAT "%6.2" /end AXIS_PTS
/begin CHARACTERISTIC ip_load_min_mis_afs_at "Zero load curve vs engine speed and coolant temperature in AFS combustion mode, with AT vehicle transmission type" MAP 0xa1009b3c _REC_MAP_20_u2_u1_u1 99.9969482421875 _CNV_A_R_LINEAR_____201_CM 0. 99.9969482421875 DISPLAY_IDENTIFIER IP_LOAD_MIN_MIS_AFS_AT FORMAT "%7.3"
 /begin AXIS_DESCR COM_AXIS n_32 _CNV_A_R_LINEAR_____9_CM 6 0. 8160. FORMAT "%4.0" AXIS_PTS_REF ldp_n_32_ip_load_min_mis_afs_at /end AXIS_DESCR
 /begin AXIS_DESCR COM_AXIS tco _CNV_A_R_LINEAR_____16_CM 6 -48. 142.5 FORMAT "%6.2" AXIS_PTS_REF ldp_tco_ip_load_min_mis_afs_at /end AXIS_DESCR
/end CHARACTERISTIC
/begin CHARACTERISTIC ip_load_min_mis_afs_mt "Zero load curve vs engine speed and coolant temperature in AFS combustion mode, with MT vehicle transmission type" MAP 0xa1009b84 _REC_MAP_20_u2_u1_u1 99.9969482421875 _CNV_A_R_LINEAR_____201_CM 0. 99.9969482421875 DISPLAY_IDENTIFIER IP_LOAD_MIN_MIS_AFS_MT FORMAT "%7.3"
 /begin AXIS_DESCR COM_AXIS n_32 _CNV_A_R_LINEAR_____9_CM 6 0. 8160. FORMAT "%4.0" AXIS_PTS_REF ldp_n_32_ip_load_min_mis_afs_mt /end AXIS_DESCR
 /begin AXIS_DESCR COM_AXIS tco _CNV_A_R_LINEAR_____16_CM 6 -48. 142.5 FORMAT "%6.2" AXIS_PTS_REF ldp_tco_ip_load_min_mis_afs_mt /end AXIS_DESCR
/end CHARACTERISTIC
/begin CHARACTERISTIC ip_load_min_ofs_amp_mis_afs_mt "Extra load from zero load curve vs engine speed and atmospheric pressure in AFS with MT vehicle" MAP 0xa1009c20 _REC_MAP_20_u2_u1_u2 99.99694800000002 _CNV_A_R_MISF_LINEA_426_CM -50. 49.996948 DISPLAY_IDENTIFIER IP_LOAD_MIN_OFS_AMP_MIS_AFS_MT FORMAT "%7.3"
 /begin AXIS_DESCR COM_AXIS n_32 _CNV_A_R_LINEAR_____9_CM 6 0. 8160. FORMAT "%4.0" AXIS_PTS_REF ldp_n_32_ip_load_amp_mis_afs_mt /end AXIS_DESCR
 /begin AXIS_DESCR COM_AXIS amp _CNV_A_R_LINEAR_____26_CM 7 0. 5434. FORMAT "%8.3" AXIS_PTS_REF ldp_amp_ip_load_amp_mis_afs_mt /end AXIS_DESCR
/end CHARACTERISTIC
/begin CHARACTERISTIC ip_load_min_ofs_amp_mis_afs_at "Extra load from zero load curve vs engine speed and atmospheric pressure in AFS with AT vehicle" MAP 0xa1009bcc _REC_MAP_20_u2_u1_u2 99.99694800000002 _CNV_A_R_MISF_LINEA_426_CM -50. 49.996948 DISPLAY_IDENTIFIER IP_LOAD_MIN_OFS_AMP_MIS_AFS_AT FORMAT "%7.3"
 /begin AXIS_DESCR COM_AXIS n_32 _CNV_A_R_LINEAR_____9_CM 6 0. 8160. FORMAT "%4.0" AXIS_PTS_REF ldp_n_32_ip_load_amp_mis_afs_at /end AXIS_DESCR
 /begin AXIS_DESCR COM_AXIS amp _CNV_A_R_LINEAR_____26_CM 7 0. 5434. FORMAT "%8.3" AXIS_PTS_REF ldp_amp_ip_load_amp_mis_afs_at /end AXIS_DESCR
/end CHARACTERISTIC
/begin CHARACTERISTIC ip_load_min_ofs_amp_mis_afl_at "Extra load from zero load curve vs engine speed and atmospheric pressure in AFL with AT vehicle" MAP 0xa100a108 _REC_MAP_20_u2_u1_u2 99.99694800000002 _CNV_A_R_MISF_LINEA_426_CM -50. 49.996948 DISPLAY_IDENTIFIER IP_LOAD_MIN_OFS_AMP_MIS_AFL_AT FORMAT "%7.3"
 /begin AXIS_DESCR COM_AXIS n_32 _CNV_A_R_LINEAR_____9_CM 6 0. 8160. FORMAT "%4.0" AXIS_PTS_REF ldp_n_32_ip_load_amp_mis_afl_at /end AXIS_DESCR
 /begin AXIS_DESCR COM_AXIS amp _CNV_A_R_LINEAR_____26_CM 7 0. 5434. FORMAT "%8.3" AXIS_PTS_REF ldp_amp_ip_load_amp_mis_afl_at /end AXIS_DESCR
/end CHARACTERISTIC
/begin CHARACTERISTIC ip_load_min_ofs_amp_mis_afl_mt "Extra load from zero load curve vs engine speed and atmospheric pressure in AFL with MT vehicle" MAP 0xa100a15c _REC_MAP_20_u2_u1_u2 99.99694800000002 _CNV_A_R_MISF_LINEA_426_CM -50. 49.996948 DISPLAY_IDENTIFIER IP_LOAD_MIN_OFS_AMP_MIS_AFL_MT FORMAT "%7.3"
 /begin AXIS_DESCR COM_AXIS n_32 _CNV_A_R_LINEAR_____9_CM 6 0. 8160. FORMAT "%4.0" AXIS_PTS_REF ldp_n_32_ip_load_amp_mis_afl_mt /end AXIS_DESCR
 /begin AXIS_DESCR COM_AXIS amp _CNV_A_R_LINEAR_____26_CM 7 0. 5434. FORMAT "%8.3" AXIS_PTS_REF ldp_amp_ip_load_amp_mis_afl_mt /end AXIS_DESCR
/end CHARACTERISTIC
/begin CHARACTERISTIC ip_load_min_ofs_amp_mis_s_mt "Extra load from zero load curve vs engine speed and atmospheric pressure in S with MT vehicle" MAP 0xa1009f50 _REC_MAP_20_u2_u1_u2 99.99694800000002 _CNV_A_R_MISF_LINEA_426_CM -50. 49.996948 DISPLAY_IDENTIFIER IP_LOAD_MIN_OFS_AMP_MIS_S_MT FORMAT "%7.3"
 /begin AXIS_DESCR COM_AXIS n_32 _CNV_A_R_LINEAR_____9_CM 6 0. 8160. FORMAT "%4.0" AXIS_PTS_REF ldp_n_32_ip_load_amp_mis_s_mt /end AXIS_DESCR
 /begin AXIS_DESCR COM_AXIS amp _CNV_A_R_LINEAR_____26_CM 7 0. 5434. FORMAT "%8.3" AXIS_PTS_REF ldp_amp_ip_load_amp_mis_s_mt /end AXIS_DESCR
/end CHARACTERISTIC
/begin CHARACTERISTIC ip_load_min_ofs_amp_mis_s_at "Extra load from zero load curve vs engine speed and atmospheric pressure in S with AT vehicle" MAP 0xa1009efc _REC_MAP_20_u2_u1_u2 99.99694800000002 _CNV_A_R_MISF_LINEA_426_CM -50. 49.996948 DISPLAY_IDENTIFIER IP_LOAD_MIN_OFS_AMP_MIS_S_AT FORMAT "%7.3"
 /begin AXIS_DESCR COM_AXIS n_32 _CNV_A_R_LINEAR_____9_CM 6 0. 8160. FORMAT "%4.0" AXIS_PTS_REF ldp_n_32_ip_load_amp_mis_s_at /end AXIS_DESCR
 /begin AXIS_DESCR COM_AXIS amp _CNV_A_R_LINEAR_____26_CM 7 0. 5434. FORMAT "%8.3" AXIS_PTS_REF ldp_amp_ip_load_amp_mis_s_at /end AXIS_DESCR
/end CHARACTERISTIC
/begin CHARACTERISTIC ip_load_min_mis_afl_at "Zero load curve vs engine speed and coolant temperature in AFL combustion mode, with AT vehicle transmission type" MAP 0xa100a078 _REC_MAP_20_u2_u1_u1 99.9969482421875 _CNV_A_R_LINEAR_____201_CM 0. 99.9969482421875 DISPLAY_IDENTIFIER IP_LOAD_MIN_MIS_AFL_AT FORMAT "%7.3"
 /begin AXIS_DESCR COM_AXIS n_32 _CNV_A_R_LINEAR_____9_CM 6 0. 8160. FORMAT "%4.0" AXIS_PTS_REF ldp_n_32_ip_load_min_mis_afl_at /end AXIS_DESCR
 /begin AXIS_DESCR COM_AXIS tco _CNV_A_R_LINEAR_____16_CM 6 -48. 142.5 FORMAT "%6.2" AXIS_PTS_REF ldp_tco_ip_load_min_mis_afl_at /end AXIS_DESCR
/end CHARACTERISTIC
/begin CHARACTERISTIC ip_load_min_mis_afl_mt "Zero load curve vs engine speed and coolant temperature in AFL combustion mode, with MT vehicle transmission type" MAP 0xa100a0c0 _REC_MAP_20_u2_u1_u1 99.9969482421875 _CNV_A_R_LINEAR_____201_CM 0. 99.9969482421875 DISPLAY_IDENTIFIER IP_LOAD_MIN_MIS_AFL_MT FORMAT "%7.3"
 /begin AXIS_DESCR COM_AXIS n_32 _CNV_A_R_LINEAR_____9_CM 6 0. 8160. FORMAT "%4.0" AXIS_PTS_REF ldp_n_32_ip_load_min_mis_afl_mt /end AXIS_DESCR
 /begin AXIS_DESCR COM_AXIS tco _CNV_A_R_LINEAR_____16_CM 6 -48. 142.5 FORMAT "%6.2" AXIS_PTS_REF ldp_tco_ip_load_min_mis_afl_mt /end AXIS_DESCR
/end CHARACTERISTIC
/begin CHARACTERISTIC ip_load_min_mis_s_at "Zero load curve vs engine speed and coolant temperature in S combustion mode, with AT vehicle transmission type" MAP 0xa1009e6c _REC_MAP_20_u2_u1_u1 99.9969482421875 _CNV_A_R_LINEAR_____201_CM 0. 99.9969482421875 DISPLAY_IDENTIFIER IP_LOAD_MIN_MIS_S_AT FORMAT "%7.3"
 /begin AXIS_DESCR COM_AXIS n_32 _CNV_A_R_LINEAR_____9_CM 6 0. 8160. FORMAT "%4.0" AXIS_PTS_REF ldp_n_32_ip_load_min_mis_s_at /end AXIS_DESCR
 /begin AXIS_DESCR COM_AXIS tco _CNV_A_R_LINEAR_____16_CM 6 -48. 142.5 FORMAT "%6.2" AXIS_PTS_REF ldp_tco_ip_load_min_mis_s_at /end AXIS_DESCR
/end CHARACTERISTIC
/begin CHARACTERISTIC ip_load_min_mis_s_mt "Zero load curve vs engine speed and coolant temperature in S combustion mode, with MT vehicle transmission type" MAP 0xa1009eb4 _REC_MAP_20_u2_u1_u1 99.9969482421875 _CNV_A_R_LINEAR_____201_CM 0. 99.9969482421875 DISPLAY_IDENTIFIER IP_LOAD_MIN_MIS_S_MT FORMAT "%7.3"
 /begin AXIS_DESCR COM_AXIS n_32 _CNV_A_R_LINEAR_____9_CM 6 0. 8160. FORMAT "%4.0" AXIS_PTS_REF ldp_n_32_ip_load_min_mis_s_mt /end AXIS_DESCR
 /begin AXIS_DESCR COM_AXIS tco _CNV_A_R_LINEAR_____16_CM 6 -48. 142.5 FORMAT "%6.2" AXIS_PTS_REF ldp_tco_ip_load_min_mis_s_mt /end AXIS_DESCR
/end CHARACTERISTIC
/begin CHARACTERISTIC ip_maf_max_mis "Maximum air mass value to determine engine load ratio scale for misfire detection" CURVE 0xa1009c74 _REC_CUR_20_u2_u1 1389. _CNV_A_R_LINEAR_____108_CM 0. 1389. DISPLAY_IDENTIFIER IP_MAF_MAX_MIS FORMAT "%7.2"
 /begin AXIS_DESCR COM_AXIS n_32 _CNV_A_R_LINEAR_____9_CM 6 0. 8160. FORMAT "%4.0" AXIS_PTS_REF ldp_n_32_ip_maf_max_mis /end AXIS_DESCR
/end CHARACTERISTIC
/begin MEASUREMENT ctr_t_zdly_mis "10 ms decounter for diagnostic fade out (general purpose)" UWORD _CNV_A_R_LINEAR_____3_CM 1 100. 0. 655.35 DISPLAY_IDENTIFIER CTR_T_ZDLY_MIS ECU_ADDRESS 0xd0002bae FORMAT "%6.2" /end MEASUREMENT
/begin MEASUREMENT lv_diag_mis "Nominal Misfire Monitoring Phase" UBYTE _CNV_S_2_RANGE__0___1_CM 1 100. 0. 1. DISPLAY_IDENTIFIER LV_DIAG_MIS ECU_ADDRESS 0xd0002f54 BIT_MASK 0x1 /end MEASUREMENT
/begin MEASUREMENT lv_zdly_diag_mis "Zero delay misfire monitoring phase" UBYTE _CNV_S_2_RANGE__0___1_CM 1 100. 0. 1. DISPLAY_IDENTIFIER LV_ZDLY_DIAG_MIS ECU_ADDRESS 0xd0002f72 BIT_MASK 0x1 /end MEASUREMENT
/begin CHARACTERISTIC lc_req_zdly_mis "Activation of CARB required 0 delay monitoring" VALUE 0xa1009d73 _REC_VAL_20_u1 1. _CNV_S_2_RANGE__0___1_CM 0. 1. DISPLAY_IDENTIFIER LC_REQ_ZDLY_MIS BIT_MASK 0x1 /end CHARACTERISTIC
/begin CHARACTERISTIC c_n_min_zdly_mis "Minimum monitoring engine speed for engine start monitoring phase" VALUE 0xa1009d38 _REC_VAL_20_u2 8160. _CNV_A_R_LINEAR_____13_CM 0. 8160. DISPLAY_IDENTIFIER C_N_MIN_ZDLY_MIS FORMAT "%4.0" /end CHARACTERISTIC
/begin CHARACTERISTIC c_t_zdly_mis "Duration for engine start specific misfire monitoring (5s according CARB)" VALUE 0xa1009d5a _REC_VAL_20_u2 655.35 _CNV_A_R_LINEAR_____3_CM 0. 655.35 DISPLAY_IDENTIFIER C_T_ZDLY_MIS FORMAT "%6.2" /end CHARACTERISTIC
/begin MEASUREMENT mis_det_cdn_inh "Misfiring detection fade out requests carrier byte (before masking)" UBYTE _CNV_A_R_LINEAR_____0_CM 1 100. 0. 255. DISPLAY_IDENTIFIER MIS_DET_CDN_INH ECU_ADDRESS 0xd0002f45 FORMAT "%3.0" /end MEASUREMENT
/begin MEASUREMENT mis_det_cdn_inh.lv_inh_n_max_det_mis "Misfire detection fade out request flag due to maximum engine speed condition" UBYTE _CNV_A_R_LINEAR_____0_CM 1 100. 0. 255. DISPLAY_IDENTIFIER LV_INH_N_MAX_DET_MIS ECU_ADDRESS 0xd0002f45 FORMAT "%3.0" BIT_MASK 0x1 /end MEASUREMENT
/begin MEASUREMENT mis_det_cdn_inh.lv_inh_n_min_det_mis "Misfire detection fade out request flag due to minimum engine speed condition" UBYTE _CNV_A_R_LINEAR_____0_CM 1 100. 0. 255. DISPLAY_IDENTIFIER LV_INH_N_MIN_DET_MIS ECU_ADDRESS 0xd0002f45 FORMAT "%3.0" BIT_MASK 0x2 /end MEASUREMENT
/begin MEASUREMENT mis_det_cdn_inh.lv_inh_load_min_det_mis "Misfire detection fade out request flag due to zero load line condition" UBYTE _CNV_A_R_LINEAR_____0_CM 1 100. 0. 255. DISPLAY_IDENTIFIER LV_INH_LOAD_MIN_DET_MIS ECU_ADDRESS 0xd0002f45 FORMAT "%3.0" BIT_MASK 0x4 /end MEASUREMENT
/begin MEASUREMENT mis_det_cdn_inh.lv_inh_tco_min_det_mis "Misfire detection fade out request flagdue to minimum temperature condition" UBYTE _CNV_A_R_LINEAR_____0_CM 1 100. 0. 255. DISPLAY_IDENTIFIER LV_INH_TCO_MIN_DET_MIS ECU_ADDRESS 0xd0002f45 FORMAT "%3.0" BIT_MASK 0x8 /end MEASUREMENT
/begin MEASUREMENT mis_det_cdn_inh.lv_inh_amp_min_det_mis "Misfire detection fade out request flagdue to minimum atmospheric pressure  condition" UBYTE _CNV_A_R_LINEAR_____0_CM 1 100. 0. 255. DISPLAY_IDENTIFIER LV_INH_AMP_MIN_DET_MIS ECU_ADDRESS 0xd0002f45 FORMAT "%3.0" BIT_MASK 0x10 /end MEASUREMENT
/begin MEASUREMENT mis_det_cdn_inh.lv_inh_st_det_mis "Misfire detection fade out request flag due to engine start condition" UBYTE _CNV_A_R_LINEAR_____0_CM 1 100. 0. 255. DISPLAY_IDENTIFIER LV_INH_ST_DET_MIS ECU_ADDRESS 0xd0002f45 FORMAT "%3.0" BIT_MASK 0x20 /end MEASUREMENT
/begin MEASUREMENT mis_det_cdn_inh.lv_inh_iv_off_det_mis "Misfire detection fade out request flag due to cylinder shut-off condition" UBYTE _CNV_A_R_LINEAR_____0_CM 1 100. 0. 255. DISPLAY_IDENTIFIER LV_INH_IV_OFF_DET_MIS ECU_ADDRESS 0xd0002f45 FORMAT "%3.0" BIT_MASK 0x40 /end MEASUREMENT
/begin MEASUREMENT mis_det_cdn_inh_nr "Misfiring detection fade out requests number (after masking)" UBYTE _CNV_A_R_LINEAR_____0_CM 1 100. 0. 255. DISPLAY_IDENTIFIER MIS_DET_CDN_INH_NR ECU_ADDRESS 0xd0002f46 FORMAT "%3.0" /end MEASUREMENT
/begin MEASUREMENT lv_req_inh_mis "Misfire detection fade out request flag" UBYTE _CNV_S_2_RANGE__0___1_CM 1 100. 0. 1. DISPLAY_IDENTIFIER LV_REQ_INH_MIS ECU_ADDRESS 0xd0002f6f BIT_MASK 0x1 /end MEASUREMENT
/begin CHARACTERISTIC c_mask_inh_det_zdly_mis "MIS_DET_CDN_INH carrier structure fade out configuration mask (misfire detection zero delay phase)" VALUE 0xa1009d13 _REC_VAL_20_u1 255. _CNV_A_R_LINEAR_____0_CM 0. 255. DISPLAY_IDENTIFIER C_MASK_INH_DET_ZDLY_MIS FORMAT "%3.0" /end CHARACTERISTIC
/begin CHARACTERISTIC c_mask_inh_det_mis "MIS_DET_CDN_INH carrier structure fade out configuration mask (misfire detection nominal phase)" VALUE 0xa1009d12 _REC_VAL_20_u1 255. _CNV_A_R_LINEAR_____0_CM 0. 255. DISPLAY_IDENTIFIER C_MASK_INH_DET_MIS FORMAT "%3.0" /end CHARACTERISTIC
/begin CHARACTERISTIC c_amp_min_mis "Minimum atmospheric pressure for misfire detection" VALUE 0xa1009d02 _REC_VAL_20_u2 5434. _CNV_A_R_LINEAR_____26_CM 0. 5434. DISPLAY_IDENTIFIER C_AMP_MIN_MIS FORMAT "%7.2" /end CHARACTERISTIC
/begin CHARACTERISTIC c_n_min_mis "Minimum engine speed for misfire detection" VALUE 0xa1009d36 _REC_VAL_20_u2 8160. _CNV_A_R_LINEAR_____13_CM 0. 8160. DISPLAY_IDENTIFIER C_N_MIN_MIS FORMAT "%4.0" /end CHARACTERISTIC
/begin CHARACTERISTIC c_n_max_mis_at "Maximum engine speed for misfire detection / automatic transmission" VALUE 0xa1009d32 _REC_VAL_20_u2 8160. _CNV_A_R_LINEAR_____13_CM 0. 8160. DISPLAY_IDENTIFIER C_N_MAX_MIS_AT FORMAT "%4.0" /end CHARACTERISTIC
/begin CHARACTERISTIC c_n_max_mis_mt "Maximum engine speed for misfire detection / manual transmission" VALUE 0xa1009d34 _REC_VAL_20_u2 8160. _CNV_A_R_LINEAR_____13_CM 0. 8160. DISPLAY_IDENTIFIER C_N_MAX_MIS_MT FORMAT "%4.0" /end CHARACTERISTIC
/begin CHARACTERISTIC c_t_dly_st_mis "Fade out duration when engine operating state start LV_ST has been exited" VALUE 0xa1009d4e _REC_VAL_20_u2 655.35 _CNV_A_R_LINEAR_____3_CM 0. 655.35 DISPLAY_IDENTIFIER C_T_DLY_ST_MIS FORMAT "%6.2" /end CHARACTERISTIC
/begin CHARACTERISTIC c_t_dly_iv_off_mis "Fade out duration after injection is back on" VALUE 0xa1009d4c _REC_VAL_20_u2 655.35 _CNV_A_R_LINEAR_____3_CM 0. 655.35 DISPLAY_IDENTIFIER C_T_DLY_IV_OFF_MIS FORMAT "%6.2" /end CHARACTERISTIC
/begin CHARACTERISTIC c_sum_inh_iv_max_mis "Maximum number of cylinders in shut-off to fade-out" VALUE 0xa1009d47 _REC_VAL_20_u1 8. _CNV_A_R_LINEAR_____0_CM 0. 8. DISPLAY_IDENTIFIER C_SUM_INH_IV_MAX_MIS FORMAT "%3.0" /end CHARACTERISTIC
/begin CHARACTERISTIC c_tco_min_mis "Minimum coolant temperature for misfire detection" VALUE 0xa1009d5c _REC_VAL_20_u1 190.5 _CNV_A_R_LINEAR_____16_CM -48. 142.5 DISPLAY_IDENTIFIER C_TCO_MIN_MIS FORMAT "%6.2" /end CHARACTERISTIC
/begin CHARACTERISTIC c_tco_wup_min_mis "Minimum warm up coolant temperature for misfire detection" VALUE 0xa1009d5d _REC_VAL_20_u1 190.5 _CNV_A_R_LINEAR_____16_CM -48. 142.5 DISPLAY_IDENTIFIER C_TCO_WUP_MIN_MIS FORMAT "%6.2" /end CHARACTERISTIC
/begin MEASUREMENT state_diag_mis "Misfire detection phase state machine" UBYTE _CNV_S_5_MISF_RANGE_427_CM 1 100. 0. 4. DISPLAY_IDENTIFIER STATE_DIAG_MIS ECU_ADDRESS 0xd0002f4a /end MEASUREMENT
/begin CHARACTERISTIC c_nr_tdc_zdly_mis "Standard TDC count disablement tdc number before monitoring (engine start phase)" VALUE 0xa1009d44 _REC_VAL_20_u1 255. _CNV_A_R_LINEAR_____425_CM 0. 255. DISPLAY_IDENTIFIER C_NR_TDC_ZDLY_MIS FORMAT "%3.0" /end CHARACTERISTIC
/begin CHARACTERISTIC c_nr_tdc_inh_mis "Fade out duration in TDC when engine speed rise up to C_N_MIN_ZDLY_MIS" VALUE 0xa1009d43 _REC_VAL_20_u1 255. _CNV_A_R_LINEAR_____425_CM 0. 255. DISPLAY_IDENTIFIER C_NR_TDC_INH_MIS FORMAT "%3.0" /end CHARACTERISTIC
/begin AXIS_PTS ldp_tco_ip_fac_thd_tco_er "" 0xa10099dc tco _REC_AXS_20_u1 190.5 _CNV_A_R_LINEAR_____16_CM 8 -48. 142.5 FORMAT "%6.2" /end AXIS_PTS
/begin AXIS_PTS ldp_n_32_ip_fac_thd_iv_er "" 0xa100996e n_32 _REC_AXS_20_u1 8160. _CNV_A_R_LINEAR_____9_CM 6 0. 8160. FORMAT "%4.0" /end AXIS_PTS
/begin AXIS_PTS ldpm_n_32_afl_misf "" 0xa100a488 n_32 _REC_AXS_20_u1 8160. _CNV_A_R_LINEAR_____9_CM 9 0. 8160. FORMAT "%4.0" /end AXIS_PTS
/begin AXIS_PTS ldpm_load_mis_afl_misf "" 0xa100a478 load_mis _REC_AXS_20_u2 99.9969482421875 _CNV_A_R_LINEAR_____201_CM 6 0. 99.9969482421875 FORMAT "%7.3" /end AXIS_PTS
/begin AXIS_PTS ldpm_n_32_s_misf "" 0xa100a5c8 n_32 _REC_AXS_20_u1 8160. _CNV_A_R_LINEAR_____9_CM 9 0. 8160. FORMAT "%4.0" /end AXIS_PTS
/begin AXIS_PTS ldpm_load_mis_s_misf "" 0xa100a5b8 load_mis _REC_AXS_20_u2 99.9969482421875 _CNV_A_R_LINEAR_____201_CM 6 0. 99.9969482421875 FORMAT "%7.3" /end AXIS_PTS
/begin AXIS_PTS ldp_n_32_ip_fac_thd_iv_s_er "" 0xa1009dda n_32 _REC_AXS_20_u1 8160. _CNV_A_R_LINEAR_____9_CM 6 0. 8160. FORMAT "%4.0" /end AXIS_PTS
/begin MEASUREMENT mis_state_er "Status carrier byte of actual detected misfire through engine roughness index - 1 bit / cylinder." UBYTE _CNV_A_R_LINEAR_____0_CM 1 100. 0. 255. DISPLAY_IDENTIFIER MIS_STATE_ER ECU_ADDRESS 0xd0002f48 FORMAT "%3.0" /end MEASUREMENT
/begin MEASUREMENT lv_puc_det_mis "Fuel Cut-Off dedicated to misfire detection, including a delay time for fuel reactivation" UBYTE _CNV_S_2_RANGE__0___1_CM 1 100. 0. 1. DISPLAY_IDENTIFIER LV_PUC_DET_MIS ECU_ADDRESS 0xd0002f6c BIT_MASK 0x1 /end MEASUREMENT
/begin MEASUREMENT lv_det_mis "Single misfire detected and confirmed (after fade out test)" UBYTE _CNV_S_2_RANGE__0___1_CM 1 100. 0. 1. DISPLAY_IDENTIFIER LV_DET_MIS ECU_ADDRESS 0xd0002f50 BIT_MASK 0x1 /end MEASUREMENT
/begin CHARACTERISTIC lc_mis_inh "Global switch to disable all misfire monitoring related modules (Inhibition with = 1)" VALUE 0xa1009d72 _REC_VAL_20_u1 1. _CNV_S_2_RANGE__0___1_CM 0. 1. DISPLAY_IDENTIFIER LC_MIS_INH BIT_MASK 0x1 /end CHARACTERISTIC
/begin MEASUREMENT thd_er "Misfire detection threshold for current ER value" SWORD _CNV_A_R_LINEAR_____0_CM 1 100. -32768. 32767. DISPLAY_IDENTIFIER THD_ER ECU_ADDRESS 0xd0002c18 FORMAT "%6.0" /end MEASUREMENT
/begin MEASUREMENT thd_er_cyl[0] "Cylinder Misfire detection threshold for current ER value" SWORD _CNV_A_R_LINEAR_____0_CM 1 100. -32768. 32767. DISPLAY_IDENTIFIER THD_ER_CYL[0] ECU_ADDRESS 0xd0002c24 FORMAT "%6.0" /end MEASUREMENT
/begin MEASUREMENT thd_er_cyl[1] "Cylinder Misfire detection threshold for current ER value" SWORD _CNV_A_R_LINEAR_____0_CM 1 100. -32768. 32767. DISPLAY_IDENTIFIER THD_ER_CYL[1] ECU_ADDRESS 0xd0002c26 FORMAT "%6.0" /end MEASUREMENT
/begin MEASUREMENT thd_er_cyl[2] "Cylinder Misfire detection threshold for current ER value" SWORD _CNV_A_R_LINEAR_____0_CM 1 100. -32768. 32767. DISPLAY_IDENTIFIER THD_ER_CYL[2] ECU_ADDRESS 0xd0002c28 FORMAT "%6.0" /end MEASUREMENT
/begin MEASUREMENT thd_er_cyl[3] "Cylinder Misfire detection threshold for current ER value" SWORD _CNV_A_R_LINEAR_____0_CM 1 100. -32768. 32767. DISPLAY_IDENTIFIER THD_ER_CYL[3] ECU_ADDRESS 0xd0002c2a FORMAT "%6.0" /end MEASUREMENT
/begin MEASUREMENT thd_er_cyl[4] "Cylinder Misfire detection threshold for current ER value" SWORD _CNV_A_R_LINEAR_____0_CM 1 100. -32768. 32767. DISPLAY_IDENTIFIER THD_ER_CYL[4] ECU_ADDRESS 0xd0002c2c FORMAT "%6.0" /end MEASUREMENT
/begin MEASUREMENT thd_er_cyl[5] "Cylinder Misfire detection threshold for current ER value" SWORD _CNV_A_R_LINEAR_____0_CM 1 100. -32768. 32767. DISPLAY_IDENTIFIER THD_ER_CYL[5] ECU_ADDRESS 0xd0002c2e FORMAT "%6.0" /end MEASUREMENT
/begin AXIS_PTS ldp_n_ip_thd_afl_er_is "" 0xa100a46c n _REC_AXS_20_u2 8160. _CNV_A_R_LINEAR_____13_CM 4 0. 8160. FORMAT "%4.0" /end AXIS_PTS
/begin AXIS_PTS ldp_load_mis_ip_thd_afl_er_is "" 0xa100a45c load_mis _REC_AXS_20_u2 99.9969482421875 _CNV_A_R_LINEAR_____201_CM 6 0. 99.9969482421875 FORMAT "%7.3" /end AXIS_PTS
/begin AXIS_PTS ldp_n_ip_thd_s_er_is "" 0xa100a5ac n _REC_AXS_20_u2 8160. _CNV_A_R_LINEAR_____13_CM 4 0. 8160. FORMAT "%4.0" /end AXIS_PTS
/begin AXIS_PTS ldp_load_mis_ip_thd_s_er_is "" 0xa100a59c load_mis _REC_AXS_20_u2 99.9969482421875 _CNV_A_R_LINEAR_____201_CM 6 0. 99.9969482421875 FORMAT "%7.3" /end AXIS_PTS
/begin MEASUREMENT lv_det_thd_mis "Single misfire detected based only on threshold criterion (before fade out test)" UBYTE _CNV_S_2_RANGE__0___1_CM 1 100. 0. 1. DISPLAY_IDENTIFIER LV_DET_THD_MIS ECU_ADDRESS 0xd0002f53 BIT_MASK 0x1 /end MEASUREMENT
/begin MEASUREMENT thd_er_buf[0] "Misfire detection threshold stack for ER evaluation" SWORD _CNV_A_R_LINEAR_____0_CM 1 100. -32768. 32767. DISPLAY_IDENTIFIER THD_ER_BUF[0] ECU_ADDRESS 0xd0002c1c FORMAT "%6.0" /end MEASUREMENT
/begin MEASUREMENT thd_er_buf[1] "Misfire detection threshold stack for ER evaluation" SWORD _CNV_A_R_LINEAR_____0_CM 1 100. -32768. 32767. DISPLAY_IDENTIFIER THD_ER_BUF[1] ECU_ADDRESS 0xd0002c1e FORMAT "%6.0" /end MEASUREMENT
/begin MEASUREMENT thd_er_buf[2] "Misfire detection threshold stack for ER evaluation" SWORD _CNV_A_R_LINEAR_____0_CM 1 100. -32768. 32767. DISPLAY_IDENTIFIER THD_ER_BUF[2] ECU_ADDRESS 0xd0002c20 FORMAT "%6.0" /end MEASUREMENT
/begin MEASUREMENT thd_er_buf[3] "Misfire detection threshold stack for ER evaluation" SWORD _CNV_A_R_LINEAR_____0_CM 1 100. -32768. 32767. DISPLAY_IDENTIFIER THD_ER_BUF[3] ECU_ADDRESS 0xd0002c22 FORMAT "%6.0" /end MEASUREMENT
/begin MEASUREMENT lv_inh_det_mis "General misfire detection fade out delayed according misfire index phasing" UBYTE _CNV_S_2_RANGE__0___1_CM 1 100. 0. 1. DISPLAY_IDENTIFIER LV_INH_DET_MIS ECU_ADDRESS 0xd0002f60 BIT_MASK 0x1 /end MEASUREMENT
/begin CHARACTERISTIC ip_fac_thd_tco_er "Temperature-dependent threshold reduction" CURVE 0xa1009b14 _REC_CUR_20_u2_u1 1.99609375 _CNV_A_R_LINEAR_____27_CM 0. 1.99609375 DISPLAY_IDENTIFIER IP_FAC_THD_TCO_ER FORMAT "%5.3"
 /begin AXIS_DESCR COM_AXIS tco _CNV_A_R_LINEAR_____16_CM 8 -48. 142.5 FORMAT "%6.2" AXIS_PTS_REF ldp_tco_ip_fac_thd_tco_er /end AXIS_DESCR
/end CHARACTERISTIC
/begin CHARACTERISTIC ip_fac_thd_iv_er "Factor for adaptation of the threshold in case of active cylinder cut-off" CURVE 0xa1009b08 _REC_CUR_20_u2_u1 0.9999847412109381 _CNV_A_R_LINEAR_____68_CM 0. 0.9999847412109381 DISPLAY_IDENTIFIER IP_FAC_THD_IV_ER FORMAT "%7.5"
 /begin AXIS_DESCR COM_AXIS n_32 _CNV_A_R_LINEAR_____9_CM 6 0. 8160. FORMAT "%4.0" AXIS_PTS_REF ldp_n_32_ip_fac_thd_iv_er /end AXIS_DESCR
/end CHARACTERISTIC
/begin CHARACTERISTIC ip_fac_thd_iv_s_er "Factor for adaptation of the threshold in case of active cylinder cut-off in stratified combustion mode" CURVE 0xa1009e48 _REC_CUR_20_u2_u1 0.9999847412109381 _CNV_A_R_LINEAR_____68_CM 0. 0.9999847412109381 DISPLAY_IDENTIFIER IP_FAC_THD_IV_S_ER FORMAT "%7.5"
 /begin AXIS_DESCR COM_AXIS n_32 _CNV_A_R_LINEAR_____9_CM 6 0. 8160. FORMAT "%4.0" AXIS_PTS_REF ldp_n_32_ip_fac_thd_iv_s_er /end AXIS_DESCR
/end CHARACTERISTIC
/begin MEASUREMENT mis_det_cyl_inh "Cylinder misfiring detection inhibition carrier byte when a fade out condition occurred (after masking & delay)" UBYTE _CNV_A_R_LINEAR_____0_CM 1 100. 0. 255. DISPLAY_IDENTIFIER MIS_DET_CYL_INH ECU_ADDRESS 0xd0002f47 FORMAT "%3.0" /end MEASUREMENT
/begin MEASUREMENT fac_thd_er "Global gain multiplicative correction applied to basic misfire detection thresholds" UWORD _CNV_A_R_LINEAR_____428_CM 1 100. 0. 255.996093 DISPLAY_IDENTIFIER FAC_THD_ER ECU_ADDRESS 0xd0002bc0 FORMAT "%7.3" /end MEASUREMENT
/begin CHARACTERISTIC ip_thd_at_afl_er "ER threshold for misfire detection in AFL mode, AT vehicle transmission type" MAP 0xa100a4c4 _REC_MAP_20_u2_u1_u2 65535. _CNV_A_R_LINEAR_____429_CM -32768. 32767. DISPLAY_IDENTIFIER IP_THD_AT_AFL_ER FORMAT "%6.0"
 /begin AXIS_DESCR COM_AXIS n_32 _CNV_A_R_LINEAR_____9_CM 9 0. 8160. FORMAT "%4.0" AXIS_PTS_REF ldpm_n_32_afl_misf /end AXIS_DESCR
 /begin AXIS_DESCR COM_AXIS load_mis _CNV_A_R_LINEAR_____201_CM 6 0. 99.9969482421875 FORMAT "%7.3" AXIS_PTS_REF ldpm_load_mis_afl_misf /end AXIS_DESCR
/end CHARACTERISTIC
/begin CHARACTERISTIC ip_thd_mt_afl_er "ER threshold for misfire detection in AFL mode, MT vehicle transmission type" MAP 0xa100a530 _REC_MAP_20_u2_u1_u2 65535. _CNV_A_R_LINEAR_____429_CM -32768. 32767. DISPLAY_IDENTIFIER IP_THD_MT_AFL_ER FORMAT "%6.0"
 /begin AXIS_DESCR COM_AXIS n_32 _CNV_A_R_LINEAR_____9_CM 9 0. 8160. FORMAT "%4.0" AXIS_PTS_REF ldpm_n_32_afl_misf /end AXIS_DESCR
 /begin AXIS_DESCR COM_AXIS load_mis _CNV_A_R_LINEAR_____201_CM 6 0. 99.9969482421875 FORMAT "%7.3" AXIS_PTS_REF ldpm_load_mis_afl_misf /end AXIS_DESCR
/end CHARACTERISTIC
/begin CHARACTERISTIC ip_thd_afl_er_is "ER threshold for misfire detection in AFL combustion mode & in idle speed" MAP 0xa100a494 _REC_MAP_20_u2_u2_u2 65535. _CNV_A_R_LINEAR_____429_CM -32768. 32767. DISPLAY_IDENTIFIER IP_THD_AFL_ER_IS FORMAT "%6.0"
 /begin AXIS_DESCR COM_AXIS n _CNV_A_R_LINEAR_____13_CM 4 0. 8160. FORMAT "%4.0" AXIS_PTS_REF ldp_n_ip_thd_afl_er_is /end AXIS_DESCR
 /begin AXIS_DESCR COM_AXIS load_mis _CNV_A_R_LINEAR_____201_CM 6 0. 99.9969482421875 FORMAT "%7.3" AXIS_PTS_REF ldp_load_mis_ip_thd_afl_er_is /end AXIS_DESCR
/end CHARACTERISTIC
/begin CHARACTERISTIC ip_thd_at_s_er "ER threshold for misfire detection in S mode, AT vehicle transmission type" MAP 0xa100a5d4 _REC_MAP_20_u2_u1_u2 65535. _CNV_A_R_LINEAR_____429_CM -32768. 32767. DISPLAY_IDENTIFIER IP_THD_AT_S_ER FORMAT "%6.0"
 /begin AXIS_DESCR COM_AXIS n_32 _CNV_A_R_LINEAR_____9_CM 9 0. 8160. FORMAT "%4.0" AXIS_PTS_REF ldpm_n_32_s_misf /end AXIS_DESCR
 /begin AXIS_DESCR COM_AXIS load_mis _CNV_A_R_LINEAR_____201_CM 6 0. 99.9969482421875 FORMAT "%7.3" AXIS_PTS_REF ldpm_load_mis_s_misf /end AXIS_DESCR
/end CHARACTERISTIC
/begin CHARACTERISTIC ip_thd_mt_s_er "ER threshold for misfire detection in S mode, MT vehicle transmission type" MAP 0xa100a640 _REC_MAP_20_u2_u1_u2 65535. _CNV_A_R_LINEAR_____429_CM -32768. 32767. DISPLAY_IDENTIFIER IP_THD_MT_S_ER FORMAT "%6.0"
 /begin AXIS_DESCR COM_AXIS n_32 _CNV_A_R_LINEAR_____9_CM 9 0. 8160. FORMAT "%4.0" AXIS_PTS_REF ldpm_n_32_s_misf /end AXIS_DESCR
 /begin AXIS_DESCR COM_AXIS load_mis _CNV_A_R_LINEAR_____201_CM 6 0. 99.9969482421875 FORMAT "%7.3" AXIS_PTS_REF ldpm_load_mis_s_misf /end AXIS_DESCR
/end CHARACTERISTIC
/begin CHARACTERISTIC ip_thd_s_er_is "ER threshold for misfire detection in S combustion mode & in idle speed" MAP 0xa100a6ac _REC_MAP_20_u2_u2_u2 65535. _CNV_A_R_LINEAR_____429_CM -32768. 32767. DISPLAY_IDENTIFIER IP_THD_S_ER_IS FORMAT "%6.0"
 /begin AXIS_DESCR COM_AXIS n _CNV_A_R_LINEAR_____13_CM 4 0. 8160. FORMAT "%4.0" AXIS_PTS_REF ldp_n_ip_thd_s_er_is /end AXIS_DESCR
 /begin AXIS_DESCR COM_AXIS load_mis _CNV_A_R_LINEAR_____201_CM 6 0. 99.9969482421875 FORMAT "%7.3" AXIS_PTS_REF ldp_load_mis_ip_thd_s_er_is /end AXIS_DESCR
/end CHARACTERISTIC
/begin AXIS_PTS ldp_load_mis_ip_thd_afs_er_is_mt "" 0xa100a254 load_mis _REC_AXS_20_u2 99.9969482421875 _CNV_A_R_LINEAR_____201_CM 6 0. 99.9969482421875 FORMAT "%7.3" /end AXIS_PTS
/begin AXIS_PTS ldp_n_ip_thd_afs_er_is_mt "" 0xa100a270 n _REC_AXS_20_u2 8160. _CNV_A_R_LINEAR_____13_CM 4 0. 8160. FORMAT "%4.0" /end AXIS_PTS
/begin AXIS_PTS ldp_load_mis_ip_thd_afs_er_is_at "" 0xa100a244 load_mis _REC_AXS_20_u2 99.9969482421875 _CNV_A_R_LINEAR_____201_CM 6 0. 99.9969482421875 FORMAT "%7.3" /end AXIS_PTS
/begin AXIS_PTS ldp_n_ip_thd_afs_er_is_at "" 0xa100a264 n _REC_AXS_20_u2 8160. _CNV_A_R_LINEAR_____13_CM 4 0. 8160. FORMAT "%4.0" /end AXIS_PTS
/begin AXIS_PTS ldp_n_32_ip_thd_mt_afs_er "" 0xa10099b0 n_32 _REC_AXS_20_u1 8160. _CNV_A_R_LINEAR_____9_CM 12 0. 8160. FORMAT "%4.0" /end AXIS_PTS
/begin AXIS_PTS ldp_n_32_ip_thd_at_afs_er "" 0xa10099a0 n_32 _REC_AXS_20_u1 8160. _CNV_A_R_LINEAR_____9_CM 12 0. 8160. FORMAT "%4.0" /end AXIS_PTS
/begin AXIS_PTS ldp_load_mis_ip_thd_mt_afs_er "" 0xa100991c load_mis _REC_AXS_20_u2 99.9969482421875 _CNV_A_R_LINEAR_____201_CM 8 0. 99.9969482421875 FORMAT "%7.3" /end AXIS_PTS
/begin AXIS_PTS ldp_load_mis_ip_thd_at_afs_er "" 0xa1009908 load_mis _REC_AXS_20_u2 99.9969482421875 _CNV_A_R_LINEAR_____201_CM 8 0. 99.9969482421875 FORMAT "%7.3" /end AXIS_PTS
/begin CHARACTERISTIC ip_thd_at_afs_er "ER threshold for misfire detection in AFS mode, AT vehicle transmission type" MAP 0xa100a2dc _REC_MAP_20_u2_u1_u2 65535. _CNV_A_R_LINEAR_____429_CM -32768. 32767. DISPLAY_IDENTIFIER IP_THD_AT_AFS_ER FORMAT "%6.0"
 /begin AXIS_DESCR COM_AXIS n_32 _CNV_A_R_LINEAR_____9_CM 12 0. 8160. FORMAT "%4.0" AXIS_PTS_REF ldp_n_32_ip_thd_at_afs_er /end AXIS_DESCR
 /begin AXIS_DESCR COM_AXIS load_mis _CNV_A_R_LINEAR_____201_CM 8 0. 99.9969482421875 FORMAT "%7.3" AXIS_PTS_REF ldp_load_mis_ip_thd_at_afs_er /end AXIS_DESCR
/end CHARACTERISTIC
/begin CHARACTERISTIC ip_thd_mt_afs_er "ER threshold for misfire detection in AFS mode, MT vehicle transmission type" MAP 0xa100a39c _REC_MAP_20_u2_u1_u2 65535. _CNV_A_R_LINEAR_____429_CM -32768. 32767. DISPLAY_IDENTIFIER IP_THD_MT_AFS_ER FORMAT "%6.0"
 /begin AXIS_DESCR COM_AXIS n_32 _CNV_A_R_LINEAR_____9_CM 12 0. 8160. FORMAT "%4.0" AXIS_PTS_REF ldp_n_32_ip_thd_mt_afs_er /end AXIS_DESCR
 /begin AXIS_DESCR COM_AXIS load_mis _CNV_A_R_LINEAR_____201_CM 8 0. 99.9969482421875 FORMAT "%7.3" AXIS_PTS_REF ldp_load_mis_ip_thd_mt_afs_er /end AXIS_DESCR
/end CHARACTERISTIC
/begin CHARACTERISTIC ip_thd_afs_er_is_mt "ER threshold for misfire detection in AFS combustion mode & in idle speed" MAP 0xa100a2ac _REC_MAP_20_u2_u2_u2 65535. _CNV_A_R_LINEAR_____429_CM -32768. 32767. DISPLAY_IDENTIFIER IP_THD_AFS_ER_IS_MT FORMAT "%6.0"
 /begin AXIS_DESCR COM_AXIS n _CNV_A_R_LINEAR_____13_CM 4 0. 8160. FORMAT "%4.0" AXIS_PTS_REF ldp_n_ip_thd_afs_er_is_mt /end AXIS_DESCR
 /begin AXIS_DESCR COM_AXIS load_mis _CNV_A_R_LINEAR_____201_CM 6 0. 99.9969482421875 FORMAT "%7.3" AXIS_PTS_REF ldp_load_mis_ip_thd_afs_er_is_mt /end AXIS_DESCR
/end CHARACTERISTIC
/begin CHARACTERISTIC ip_thd_afs_er_is_at "ER threshold for misfire detection in AFS combustion mode & in idle speed" MAP 0xa100a27c _REC_MAP_20_u2_u2_u2 65535. _CNV_A_R_LINEAR_____429_CM -32768. 32767. DISPLAY_IDENTIFIER IP_THD_AFS_ER_IS_AT FORMAT "%6.0"
 /begin AXIS_DESCR COM_AXIS n _CNV_A_R_LINEAR_____13_CM 4 0. 8160. FORMAT "%4.0" AXIS_PTS_REF ldp_n_ip_thd_afs_er_is_at /end AXIS_DESCR
 /begin AXIS_DESCR COM_AXIS load_mis _CNV_A_R_LINEAR_____201_CM 6 0. 99.9969482421875 FORMAT "%7.3" AXIS_PTS_REF ldp_load_mis_ip_thd_afs_er_is_at /end AXIS_DESCR
/end CHARACTERISTIC
/begin MEASUREMENT ctr_tdc_zdly_mis "TDC decounter for disabled diagnostic" UWORD _CNV_A_R_LINEAR_____425_CM 1 100. 0. 65535. DISPLAY_IDENTIFIER CTR_TDC_ZDLY_MIS ECU_ADDRESS 0xd0002bb0 FORMAT "%5.0" /end MEASUREMENT
/begin MEASUREMENT ctr_tot_mis "Overall misfire detection counter" ULONG _CNV_A_R_LINEAR_____50_CM 1 100. 0. 4294967295. DISPLAY_IDENTIFIER CTR_TOT_MIS ECU_ADDRESS 0xd0002bb2 FORMAT "%11.0" /end MEASUREMENT
/begin MEASUREMENT fac_thd_app_er "Misfire detection threshold correction gain specific to application" UWORD _CNV_A_R_LINEAR_____27_CM 1 100. 0. 1.99609375 DISPLAY_IDENTIFIER FAC_THD_APP_ER ECU_ADDRESS 0xd0002bbe FORMAT "%5.3" /end MEASUREMENT
/begin MEASUREMENT lv_ftl_l_diag_mis "Request to allow error management of misfire occurence with low fuel tank level" UBYTE _CNV_S_2_RANGE__0___1_CM 1 100. 0. 1. DISPLAY_IDENTIFIER LV_FTL_L_DIAG_MIS ECU_ADDRESS 0xd0002f5b BIT_MASK 0x1 /end MEASUREMENT
/begin MEASUREMENT lv_inh_crk_osc_det "Crankshaft oscillation detection fade out" UBYTE _CNV_S_2_RANGE__0___1_CM 1 100. 0. 1. DISPLAY_IDENTIFIER LV_INH_CRK_OSC_DET ECU_ADDRESS 0xd0002f5f BIT_MASK 0x1 /end MEASUREMENT
/begin MEASUREMENT lv_inh_obd_det_mis "OBD I misfire detection process inhibition flag" UBYTE _CNV_S_2_RANGE__0___1_CM 1 100. 0. 1. DISPLAY_IDENTIFIER LV_INH_OBD_DET_MIS ECU_ADDRESS 0xd0002f65 BIT_MASK 0x1 /end MEASUREMENT
/begin CHARACTERISTIC lc_ftl_l_det_mis "Global switch to disable all misfire monitoring related modules (Inhibition with = 1)" VALUE 0xa1009d70 _REC_VAL_20_u1 1. _CNV_S_2_RANGE__0___1_CM 0. 1. DISPLAY_IDENTIFIER LC_FTL_L_DET_MIS BIT_MASK 0x1 /end CHARACTERISTIC
/begin CHARACTERISTIC lc_ftl_l_diag_mis "Enable error management of misfire with low fuel tank level" VALUE 0xa1009d71 _REC_VAL_20_u1 1. _CNV_S_2_RANGE__0___1_CM 0. 1. DISPLAY_IDENTIFIER LC_FTL_L_DIAG_MIS BIT_MASK 0x1 /end CHARACTERISTIC
/begin MEASUREMENT lv_inh_app_det_mis "Misfire detection process inhibition flag (application specific)." UBYTE _CNV_S_2_RANGE__0___1_CM 1 100. 0. 1. DISPLAY_IDENTIFIER LV_INH_APP_DET_MIS ECU_ADDRESS 0xd0002f5d BIT_MASK 0x1 /end MEASUREMENT
/begin MEASUREMENT lv_inh_ftl_l_det_mis "Misfire detection inhibition flag in case of low fuel tank level" UBYTE _CNV_S_2_RANGE__0___1_CM 1 100. 0. 1. DISPLAY_IDENTIFIER LV_INH_FTL_L_DET_MIS ECU_ADDRESS 0xd0002f61 BIT_MASK 0x1 /end MEASUREMENT
/begin MEASUREMENT lv_inh_app_rr "Rough Road detection Appli Inci fade out" UBYTE _CNV_S_2_RANGE__0___1_CM 1 100. 0. 1. DISPLAY_IDENTIFIER LV_INH_APP_RR ECU_ADDRESS 0xd0002f5e BIT_MASK 0x1 /end MEASUREMENT
/begin CHARACTERISTIC c_n_thd_mis_inh "Global condition for inhibiting (deactivation) of all misfire modules" VALUE 0xa1009d3c _REC_VAL_20_u1 8160. _CNV_A_R_LINEAR_____9_CM 0. 8160. DISPLAY_IDENTIFIER C_N_THD_MIS_INH FORMAT "%4.0" /end CHARACTERISTIC
/begin CHARACTERISTIC c_t_amt_gs_dly_mis "Fade out duration when gearshift of AMT has been detected" VALUE 0xa1009d4a _REC_VAL_20_u2 655.35 _CNV_A_R_LINEAR_____3_CM 0. 655.35 DISPLAY_IDENTIFIER C_T_AMT_GS_DLY_MIS FORMAT "%5.2" /end CHARACTERISTIC
/begin CHARACTERISTIC ip_fac_thd_er_ch "Threshold correction depending on torque reserve at catalyst heating" CURVE 0xa1009b00 _REC_CUR_20_u2_u2 1.99609375 _CNV_A_R_LINEAR_____27_CM 0. 1.99609375 DISPLAY_IDENTIFIER IP_FAC_THD_ER_CH FORMAT "%5.3"
 /begin AXIS_DESCR COM_AXIS tq_add_ch _CNV_A_R_LINEAR_____65_CM 4 -1024. 1023.96875 FORMAT "%11.5" AXIS_PTS_REF ldp_tq_add_ch_fac_thd_er_ch /end AXIS_DESCR
/end CHARACTERISTIC
/begin AXIS_PTS ldp_tq_add_ch_fac_thd_er_ch "" 0xa1009a20 tq_add_ch _REC_AXS_20_u2 2047.96875 _CNV_A_R_LINEAR_____65_CM 4 -1024. 1023.96875 FORMAT "%11.5" /end AXIS_PTS
/begin CHARACTERISTIC lc_use_ivvt_inh_mis "Enable IVVT diagnosis for inhibition of misfire detection" VALUE 0xa1009d74 _REC_VAL_20_u1 1. _CNV_S_2_RANGE__0___1_CM 0. 1. DISPLAY_IDENTIFIER LC_USE_IVVT_INH_MIS /end CHARACTERISTIC
/begin CHARACTERISTIC c_mis_max_nr_off_iv "Maximum number of allowed cylinder to be shut-off after detection of the misfire status CARB A." VALUE 0xa1009d1b _REC_VAL_20_u1 4. _CNV_A_R_LINEAR_____0_CM 0. 4. DISPLAY_IDENTIFIER C_MIS_MAX_NR_OFF_IV FORMAT "%3.0" /end CHARACTERISTIC
/begin MEASUREMENT fac_er_diag_mis "Reliability weighting factor for detection based on misfire detection index (ER)" UBYTE _CNV_A_R_LINEAR_____100_CM 1 100. 0. 1.9921875 DISPLAY_IDENTIFIER FAC_ER_DIAG_MIS ECU_ADDRESS 0xd0002f30 FORMAT "%8.6" /end MEASUREMENT
/begin MEASUREMENT fac_igc_diag_mis "Reliability weighting factor for ignition diagnosis (ignition failure detected)" UBYTE _CNV_A_R_LINEAR_____100_CM 1 100. 0. 1.9921875 DISPLAY_IDENTIFIER FAC_IGC_DIAG_MIS ECU_ADDRESS 0xd0002f31 FORMAT "%8.6" /end MEASUREMENT
/begin MEASUREMENT fac_iv_diag_mis "Reliability weighting factor for injection valve (injection valve failure detected)" UBYTE _CNV_A_R_LINEAR_____100_CM 1 100. 0. 1.9921875 DISPLAY_IDENTIFIER FAC_IV_DIAG_MIS ECU_ADDRESS 0xd0002f32 FORMAT "%8.6" /end MEASUREMENT
/begin MEASUREMENT lv_det_cfm_mis "Flag for individual confirmed misfire detection after crossed diagnosis" UBYTE _CNV_S_2_RANGE__0___1_CM 1 100. 0. 1. DISPLAY_IDENTIFIER LV_DET_CFM_MIS ECU_ADDRESS 0xd0002f4f BIT_MASK 0x1 /end MEASUREMENT
/begin CHARACTERISTIC c_mis_nr_off_iv_igcfb "Threshold for number of cylinders shut off due to misfire" VALUE 0xa1009d1d _REC_VAL_20_u1 8. _CNV_A_R_LINEAR_____0_CM 0. 8. DISPLAY_IDENTIFIER C_MIS_NR_OFF_IV_IGCFB FORMAT "%3.0" /end CHARACTERISTIC
/begin AXIS_PTS ldp_n_32_ip_fac_igc_diag_mis "" 0xa100995e n_32 _REC_AXS_20_u1 8160. _CNV_A_R_LINEAR_____9_CM 6 0. 8160. FORMAT "%4.0" /end AXIS_PTS
/begin AXIS_PTS ldp_load_mis_ip_fac_igc_diag_mis "" 0xa10098cc load_mis _REC_AXS_20_u2 99.9969482421875 _CNV_A_R_LINEAR_____201_CM 6 0. 99.9969482421875 FORMAT "%7.3" /end AXIS_PTS
/begin AXIS_PTS ldp_n_32_ip_fac_iv_diag_mis "" 0xa1009966 n_32 _REC_AXS_20_u1 8160. _CNV_A_R_LINEAR_____9_CM 6 0. 8160. FORMAT "%4.0" /end AXIS_PTS
/begin AXIS_PTS ldp_load_mis_ip_fac_iv_diag_mis "" 0xa10098dc load_mis _REC_AXS_20_u2 99.9969482421875 _CNV_A_R_LINEAR_____201_CM 6 0. 99.9969482421875 FORMAT "%7.3" /end AXIS_PTS
/begin AXIS_PTS ldp_n_32_ip_fac_er_s_diag_mis "" 0xa1009dd2 n_32 _REC_AXS_20_u1 8160. _CNV_A_R_LINEAR_____9_CM 6 0. 8160. FORMAT "%4.0" /end AXIS_PTS
/begin MEASUREMENT lv_det_mis_a "CARB A misfire criteria detected in actual 200 rev. window (not debounced)" UBYTE _CNV_S_2_RANGE__0___1_CM 1 100. 0. 1. DISPLAY_IDENTIFIER LV_DET_MIS_A ECU_ADDRESS 0xd0002f51 BIT_MASK 0x1 /end MEASUREMENT
/begin MEASUREMENT lv_mis_state_a "CARB A misfire criterion confirmed (debounced)" UBYTE _CNV_S_2_RANGE__0___1_CM 1 100. 0. 1. DISPLAY_IDENTIFIER LV_MIS_STATE_A ECU_ADDRESS 0xd0002f68 BIT_MASK 0x1 /end MEASUREMENT
/begin MEASUREMENT mis_a_fac "Catalyst damage weighting factor to increment cylinder specific counters when misfire is detected" UBYTE _CNV_A_R_LINEAR_____0_CM 1 100. 0. 255. DISPLAY_IDENTIFIER MIS_A_FAC ECU_ADDRESS 0xd0002f3e FORMAT "%3.0" /end MEASUREMENT
/begin MEASUREMENT mis_a_fac_buf[0] "Catalyst damage weighting factor buffer" UBYTE _CNV_A_R_LINEAR_____0_CM 1 100. 0. 255. DISPLAY_IDENTIFIER MIS_A_FAC_BUF[0] ECU_ADDRESS 0xd0002f40 FORMAT "%3.0" /end MEASUREMENT
/begin MEASUREMENT mis_a_fac_buf[1] "Catalyst damage weighting factor buffer" UBYTE _CNV_A_R_LINEAR_____0_CM 1 100. 0. 255. DISPLAY_IDENTIFIER MIS_A_FAC_BUF[1] ECU_ADDRESS 0xd0002f41 FORMAT "%3.0" /end MEASUREMENT
/begin MEASUREMENT mis_a_fac_buf[2] "Catalyst damage weighting factor buffer" UBYTE _CNV_A_R_LINEAR_____0_CM 1 100. 0. 255. DISPLAY_IDENTIFIER MIS_A_FAC_BUF[2] ECU_ADDRESS 0xd0002f42 FORMAT "%3.0" /end MEASUREMENT
/begin MEASUREMENT mis_a_fac_buf[3] "Catalyst damage weighting factor buffer" UBYTE _CNV_A_R_LINEAR_____0_CM 1 100. 0. 255. DISPLAY_IDENTIFIER MIS_A_FAC_BUF[3] ECU_ADDRESS 0xd0002f43 FORMAT "%3.0" /end MEASUREMENT
/begin MEASUREMENT inh_iv_mis "Idendification of cylinders shut off by misifre CARB A" UBYTE _CNV_A_R_LINEAR_____0_CM 1 100. 0. 255. DISPLAY_IDENTIFIER INH_IV_MIS ECU_ADDRESS 0xd0002f3a FORMAT "%3.0" /end MEASUREMENT
/begin MEASUREMENT mis_ctr_a[0] "Misfire sums (cylinder individual) after combination and weighting in CARB A window." UWORD _CNV_A_R_LINEAR_____0_CM 1 100. 0. 65535. DISPLAY_IDENTIFIER MIS_CTR_A[0] ECU_ADDRESS 0xd0002bd0 FORMAT "%5.0" /end MEASUREMENT
/begin MEASUREMENT mis_ctr_a[1] "Misfire sums (cylinder individual) after combination and weighting in CARB A window." UWORD _CNV_A_R_LINEAR_____0_CM 1 100. 0. 65535. DISPLAY_IDENTIFIER MIS_CTR_A[1] ECU_ADDRESS 0xd0002bd2 FORMAT "%5.0" /end MEASUREMENT
/begin MEASUREMENT mis_ctr_a[2] "Misfire sums (cylinder individual) after combination and weighting in CARB A window." UWORD _CNV_A_R_LINEAR_____0_CM 1 100. 0. 65535. DISPLAY_IDENTIFIER MIS_CTR_A[2] ECU_ADDRESS 0xd0002bd4 FORMAT "%5.0" /end MEASUREMENT
/begin MEASUREMENT mis_ctr_a[3] "Misfire sums (cylinder individual) after combination and weighting in CARB A window." UWORD _CNV_A_R_LINEAR_____0_CM 1 100. 0. 65535. DISPLAY_IDENTIFIER MIS_CTR_A[3] ECU_ADDRESS 0xd0002bd6 FORMAT "%5.0" /end MEASUREMENT
/begin MEASUREMENT mis_ctr_a[4] "Misfire sums (cylinder individual) after combination and weighting in CARB A window." UWORD _CNV_A_R_LINEAR_____0_CM 1 100. 0. 65535. DISPLAY_IDENTIFIER MIS_CTR_A[4] ECU_ADDRESS 0xd0002bd8 FORMAT "%5.0" /end MEASUREMENT
/begin MEASUREMENT mis_ctr_a[5] "Misfire sums (cylinder individual) after combination and weighting in CARB A window." UWORD _CNV_A_R_LINEAR_____0_CM 1 100. 0. 65535. DISPLAY_IDENTIFIER MIS_CTR_A[5] ECU_ADDRESS 0xd0002bda FORMAT "%5.0" /end MEASUREMENT
/begin MEASUREMENT mis_nr_tdc_a "TDC counter CARB A window (200 crankshaft revolutions)." UWORD _CNV_A_R_LINEAR_____0_CM 1 100. 0. 65535. DISPLAY_IDENTIFIER MIS_NR_TDC_A ECU_ADDRESS 0xd0002bea FORMAT "%5.0" /end MEASUREMENT
/begin MEASUREMENT mis_sum_a "CARB A misfire weighted sum (global)" UWORD _CNV_A_R_LINEAR_____0_CM 1 100. 0. 65535. DISPLAY_IDENTIFIER MIS_SUM_A ECU_ADDRESS 0xd0002bee FORMAT "%5.0" /end MEASUREMENT
/begin MEASUREMENT mis_sum_a_cbk[0] "CARB A misfire weighted sum (dedicated to cylinder bank)" UWORD _CNV_A_R_LINEAR_____0_CM 1 100. 0. 65535. DISPLAY_IDENTIFIER MIS_SUM_A_CBK[0] ECU_ADDRESS 0xd0002bf0 FORMAT "%5.0" /end MEASUREMENT
/begin MEASUREMENT mis_sum_a_cbk[1] "CARB A misfire weighted sum (dedicated to cylinder bank)" UWORD _CNV_A_R_LINEAR_____0_CM 1 100. 0. 65535. DISPLAY_IDENTIFIER MIS_SUM_A_CBK[1] ECU_ADDRESS 0xd0002bf2 FORMAT "%5.0" /end MEASUREMENT
/begin MEASUREMENT ctr_chk_mis_a "CARB A windows occurrence counter" UBYTE _CNV_A_R_LINEAR_____0_CM 1 100. 0. 255. DISPLAY_IDENTIFIER CTR_CHK_MIS_A ECU_ADDRESS 0xd0002f2c FORMAT "%3.0" /end MEASUREMENT
/begin MEASUREMENT ctr_ftp_cdn_mis_a "TDC counter for FTP condition detection" UWORD _CNV_A_R_LINEAR_____0_CM 1 100. 0. 65535. DISPLAY_IDENTIFIER CTR_FTP_CDN_MIS_A ECU_ADDRESS 0xd0002b74 FORMAT "%5.0" /end MEASUREMENT
/begin MEASUREMENT ctr_det_mis_a "CARB A misfire criteria detected counter" UBYTE _CNV_A_R_LINEAR_____0_CM 1 100. 0. 255. DISPLAY_IDENTIFIER CTR_DET_MIS_A ECU_ADDRESS 0xd0002f2e FORMAT "%3.0" /end MEASUREMENT
/begin MEASUREMENT lv_ftp_mis_a "Boolean for FTP emission cycle condition status at the end of CARB A window" UBYTE _CNV_S_2_RANGE__0___1_CM 1 100. 0. 1. DISPLAY_IDENTIFIER LV_FTP_MIS_A ECU_ADDRESS 0xd0002f5c BIT_MASK 0x1 /end MEASUREMENT
/begin MEASUREMENT sym_cyl_mis_a "CARB A misfire criteria symptoms" UWORD _CNV_A_R_LINEAR_____0_CM 1 100. 0. 65535. DISPLAY_IDENTIFIER SYM_CYL_MIS_A ECU_ADDRESS 0xd0002c0a FORMAT "%5.0" /end MEASUREMENT
/begin CHARACTERISTIC c_n_mis_ftp "FTP cycle engine speed threshold" VALUE 0xa1009d3a _REC_VAL_20_u2 8160. _CNV_A_R_LINEAR_____13_CM 0. 8160. DISPLAY_IDENTIFIER C_N_MIS_FTP FORMAT "%4.0" /end CHARACTERISTIC
/begin CHARACTERISTIC c_load_mis_ftp "FTP cycle engine load threshold" VALUE 0xa1009d08 _REC_VAL_20_u2 99.9969482421875 _CNV_A_R_LINEAR_____201_CM 0. 99.9969482421875 DISPLAY_IDENTIFIER C_LOAD_MIS_FTP FORMAT "%7.3" /end CHARACTERISTIC
/begin CHARACTERISTIC c_ratio_ftp_cdn_mis_a "Covering ratio to detect FTP conditions for long term protection" VALUE 0xa1009d46 _REC_VAL_20_u1 99.609375 _CNV_A_R_LINEAR_____5_CM 0. 99.609375 DISPLAY_IDENTIFIER C_RATIO_FTP_CDN_MIS_A FORMAT "%9.6" /end CHARACTERISTIC
/begin CHARACTERISTIC c_ratio_ftp_cdn_ind_mis_a "Covering ratio to detect FTP conditions for short term protection" VALUE 0xa1009d45 _REC_VAL_20_u1 99.609375 _CNV_A_R_LINEAR_____5_CM 0. 99.609375 DISPLAY_IDENTIFIER C_RATIO_FTP_CDN_IND_MIS_A FORMAT "%9.6" /end CHARACTERISTIC
/begin CHARACTERISTIC c_mis_a_min_nr "Cylinder indentification ratio for CARB A criteria detection" VALUE 0xa1009d18 _REC_VAL_20_u1 99.609375 _CNV_A_R_LINEAR_____5_CM 0. 99.609375 DISPLAY_IDENTIFIER C_MIS_A_MIN_NR FORMAT "%9.6" /end CHARACTERISTIC
/begin CHARACTERISTIC c_nr_det_max_mis_a "Maximum value to confirm misfire CARB A status detection (typical: 3) for long term protection" VALUE 0xa1009d3f _REC_VAL_20_u1 255. _CNV_A_R_LINEAR_____0_CM 0. 255. DISPLAY_IDENTIFIER C_NR_DET_MAX_MIS_A FORMAT "%3.0" /end CHARACTERISTIC
/begin CHARACTERISTIC c_mis_min_nr_puc "Minimum number of trailing throttle fuel cut-off phases LV_PUC before cancelling cylinder(s) shut-off. " VALUE 0xa1009d1c _REC_VAL_20_u1 254. _CNV_A_R_LINEAR_____0_CM 1. 255. DISPLAY_IDENTIFIER C_MIS_MIN_NR_PUC FORMAT "%3.0" /end CHARACTERISTIC
/begin CHARACTERISTIC lc_conf_inh_iv_mis "Cylinder switch back on configuration mode" VALUE 0xa1009d65 _REC_VAL_20_u1 1. _CNV_S_2_RANGE__0___1_CM 0. 1. DISPLAY_IDENTIFIER LC_CONF_INH_IV_MIS BIT_MASK 0x1 /end CHARACTERISTIC
/begin CHARACTERISTIC lc_conf_rnd_det_mis_a "Configuration for random cylinder detection " VALUE 0xa1009d6a _REC_VAL_20_u1 1. _CNV_S_2_RANGE__0___1_CM 0. 1. DISPLAY_IDENTIFIER LC_CONF_RND_DET_MIS_A BIT_MASK 0x1 /end CHARACTERISTIC
/begin CHARACTERISTIC lc_conf_mpl_det_mis_a "Configuration for multiple cylinder status set in SYM_CYL_MIS_A (multiple misfire pattern Pcode saved) (=1)" VALUE 0xa1009d68 _REC_VAL_20_u1 1. _CNV_S_2_RANGE__0___1_CM 0. 1. DISPLAY_IDENTIFIER LC_CONF_MPL_DET_MIS_A BIT_MASK 0x1 /end CHARACTERISTIC
/begin MEASUREMENT lv_mis_state_b1 "CARB B1 misfire criterion confirmed" UBYTE _CNV_S_2_RANGE__0___1_CM 1 100. 0. 1. DISPLAY_IDENTIFIER LV_MIS_STATE_B1 ECU_ADDRESS 0xd0002f6a BIT_MASK 0x1 /end MEASUREMENT
/begin MEASUREMENT lv_mis_state_b4 "CARB B4 misfire criterion confirmed (debounced)" UBYTE _CNV_S_2_RANGE__0___1_CM 1 100. 0. 1. DISPLAY_IDENTIFIER LV_MIS_STATE_B4 ECU_ADDRESS 0xd0002f6b BIT_MASK 0x1 /end MEASUREMENT
/begin MEASUREMENT lv_det_mis_b4 "CARB B4 misfire criteria detected in actual 1000 rev. window, (not debounced)" UBYTE _CNV_S_2_RANGE__0___1_CM 1 100. 0. 1. DISPLAY_IDENTIFIER LV_DET_MIS_B4 ECU_ADDRESS 0xd0002f52 BIT_MASK 0x1 /end MEASUREMENT
/begin MEASUREMENT mis_nr_tdc_b "TDC counter CARB B window (1000 crankshaft revolutions)." UWORD _CNV_A_R_LINEAR_____0_CM 1 100. 0. 65535. DISPLAY_IDENTIFIER MIS_NR_TDC_B ECU_ADDRESS 0xd0002bec FORMAT "%5.0" /end MEASUREMENT
/begin MEASUREMENT mis_sum_b "CARB B misfire sum (global)" UWORD _CNV_A_R_LINEAR_____0_CM 1 100. 0. 65535. DISPLAY_IDENTIFIER MIS_SUM_B ECU_ADDRESS 0xd0002bf4 FORMAT "%5.0" /end MEASUREMENT
/begin MEASUREMENT mis_sum_b_cbk[0] "CARB B misfire sum (cylinder bank dedicated)" UWORD _CNV_A_R_LINEAR_____0_CM 1 100. 0. 65535. DISPLAY_IDENTIFIER MIS_SUM_B_CBK[0] ECU_ADDRESS 0xd0002bf6 FORMAT "%5.0" /end MEASUREMENT
/begin MEASUREMENT mis_sum_b_cbk[1] "CARB B misfire sum (cylinder bank dedicated)" UWORD _CNV_A_R_LINEAR_____0_CM 1 100. 0. 65535. DISPLAY_IDENTIFIER MIS_SUM_B_CBK[1] ECU_ADDRESS 0xd0002bf8 FORMAT "%5.0" /end MEASUREMENT
/begin MEASUREMENT ctr_chk_mis_b4 "CARB B4 diagnosis occurence counter" UBYTE _CNV_A_R_LINEAR_____0_CM 1 100. 0. 255. DISPLAY_IDENTIFIER CTR_CHK_MIS_B4 ECU_ADDRESS 0xd0002f2d FORMAT "%3.0" /end MEASUREMENT
/begin MEASUREMENT ctr_det_mis_b4 "CARB B4 misfire criterion detected counter" UBYTE _CNV_A_R_LINEAR_____0_CM 1 100. 0. 255. DISPLAY_IDENTIFIER CTR_DET_MIS_B4 ECU_ADDRESS 0xd0002f2f FORMAT "%3.0" /end MEASUREMENT
/begin MEASUREMENT lv_end_mis_b1 "CARB B1 misfire criterion determination end" UBYTE _CNV_S_2_RANGE__0___1_CM 1 100. 0. 1. DISPLAY_IDENTIFIER LV_END_MIS_B1 ECU_ADDRESS 0xd0002f56 BIT_MASK 0x1 /end MEASUREMENT
/begin MEASUREMENT lv_end_mis_a "CARB A misfire criterion determination end" UBYTE _CNV_S_2_RANGE__0___1_CM 1 100. 0. 1. DISPLAY_IDENTIFIER LV_END_MIS_A ECU_ADDRESS 0xd0002f55 BIT_MASK 0x1 /end MEASUREMENT
/begin MEASUREMENT lv_end_mis_b4 "CARB B4 misfire criterion determination end" UBYTE _CNV_S_2_RANGE__0___1_CM 1 100. 0. 1. DISPLAY_IDENTIFIER LV_END_MIS_B4 ECU_ADDRESS 0xd0002f57 BIT_MASK 0x1 /end MEASUREMENT
/begin MEASUREMENT lv_end_win_mis_b1 "End of CARB B1 window for similar condition" UBYTE _CNV_S_2_RANGE__0___1_CM 1 100. 0. 1. DISPLAY_IDENTIFIER LV_END_WIN_MIS_B1 ECU_ADDRESS 0xd0002f59 BIT_MASK 0x1 /end MEASUREMENT
/begin MEASUREMENT lv_end_win_mis_b4 "End of CARB B4 window for similar condition" UBYTE _CNV_S_2_RANGE__0___1_CM 1 100. 0. 1. DISPLAY_IDENTIFIER LV_END_WIN_MIS_B4 ECU_ADDRESS 0xd0002f5a BIT_MASK 0x1 /end MEASUREMENT
/begin MEASUREMENT sym_cyl_mis_b1 "CARB B1 misfire criterion symptoms" UWORD _CNV_A_R_LINEAR_____0_CM 1 100. 0. 65535. DISPLAY_IDENTIFIER SYM_CYL_MIS_B1 ECU_ADDRESS 0xd0002c0c FORMAT "%5.0" /end MEASUREMENT
/begin MEASUREMENT sym_cyl_mis_b4 "CARB B4 misfire criteria symptoms" UWORD _CNV_A_R_LINEAR_____0_CM 1 100. 0. 65535. DISPLAY_IDENTIFIER SYM_CYL_MIS_B4 ECU_ADDRESS 0xd0002c0e FORMAT "%5.0" /end MEASUREMENT
/begin CHARACTERISTIC c_mis_sum_b1_thd_mt "Global threshold for CARB B1 misfire criteria detection, LV_AT = 0" VALUE 0xa1009d2a _REC_VAL_20_u2 65535. _CNV_A_R_LINEAR_____0_CM 0. 65535. DISPLAY_IDENTIFIER C_MIS_SUM_B1_THD_MT FORMAT "%5.0" /end CHARACTERISTIC
/begin CHARACTERISTIC c_mis_sum_b1_thd_at "Global threshold for  CARB B1 misfire criteria detection, LV_AT = 1" VALUE 0xa1009d28 _REC_VAL_20_u2 65535. _CNV_A_R_LINEAR_____0_CM 0. 65535. DISPLAY_IDENTIFIER C_MIS_SUM_B1_THD_AT FORMAT "%5.0" /end CHARACTERISTIC
/begin CHARACTERISTIC c_mis_sum_b4_thd_mt "Global threshold for CARB B4 misfire criteria detection, LV_AT = 0" VALUE 0xa1009d30 _REC_VAL_20_u2 65535. _CNV_A_R_LINEAR_____0_CM 0. 65535. DISPLAY_IDENTIFIER C_MIS_SUM_B4_THD_MT FORMAT "%5.0" /end CHARACTERISTIC
/begin CHARACTERISTIC c_mis_sum_b4_thd_at "Global threshold for CARB B4 misfire criterion detection, LV_AT = 1" VALUE 0xa1009d2e _REC_VAL_20_u2 65535. _CNV_A_R_LINEAR_____0_CM 0. 65535. DISPLAY_IDENTIFIER C_MIS_SUM_B4_THD_AT FORMAT "%5.0" /end CHARACTERISTIC
/begin CHARACTERISTIC c_mis_b1_min_nr "Cylinder indentification ratio for CARB B1 criteria detection" VALUE 0xa1009d19 _REC_VAL_20_u1 99.609375 _CNV_A_R_LINEAR_____5_CM 0. 99.609375 DISPLAY_IDENTIFIER C_MIS_B1_MIN_NR FORMAT "%9.6" /end CHARACTERISTIC
/begin CHARACTERISTIC c_mis_b4_min_nr "Cylinder indentification ratio for CARB B4 criteria detection" VALUE 0xa1009d1a _REC_VAL_20_u1 99.609375 _CNV_A_R_LINEAR_____5_CM 0. 99.609375 DISPLAY_IDENTIFIER C_MIS_B4_MIN_NR FORMAT "%9.6" /end CHARACTERISTIC
/begin CHARACTERISTIC c_mis_sum_b1_cbk_thd "Cylinder bank threshold for CARB B1 misfire criterion detection" VALUE 0xa1009d26 _REC_VAL_20_u2 65535. _CNV_A_R_LINEAR_____0_CM 0. 65535. DISPLAY_IDENTIFIER C_MIS_SUM_B1_CBK_THD FORMAT "%5.0" /end CHARACTERISTIC
/begin CHARACTERISTIC c_mis_sum_b4_cbk_thd "Cylinder bank threshold for CARB B4 misfire criteria detection" VALUE 0xa1009d2c _REC_VAL_20_u2 65535. _CNV_A_R_LINEAR_____0_CM 0. 65535. DISPLAY_IDENTIFIER C_MIS_SUM_B4_CBK_THD FORMAT "%5.0" /end CHARACTERISTIC
/begin CHARACTERISTIC c_nr_cyl_mpl_mis_b "Number of cylinder in MIS_Bx to set the multiple misfire CARB Bx status (typical: 2)" VALUE 0xa1009d3e _REC_VAL_20_u1 255. _CNV_A_R_LINEAR_____0_CM 0. 255. DISPLAY_IDENTIFIER C_NR_CYL_MPL_MIS_B FORMAT "%3.0" /end CHARACTERISTIC
/begin CHARACTERISTIC c_nr_det_max_mis_b4 "Maximum value of CTR_ERR_DET_MIS_B4 for misfire CARB B4 status detection (typical: 4)" VALUE 0xa1009d40 _REC_VAL_20_u1 255. _CNV_A_R_LINEAR_____0_CM 0. 255. DISPLAY_IDENTIFIER C_NR_DET_MAX_MIS_B4 FORMAT "%3.0" /end CHARACTERISTIC
/begin CHARACTERISTIC lc_conf_rnd_det_mis_b "Configuration for random cylinder detection " VALUE 0xa1009d6b _REC_VAL_20_u1 1. _CNV_S_2_RANGE__0___1_CM 0. 1. DISPLAY_IDENTIFIER LC_CONF_RND_DET_MIS_B BIT_MASK 0x1 /end CHARACTERISTIC
/begin MEASUREMENT lv_inh_iv_mis_a "At least one cylinder is shut-off by a CARB A misfire criterion confirmed" UBYTE _CNV_S_2_RANGE__0___1_CM 1 100. 0. 1. DISPLAY_IDENTIFIER LV_INH_IV_MIS_A ECU_ADDRESS 0xd0002f64 BIT_MASK 0x1 /end MEASUREMENT
/begin AXIS_PTS ldp_n_32_ip_fac_er_afs_diag_mis "" 0xa1009956 n_32 _REC_AXS_20_u1 8160. _CNV_A_R_LINEAR_____9_CM 6 0. 8160. FORMAT "%4.0" /end AXIS_PTS
/begin AXIS_PTS ldp_n__mis_a_fac_afl "" 0xa100a034 n _REC_AXS_20_u2 8160. _CNV_A_R_LINEAR_____13_CM 6 0. 8160. FORMAT "%4.0" /end AXIS_PTS
/begin AXIS_PTS ldp_load_mis_2__mis_a_fac_afl "" 0xa1009ffc load_mis_2 _REC_AXS_20_u2 99.9969482421875 _CNV_A_R_LINEAR_____201_CM 6 0. 99.9969482421875 FORMAT "%7.3" /end AXIS_PTS
/begin AXIS_PTS ldp_n__mis_a_fac_afs "" 0xa10099cc n _REC_AXS_20_u2 8160. _CNV_A_R_LINEAR_____13_CM 6 0. 8160. FORMAT "%4.0" /end AXIS_PTS
/begin AXIS_PTS ldp_load_mis_2__mis_a_fac_afs "" 0xa10098a8 load_mis_2 _REC_AXS_20_u2 99.9969482421875 _CNV_A_R_LINEAR_____201_CM 6 0. 99.9969482421875 FORMAT "%7.3" /end AXIS_PTS
/begin AXIS_PTS ldp_n__mis_a_fac_s "" 0xa1009e04 n _REC_AXS_20_u2 8160. _CNV_A_R_LINEAR_____13_CM 6 0. 8160. FORMAT "%4.0" /end AXIS_PTS
/begin AXIS_PTS ldp_load_mis_2__mis_a_fac_s "" 0xa1009da8 load_mis_2 _REC_AXS_20_u2 99.9969482421875 _CNV_A_R_LINEAR_____201_CM 6 0. 99.9969482421875 FORMAT "%7.3" /end AXIS_PTS
/begin MEASUREMENT lv_end_win_mis_a "End of CARB A window for similar condition" UBYTE _CNV_S_2_RANGE__0___1_CM 1 100. 0. 1. DISPLAY_IDENTIFIER LV_END_WIN_MIS_A ECU_ADDRESS 0xd0002f58 BIT_MASK 0x1 /end MEASUREMENT
/begin MEASUREMENT lv_mis_state_b "CARB B (B1 or B4) misfire criterion confirmed (debounced )" UBYTE _CNV_S_2_RANGE__0___1_CM 1 100. 0. 1. DISPLAY_IDENTIFIER LV_MIS_STATE_B ECU_ADDRESS 0xd0002f69 BIT_MASK 0x1 /end MEASUREMENT
/begin CHARACTERISTIC ip_mis_a_fac_s "Catalyst damage weighting factor used for MIS_A counters increment (Stratified combustion mode)" MAP 0xa1009fa4 _REC_MAP_20_u1_u2_u2 100. _CNV_A_R_LINEAR_____0_CM 0. 100. DISPLAY_IDENTIFIER IP_MIS_A_FAC_S FORMAT "%3.0"
 /begin AXIS_DESCR COM_AXIS n _CNV_A_R_LINEAR_____13_CM 6 0. 8160. FORMAT "%4.0" AXIS_PTS_REF ldp_n__mis_a_fac_s /end AXIS_DESCR
 /begin AXIS_DESCR COM_AXIS load_mis_2 _CNV_A_R_LINEAR_____201_CM 6 0. 99.9969482421875 FORMAT "%7.3" AXIS_PTS_REF ldp_load_mis_2__mis_a_fac_s /end AXIS_DESCR
/end CHARACTERISTIC
/begin AXIS_PTS ldp_n_32_ip_fac_er_afl_diag_mis "" 0xa100a00a n_32 _REC_AXS_20_u1 8160. _CNV_A_R_LINEAR_____9_CM 6 0. 8160. FORMAT "%4.0" /end AXIS_PTS
/begin CHARACTERISTIC ip_fac_igc_diag_mis "Weighting factor for ignition diagnosis (ignition failure detected)" MAP 0xa1009ab8 _REC_MAP_20_u1_u1_u2 1.9921875 _CNV_A_R_LINEAR_____100_CM 0. 1.9921875 DISPLAY_IDENTIFIER IP_FAC_IGC_DIAG_MIS FORMAT "%8.6"
 /begin AXIS_DESCR COM_AXIS n_32 _CNV_A_R_LINEAR_____9_CM 6 0. 8160. FORMAT "%4.0" AXIS_PTS_REF ldp_n_32_ip_fac_igc_diag_mis /end AXIS_DESCR
 /begin AXIS_DESCR COM_AXIS load_mis _CNV_A_R_LINEAR_____201_CM 6 0. 99.9969482421875 FORMAT "%7.3" AXIS_PTS_REF ldp_load_mis_ip_fac_igc_diag_mis /end AXIS_DESCR
/end CHARACTERISTIC
/begin CHARACTERISTIC ip_fac_iv_diag_mis "Weighting factor for injection valve diagnosis (injection valve failure detected)" MAP 0xa1009adc _REC_MAP_20_u1_u1_u2 1.9921875 _CNV_A_R_LINEAR_____100_CM 0. 1.9921875 DISPLAY_IDENTIFIER IP_FAC_IV_DIAG_MIS FORMAT "%8.6"
 /begin AXIS_DESCR COM_AXIS n_32 _CNV_A_R_LINEAR_____9_CM 6 0. 8160. FORMAT "%4.0" AXIS_PTS_REF ldp_n_32_ip_fac_iv_diag_mis /end AXIS_DESCR
 /begin AXIS_DESCR COM_AXIS load_mis _CNV_A_R_LINEAR_____201_CM 6 0. 99.9969482421875 FORMAT "%7.3" AXIS_PTS_REF ldp_load_mis_ip_fac_iv_diag_mis /end AXIS_DESCR
/end CHARACTERISTIC
/begin CHARACTERISTIC ip_mis_a_fac_afs "Catalyst damage weighting factor used for MIS_A counters increment (AFS combustion mode)" MAP 0xa1009c98 _REC_MAP_20_u1_u2_u2 100. _CNV_A_R_LINEAR_____0_CM 0. 100. DISPLAY_IDENTIFIER IP_MIS_A_FAC_AFS FORMAT "%3.0"
 /begin AXIS_DESCR COM_AXIS n _CNV_A_R_LINEAR_____13_CM 6 0. 8160. FORMAT "%4.0" AXIS_PTS_REF ldp_n__mis_a_fac_afs /end AXIS_DESCR
 /begin AXIS_DESCR COM_AXIS load_mis_2 _CNV_A_R_LINEAR_____201_CM 6 0. 99.9969482421875 FORMAT "%7.3" AXIS_PTS_REF ldp_load_mis_2__mis_a_fac_afs /end AXIS_DESCR
/end CHARACTERISTIC
/begin CHARACTERISTIC ip_mis_a_fac_afl "Catalyst damage weighting factor used for MIS_A counters increment (AFL combustion mode)" MAP 0xa100a1b0 _REC_MAP_20_u1_u2_u2 100. _CNV_A_R_LINEAR_____0_CM 0. 100. DISPLAY_IDENTIFIER IP_MIS_A_FAC_AFL FORMAT "%3.0"
 /begin AXIS_DESCR COM_AXIS n _CNV_A_R_LINEAR_____13_CM 6 0. 8160. FORMAT "%4.0" AXIS_PTS_REF ldp_n__mis_a_fac_afl /end AXIS_DESCR
 /begin AXIS_DESCR COM_AXIS load_mis_2 _CNV_A_R_LINEAR_____201_CM 6 0. 99.9969482421875 FORMAT "%7.3" AXIS_PTS_REF ldp_load_mis_2__mis_a_fac_afl /end AXIS_DESCR
/end CHARACTERISTIC
/begin MEASUREMENT ctr_mis_tot_nvmy "Overall misfire detection counter" ULONG _CNV_A_R_LINEAR_____0_CM 1 100. 0. 4294967295. DISPLAY_IDENTIFIER CTR_MIS_TOT_NVMY ECU_ADDRESS 0xd0002ba6 FORMAT "%10.0" /end MEASUREMENT
/begin MEASUREMENT ctr_mis_tot_dc "Former / current driving cycle overall misfire detection counter" UWORD _CNV_A_R_LINEAR_____0_CM 1 100. 0. 65535. DISPLAY_IDENTIFIER CTR_MIS_TOT_DC ECU_ADDRESS 0xd0002ba4 FORMAT "%5.0" /end MEASUREMENT
/begin MEASUREMENT ctr_mis_dc_cyl[0] "Former / current driving cycle misfire detection cylinder counters (ISO15031 Data $0C) " UWORD _CNV_A_R_LINEAR_____0_CM 1 100. 0. 65535. DISPLAY_IDENTIFIER CTR_MIS_DC_CYL[0] ECU_ADDRESS 0xd0002b7c FORMAT "%5.0" /end MEASUREMENT
/begin MEASUREMENT ctr_mis_dc_cyl[1] "Former / current driving cycle misfire detection cylinder counters (ISO15031 Data $0C) " UWORD _CNV_A_R_LINEAR_____0_CM 1 100. 0. 65535. DISPLAY_IDENTIFIER CTR_MIS_DC_CYL[1] ECU_ADDRESS 0xd0002b7e FORMAT "%5.0" /end MEASUREMENT
/begin MEASUREMENT ctr_mis_dc_cyl[2] "Former / current driving cycle misfire detection cylinder counters (ISO15031 Data $0C) " UWORD _CNV_A_R_LINEAR_____0_CM 1 100. 0. 65535. DISPLAY_IDENTIFIER CTR_MIS_DC_CYL[2] ECU_ADDRESS 0xd0002b80 FORMAT "%5.0" /end MEASUREMENT
/begin MEASUREMENT ctr_mis_dc_cyl[3] "Former / current driving cycle misfire detection cylinder counters (ISO15031 Data $0C) " UWORD _CNV_A_R_LINEAR_____0_CM 1 100. 0. 65535. DISPLAY_IDENTIFIER CTR_MIS_DC_CYL[3] ECU_ADDRESS 0xd0002b82 FORMAT "%5.0" /end MEASUREMENT
/begin MEASUREMENT ctr_mis_dc_cyl[4] "Former / current driving cycle misfire detection cylinder counters (ISO15031 Data $0C) " UWORD _CNV_A_R_LINEAR_____0_CM 1 100. 0. 65535. DISPLAY_IDENTIFIER CTR_MIS_DC_CYL[4] ECU_ADDRESS 0xd0002b84 FORMAT "%5.0" /end MEASUREMENT
/begin MEASUREMENT ctr_mis_dc_cyl[5] "Former / current driving cycle misfire detection cylinder counters (ISO15031 Data $0C) " UWORD _CNV_A_R_LINEAR_____0_CM 1 100. 0. 65535. DISPLAY_IDENTIFIER CTR_MIS_DC_CYL[5] ECU_ADDRESS 0xd0002b86 FORMAT "%5.0" /end MEASUREMENT
/begin MEASUREMENT ctr_mis_dc_mmv_cyl[0] "Exponential weighted moving average (EWMA) misfire counters (ISO15031 Data $0B)" UWORD _CNV_A_R_LINEAR_____0_CM 1 100. 0. 65535. DISPLAY_IDENTIFIER CTR_MIS_DC_MMV_CYL[0] ECU_ADDRESS 0xd0002b88 FORMAT "%5.0" /end MEASUREMENT
/begin MEASUREMENT ctr_mis_dc_mmv_cyl[1] "Exponential weighted moving average (EWMA) misfire counters (ISO15031 Data $0B)" UWORD _CNV_A_R_LINEAR_____0_CM 1 100. 0. 65535. DISPLAY_IDENTIFIER CTR_MIS_DC_MMV_CYL[1] ECU_ADDRESS 0xd0002b8a FORMAT "%5.0" /end MEASUREMENT
/begin MEASUREMENT ctr_mis_dc_mmv_cyl[2] "Exponential weighted moving average (EWMA) misfire counters (ISO15031 Data $0B)" UWORD _CNV_A_R_LINEAR_____0_CM 1 100. 0. 65535. DISPLAY_IDENTIFIER CTR_MIS_DC_MMV_CYL[2] ECU_ADDRESS 0xd0002b8c FORMAT "%5.0" /end MEASUREMENT
/begin MEASUREMENT ctr_mis_dc_mmv_cyl[3] "Exponential weighted moving average (EWMA) misfire counters (ISO15031 Data $0B)" UWORD _CNV_A_R_LINEAR_____0_CM 1 100. 0. 65535. DISPLAY_IDENTIFIER CTR_MIS_DC_MMV_CYL[3] ECU_ADDRESS 0xd0002b8e FORMAT "%5.0" /end MEASUREMENT
/begin MEASUREMENT ctr_mis_dc_mmv_cyl[4] "Exponential weighted moving average (EWMA) misfire counters (ISO15031 Data $0B)" UWORD _CNV_A_R_LINEAR_____0_CM 1 100. 0. 65535. DISPLAY_IDENTIFIER CTR_MIS_DC_MMV_CYL[4] ECU_ADDRESS 0xd0002b90 FORMAT "%5.0" /end MEASUREMENT
/begin MEASUREMENT ctr_mis_dc_mmv_cyl[5] "Exponential weighted moving average (EWMA) misfire counters (ISO15031 Data $0B)" UWORD _CNV_A_R_LINEAR_____0_CM 1 100. 0. 65535. DISPLAY_IDENTIFIER CTR_MIS_DC_MMV_CYL[5] ECU_ADDRESS 0xd0002b92 FORMAT "%5.0" /end MEASUREMENT
/begin CHARACTERISTIC lc_conf_mpl_det_mis_b "Configuration for multiple cylinder status set in SYM_CYL_MIS_Bx (multiple misfire pattern Pcode saved) (=1)" VALUE 0xa1009d69 _REC_VAL_20_u1 1. _CNV_S_2_RANGE__0___1_CM 0. 1. DISPLAY_IDENTIFIER LC_CONF_MPL_DET_MIS_B BIT_MASK 0x1 /end CHARACTERISTIC
/begin CHARACTERISTIC lc_conf_mis_state_b "Configuration for LV_MIS_STATE_B setting" VALUE 0xa1009d67 _REC_VAL_20_u1 1. _CNV_S_2_RANGE__0___1_CM 0. 1. DISPLAY_IDENTIFIER LC_CONF_MIS_STATE_B BIT_MASK 0x1 /end CHARACTERISTIC
/begin MEASUREMENT sum_fac_diag_mis "Sum of the weighting factor from diagnosis combinations for final misfire decision" UWORD _CNV_A_R_MISF_LINEA_430_CM 1 100. 0. 5.976 DISPLAY_IDENTIFIER SUM_FAC_DIAG_MIS ECU_ADDRESS 0xd0002c06 FORMAT "%6.4" /end MEASUREMENT
/begin CHARACTERISTIC c_t_mis_min_puc "Minimum duration of trailing throttle fuel cut-off phase to be validated like this." VALUE 0xa1009d54 _REC_VAL_20_u2 99.90000000000001 _CNV_A_R_MISF_LINEA_431_CM 0.1 100. DISPLAY_IDENTIFIER C_T_MIS_MIN_PUC FORMAT "%5.1" /end CHARACTERISTIC
/begin AXIS_PTS ldp_load_ip_fac_er_afl_diag_mis "" 0xa1009fec load_mis _REC_AXS_20_u2 99.9969482421875 _CNV_A_R_LINEAR_____201_CM 6 0. 99.9969482421875 FORMAT "%7.3" /end AXIS_PTS
/begin AXIS_PTS ldp_load_ip_fac_er_s_diag_mis "" 0xa1009d98 load_mis _REC_AXS_20_u2 99.9969482421875 _CNV_A_R_LINEAR_____201_CM 6 0. 99.9969482421875 FORMAT "%7.3" /end AXIS_PTS
/begin AXIS_PTS ldp_load_ip_fac_er_afs_diag_mis "" 0xa1009898 load_mis _REC_AXS_20_u2 99.9969482421875 _CNV_A_R_LINEAR_____201_CM 6 0. 99.9969482421875 FORMAT "%7.3" /end AXIS_PTS
/begin MEASUREMENT mis_ctr_b[0] "Misfire sums (cylinder individual) after combination in CARB B window" UWORD _CNV_A_R_LINEAR_____0_CM 1 100. 0. 65535. DISPLAY_IDENTIFIER MIS_CTR_B[0] ECU_ADDRESS 0xd0002bdc FORMAT "%5.0" /end MEASUREMENT
/begin MEASUREMENT mis_ctr_b[1] "Misfire sums (cylinder individual) after combination in CARB B window" UWORD _CNV_A_R_LINEAR_____0_CM 1 100. 0. 65535. DISPLAY_IDENTIFIER MIS_CTR_B[1] ECU_ADDRESS 0xd0002bde FORMAT "%5.0" /end MEASUREMENT
/begin MEASUREMENT mis_ctr_b[2] "Misfire sums (cylinder individual) after combination in CARB B window" UWORD _CNV_A_R_LINEAR_____0_CM 1 100. 0. 65535. DISPLAY_IDENTIFIER MIS_CTR_B[2] ECU_ADDRESS 0xd0002be0 FORMAT "%5.0" /end MEASUREMENT
/begin MEASUREMENT mis_ctr_b[3] "Misfire sums (cylinder individual) after combination in CARB B window" UWORD _CNV_A_R_LINEAR_____0_CM 1 100. 0. 65535. DISPLAY_IDENTIFIER MIS_CTR_B[3] ECU_ADDRESS 0xd0002be2 FORMAT "%5.0" /end MEASUREMENT
/begin MEASUREMENT mis_ctr_b[4] "Misfire sums (cylinder individual) after combination in CARB B window" UWORD _CNV_A_R_LINEAR_____0_CM 1 100. 0. 65535. DISPLAY_IDENTIFIER MIS_CTR_B[4] ECU_ADDRESS 0xd0002be4 FORMAT "%5.0" /end MEASUREMENT
/begin MEASUREMENT mis_ctr_b[5] "Misfire sums (cylinder individual) after combination in CARB B window" UWORD _CNV_A_R_LINEAR_____0_CM 1 100. 0. 65535. DISPLAY_IDENTIFIER MIS_CTR_B[5] ECU_ADDRESS 0xd0002be6 FORMAT "%5.0" /end MEASUREMENT
/begin MEASUREMENT ctr_mis_a_lih_cyl[0] "Cylinder dedicated counters for CARB A Limp-home phases on current DC" UBYTE _CNV_A_R_LINEAR_____0_CM 1 100. 0. 255. DISPLAY_IDENTIFIER CTR_MIS_A_LIH_CYL[0] ECU_ADDRESS 0xd0002b76 FORMAT "%3.0" /end MEASUREMENT
/begin MEASUREMENT ctr_mis_a_lih_cyl[1] "Cylinder dedicated counters for CARB A Limp-home phases on current DC" UBYTE _CNV_A_R_LINEAR_____0_CM 1 100. 0. 255. DISPLAY_IDENTIFIER CTR_MIS_A_LIH_CYL[1] ECU_ADDRESS 0xd0002b77 FORMAT "%3.0" /end MEASUREMENT
/begin MEASUREMENT ctr_mis_a_lih_cyl[2] "Cylinder dedicated counters for CARB A Limp-home phases on current DC" UBYTE _CNV_A_R_LINEAR_____0_CM 1 100. 0. 255. DISPLAY_IDENTIFIER CTR_MIS_A_LIH_CYL[2] ECU_ADDRESS 0xd0002b78 FORMAT "%3.0" /end MEASUREMENT
/begin MEASUREMENT ctr_mis_a_lih_cyl[3] "Cylinder dedicated counters for CARB A Limp-home phases on current DC" UBYTE _CNV_A_R_LINEAR_____0_CM 1 100. 0. 255. DISPLAY_IDENTIFIER CTR_MIS_A_LIH_CYL[3] ECU_ADDRESS 0xd0002b79 FORMAT "%3.0" /end MEASUREMENT
/begin MEASUREMENT ctr_mis_a_lih_cyl[4] "Cylinder dedicated counters for CARB A Limp-home phases on current DC" UBYTE _CNV_A_R_LINEAR_____0_CM 1 100. 0. 255. DISPLAY_IDENTIFIER CTR_MIS_A_LIH_CYL[4] ECU_ADDRESS 0xd0002b7a FORMAT "%3.0" /end MEASUREMENT
/begin MEASUREMENT ctr_mis_a_lih_cyl[5] "Cylinder dedicated counters for CARB A Limp-home phases on current DC" UBYTE _CNV_A_R_LINEAR_____0_CM 1 100. 0. 255. DISPLAY_IDENTIFIER CTR_MIS_A_LIH_CYL[5] ECU_ADDRESS 0xd0002b7b FORMAT "%3.0" /end MEASUREMENT
/begin CHARACTERISTIC c_mis_a_ind_thd_mt "Cylinder individual threshold used for cylinder shut-off during CARB A criterion window with MT" VALUE 0xa1009d16 _REC_VAL_20_u2 65535. _CNV_A_R_LINEAR_____0_CM 0. 65535. DISPLAY_IDENTIFIER C_MIS_A_IND_THD_MT FORMAT "%5.0" /end CHARACTERISTIC
/begin CHARACTERISTIC c_mis_a_ind_thd_at "Cylinder individual threshold used for cylinder shut-off during CARB A criterion window with AT" VALUE 0xa1009d14 _REC_VAL_20_u2 65535. _CNV_A_R_LINEAR_____0_CM 0. 65535. DISPLAY_IDENTIFIER C_MIS_A_IND_THD_AT FORMAT "%5.0" /end CHARACTERISTIC
/begin CHARACTERISTIC c_mis_sum_a_thd_mt "Cylinder global threshold for misfire status CARB A detection with MT" VALUE 0xa1009d24 _REC_VAL_20_u2 65535. _CNV_A_R_LINEAR_____0_CM 0. 65535. DISPLAY_IDENTIFIER C_MIS_SUM_A_THD_MT FORMAT "%5.0" /end CHARACTERISTIC
/begin CHARACTERISTIC c_mis_sum_a_thd_at "Cylinder global threshold for misfire status CARB A detection with AT" VALUE 0xa1009d22 _REC_VAL_20_u2 65535. _CNV_A_R_LINEAR_____0_CM 0. 65535. DISPLAY_IDENTIFIER C_MIS_SUM_A_THD_AT FORMAT "%5.0" /end CHARACTERISTIC
/begin CHARACTERISTIC c_mis_sum_a_cbk_thd_mt "Cylinder bank threshold for misfire status CARB A detection with MT" VALUE 0xa1009d20 _REC_VAL_20_u2 65535. _CNV_A_R_LINEAR_____0_CM 0. 65535. DISPLAY_IDENTIFIER C_MIS_SUM_A_CBK_THD_MT FORMAT "%5.0" /end CHARACTERISTIC
/begin CHARACTERISTIC c_mis_sum_a_cbk_thd_at "Cylinder bank threshold for misfire status CARB A detection with AT" VALUE 0xa1009d1e _REC_VAL_20_u2 65535. _CNV_A_R_LINEAR_____0_CM 0. 65535. DISPLAY_IDENTIFIER C_MIS_SUM_A_CBK_THD_AT FORMAT "%5.0" /end CHARACTERISTIC
/begin CHARACTERISTIC c_nr_cyl_mpl_mis_a "Number of cylinder in MIS_A to set the multiple misfire CARB A status (typical: 2)" VALUE 0xa1009d3d _REC_VAL_20_u1 255. _CNV_A_R_LINEAR_____0_CM 0. 255. DISPLAY_IDENTIFIER C_NR_CYL_MPL_MIS_A FORMAT "%3.0" /end CHARACTERISTIC
/begin CHARACTERISTIC c_nr_max_mis_a_lih_cyl "Maximum number of MIS_A cylinder limp-home cycle to disable fuel reactivation during current DC" VALUE 0xa1009d41 _REC_VAL_20_u1 255. _CNV_A_R_LINEAR_____0_CM 0. 255. DISPLAY_IDENTIFIER C_NR_MAX_MIS_A_LIH_CYL FORMAT "%3.0" /end CHARACTERISTIC
/begin CHARACTERISTIC lc_conf_mis_a_lih "Configuration to select MIL mode" VALUE 0xa1009d66 _REC_VAL_20_u1 1. _CNV_S_2_RANGE__0___1_CM 0. 1. DISPLAY_IDENTIFIER LC_CONF_MIS_A_LIH BIT_MASK 0x1 /end CHARACTERISTIC
/begin CHARACTERISTIC lc_ena_mis_a_ind_lih "Enable the misfire cylinder limp home process during the CARB A window (short term catalyst protection) (1 = active)" VALUE 0xa1009d6e _REC_VAL_20_u1 1. _CNV_S_2_RANGE__0___1_CM 0. 1. DISPLAY_IDENTIFIER LC_ENA_MIS_A_IND_LIH BIT_MASK 0x1 /end CHARACTERISTIC
/begin CHARACTERISTIC lc_ena_mis_a_lih "Enable the misfire cylinder limp home process at the end of the CARB A window (long term catalyst protection) (1 = active)" VALUE 0xa1009d6f _REC_VAL_20_u1 1. _CNV_S_2_RANGE__0___1_CM 0. 1. DISPLAY_IDENTIFIER LC_ENA_MIS_A_LIH BIT_MASK 0x1 /end CHARACTERISTIC
/begin AXIS_PTS ldpm_n_32_1_misf "" 0xa1009a2c n_32 _REC_AXS_20_u1 8160. _CNV_A_R_LINEAR_____9_CM 8 0. 8160. FORMAT "%4.0" /end AXIS_PTS
/begin CHARACTERISTIC id_nr_det_ena_mis_a_lih_mt "Number of CARB A detections to enable MIS_A cylinder switch-off limp-home for MT" CURVE 0xa1009a4c _REC_CUR_20_u1_u1 255. _CNV_A_R_LINEAR_____0_CM 0. 255. DISPLAY_IDENTIFIER ID_NR_DET_ENA_MIS_A_LIH_MT FORMAT "%3.0"
 /begin AXIS_DESCR COM_AXIS n_32 _CNV_A_R_LINEAR_____9_CM 8 0. 8160. FORMAT "%4.0" AXIS_PTS_REF ldpm_n_32_1_misf /end AXIS_DESCR
/end CHARACTERISTIC
/begin CHARACTERISTIC id_nr_det_ena_mis_a_lih_at "Number of CARB A detections to enable MIS_A cylinder switch-off limp-home for AT" CURVE 0xa1009a44 _REC_CUR_20_u1_u1 255. _CNV_A_R_LINEAR_____0_CM 0. 255. DISPLAY_IDENTIFIER ID_NR_DET_ENA_MIS_A_LIH_AT FORMAT "%3.0"
 /begin AXIS_DESCR COM_AXIS n_32 _CNV_A_R_LINEAR_____9_CM 8 0. 8160. FORMAT "%4.0" AXIS_PTS_REF ldpm_n_32_1_misf /end AXIS_DESCR
/end CHARACTERISTIC
/begin CHARACTERISTIC ip_fac_er_afs_diag_mis "Weighting factor for irregular engine operation (engine speed analysis) in AFS combustion mode" MAP 0xa1009a94 _REC_MAP_20_u1_u1_u2 1.9921875 _CNV_A_R_LINEAR_____100_CM 0. 1.9921875 DISPLAY_IDENTIFIER IP_FAC_ER_AFS_DIAG_MIS FORMAT "%8.6"
 /begin AXIS_DESCR COM_AXIS n_32 _CNV_A_R_LINEAR_____9_CM 6 0. 8160. FORMAT "%4.0" AXIS_PTS_REF ldp_n_32_ip_fac_er_afs_diag_mis /end AXIS_DESCR
 /begin AXIS_DESCR COM_AXIS load_mis _CNV_A_R_LINEAR_____201_CM 6 0. 99.9969482421875 FORMAT "%7.3" AXIS_PTS_REF ldp_load_ip_fac_er_afs_diag_mis /end AXIS_DESCR
/end CHARACTERISTIC
/begin CHARACTERISTIC ip_fac_er_afl_diag_mis "Weighting factor for irregular engine operation (engine speed analysis) in AFL combustion mode" MAP 0xa100a054 _REC_MAP_20_u1_u1_u2 1.9921875 _CNV_A_R_LINEAR_____100_CM 0. 1.9921875 DISPLAY_IDENTIFIER IP_FAC_ER_AFL_DIAG_MIS FORMAT "%8.6"
 /begin AXIS_DESCR COM_AXIS n_32 _CNV_A_R_LINEAR_____9_CM 6 0. 8160. FORMAT "%4.0" AXIS_PTS_REF ldp_n_32_ip_fac_er_afl_diag_mis /end AXIS_DESCR
 /begin AXIS_DESCR COM_AXIS load_mis _CNV_A_R_LINEAR_____201_CM 6 0. 99.9969482421875 FORMAT "%7.3" AXIS_PTS_REF ldp_load_ip_fac_er_afl_diag_mis /end AXIS_DESCR
/end CHARACTERISTIC
/begin CHARACTERISTIC ip_fac_er_s_diag_mis "Weighting factor for irregular engine operation (engine speed analysis) in S combustion mode" MAP 0xa1009e24 _REC_MAP_20_u1_u1_u2 1.9921875 _CNV_A_R_LINEAR_____100_CM 0. 1.9921875 DISPLAY_IDENTIFIER IP_FAC_ER_S_DIAG_MIS FORMAT "%8.6"
 /begin AXIS_DESCR COM_AXIS n_32 _CNV_A_R_LINEAR_____9_CM 6 0. 8160. FORMAT "%4.0" AXIS_PTS_REF ldp_n_32_ip_fac_er_s_diag_mis /end AXIS_DESCR
 /begin AXIS_DESCR COM_AXIS load_mis _CNV_A_R_LINEAR_____201_CM 6 0. 99.9969482421875 FORMAT "%7.3" AXIS_PTS_REF ldp_load_ip_fac_er_s_diag_mis /end AXIS_DESCR
/end CHARACTERISTIC
/begin MEASUREMENT n_tooth_cus "fast engine speed generated especially for engine start (independently of C_N_FAST_SWI)" UWORD _CNV_A_R_LINEAR_____13_CM 1 100. 0. 8160. DISPLAY_IDENTIFIER N_TOOTH_CUS ECU_ADDRESS 0xd00025a0 FORMAT "%4.0" /end MEASUREMENT
/begin MEASUREMENT lv_err_cam_cus "Customer specific CAM error" UBYTE _CNV_S_2_RANGE__0___1_CM 1 100. 0. 1. DISPLAY_IDENTIFIER LV_ERR_CAM_CUS ECU_ADDRESS 0xd0002def BIT_MASK 0x1 /end MEASUREMENT
/begin COMPU_METHOD _CNV_A_R_LINEAR_____0_CM "" RAT_FUNC "%6.3" "-" COEFFS 0 1. 0. 0 0 1 /end COMPU_METHOD
/begin COMPU_METHOD _CNV_S_2_RANGE__0___1_CM "" TAB_VERB "%6.3" "-" COMPU_TAB_REF _CNV_S_2_RANGE__0___1 /end COMPU_METHOD
/begin COMPU_VTAB _CNV_S_2_RANGE__0___1 "" TAB_VERB 2 0 "0" 1 "1" /end COMPU_VTAB
/begin COMPU_METHOD _CNV_A_R_LINEAR_____3_CM "" RAT_FUNC "%6.3" "s" COEFFS 0 100. 0. 0 0 1 /end COMPU_METHOD
/begin COMPU_METHOD _CNV_A_R_LINEAR_____5_CM "" RAT_FUNC "%6.3" "%" COEFFS 0 2.56 0. 0 0 1 /end COMPU_METHOD
/begin COMPU_METHOD _CNV_A_R_LINEAR_____9_CM "" RAT_FUNC "%6.3" "rpm" COEFFS 0 3.125e-002 0. 0 0 1 /end COMPU_METHOD
/begin COMPU_METHOD _CNV_A_R_LINEAR_____13_CM "" RAT_FUNC "%6.3" "rpm" COEFFS 0 1. 0. 0 0 1 /end COMPU_METHOD
/begin COMPU_METHOD _CNV_A_R_LINEAR_____16_CM "" RAT_FUNC "%6.3" "°C" COEFFS 0 1.333333333333333 64. 0 0 1 /end COMPU_METHOD
/begin COMPU_METHOD _CNV_A_R_LINEAR_____26_CM "" RAT_FUNC "%6.3" "hPa" COEFFS 0 12.06017666543982 0. 0 0 1 /end COMPU_METHOD
/begin COMPU_METHOD _CNV_A_R_LINEAR_____27_CM "" RAT_FUNC "%6.3" "-" COEFFS 0 256. 0. 0 0 1 /end COMPU_METHOD
/begin COMPU_METHOD _CNV_A_R_LINEAR_____29_CM "" RAT_FUNC "%6.3" "rpm/s" COEFFS 0 3.125e-002 0. 0 0 1 /end COMPU_METHOD
/begin COMPU_METHOD _CNV_A_R_LINEAR_____30_CM "" RAT_FUNC "%6.3" "Nm" COEFFS 0 32. 0. 0 0 1 /end COMPU_METHOD
/begin COMPU_METHOD _CNV_A_R_LINEAR_____50_CM "" RAT_FUNC "%6.3" "" COEFFS 0 1. 0. 0 0 1 /end COMPU_METHOD
/begin COMPU_METHOD _CNV_A_R_LINEAR_____65_CM "" RAT_FUNC "%6.3" "Nm" COEFFS 0 32. 32768. 0 0 1 /end COMPU_METHOD
/begin COMPU_METHOD _CNV_A_R_LINEAR_____68_CM "" RAT_FUNC "%6.3" "-" COEFFS 0 65535.99999999996 0. 0 0 1 /end COMPU_METHOD
/begin COMPU_METHOD _CNV_A_R_LINEAR_____100_CM "" RAT_FUNC "%6.3" "-" COEFFS 0 128. 0. 0 0 1 /end COMPU_METHOD
/begin COMPU_METHOD _CNV_A_R_LINEAR_____108_CM "" RAT_FUNC "%6.3" "mg/stk" COEFFS 0 47.18142548596112 0. 0 0 1 /end COMPU_METHOD
/begin COMPU_METHOD _CNV_A_R_LINEAR_____166_CM "" RAT_FUNC "%6.3" "°CRK" COEFFS 0 16. 0. 0 0 1 /end COMPU_METHOD
/begin COMPU_METHOD _CNV_A_R_LINEAR_____167_CM "" RAT_FUNC "%6.3" "°CRK" COEFFS 0 2.666666666666667 95. 0 0 1 /end COMPU_METHOD
/begin COMPU_METHOD _CNV_A_R_LINEAR_____168_CM "" RAT_FUNC "%6.3" "°CRK" COEFFS 0 2.666666666666667 0. 0 0 1 /end COMPU_METHOD
/begin COMPU_METHOD _CNV_A_R_LINEAR_____171_CM "" RAT_FUNC "%6.3" "°CRK" COEFFS 0 2.666666666666667 128. 0 0 1 /end COMPU_METHOD
/begin COMPU_METHOD _CNV_A_R_LINEAR_____201_CM "" RAT_FUNC "%6.3" "%" COEFFS 0 327.68 0. 0 0 1 /end COMPU_METHOD
/begin COMPU_METHOD _CNV_A_R_LINEAR_____221_CM "" RAT_FUNC "%6.3" "°TPS" COEFFS 0 137.0962343096234 0. 0 0 1 /end COMPU_METHOD
/begin COMPU_METHOD _CNV_A_R_LINEAR_____260_CM "" RAT_FUNC "%6.3" "°TPS/s" COEFFS 0 8.535564853556485e-002 0. 0 0 1 /end COMPU_METHOD
/begin COMPU_METHOD _CNV_A_R_EVAC_LINEA_314_CM "" RAT_FUNC "%6.3" "-" COEFFS 0 16. 0. 0 0 1 /end COMPU_METHOD
/begin COMPU_METHOD _CNV_A_R_ENRD_LINEA_397_CM "" RAT_FUNC "%6.3" "%." COEFFS 0 65.41078491943799 0. 0 0 1 /end COMPU_METHOD
/begin COMPU_METHOD _CNV_A_R_ENRD_LINEA_398_CM "" RAT_FUNC "%6.3" "%." COEFFS 0 4194.293686959193 -8.057063130399911e-002 0 0 1 /end COMPU_METHOD
/begin COMPU_METHOD _CNV_A_R_ENRD_LINEA_399_CM "" RAT_FUNC "%6.3" "%." COEFFS 0 65.408 0. 0 0 1 /end COMPU_METHOD
/begin COMPU_METHOD _CNV_A_R_ENRD_LINEA_400_CM "" RAT_FUNC "%6.3" "%." COEFFS 0 4194.283373654366 0. 0 0 1 /end COMPU_METHOD
/begin COMPU_METHOD _CNV_A_R_LINEAR_____401_CM "" RAT_FUNC "%6.3" "µs" COEFFS 0 1. 0. 0 0 1 /end COMPU_METHOD
/begin COMPU_METHOD _CNV_A_R_LINEAR_____404_CM "" RAT_FUNC "%6.3" "-" COEFFS 0 100. 0. 0 0 1 /end COMPU_METHOD
/begin COMPU_METHOD _CNV_A_R_ENRD_LINEA_405_CM "" RAT_FUNC "%6.3" "%." COEFFS 0 4194.293686959193 32767.9194293687 0 0 1 /end COMPU_METHOD
/begin COMPU_METHOD _CNV_A_R_ENSD_LINEA_406_CM "" RAT_FUNC "%6.3" "rpm/s" COEFFS 0 1. 0. 0 0 1 /end COMPU_METHOD
/begin COMPU_METHOD _CNV_A_R_LINEAR_____407_CM "" RAT_FUNC "%6.3" "s" COEFFS 0 250000. 0. 0 0 1 /end COMPU_METHOD
/begin COMPU_METHOD _CNV_A_R_ENSD_LINEA_408_CM "" RAT_FUNC "%6.3" "°CRK" COEFFS 0 16. 512. 0 0 1 /end COMPU_METHOD
/begin COMPU_METHOD _CNV_A_R_LINEAR_____409_CM "" RAT_FUNC "%6.3" "°CRK" COEFFS 0 2.666666666666667 256. 0 0 1 /end COMPU_METHOD
/begin COMPU_METHOD _CNV_A_R_ENSD_LINEA_410_CM "" RAT_FUNC "%6.3" "°CRK" COEFFS 0 16. 2048. 0 0 1 /end COMPU_METHOD
/begin COMPU_METHOD _CNV_A_R_ENSD_LINEA_411_CM "" RAT_FUNC "%6.3" "°CRK" COEFFS 0 16. 768. 0 0 1 /end COMPU_METHOD
/begin COMPU_METHOD _CNV_A_R_LINEAR_____412_CM "" RAT_FUNC "%6.3" "-" COEFFS 0 1. -1. 0 0 1 /end COMPU_METHOD
/begin COMPU_METHOD _CNV_A_R_LINEAR_____413_CM "" RAT_FUNC "%6.3" "s" COEFFS 0 4201656.398697721 0. 0 0 1 /end COMPU_METHOD
/begin COMPU_METHOD _CNV_A_R_ENSD_LINEA_414_CM "" RAT_FUNC "%6.3" "s" COEFFS 0 4201678.146825826 0. 0 0 1 /end COMPU_METHOD
/begin COMPU_METHOD _CNV_A_R_ENSD_LINEA_415_CM "" RAT_FUNC "%6.3" "°C" COEFFS 0 1. 50. 0 0 1 /end COMPU_METHOD
/begin COMPU_METHOD _CNV_A_R_ENSD_LINEA_416_CM "" RAT_FUNC "%6.3" "V" COEFFS 0 8.854166666666666 0. 0 0 1 /end COMPU_METHOD
/begin COMPU_METHOD _CNV_A_R_LINEAR_____425_CM "" RAT_FUNC "%6.3" "tdc" COEFFS 0 1. 0. 0 0 1 /end COMPU_METHOD
/begin COMPU_METHOD _CNV_A_R_MISF_LINEA_426_CM "" RAT_FUNC "%6.3" "%" COEFFS 0 327.6800007936242 16384.00003968121 0 0 1 /end COMPU_METHOD
/begin COMPU_METHOD _CNV_S_5_MISF_RANGE_427_CM "" TAB_VERB "%6.3" "-" COMPU_TAB_REF _CNV_S_5_MISF_RANGE_427 /end COMPU_METHOD
/begin COMPU_VTAB _CNV_S_5_MISF_RANGE_427 "" TAB_VERB 5 0 "Init Phase" 1 "Prepa. 0 delay" 2 "0 delay monit." 3 "Prepa nominal" 4 "Nominal monit." /end COMPU_VTAB
/begin COMPU_METHOD _CNV_A_R_LINEAR_____428_CM "" RAT_FUNC "%6.3" "-" COEFFS 0 256.0000007500115 0. 0 0 1 /end COMPU_METHOD
/begin COMPU_METHOD _CNV_A_R_LINEAR_____429_CM "" RAT_FUNC "%6.3" "-" COEFFS 0 1. 32768. 0 0 1 /end COMPU_METHOD
/begin COMPU_METHOD _CNV_A_R_MISF_LINEA_430_CM "" RAT_FUNC "%6.3" "-" COEFFS 0 128.0120481927711 0. 0 0 1 /end COMPU_METHOD
/begin COMPU_METHOD _CNV_A_R_MISF_LINEA_431_CM "" RAT_FUNC "%6.3" "-" COEFFS 0 10. 0. 0 0 1 /end COMPU_METHOD
/begin RECORD_LAYOUT _REC_VAL_20_u1 FNC_VALUES 1 UBYTE COLUMN_DIR DIRECT /end RECORD_LAYOUT
/begin RECORD_LAYOUT _REC_VAL_20_u2 FNC_VALUES 1 UWORD COLUMN_DIR DIRECT /end RECORD_LAYOUT
/begin RECORD_LAYOUT _REC_AXS_20_u1 NO_AXIS_PTS_X 1 UBYTE AXIS_PTS_X 2 UBYTE INDEX_INCR DIRECT /end RECORD_LAYOUT
/begin RECORD_LAYOUT _REC_MAP_20_u2_u1_u1 FNC_VALUES 1 UWORD COLUMN_DIR DIRECT /end RECORD_LAYOUT
/begin RECORD_LAYOUT _REC_CUR_20_u1_u1 FNC_VALUES 1 UBYTE COLUMN_DIR DIRECT /end RECORD_LAYOUT
/begin RECORD_LAYOUT _REC_AXS_20_u2 NO_AXIS_PTS_X 1 UWORD AXIS_PTS_X 2 UWORD INDEX_INCR DIRECT /end RECORD_LAYOUT
/begin RECORD_LAYOUT _REC_CUR_20_u2_u1 FNC_VALUES 1 UWORD COLUMN_DIR DIRECT /end RECORD_LAYOUT
/begin RECORD_LAYOUT _REC_CUR_20_u2_u2 FNC_VALUES 1 UWORD COLUMN_DIR DIRECT /end RECORD_LAYOUT
/begin RECORD_LAYOUT _REC_MAP_20_u2_u1_u2 FNC_VALUES 1 UWORD COLUMN_DIR DIRECT /end RECORD_LAYOUT
/begin RECORD_LAYOUT _REC_CUR_20_u1_u2 FNC_VALUES 1 UBYTE COLUMN_DIR DIRECT /end RECORD_LAYOUT
/begin RECORD_LAYOUT _REC_MAP_20_u2_u2_u2 FNC_VALUES 1 UWORD COLUMN_DIR DIRECT /end RECORD_LAYOUT
/begin RECORD_LAYOUT _REC_MAP_20_u1_u2_u2 FNC_VALUES 1 UBYTE COLUMN_DIR DIRECT /end RECORD_LAYOUT
/begin RECORD_LAYOUT _REC_VAL_20_u4 FNC_VALUES 1 ULONG COLUMN_DIR DIRECT /end RECORD_LAYOUT
/begin RECORD_LAYOUT _REC_MAP_20_u1_u1_u2 FNC_VALUES 1 UBYTE COLUMN_DIR DIRECT /end RECORD_LAYOUT
/begin FUNCTION ENRD_Calculation_Appli_Inci "" /begin DEF_CHARACTERISTIC lc_seg_ad_rst_ena_eol c_gr_inh_er_ad_at c_gr_inh_er_ad_mt /end DEF_CHARACTERISTIC
 /begin OUT_MEASUREMENT lv_inh_app_er_ad lv_inh_obd_er_ad lv_seg_ad_rst_er_eol lv_req_seg_ad_mmv_er_app seg_ad_mmv_er_app[0] seg_ad_mmv_er_app[1] seg_ad_mmv_er_app[2] seg_ad_mmv_er_app[3] seg_ad_mmv_er_app[4] seg_ad_mmv_er_app[5] er_av_quo /end OUT_MEASUREMENT
/end FUNCTION
/begin FUNCTION ENRD_Segment_Time_Correction ""
 /begin DEF_CHARACTERISTIC c_seg_t_mes_max c_seg_t_mes_min ldpm_n_32_1_enrd ldpm_n_32_6_enrd ip_seg_ad_cor_er_mt_1 ip_seg_ad_cor_er_at_1 ip_seg_ad_cor_er_mt_2 ip_seg_ad_cor_er_at_2 /end DEF_CHARACTERISTIC
 /begin OUT_MEASUREMENT seg_ad_cor_er seg_nr_mes seg_t_mes seg_t_cor_buf[0] seg_t_cor_buf[1] seg_t_cor_buf[2] seg_t_cor_buf[3] seg_t_cor_buf[4] seg_t_cor_buf[5] seg_t_cor_buf[6] seg_t_cor lv_ena_seg_t_mes seg_t_mes_cyl[0] seg_t_mes_cyl[1] seg_t_mes_cyl[2] seg_t_mes_cyl[3] seg_t_mes_cyl[4] seg_t_mes_cyl[5] /end OUT_MEASUREMENT
/end FUNCTION
/begin FUNCTION ENRD_Adaptive_Learning_Process ""
 /begin DEF_CHARACTERISTIC c_crk_dif_max_er c_seg_ad_max_er c_seg_ad_dif_max_er ldp_maf_ip_maf_dif_max_er_ad ldp_load_mis_ip_load_grd_er_ad ldp_tps_av_ip_tps_grd_max_er c_t_maf_dif_dly_er_ad c_t_load_grd_dly_er_ad c_t_tps_grd_dly_er_ad c_t_accout_dly_er_ad c_drv1_max_seg_ad_er_eol c_nr_seg_ad_act_min_er_eol c_nr_seg_drv1_min_er_eol lc_seg_ad_er_req_eol c_n_seg_t_ad_raw_max_er c_n_seg_t_ad_raw_min_er c_drv1_max_seg_ad_er c_nr_seg_ad_act_min_er c_nr_seg_drv1_min_er c_crlc_seg_ad_er c_crlc_seg_ad_er_eol c_nr_seg_ad_avl_er lc_seg_ad_lim_reac_er c_crlc_fast_seg_ad_er c_crlc_seg_ad_raw_er ip_maf_dif_max_er_ad ip_load_grd_er_ad ip_tps_grd_max_er_ad c_mask_seg_ad_fdout_er c_n_max_seg_ad_er_eol_mt c_n_max_seg_ad_er_eol_at c_n_min_seg_ad_er_eol_mt c_n_min_seg_ad_er_eol_at c_n_max_seg_ad_er_mt c_n_max_seg_ad_er_at c_n_min_seg_ad_er_mt c_n_min_seg_ad_er_at /end DEF_CHARACTERISTIC
 /begin OUT_MEASUREMENT delta_crk_dif_max_er seg_ad_mmv_er[0] seg_ad_mmv_er[1] seg_ad_mmv_er[2] seg_ad_mmv_er[3] seg_ad_mmv_er[4] seg_ad_mmv_er[5] seg_ad_raw_mmv_er[0] seg_ad_raw_mmv_er[1] seg_ad_raw_mmv_er[2] seg_ad_raw_mmv_er[3] seg_ad_raw_mmv_er[4] seg_ad_raw_mmv_er[5] seg_ad_dif_er_0 seg_ad_dif_er_1 seg_ad_dif_er_2 thd_ad_er lv_seg_ad_fdout_er lv_seg_ad_dif_max_er lv_seg_ad_fdout_er_eol crlc_seg_ad_er ctr_seg_ad_er lv_seg_ad_avl_er lv_seg_ad_er lv_seg_ad_raw_er lv_seg_ad_lim_er seg_ad_fdout_er_cdn seg_ad_fdout_er_cdn.lv_inh_maf_dif_er_ad seg_ad_fdout_er_cdn.lv_inh_load_grd_max_er_ad seg_ad_fdout_er_cdn.lv_inh_tps_grd_er_ad seg_ad_fdout_er_cdn.lv_inh_acc_er_ad seg_ad_fdout_er_cdn_nr /end OUT_MEASUREMENT
/end FUNCTION
/begin FUNCTION C_A_ENRD "" /begin SUB_FUNCTION ENRD_Diagnosis ENRD_Diagnosis_Appli_Inci /end SUB_FUNCTION /end FUNCTION
/begin FUNCTION ENRD_Diagnosis ""
 /begin DEF_CHARACTERISTIC lc_cdn_diag_seg_ad_er c_abc_inc_seg_ad_er c_abc_inc_t_seg_er c_abc_max_seg_ad_er c_abc_max_t_seg_er /end DEF_CHARACTERISTIC
 /begin OUT_MEASUREMENT lv_err_t_seg_er lv_err_seg_ad_er /end OUT_MEASUREMENT
/end FUNCTION
/begin FUNCTION ENRD_Diagnosis_Appli_Inci "" /end FUNCTION
/begin FUNCTION C_4_ENSD "C_4_ENSD" /begin DEF_CHARACTERISTIC ldpm_n_32_1_ensd ldpm_n_32_2_ensd /end DEF_CHARACTERISTIC
 /begin SUB_FUNCTION ENSD_Engine_position_control ENSD_Engine_pos_speed_calc ENSD_Camshaft_adaptation ENSD_Synchro_det_in_Cam_LH /end SUB_FUNCTION
/end FUNCTION
/begin FUNCTION ENSD_Engine_position_control "Engine_position_control"
 /begin DEF_CHARACTERISTIC lc_inh_lih_crk lc_inh_lih_cam c_nr_vld_cam_syn_crk c_t_dly_stop_eng /end DEF_CHARACTERISTIC
 /begin OUT_MEASUREMENT lv_run_eng lv_syn_eng lv_syn_vld lv_lih_err_crk lv_lih_err_cam lv_act_crk lv_err_lih_crk_cam ctr_vld_cam_syn_crk lv_first_vld_tooth lv_timeout_cam_syn_crk idx_n_ctl_ex[0].lv_act_cam idx_n_ctl_ex[0].lv_act_lih_crk_cam idx_n_ctl_ex[0].lv_act_syn_crk_cam idx_n_ctl_in[0].lv_act_cam idx_n_ctl_in[0].lv_act_lih_crk_cam idx_n_ctl_in[0].lv_act_syn_crk_cam lv_err_cam lv_eng_back_det lv_eng_back_cfm lv_crk_miss_run_eng /end OUT_MEASUREMENT
/end FUNCTION
/begin FUNCTION ENSD_Engine_pos_speed_calc "Engine_pos_speed_calc"
 /begin DEF_CHARACTERISTIC ldp_n_32_id_crk_pha_cor c_n_tooth_end c_n_fast_swi c_fac_n_fast id_crk_pha_cor /end DEF_CHARACTERISTIC
 /begin OUT_MEASUREMENT n_grd_h_res n_mmv n_grd seg_ctr psn_eng_syn_min psn_eng_syn_max n_32 n_tooth t_seg_half_av t_crk_win seg_nr n n_fast t_seg_av id_seg_nr[0] id_seg_nr[1] id_seg_nr[2] id_seg_nr[3] id_seg_nr[4] id_seg_nr[5] n_tooth_cus lv_err_cam_cus /end OUT_MEASUREMENT
/end FUNCTION
/begin FUNCTION ENSD_Camshaft_adaptation "Camshaft_adaptation"
 /begin DEF_CHARACTERISTIC c_grd_ad_max_cam_in c_grd_ad_max_cam_ex c_grd_ad_ref_max_cam_in c_grd_ad_ref_max_cam_ex c_crlc_ad_cam_in c_crlc_ad_cam_ex c_crlc_ad_ref_cam_ex c_crlc_ad_ref_cam_in c_nr_rev_ad_ref_cam_ex c_nr_rev_ad_ref_cam_in ldp_n_32_id_cam_pha_cor id_cam_pha_cor /end DEF_CHARACTERISTIC
 /begin OUT_MEASUREMENT idx_psn_edge_ad_cam_ex_1[0] idx_psn_edge_ad_cam_ex_1[1] idx_psn_edge_ad_cam_ex_1[2] idx_psn_edge_ad_cam_ex_1[3] idx_psn_edge_ad_cam_ex_1[4] idx_psn_edge_ad_cam_ex_1[5] idx_psn_edge_ad_cam_in_1[0] idx_psn_edge_ad_cam_in_1[1] idx_psn_edge_ad_cam_in_1[2] idx_psn_edge_ad_cam_in_1[3] idx_psn_edge_ad_cam_in_1[4] idx_psn_edge_ad_cam_in_1[5] idx_psn_edge_cam_ex_1[0] idx_psn_edge_cam_ex_1[1] idx_psn_edge_cam_ex_1[2] idx_psn_edge_cam_ex_1[3] idx_psn_edge_cam_ex_1[4] idx_psn_edge_cam_ex_1[5] idx_psn_edge_cam_in_1[0] idx_psn_edge_cam_in_1[1] idx_psn_edge_cam_in_1[2] idx_psn_edge_cam_in_1[3] idx_psn_edge_cam_in_1[4] idx_psn_edge_cam_in_1[5] idx_cam_ad_ex[0].psn_ad_cam idx_cam_ad_ex[0].ctr_rev_ad_ref_cam idx_cam_ad_ex[0].psn_cam idx_cam_ad_ex[0].psn_dif_edge_cam idx_cam_ad_ex[0].psn_edge_cam_old idx_cam_ad_ex[0].ptr_psn_edge_cam idx_cam_ad_ex[0].ptr_psn_edge_ad_cam idx_cam_ad_ex[0].t_dif_edge_cam idx_cam_ad_ex[0].lv_ad_end_cam idx_cam_ad_in[0].psn_ad_cam idx_cam_ad_in[0].ctr_rev_ad_ref_cam idx_cam_ad_in[0].psn_cam idx_cam_ad_in[0].psn_dif_edge_cam idx_cam_ad_in[0].psn_edge_cam_old idx_cam_ad_in[0].ptr_psn_edge_cam idx_cam_ad_in[0].ptr_psn_edge_ad_cam idx_cam_ad_in[0].t_dif_edge_cam idx_cam_ad_in[0].lv_ad_end_cam /end OUT_MEASUREMENT
/end FUNCTION
/begin FUNCTION ENSD_Synchro_det_in_Cam_LH "" /begin OUT_MEASUREMENT lv_cam_lih_ext_ena lv_seg_nr_upd_req lv_syn_vld_cam_lih /end OUT_MEASUREMENT /end FUNCTION
/begin FUNCTION C_A_ENSD "C_A_ENSD"
 /begin SUB_FUNCTION ENSD_Eng_pos_speed_diag_manager ENSD_Camshaft_pos_diagnosis ENSD_Camshaft_sensor_diagnosis ENSD_Crank_sensor_diagnosis ENSD_Crank_sensor_plaus_diag ENSD_Crank_sensor_circuit_diag ENSD_Cam_sensor_diag_Appl_inc ENSD_Crank_sensor_diag_Appl_inc /end SUB_FUNCTION
/end FUNCTION
/begin FUNCTION ENSD_Eng_pos_speed_diag_manager "Eng_pos_speed_diag_manager"
 /begin DEF_CHARACTERISTIC c_t_dly_rest_igk c_t_dly_rest_stall c_n_not_rest lc_eng_back_inh c_t_min_inh_diag_ensd c_t_max_inh_diag_ensd /end DEF_CHARACTERISTIC
 /begin OUT_MEASUREMENT lv_err_cam_tot lv_err_crk lv_inh_diag_crk_syn lv_inh_diag_crk_tooth lv_inh_diag_crk_tooth_per lv_inh_diag_crk_plaus lv_inh_diag_crk_oc lv_inh_diag_ensd idx_diag_mng_ex[0].lv_err_cam idx_diag_mng_ex[0].lv_inh_diag_syn_cam idx_diag_mng_ex[0].lv_inh_diag_per_cam idx_diag_mng_ex[0].lv_inh_diag_plaus_cam idx_diag_mng_ex[0].lv_inh_diag_ref_crk_cam idx_diag_mng_ex[0].lv_inh_diag_syn_crk_cam idx_diag_mng_in[0].lv_err_cam idx_diag_mng_in[0].lv_inh_diag_syn_cam idx_diag_mng_in[0].lv_inh_diag_per_cam idx_diag_mng_in[0].lv_inh_diag_plaus_cam idx_diag_mng_in[0].lv_inh_diag_ref_crk_cam idx_diag_mng_in[0].lv_inh_diag_syn_crk_cam lv_ign_inj_lock_req /end OUT_MEASUREMENT
/end FUNCTION
/begin FUNCTION ENSD_Camshaft_pos_diagnosis "Camshaft_position_diagnosis"
 /begin DEF_CHARACTERISTIC c_tol_ref_crk_cam_in c_tol_ref_crk_cam_ex c_abc_inc_diag_ref_crk_cam_in c_abc_inc_diag_ref_crk_cam_ex c_abc_max_diag_ref_crk_cam_in c_abc_max_diag_ref_crk_cam_ex /end DEF_CHARACTERISTIC
 /begin OUT_MEASUREMENT lv_err_ref_crk_cam_ex_1 lv_err_ref_crk_cam_in_1 /end OUT_MEASUREMENT
/end FUNCTION
/begin FUNCTION ENSD_Camshaft_sensor_diagnosis "Camshaft_sensor_diagnosis"
 /begin DEF_CHARACTERISTIC c_abc_inc_diag_per_cam_in c_abc_inc_diag_per_cam_ex c_abc_max_diag_per_cam_ex c_abc_max_diag_per_cam_in c_abc_inc_diag_syn_cam_ex c_abc_inc_diag_syn_cam_in c_abc_max_diag_syn_cam_ex c_abc_max_diag_syn_cam_in /end DEF_CHARACTERISTIC
 /begin OUT_MEASUREMENT lv_err_per_cam_ex_1 lv_err_per_cam_in_1 lv_err_syn_cam_ex_1 lv_err_syn_cam_in_1 /end OUT_MEASUREMENT
/end FUNCTION
/begin FUNCTION ENSD_Crank_sensor_diagnosis "Crankshaft_sensor_diagnosis"
 /begin DEF_CHARACTERISTIC c_abc_inc_diag_crk_tooth_per c_abc_inc_diag_crk_tooth c_abc_max_diag_crk_tooth c_abc_max_diag_crk_tooth_per c_abc_max_diag_crk_syn c_abc_inc_diag_crk_syn c_n_32_max_diag_crk_tooth /end DEF_CHARACTERISTIC
 /begin OUT_MEASUREMENT lv_inh_mis_crk lv_err_crk_tooth lv_err_crk_tooth_per lv_err_crk_syn /end OUT_MEASUREMENT
/end FUNCTION
/begin FUNCTION ENSD_Crank_sensor_plaus_diag "Crank_sensor_plaus_diag"
 /begin DEF_CHARACTERISTIC c_nr_edge_cam_ex_syn_crk_max c_nr_edge_cam_in_syn_crk_max c_nr_cyc_eng_plaus_cam_max c_ctr_orng_cam_syn_crk_max lc_cam_err_ena_vvt /end DEF_CHARACTERISTIC
 /begin OUT_MEASUREMENT lv_err_crk_plaus lv_err_plaus_cam_ex_1 lv_err_plaus_cam_in_1 ctr_cyc_eng_plaus_cam_ex_1 ctr_cyc_eng_plaus_cam_in_1 lv_err_syn_crk_cam_ex_1 lv_err_syn_crk_cam_in_1 ctr_orng_cam_syn_crk /end OUT_MEASUREMENT
/end FUNCTION
/begin FUNCTION ENSD_Crank_sensor_circuit_diag "Crank_sensor_circuit_diag" /end FUNCTION
/begin FUNCTION ENSD_Cam_sensor_diag_Appl_inc "Camshaft sensor diagnosis ( appl.inci )" /end FUNCTION
/begin FUNCTION ENSD_Crank_sensor_diag_Appl_inc "Crankshaft sensor diagnosis ( Appli.inc )" /end FUNCTION
/begin FUNCTION C_2_ENSD "C_2_ENSD" /begin SUB_FUNCTION ENSD_Acq_crankshaft_signal ENSD_Acq_camshaft_signal /end SUB_FUNCTION /end FUNCTION
/begin FUNCTION ENSD_Acq_crankshaft_signal "Acq_crankshaft_signal" /begin DEF_CHARACTERISTIC c_t_crk_dly id_fac_tol_crk_tooth /end DEF_CHARACTERISTIC
 /begin OUT_MEASUREMENT lv_orng_tooth_per_crk lv_orng_nr_tooth_crk lv_lost_syn_crk lv_crk_syn t_crk_win_ensd t_seg_er lv_crk_miss_tooth /end OUT_MEASUREMENT
/end FUNCTION
/begin FUNCTION ENSD_Acq_camshaft_signal "Acq_camshaft_signal"
 /begin DEF_CHARACTERISTIC c_dyw_cam_crk_syn_adc_ex c_dyw_cam_crk_syn_rtd_ex c_dyw_cam_crk_syn_rtd_in c_dyw_cam_syn_ex c_dyw_cam_syn_in c_dyw_cam_crk_syn_adc_in id_fac_cam_ex id_fac_cam_in c_nr_edge_min_vld_cam_ex c_nr_edge_min_vld_cam_in c_cam_adj_vvt_syn_in c_cam_adj_vvt_syn_ex c_cam_adj_vvt_syn_crk_adc_in c_cam_adj_vvt_syn_crk_rtd_ex /end DEF_CHARACTERISTIC
 /begin OUT_MEASUREMENT lv_cam_syn_crk lv_orng_cam_syn_crk idx_cam_acq_ex[0].idx_edge_cam idx_cam_acq_ex[0].ctr_edge_cam idx_cam_acq_ex[0].lv_vld_psn_cam idx_cam_acq_ex[0].lv_syn_cam idx_cam_acq_ex[0].lv_orng_per_cam idx_cam_acq_ex[0].lv_orng_ratio_cam idx_cam_acq_ex[0].psn_eng_cam idx_cam_acq_ex[0].t_seg_cam idx_cam_acq_in[0].idx_edge_cam idx_cam_acq_in[0].ctr_edge_cam idx_cam_acq_in[0].lv_vld_psn_cam idx_cam_acq_in[0].lv_syn_cam idx_cam_acq_in[0].lv_orng_per_cam idx_cam_acq_in[0].lv_orng_ratio_cam idx_cam_acq_in[0].psn_eng_cam idx_cam_acq_in[0].t_seg_cam /end OUT_MEASUREMENT
/end FUNCTION
/begin FUNCTION C_1_ENSD "" /begin SUB_FUNCTION ENSD_Interface_adaptation /end SUB_FUNCTION /end FUNCTION
/begin FUNCTION ENSD_Interface_adaptation "" /begin OUT_MEASUREMENT tco_cmn vb_cmn /end OUT_MEASUREMENT /end FUNCTION
/begin FUNCTION C_B_MISF ""
 /begin SUB_FUNCTION MISF__Misfire_Detection MISF__Misf_Detect_Appli_Inci MISF__Gen_Misf_Param_Fdout_Cnd MISF__Lgal_Misf_Detect_Fdout_Cnd MISF__Misf_Rate_Det_ERRM MISF__Misf_Rate_Det_ERRM_Inci MISF__Crankshaft_Oscil_Detect MISF__Rough_Road_Inter_For_Misf /end SUB_FUNCTION
/end FUNCTION
/begin FUNCTION MISF__Misfire_Detection ""
 /begin DEF_CHARACTERISTIC ldp_tco_ip_fac_thd_tco_er ldp_n_32_ip_fac_thd_iv_er ldpm_n_32_afl_misf ldpm_load_mis_afl_misf ldpm_n_32_s_misf ldpm_load_mis_s_misf ldp_n_32_ip_fac_thd_iv_s_er lc_mis_inh ldp_n_ip_thd_afl_er_is ldp_load_mis_ip_thd_afl_er_is ldp_n_ip_thd_s_er_is ldp_load_mis_ip_thd_s_er_is ip_fac_thd_tco_er ip_fac_thd_iv_er ip_fac_thd_iv_s_er ip_thd_at_afl_er ip_thd_mt_afl_er ip_thd_afl_er_is ip_thd_at_s_er ip_thd_mt_s_er ip_thd_s_er_is ldp_load_mis_ip_thd_afs_er_is_mt ldp_n_ip_thd_afs_er_is_mt ldp_load_mis_ip_thd_afs_er_is_at ldp_n_ip_thd_afs_er_is_at ldp_n_32_ip_thd_mt_afs_er ldp_n_32_ip_thd_at_afs_er ldp_load_mis_ip_thd_mt_afs_er ldp_load_mis_ip_thd_at_afs_er ip_thd_at_afs_er ip_thd_mt_afs_er ip_thd_afs_er_is_mt ip_thd_afs_er_is_at /end DEF_CHARACTERISTIC
 /begin OUT_MEASUREMENT mis_state_er lv_puc_det_mis lv_det_mis thd_er thd_er_cyl[0] thd_er_cyl[1] thd_er_cyl[2] thd_er_cyl[3] thd_er_cyl[4] thd_er_cyl[5] lv_det_thd_mis thd_er_buf[0] thd_er_buf[1] thd_er_buf[2] thd_er_buf[3] lv_inh_det_mis fac_thd_er ctr_mis_tot_nvmy ctr_mis_tot_dc ctr_mis_dc_cyl[0] ctr_mis_dc_cyl[1] ctr_mis_dc_cyl[2] ctr_mis_dc_cyl[3] ctr_mis_dc_cyl[4] ctr_mis_dc_cyl[5] ctr_mis_dc_mmv_cyl[0] ctr_mis_dc_mmv_cyl[1] ctr_mis_dc_mmv_cyl[2] ctr_mis_dc_mmv_cyl[3] ctr_mis_dc_mmv_cyl[4] ctr_mis_dc_mmv_cyl[5] /end OUT_MEASUREMENT
/end FUNCTION
/begin FUNCTION MISF__Misf_Detect_Appli_Inci ""
 /begin DEF_CHARACTERISTIC lc_ftl_l_det_mis lc_ftl_l_diag_mis c_n_thd_mis_inh c_t_amt_gs_dly_mis ip_fac_thd_er_ch ldp_tq_add_ch_fac_thd_er_ch lc_use_ivvt_inh_mis /end DEF_CHARACTERISTIC
 /begin OUT_MEASUREMENT ctr_tot_mis fac_thd_app_er lv_ftl_l_diag_mis lv_inh_crk_osc_det lv_inh_obd_det_mis lv_inh_app_det_mis lv_inh_ftl_l_det_mis lv_inh_app_rr /end OUT_MEASUREMENT
/end FUNCTION
/begin FUNCTION MISF__Gen_Misf_Param_Fdout_Cnd ""
 /begin DEF_CHARACTERISTIC ldp_n_32_ip_tqi_av_max_mis c_mask_app_inh_det_zdly_mis c_t_map_dif_dly_mis c_t_tps_grd_dly_mis c_t_tps_grd_dly_zdly_mis c_nr_tdc_iga_dif_mis c_t_load_grd_hom_dly_mis c_t_accout_dly_mis ldp_tps_av_ip_tps_grd_max_mis ldp_tps_av_ip_tps_grd_zdly_er ldp_load_mis_ip_load_grd_mis ldp_map_ip_map_dif_max_mis ldp_n_32_ip_delta_iga_mis ldp_load_mis_ip_delta_iga_mis ldp_load_mis_ip_load_grd_s_mis c_t_load_grd_s_dly_mis c_map_max_mis c_conf_load_mis ip_tps_grd_max_mis ip_tps_grd_zdly_mis ip_load_grd_mis ip_map_dif_max_mis ip_delta_iga_mis ip_load_grd_s_mis c_nr_tdc_cmb_tra_s_mis c_nr_tdc_cmb_tra_afl_mis ip_tqi_av_max_mis c_mask_app_inh_det_mis c_mask_app_inh_det_mis_is ldp_n_32_ip_maf_max_mis ldp_n_32_ip_load_min_mis_afs_mt ldp_n_32_ip_load_amp_mis_afs_at ldp_n_32_ip_load_amp_mis_afs_mt ldp_n_32_ip_load_min_mis_afl_mt ldp_n_32_ip_load_min_mis_afl_at ldp_n_32_ip_load_amp_mis_afl_mt ldp_n_32_ip_load_amp_mis_afl_at ldp_n_32_ip_load_min_mis_s_at ldp_n_32_ip_load_min_mis_s_mt ldp_n_32_ip_load_amp_mis_s_mt ldp_n_32_ip_load_amp_mis_s_at ldp_n_32_ip_load_min_mis_afs_at ldp_tco_ip_load_min_mis_afs_mt ldp_amp_ip_load_amp_mis_afs_mt ldp_amp_ip_load_amp_mis_afs_at ldp_amp_ip_load_amp_mis_afl_at ldp_amp_ip_load_amp_mis_afl_mt ldp_amp_ip_load_amp_mis_s_mt ldp_amp_ip_load_amp_mis_s_at ldp_tco_ip_load_min_mis_afs_at ldp_tco_ip_load_min_mis_afl_at ldp_tco_ip_load_min_mis_afl_mt ldp_tco_ip_load_min_mis_s_mt ldp_tco_ip_load_min_mis_s_at ip_load_min_mis_afs_at ip_load_min_mis_afs_mt ip_load_min_ofs_amp_mis_afs_mt ip_load_min_ofs_amp_mis_afs_at ip_load_min_ofs_amp_mis_afl_at ip_load_min_ofs_amp_mis_afl_mt ip_load_min_ofs_amp_mis_s_mt ip_load_min_ofs_amp_mis_s_at ip_load_min_mis_afl_at ip_load_min_mis_afl_mt ip_load_min_mis_s_at ip_load_min_mis_s_mt ip_maf_max_mis /end DEF_CHARACTERISTIC
 /begin OUT_MEASUREMENT load_mis load_mis_1 load_mis_2 load_mis_3 load_grd_mis load_min_mis mis_det_cdn_app_inh mis_det_cdn_app_inh.lv_inh_map_dif_det_mis mis_det_cdn_app_inh.lv_inh_tps_grd_det_mis mis_det_cdn_app_inh.lv_inh_load_grd_det_mis mis_det_cdn_app_inh.lv_inh_iga_dif_det_mis mis_det_cdn_app_inh.lv_inh_cmb_tra_mis mis_det_cdn_app_inh.lv_inh_acc_det_mis mis_det_cdn_app_inh_nr map_dif_mis iga_dif_mis iga_mis_2 iga_mis_1 iga_mis lv_req_app_inh_mis /end OUT_MEASUREMENT
/end FUNCTION
/begin FUNCTION MISF__Lgal_Misf_Detect_Fdout_Cnd ""
 /begin DEF_CHARACTERISTIC lc_req_zdly_mis c_n_min_zdly_mis c_t_zdly_mis c_mask_inh_det_zdly_mis c_mask_inh_det_mis c_amp_min_mis c_n_min_mis c_n_max_mis_at c_n_max_mis_mt c_t_dly_st_mis c_t_dly_iv_off_mis c_sum_inh_iv_max_mis c_tco_min_mis c_tco_wup_min_mis c_nr_tdc_zdly_mis c_nr_tdc_inh_mis /end DEF_CHARACTERISTIC
 /begin OUT_MEASUREMENT ctr_t_zdly_mis lv_diag_mis lv_zdly_diag_mis mis_det_cdn_inh mis_det_cdn_inh.lv_inh_n_max_det_mis mis_det_cdn_inh.lv_inh_n_min_det_mis mis_det_cdn_inh.lv_inh_load_min_det_mis mis_det_cdn_inh.lv_inh_tco_min_det_mis mis_det_cdn_inh.lv_inh_amp_min_det_mis mis_det_cdn_inh.lv_inh_st_det_mis mis_det_cdn_inh.lv_inh_iv_off_det_mis mis_det_cdn_inh_nr lv_req_inh_mis state_diag_mis mis_det_cyl_inh ctr_tdc_zdly_mis /end OUT_MEASUREMENT
/end FUNCTION
/begin FUNCTION MISF__Misf_Rate_Det_ERRM ""
 /begin DEF_CHARACTERISTIC c_mis_max_nr_off_iv c_mis_nr_off_iv_igcfb ldp_n_32_ip_fac_igc_diag_mis ldp_load_mis_ip_fac_igc_diag_mis ldp_n_32_ip_fac_iv_diag_mis ldp_load_mis_ip_fac_iv_diag_mis ldp_n_32_ip_fac_er_s_diag_mis c_n_mis_ftp c_load_mis_ftp c_ratio_ftp_cdn_mis_a c_ratio_ftp_cdn_ind_mis_a c_mis_a_min_nr c_nr_det_max_mis_a c_mis_min_nr_puc lc_conf_inh_iv_mis lc_conf_rnd_det_mis_a lc_conf_mpl_det_mis_a c_mis_sum_b1_thd_mt c_mis_sum_b1_thd_at c_mis_sum_b4_thd_mt c_mis_sum_b4_thd_at c_mis_b1_min_nr c_mis_b4_min_nr c_mis_sum_b1_cbk_thd c_mis_sum_b4_cbk_thd c_nr_cyl_mpl_mis_b c_nr_det_max_mis_b4 lc_conf_rnd_det_mis_b ldp_n_32_ip_fac_er_afs_diag_mis ldp_n__mis_a_fac_afl ldp_load_mis_2__mis_a_fac_afl ldp_n__mis_a_fac_afs ldp_load_mis_2__mis_a_fac_afs ldp_n__mis_a_fac_s ldp_load_mis_2__mis_a_fac_s ip_mis_a_fac_s ldp_n_32_ip_fac_er_afl_diag_mis ip_fac_igc_diag_mis ip_fac_iv_diag_mis ip_mis_a_fac_afs ip_mis_a_fac_afl lc_conf_mpl_det_mis_b lc_conf_mis_state_b c_t_mis_min_puc ldp_load_ip_fac_er_afl_diag_mis ldp_load_ip_fac_er_s_diag_mis ldp_load_ip_fac_er_afs_diag_mis c_mis_a_ind_thd_mt c_mis_a_ind_thd_at c_mis_sum_a_thd_mt c_mis_sum_a_thd_at c_mis_sum_a_cbk_thd_mt c_mis_sum_a_cbk_thd_at c_nr_cyl_mpl_mis_a c_nr_max_mis_a_lih_cyl lc_conf_mis_a_lih lc_ena_mis_a_ind_lih lc_ena_mis_a_lih ldpm_n_32_1_misf id_nr_det_ena_mis_a_lih_mt id_nr_det_ena_mis_a_lih_at ip_fac_er_afs_diag_mis ip_fac_er_afl_diag_mis ip_fac_er_s_diag_mis /end DEF_CHARACTERISTIC
 /begin OUT_MEASUREMENT fac_er_diag_mis fac_igc_diag_mis fac_iv_diag_mis lv_det_cfm_mis lv_det_mis_a lv_mis_state_a mis_a_fac mis_a_fac_buf[0] mis_a_fac_buf[1] mis_a_fac_buf[2] mis_a_fac_buf[3] inh_iv_mis mis_ctr_a[0] mis_ctr_a[1] mis_ctr_a[2] mis_ctr_a[3] mis_ctr_a[4] mis_ctr_a[5] mis_nr_tdc_a mis_sum_a mis_sum_a_cbk[0] mis_sum_a_cbk[1] ctr_chk_mis_a ctr_ftp_cdn_mis_a ctr_det_mis_a lv_ftp_mis_a sym_cyl_mis_a lv_mis_state_b1 lv_mis_state_b4 lv_det_mis_b4 mis_nr_tdc_b mis_sum_b mis_sum_b_cbk[0] mis_sum_b_cbk[1] ctr_chk_mis_b4 ctr_det_mis_b4 lv_end_mis_b1 lv_end_mis_a lv_end_mis_b4 lv_end_win_mis_b1 lv_end_win_mis_b4 sym_cyl_mis_b1 sym_cyl_mis_b4 lv_inh_iv_mis_a lv_end_win_mis_a lv_mis_state_b sum_fac_diag_mis mis_ctr_b[0] mis_ctr_b[1] mis_ctr_b[2] mis_ctr_b[3] mis_ctr_b[4] mis_ctr_b[5] ctr_mis_a_lih_cyl[0] ctr_mis_a_lih_cyl[1] ctr_mis_a_lih_cyl[2] ctr_mis_a_lih_cyl[3] ctr_mis_a_lih_cyl[4] ctr_mis_a_lih_cyl[5] /end OUT_MEASUREMENT
/end FUNCTION
/end MODULE
/end PROJECT
