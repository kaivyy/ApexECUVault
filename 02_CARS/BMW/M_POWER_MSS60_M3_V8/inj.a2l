ASAP2_VERSION 1 30
/begin PROJECT MSS65-inj "Generiert am 14.10.05 um 11:34:36"
/begin HEADER "" VERSION "R341" /end HEADER
/begin MODULE _MSS65-inj "Generiert am 14.10.05 um 11:34:36"
/begin MOD_COMMON "" BYTE_ORDER MSB_FIRST ALIGNMENT_BYTE 1 ALIGNMENT_WORD 2 ALIGNMENT_LONG 4 ALIGNMENT_FLOAT32_IEEE 4 ALIGNMENT_FLOAT64_IEEE 8 /end MOD_COMMON
/begin CHARACTERISTIC CW_BNS_LR "Codewort zur Einrechnung Bordnetzstabilität in Loadresponse" VALUE 0x7467E TKW_VV_VV_UB 100.0 FORMULA_0003 0.0 1.0 /end CHARACTERISTIC
/begin CHARACTERISTIC CW_BNSUMAX "Freischatung Berücksichtigung Bordnetzstabilität" VALUE 0x78956 TKW_VV_VV_UB 100.0 FORMULA_0003 0.0 255.0 /end CHARACTERISTIC
/begin CHARACTERISTIC CW_GENOFFSLP "Codewort zum Sperren Eingriff Sekundärluftpumpe" VALUE 0x78957 TKW_VV_VV_UB 100.0 FORMULA_0478 0.0 1.0 /end CHARACTERISTIC
/begin CHARACTERISTIC K_APP_LLAH "Kennwert zum Umschalten auf Applikationskonstante" VALUE 0x7464C TKW_VV_VV_UB 100.0 FORMULA_0003 0.0 255.0 /end CHARACTERISTIC
/begin CHARACTERISTIC K_APP_UGEN "Umschaltung auf manuelle Generatorspannungsvorgabe" VALUE 0x78958 TKW_VV_VV_UB 100.0 FORMULA_0003 0.0 255.0 /end CHARACTERISTIC
/begin CHARACTERISTIC K_APPLROFF "" VALUE 0x7467F TKW_VV_VV_UB 100.0 FORMULA_0478 0.0 1.0 /end CHARACTERISTIC
/begin CHARACTERISTIC K_APPUPLLDST "Applikationswert St_ldstgen für Nachlauf" VALUE 0x74620 TKW_VV_VV_UB 100.0 FORMULA_0003 0.0 255.0 /end CHARACTERISTIC
/begin CHARACTERISTIC K_BGAPP "Applikationswert Generatorbegrenzung über Maximalmoment" VALUE 0x74680 TKW_VV_VV_UB 100.0 FORMULA_0478 0.0 1.0 /end CHARACTERISTIC
/begin CHARACTERISTIC K_CODIER_INDEX "Codierindex" VALUE 0x7024A TKW_VV_VV_UB 100.0 FORMULA_0003 0.0 255.0 /end CHARACTERISTIC
/begin CHARACTERISTIC K_DF_DEAKAPP "Df-Schwelle für IG 0A Zwangssetzung" VALUE 0x7281E TKW_VV_VV_UB 100.0 FORMULA_0475 0.0 99.60929870605469 /end CHARACTERISTIC
/begin CHARACTERISTIC K_DFMODE "DF-Mode-Schalter themermisch/elektrisch" VALUE 0x74621 TKW_VV_VV_UB 100.0 FORMULA_0003 0.0 255.0 /end CHARACTERISTIC
/begin CHARACTERISTIC K_DFS_MAX "DF-Auslastung Maximalschwelle" VALUE 0x74622 TKW_VV_VV_UB 100.0 FORMULA_0475 0.0 99.60929870605469 /end CHARACTERISTIC
/begin CHARACTERISTIC K_DFS_MIN "DF-Auslastung Minimalschwelle" VALUE 0x74623 TKW_VV_VV_UB 100.0 FORMULA_0475 0.0 99.60929870605469 /end CHARACTERISTIC
/begin CHARACTERISTIC K_DFS_MITT "DF-Auslastung Mittelschwelle" VALUE 0x74624 TKW_VV_VV_UB 100.0 FORMULA_0475 0.0 99.60929870605469 /end CHARACTERISTIC
/begin CHARACTERISTIC K_DIAGNOSE_INDEX_HI "Diagnoseindex" VALUE 0x7024B TKW_VV_VV_UB 100.0 FORMULA_0003 0.0 255.0 /end CHARACTERISTIC
/begin CHARACTERISTIC K_DIAGNOSE_INDEX_LO "Diagnoseindex" VALUE 0x7024C TKW_VV_VV_UB 100.0 FORMULA_0003 0.0 255.0 /end CHARACTERISTIC
/begin CHARACTERISTIC K_DMDGEN_SCHMN "" VALUE 0x74650 TKW_VV_VV_SW 100.0 FORMULA_0113 -3276.800048828125 3276.699951171875 FORMAT "%5.2" /end CHARACTERISTIC
/begin CHARACTERISTIC K_DMDGEN_SCHMX "" VALUE 0x74652 TKW_VV_VV_SW 100.0 FORMULA_0113 -3276.800048828125 3276.699951171875 FORMAT "%5.2" /end CHARACTERISTIC
/begin CHARACTERISTIC K_DSOCMIN "" VALUE 0x74654 TKW_VV_VV_SW 100.0 FORMULA_0479 -100.0 99.99690246582031 FORMAT "%5.2" /end CHARACTERISTIC
/begin CHARACTERISTIC K_EN_MDGEN "" VALUE 0x7281F TKW_VV_VV_UB 100.0 FORMULA_0003 0.0 255.0 /end CHARACTERISTIC
/begin CHARACTERISTIC K_ENAPPLGOFF "Enable Generatorauschaltsteuerung" VALUE 0x74681 TKW_VV_VV_UB 100.0 FORMULA_0003 0.0 255.0 /end CHARACTERISTIC
/begin CHARACTERISTIC K_ENAPPLRESP "Enable Handsteuerung Loadresponse" VALUE 0x74682 TKW_VV_VV_UB 100.0 FORMULA_0003 0.0 255.0 /end CHARACTERISTIC
/begin CHARACTERISTIC K_ENGENTANS "Schwelle Motortemperatur fuer Freigabe Generaturansaugluft " VALUE 0x727C8 TKW_VV_VV_SW 100.0 FORMULA_0431 -3276.800048828125 3276.699951171875 /end CHARACTERISTIC
/begin CHARACTERISTIC K_ENGENTOGGL "Freigabe Generatortoggeln" VALUE 0x78959 TKW_VV_VV_UB 100.0 FORMULA_0478 0.0 1.0 /end CHARACTERISTIC
/begin CHARACTERISTIC K_EWS_FETRAWE_WEG "zul. Kilometerstand zum automatischen aktivieren des Fertigungsmodes beim EWS-DME-Abgl." VALUE 0x72156 TKW_VV_VV_UW 100.0 FORMULA_0613 0.0 65535.0 /end CHARACTERISTIC
/begin CHARACTERISTIC K_FHOGNMN "minimaler Wichtungsfaktor fuer minimale HFM-Luftmassen Schwelle in Abhaengigkeit von d.Hoehe fuer Generatorreduzierung" VALUE 0x74683 TKW_VV_VV_UB 100.0 FORMULA_0465 0.0 3.984299898147583 /end CHARACTERISTIC
/begin CHARACTERISTIC K_FPLAU_AQ_OBD_CNT "Fehlerschwelle, wenn überschritten erfolgt ein Fehlereintrag" VALUE 0x72168 TKW_VV_VV_UB 100.0 FORMULA_0003 0.0 255.0 /end CHARACTERISTIC
/begin CHARACTERISTIC K_FPLAU_HFM_OBD_CNT "Fehlerschwelle, wenn überschritten erfolgt ein Fehlereintrag" VALUE 0x72166 TKW_VV_VV_UB 100.0 FORMULA_0003 0.0 255.0 /end CHARACTERISTIC
/begin CHARACTERISTIC K_FPLAU_LAM_OBD_CNT "Fehlerschwelle, wenn überschritten erfolgt ein Fehlereintrag" VALUE 0x72167 TKW_VV_VV_UB 100.0 FORMULA_0003 0.0 255.0 /end CHARACTERISTIC
/begin CHARACTERISTIC K_FPLAU_OBD_CFG "Freigabe Bit für die Plausibilitätsdiagnose" VALUE 0x72158 TKW_VV_VV_UB 100.0 FORMULA_0709 0.0 255.0 /end CHARACTERISTIC
/begin CHARACTERISTIC K_FPLAU_OBD_DYN_DELTA_RF "Dynamikschwelle RF" VALUE 0x7216A TKW_VV_VV_SW 100.0 FORMULA_0007 0.0 2.0 FORMAT "%6.3" /end CHARACTERISTIC
/begin CHARACTERISTIC K_FPLAU_OBD_DYN_RF_T "Zeit nach Dynamikabbruch durch rf, bevor die Diagnose weiterlaeuft" VALUE 0x7216C TKW_VV_VV_UW 100.0 FORMULA_0021 0.0 655.0 FORMAT "%5.2" /end CHARACTERISTIC
/begin CHARACTERISTIC K_FPLAU_OBD_FR_ADAP_F "Aufweitungsfaktor wenn FR noch nicht eingeregelt" VALUE 0x72172 TKW_VV_VV_UW 100.0 FORMULA_0073 0.0 4.0 FORMAT "%6.3" /end CHARACTERISTIC
/begin CHARACTERISTIC K_FPLAU_OBD_ML_MAX "Maximale Luftmasse zum Aktiveren der Diagnose" VALUE 0x72170 TKW_VV_VV_SW 100.0 FORMULA_0103 -100.0 1400.0 FORMAT "%4.1" /end CHARACTERISTIC
/begin CHARACTERISTIC K_FPLAU_OBD_ML_MIN "Minimale Luftmasse zum Aktiveren der Diagnose" VALUE 0x7216E TKW_VV_VV_SW 100.0 FORMULA_0103 -100.0 1400.0 FORMAT "%4.1" /end CHARACTERISTIC
/begin CHARACTERISTIC K_FPLAU_OBD_N_MAX "Maximale Motordrehzahl zum Aktiveren der Diagnose" VALUE 0x72160 TKW_VV_VV_SW 100.0 FORMULA_0006 0.0 10000.0 /end CHARACTERISTIC
/begin CHARACTERISTIC K_FPLAU_OBD_N_MIN "Minimale Motordrehzahl zum Aktiveren der Diagnose" VALUE 0x7215E TKW_VV_VV_SW 100.0 FORMULA_0006 0.0 10000.0 /end CHARACTERISTIC
/begin CHARACTERISTIC K_FPLAU_OBD_T_DELTA "Zeit nach der die Diagnose als IO betrachtet wird" VALUE 0x72164 TKW_VV_VV_UW 100.0 FORMULA_0071 0.0 6553.5 FORMAT "%4.1" /end CHARACTERISTIC
/begin CHARACTERISTIC K_FPLAU_OBD_T_MAX "Maximale Zeit, in der die Abweichung anliegen muss, bis ein Fehler eingetragen wird" VALUE 0x72162 TKW_VV_VV_UW 100.0 FORMULA_0071 0.0 6553.5 FORMAT "%4.1" /end CHARACTERISTIC
/begin CHARACTERISTIC K_FPLAU_OBD_T_MIN "Diagnose Sperrzeit nach Motor Start" VALUE 0x7215C TKW_VV_VV_UW 100.0 FORMULA_0071 0.0 6553.5 FORMAT "%4.1" /end CHARACTERISTIC
/begin CHARACTERISTIC K_FPLAU_OBD_TMOT_MIN "Kühlwassertemperaturschwelle zum Aktiveren der Diagnose " VALUE 0x7215A TKW_VV_VV_SW 100.0 FORMULA_0023 -50.0 170.0 FORMAT "%4.1" /end CHARACTERISTIC
/begin CHARACTERISTIC K_GEN_APPUG "Manuelle Generatorspannungsvorgabe" VALUE 0x7893E TKW_VV_VV_UW 100.0 FORMULA_0466 0.0 6553.5 FORMAT "%6.3" /end CHARACTERISTIC
/begin CHARACTERISTIC K_GEN_DNMIN "Motordrehzahlschwelle für Auswertung der Generatorfehler" VALUE 0x70792 TKW_VV_VV_SW 100.0 FORMULA_0006 -32768.0 32767.0 /end CHARACTERISTIC
/begin CHARACTERISTIC K_GEN_IGOF "Offsetwert Generatorstrom" VALUE 0x727E2 TKW_VV_VV_UW 100.0 FORMULA_0470 0.0 254.0 FORMAT "%5.2" /end CHARACTERISTIC
/begin CHARACTERISTIC K_GENDIFAK1 "Stromfaktor Diode1" VALUE 0x72820 TKW_VV_VV_UB 100.0 FORMULA_0455 0.0 0.9959999918937683 /end CHARACTERISTIC
/begin CHARACTERISTIC K_GENDIFAK2 "Stromfaktor Diode2" VALUE 0x72821 TKW_VV_VV_UB 100.0 FORMULA_0455 0.0 0.9959999918937683 /end CHARACTERISTIC
/begin CHARACTERISTIC K_GENDIFAK3 "Stromfaktor Diode3" VALUE 0x72822 TKW_VV_VV_UB 100.0 FORMULA_0455 0.0 0.9959999918937683 /end CHARACTERISTIC
/begin CHARACTERISTIC K_GENDIFAK4 "Stromfaktor Diode4" VALUE 0x72823 TKW_VV_VV_UB 100.0 FORMULA_0455 0.0 0.9959999918937683 /end CHARACTERISTIC
/begin CHARACTERISTIC K_GENITYP "Generatorstrotyp 0=gerechnet / 1=gemessen" VALUE 0x72824 TKW_VV_VV_UB 100.0 FORMULA_0003 0.0 1.0 /end CHARACTERISTIC
/begin CHARACTERISTIC K_GENLDDFMAX "Schwell Anzeige maximaler Auslastungsgrad Generator" VALUE 0x74625 TKW_VV_VV_UB 100.0 FORMULA_0475 0.0 99.60929870605469 /end CHARACTERISTIC
/begin CHARACTERISTIC K_GENLLAHAPP "Applikationskonstente zum Setzen B_idlespec" VALUE 0x7464D TKW_VV_VV_UB 100.0 FORMULA_0003 0.0 255.0 /end CHARACTERISTIC
/begin CHARACTERISTIC K_GENMDNMOF "Offset des Generatormoments" VALUE 0x727CA TKW_VV_VV_SW 100.0 FORMULA_0113 -3276.800048828125 3276.699951171875 FORMAT "%5.2" /end CHARACTERISTIC
/begin CHARACTERISTIC K_GENOFFTIME "maximale Generatorauszeit" VALUE 0x78936 TKW_VV_VV_UW 100.0 FORMULA_0071 0.0 6553.5 FORMAT "%4.1" /end CHARACTERISTIC
/begin CHARACTERISTIC K_GENPDTIME "Predrivetime für Ladekontrollampe KL61" VALUE 0x70796 TKW_VV_VV_UB 100.0 FORMULA_0461 0.0 25.5 /end CHARACTERISTIC
/begin CHARACTERISTIC K_GENRS0_1 "Generatorstatorwiderstand1 bei 25°" VALUE 0x727D8 TKW_VV_VV_UW 100.0 FORMULA_0460 0.0 0.9999847412109375 FORMAT "%7.4" /end CHARACTERISTIC
/begin CHARACTERISTIC K_GENRS0_2 "Generatorstatorwiderstand2 bei 25°" VALUE 0x727DA TKW_VV_VV_UW 100.0 FORMULA_0460 0.0 0.9999847412109375 FORMAT "%7.4" /end CHARACTERISTIC
/begin CHARACTERISTIC K_GENRS0_3 "Generatorstatorwiderstand3 bei 25°" VALUE 0x727DC TKW_VV_VV_UW 100.0 FORMULA_0460 0.0 0.9999847412109375 FORMAT "%7.4" /end CHARACTERISTIC
/begin CHARACTERISTIC K_GENRS0_4 "Generatorstatorwiderstand4 bei 25°" VALUE 0x727DE TKW_VV_VV_UW 100.0 FORMULA_0460 0.0 0.9999847412109375 FORMAT "%7.4" /end CHARACTERISTIC
/begin CHARACTERISTIC K_GENSTFAK1 "Stromfaktor Statorspule" VALUE 0x72825 TKW_VV_VV_UB 100.0 FORMULA_0455 0.0 0.9959999918937683 /end CHARACTERISTIC
/begin CHARACTERISTIC K_GENSTFAK2 "Stromfaktor Statorspule2" VALUE 0x72826 TKW_VV_VV_UB 100.0 FORMULA_0455 0.0 0.9959999918937683 /end CHARACTERISTIC
/begin CHARACTERISTIC K_GENSTFAK3 "Stromfaktor Statorspule3" VALUE 0x72827 TKW_VV_VV_UB 100.0 FORMULA_0455 0.0 0.9959999918937683 /end CHARACTERISTIC
/begin CHARACTERISTIC K_GENSTFAK4 "Stromfaktor Statorspule4" VALUE 0x72828 TKW_VV_VV_UB 100.0 FORMULA_0455 0.0 0.9959999918937683 /end CHARACTERISTIC
/begin CHARACTERISTIC K_GENTEMPAPP "Geneeratortemperatur mauelle Vorgabe" VALUE 0x727CC TKW_VV_VV_SW 100.0 FORMULA_0431 -3276.800048828125 3276.699951171875 /end CHARACTERISTIC
/begin CHARACTERISTIC K_GENTEMPMAN "Manuelle Generatorvorgabe" VALUE 0x72829 TKW_VV_VV_UB 100.0 FORMULA_0003 0.0 255.0 /end CHARACTERISTIC
/begin CHARACTERISTIC K_GENTMOTDT "" VALUE 0x727CE TKW_VV_VV_SW 100.0 FORMULA_0431 -3276.800048828125 3276.699951171875 /end CHARACTERISTIC
/begin CHARACTERISTIC K_GENTMOTOF1 "Offset Generatoransaugluft" VALUE 0x727D0 TKW_VV_VV_SW 100.0 FORMULA_0431 -3276.800048828125 3276.699951171875 /end CHARACTERISTIC
/begin CHARACTERISTIC K_GENTMOTOF2 "Offset Generatoransaugluft" VALUE 0x727D2 TKW_VV_VV_SW 100.0 FORMULA_0431 -3276.800048828125 3276.699951171875 /end CHARACTERISTIC
/begin CHARACTERISTIC K_GENTMOTOF3 "Offset Generatoransaugluft" VALUE 0x727D4 TKW_VV_VV_SW 100.0 FORMULA_0431 -3276.800048828125 3276.699951171875 /end CHARACTERISTIC
/begin CHARACTERISTIC K_GENTMOTOF4 "Offset Generatoransaugluft" VALUE 0x727D6 TKW_VV_VV_SW 100.0 FORMULA_0431 -3276.800048828125 3276.699951171875 /end CHARACTERISTIC
/begin CHARACTERISTIC K_GENTYP "Generatortyp" VALUE 0x7282A TKW_VV_VV_UB 100.0 FORMULA_0003 0.0 255.0 /end CHARACTERISTIC
/begin CHARACTERISTIC K_GENTYPFELD "Generatorkennfeldzuordnung" VAL_BLK 0x7283A TKW_VV_VV_UB 100.0 FORMULA_0003 0.0 255.0 NUMBER 33 /end CHARACTERISTIC
/begin CHARACTERISTIC K_GENUEBSETZ1 "Generatoruebersetzung1" VALUE 0x7253C TKW_VV_VV_UB 100.0 FORMULA_0465 0.0 3.984299898147583 /end CHARACTERISTIC
/begin CHARACTERISTIC K_GENUEBSETZ2 "Generatoruebersetzung2" VALUE 0x7253D TKW_VV_VV_UB 100.0 FORMULA_0465 0.0 3.984299898147583 /end CHARACTERISTIC
/begin CHARACTERISTIC K_GENUEBSETZ3 "Generatoruebersetzung3" VALUE 0x7253E TKW_VV_VV_UB 100.0 FORMULA_0465 0.0 3.984299898147583 /end CHARACTERISTIC
/begin CHARACTERISTIC K_GENUEBSETZ4 "Generatoruebersetzung4" VALUE 0x7253F TKW_VV_VV_UB 100.0 FORMULA_0465 0.0 3.984299898147583 /end CHARACTERISTIC
/begin CHARACTERISTIC K_GENUMAX "maximale Generatorspannung" VALUE 0x78938 TKW_VV_VV_UW 100.0 FORMULA_0466 0.0 6553.5 FORMAT "%6.3" /end CHARACTERISTIC
/begin CHARACTERISTIC K_GENUMGTYP "" VALUE 0x7282B TKW_VV_VV_UB 100.0 FORMULA_0003 0.0 255.0 /end CHARACTERISTIC
/begin CHARACTERISTIC K_GENURAMP "Spannungsinkrement fuer Rampe" VALUE 0x7893A TKW_VV_VV_UW 100.0 FORMULA_0466 0.0 6553.5 FORMAT "%6.3" /end CHARACTERISTIC
/begin CHARACTERISTIC K_GENURAMPOF "Spannungsinkrement fuer Rampe, Generator ausschalten" VALUE 0x7893C TKW_VV_VV_UW 100.0 FORMULA_0466 0.0 6553.5 FORMAT "%6.3" /end CHARACTERISTIC
/begin CHARACTERISTIC K_GENVFZGSW "geschwindigkeitsabhängige Generatoransaugluftschwelle" VALUE 0x727E0 TKW_VV_VV_UW 100.0 FORMULA_0474 0.0 65535.0 /end CHARACTERISTIC
/begin CHARACTERISTIC K_IERRFIL "Filterkonstante für Filterung Erregerstrom" VALUE 0x74626 TKW_VV_VV_UB 100.0 FORMULA_0455 4.000000189989805e-003 0.9959999918937683 /end CHARACTERISTIC
/begin CHARACTERISTIC K_IGBASIS "Generatorgrundstrombedarf FZG " VALUE 0x7282C TKW_VV_VV_UB 100.0 FORMULA_0463 0.0 255.0 /end CHARACTERISTIC
/begin CHARACTERISTIC K_IGBASISOFF "Generatorgrundstrombedarf FZG bei Genred" VALUE 0x7282D TKW_VV_VV_UB 100.0 FORMULA_0463 0.0 255.0 /end CHARACTERISTIC
/begin CHARACTERISTIC K_IGNOTWERT "" VALUE 0x7282E TKW_VV_VV_UB 100.0 FORMULA_0463 0.0 255.0 /end CHARACTERISTIC
/begin CHARACTERISTIC K_LRBNS "Loadrespo´nse bei Warnung Bordnetzstabilität gefährdet" VALUE 0x74684 TKW_VV_VV_UB 100.0 FORMULA_0461 0.0 25.5 /end CHARACTERISTIC
/begin CHARACTERISTIC K_LRESPAPP "Load-Response Applikation" VALUE 0x74685 TKW_VV_VV_UB 100.0 FORMULA_0461 0.0 25.5 /end CHARACTERISTIC
/begin CHARACTERISTIC K_MANAWNUMM "" VALUE 0x7282F TKW_VV_VV_UB 100.0 FORMULA_0003 0.0 255.0 /end CHARACTERISTIC
/begin CHARACTERISTIC K_MDGNHYS "Hysterese für Drehzahlschwelle Generator-Maximalmomentbegrenzung" VALUE 0x74656 TKW_VV_VV_SW 100.0 FORMULA_0006 -32768.0 32767.0 /end CHARACTERISTIC
/begin CHARACTERISTIC K_MDGNMAX "Maximaldrehzahl für Generator-Maximalmomentbegrenzung" VALUE 0x74658 TKW_VV_VV_SW 100.0 FORMULA_0006 -32768.0 32767.0 /end CHARACTERISTIC
/begin CHARACTERISTIC K_MGMAXAPP "Applikationswert Genratormaximalmoment" VALUE 0x7465A TKW_VV_VV_SW 100.0 FORMULA_0113 -3276.800048828125 3276.699951171875 FORMAT "%5.2" /end CHARACTERISTIC
/begin CHARACTERISTIC K_MSKGENDFP "Bitmaske Generator Fehler-> DFP" VALUE 0x70797 TKW_VV_VV_UB 100.0 FORMULA_0003 0.0 255.0 /end CHARACTERISTIC
/begin CHARACTERISTIC K_MSKGENKL61 "Bitmaske fuer Generatorfehler -> Ladekontrolle" VALUE 0x70798 TKW_VV_VV_UB 100.0 FORMULA_0003 0.0 255.0 /end CHARACTERISTIC
/begin CHARACTERISTIC K_NGENOFMN "" VALUE 0x7465C TKW_VV_VV_SW 100.0 FORMULA_0006 -32768.0 32767.0 /end CHARACTERISTIC
/begin CHARACTERISTIC K_NGENOFMX "" VALUE 0x7465E TKW_VV_VV_SW 100.0 FORMULA_0006 -32768.0 32767.0 /end CHARACTERISTIC
/begin CHARACTERISTIC K_NKW_SCH "Drehzahlschwelle für Grenzmomentberechnung" VALUE 0x7464E TKW_VV_VV_SW 100.0 FORMULA_0006 0.0 32767.0 /end CHARACTERISTIC
/begin CHARACTERISTIC K_NMXGENOF "Motordrehzahlschwelle für Generatorzuschaltung" VALUE 0x74660 TKW_VV_VV_SW 100.0 FORMULA_0006 -32768.0 32767.0 /end CHARACTERISTIC
/begin CHARACTERISTIC K_NSUBO "N_soll bei Batterieladebilanz zu niedrig" VALUE 0x74648 TKW_VV_VV_SW 100.0 FORMULA_0006 0.0 32767.0 /end CHARACTERISTIC
/begin CHARACTERISTIC K_NSUBU "N_soll bei Ladebilanz iO" VALUE 0x7464A TKW_VV_VV_SW 100.0 FORMULA_0006 0.0 32767.0 /end CHARACTERISTIC
/begin CHARACTERISTIC K_PMSA_DEC "Pmigrlowctr dekrementfaktor" VALUE 0x7895A TKW_VV_VV_UB 100.0 FORMULA_0003 0.0 255.0 /end CHARACTERISTIC
/begin CHARACTERISTIC K_PMSA_INC "Pmigrlowctr inkrementfaktor" VALUE 0x7895B TKW_VV_VV_UB 100.0 FORMULA_0003 0.0 255.0 /end CHARACTERISTIC
/begin CHARACTERISTIC K_PMSA_RST "Untere Hystereseschwelle iGR Reaktivieren" VALUE 0x78940 TKW_VV_VV_UW 100.0 FORMULA_0010 0.0 65535.0 /end CHARACTERISTIC
/begin CHARACTERISTIC K_PMSA_SET "Obere Hystereseschwelle iGR Deaktivieren" VALUE 0x78942 TKW_VV_VV_UW 100.0 FORMULA_0010 0.0 65535.0 /end CHARACTERISTIC
/begin CHARACTERISTIC K_PRELLGTMOT "Prellzeit für Tmot-Schwelle" VALUE 0x72830 TKW_VV_VV_UB 100.0 FORMULA_0476 0.0 255.0 /end CHARACTERISTIC
/begin CHARACTERISTIC K_RLMXGENOF "relative Luftfüllungschwelle für Generatorzuschaltung" VALUE 0x74662 TKW_VV_VV_SW 100.0 FORMULA_0480 -327.6799926757813 327.6700134277344 FORMAT "%7.4" /end CHARACTERISTIC
/begin CHARACTERISTIC K_SNMBSDKL61 "" VALUE 0x70794 TKW_VV_VV_SW 100.0 FORMULA_0006 -32768.0 32767.0 /end CHARACTERISTIC
/begin CHARACTERISTIC K_T_IGRNACHL "Nachlaufzeit iGR aktiv" VALUE 0x78944 TKW_VV_VV_UW 100.0 FORMULA_0071 0.0 6553.5 FORMAT "%4.1" /end CHARACTERISTIC
/begin CHARACTERISTIC K_T_VERBON "Verzugszeit Verbraucherzuschaltung nach Aufhebung Genertorreduzierung" VALUE 0x7895D TKW_VV_VV_UB 100.0 FORMULA_0461 0.0 25.5 /end CHARACTERISTIC
/begin CHARACTERISTIC K_TABSTGNMN "minimale Abstellzeit für Generatorreduzierung" VALUE 0x74670 TKW_VV_VV_UW 100.0 FORMULA_0010 0.0 65535.0 /end CHARACTERISTIC
/begin CHARACTERISTIC K_TABSTGNMX "maximale Abstellzeit für Generatorreduzierung" VALUE 0x74672 TKW_VV_VV_UW 100.0 FORMULA_0010 0.0 65535.0 /end CHARACTERISTIC
/begin CHARACTERISTIC K_TATMGENOF "Motordrehzahlschwelle Katalysatortemperatur" VALUE 0x74664 TKW_VV_VV_SW 100.0 FORMULA_0431 -3276.800048828125 3276.699951171875 /end CHARACTERISTIC
/begin CHARACTERISTIC K_TDGENOFFST "Zeitverzögerung B_start für Spannung im Start Generator" VALUE 0x7895C TKW_VV_VV_UB 100.0 FORMULA_0461 0.0 25.5 /end CHARACTERISTIC
/begin CHARACTERISTIC K_TDMDGEN_VERZAUS "" VALUE 0x74674 TKW_VV_VV_UW 100.0 FORMULA_0021 0.0 655.3499755859375 FORMAT "%5.2" /end CHARACTERISTIC
/begin CHARACTERISTIC K_TDMDGEN_VERZEIN "" VALUE 0x74676 TKW_VV_VV_UW 100.0 FORMULA_0021 0.0 655.3499755859375 FORMAT "%5.2" /end CHARACTERISTIC
/begin CHARACTERISTIC K_TGENOFMN "" VALUE 0x74666 TKW_VV_VV_SW 100.0 FORMULA_0431 -3276.800048828125 3276.699951171875 /end CHARACTERISTIC
/begin CHARACTERISTIC K_TGENOFMX "" VALUE 0x74668 TKW_VV_VV_SW 100.0 FORMULA_0431 -3276.800048828125 3276.699951171875 /end CHARACTERISTIC
/begin CHARACTERISTIC K_TGENOFVL "Generatorsabschaltzeit bei Vollastbeschleunigung" VALUE 0x74686 TKW_VV_VV_UB 100.0 FORMULA_0003 0.0 255.0 /end CHARACTERISTIC
/begin CHARACTERISTIC K_TGETR_CC_HIGH "Obere Grenze CC Meldung Getriebetemperatur" VALUE 0x77926 TKW_VV_VV_SW 100.0 FORMULA_1167 -50.0 170.0 FORMAT "%6.3" /end CHARACTERISTIC
/begin CHARACTERISTIC K_TGETR_CC_HYST "Hysterese CC Meldung Getriebetemperatur" VALUE 0x77928 TKW_VV_VV_SW 100.0 FORMULA_1169 -50.0 170.0 FORMAT "%6.3" /end CHARACTERISTIC
/begin CHARACTERISTIC K_TGETR_DIAG_MAX "Obere Grenze Getriebetemperatur" VALUE 0x77924 TKW_VV_VV_SW 100.0 FORMULA_1167 -50.0 170.0 FORMAT "%6.3" /end CHARACTERISTIC
/begin CHARACTERISTIC K_TGETR_DIAG_MIN "Untere Grenze Getriebetemperatur" VALUE 0x77922 TKW_VV_VV_SW 100.0 FORMULA_1167 -50.0 170.0 FORMAT "%6.3" /end CHARACTERISTIC
/begin CHARACTERISTIC K_TGETR_DIAG_TUMG_MIN "Untere Diagnosegrenze Umgebungstemperatur" VALUE 0x77920 TKW_VV_VV_SW 100.0 FORMULA_0023 -50.0 170.0 FORMAT "%4.1" /end CHARACTERISTIC
/begin CHARACTERISTIC K_TGETR_TAU "Filterkonstante fuer die Getriebetemperatur" VALUE 0x7792A TKW_VV_VV_UB 100.0 FORMULA_0679 0.1004000008106232 25.60000038146973 /end CHARACTERISTIC
/begin CHARACTERISTIC K_TIGMISCH "" VALUE 0x72831 TKW_VV_VV_UB 100.0 FORMULA_0306 0.0 2.549999952316284 /end CHARACTERISTIC
/begin CHARACTERISTIC K_TLORESPST "Startloadresponse" VALUE 0x74687 TKW_VV_VV_UB 100.0 FORMULA_0461 0.0 25.5 /end CHARACTERISTIC
/begin CHARACTERISTIC K_TMOTABGNMN "minimale Motorabstelltemperatur für Generatorreduzierung" VALUE 0x7466A TKW_VV_VV_SW 100.0 FORMULA_0445 -327.6799926757813 327.6700134277344 FORMAT "%5.2" /end CHARACTERISTIC
/begin CHARACTERISTIC K_TNNSTART "Zeittriggerschwelle nach Motorstart" VALUE 0x7461E TKW_VV_VV_UW 100.0 FORMULA_0021 0.0 655.3499755859375 FORMAT "%5.2" /end CHARACTERISTIC
/begin CHARACTERISTIC K_TSTCNTEN "" VALUE 0x72832 TKW_VV_VV_UB 100.0 FORMULA_0003 0.0 255.0 /end CHARACTERISTIC
/begin CHARACTERISTIC K_TSTFIL_IN "" VALUE 0x727E4 TKW_VV_VV_UW 100.0 FORMULA_0471 0.0 49151.25 FORMAT "%5.2" /end CHARACTERISTIC
/begin CHARACTERISTIC K_TSTFIL_INI "" VALUE 0x72833 TKW_VV_VV_UB 100.0 FORMULA_0003 0.0 255.0 /end CHARACTERISTIC
/begin CHARACTERISTIC K_TUMGGNMN "minimale Umgebungstemperatur für Generatorreduzierung" VALUE 0x7466C TKW_VV_VV_SW 100.0 FORMULA_0431 -3276.800048828125 3276.699951171875 /end CHARACTERISTIC
/begin CHARACTERISTIC K_TUMGGNMX "maximale Umgebungstemperatur für Generatorreduzierung" VALUE 0x7466E TKW_VV_VV_SW 100.0 FORMULA_0431 -3276.800048828125 3276.699951171875 /end CHARACTERISTIC
/begin CHARACTERISTIC K_TVLOFHYST "Hysterese Generatorvollastabschaltung" VALUE 0x74688 TKW_VV_VV_UB 100.0 FORMULA_0003 0.0 255.0 /end CHARACTERISTIC
/begin CHARACTERISTIC K_U_BNMAX "Maximale Bordnetzspannung" VALUE 0x78952 TKW_VV_VV_UW 100.0 FORMULA_0466 0.0 6553.5 FORMAT "%6.3" /end CHARACTERISTIC
/begin CHARACTERISTIC K_U_IGRRAMP "iGR Spannungsrampe" VALUE 0x78954 TKW_VV_VV_UW 100.0 FORMULA_0466 0.0 6553.5 FORMAT "%6.3" /end CHARACTERISTIC
/begin CHARACTERISTIC K_UBNS "Spannungswert für krit. Bordnetzzustand" VALUE 0x78946 TKW_VV_VV_UW 100.0 FORMULA_0466 0.0 6553.5 FORMAT "%6.3" /end CHARACTERISTIC
/begin CHARACTERISTIC K_UDIODERMS1 "RMS-Schwellspannung Generatordiode1" VALUE 0x72834 TKW_VV_VV_UB 100.0 FORMULA_0477 0.0 1.99210000038147 /end CHARACTERISTIC
/begin CHARACTERISTIC K_UDIODERMS2 "RMS-Schwellspannung Generatordiode2" VALUE 0x72835 TKW_VV_VV_UB 100.0 FORMULA_0477 0.0 1.99210000038147 /end CHARACTERISTIC
/begin CHARACTERISTIC K_UDIODERMS3 "RMS-Schwellspannung Generatordiode3" VALUE 0x72836 TKW_VV_VV_UB 100.0 FORMULA_0477 0.0 1.99210000038147 /end CHARACTERISTIC
/begin CHARACTERISTIC K_UDIODERMS4 "RMS-Schwellspannung Generatordiode3" VALUE 0x72837 TKW_VV_VV_UB 100.0 FORMULA_0477 0.0 1.99210000038147 /end CHARACTERISTIC
/begin CHARACTERISTIC K_UGENDELTA "Spannungsdelta bei Betrieb von 2 Generatoren" VALUE 0x78948 TKW_VV_VV_UW 100.0 FORMULA_0466 0.0 6553.5 FORMAT "%6.3" /end CHARACTERISTIC
/begin CHARACTERISTIC K_UGENMAXE65 "Maximale Generatorspannung im E65" VALUE 0x7894A TKW_VV_VV_UW 100.0 FORMULA_0466 0.0 6553.5 FORMAT "%6.3" /end CHARACTERISTIC
/begin CHARACTERISTIC K_UGENOFF "Generatorauschaltspannung bei vfzg != 0" VALUE 0x7894C TKW_VV_VV_UW 100.0 FORMULA_0466 0.0 6553.5 FORMAT "%6.3" /end CHARACTERISTIC
/begin CHARACTERISTIC K_UGENOFFSTART "Spannung im Start Generator" VALUE 0x7894E TKW_VV_VV_UW 100.0 FORMULA_0466 0.0 6553.5 FORMAT "%6.3" /end CHARACTERISTIC
/begin CHARACTERISTIC K_UGENOFFV0 "Generatorauschaltspannung bei vfzg = 0" VALUE 0x78950 TKW_VV_VV_UW 100.0 FORMULA_0466 0.0 6553.5 FORMAT "%6.3" /end CHARACTERISTIC
/begin CHARACTERISTIC K_V_MAX_ANH_KM_STAND "minimaler km-Stand fuer v_max-Anhebung" VALUE 0x7953C TKW_VV_VV_UW 100.0 FORMULA_0613 0.0 65535.0 /end CHARACTERISTIC
/begin CHARACTERISTIC K_V_MAX_ANH_MAX_CNT "Begrenzung v_max-Anhebungen per Tester" VALUE 0x7953E TKW_VV_VV_UB 100.0 FORMULA_0003 0.0 4.0 /end CHARACTERISTIC
/begin CHARACTERISTIC K_V_MAX_FF_RESET "FF-Reset fuer meinen INCA-Spezl" VALUE 0x79538 TKW_VV_VV_UB 100.0 FORMULA_0998 0.0 255.0 /end CHARACTERISTIC
/begin CHARACTERISTIC K_V_MAX_MAX "Stoll'sche v_max-Konstante" VALUE 0x7953A TKW_VV_VV_SW 100.0 FORMULA_0076 -80.0 360.0 FORMAT "%4.1" /end CHARACTERISTIC
/begin CHARACTERISTIC K_V_RAD_TOL_CFG "Schalter RadToleranz" VALUE 0x79536 TKW_VV_VV_UB 100.0 FORMULA_1238 0.0 255.0 /end CHARACTERISTIC
/begin CHARACTERISTIC K_V_RAD_TOL_TAU "Filterkonstante RadToleranz" VALUE 0x79537 TKW_VV_VV_UB 100.0 FORMULA_0645 5.100000184029341e-003 1.279999971389771 /end CHARACTERISTIC
/begin CHARACTERISTIC K_VGENOFMN "Geschwindigkeitgeneratorabschaltschwelle bei Vollastbeschleunigung" VALUE 0x74678 TKW_VV_VV_UW 100.0 FORMULA_0474 0.0 65535.0 /end CHARACTERISTIC
/begin CHARACTERISTIC K_VGENOGMX "Geschwindigkeitgeneratorzuschaltschwelle bei Vollastbeschleunigung" VALUE 0x7467A TKW_VV_VV_UW 100.0 FORMULA_0474 0.0 65535.0 /end CHARACTERISTIC
/begin CHARACTERISTIC K_VZLORESOFV "Geschwindigkeitsschwelle für Generatorzuschaltung" VALUE 0x7467C TKW_VV_VV_UW 100.0 FORMULA_0474 0.0 65535.0 /end CHARACTERISTIC
/begin CHARACTERISTIC K_ZMGENIG "" VALUE 0x727E6 TKW_VV_VV_UW 100.0 FORMULA_0460 0.0 0.9999847412109375 FORMAT "%7.4" /end CHARACTERISTIC
/begin CHARACTERISTIC K_ZMGENS0HZ1 "Zeitkonstante Generatorstator1 Aufheizung im Stand" VALUE 0x727E8 TKW_VV_VV_UW 100.0 FORMULA_0460 0.0 0.9999847412109375 FORMAT "%7.4" /end CHARACTERISTIC
/begin CHARACTERISTIC K_ZMGENS0HZ2 "Zeitkonstante Generatorstator2 Aufheizung im Stand" VALUE 0x727EA TKW_VV_VV_UW 100.0 FORMULA_0460 0.0 0.9999847412109375 FORMAT "%7.4" /end CHARACTERISTIC
/begin CHARACTERISTIC K_ZMGENS0HZ3 "Zeitkonstante Generatorstator3 Aufheizung im Stand" VALUE 0x727EC TKW_VV_VV_UW 100.0 FORMULA_0460 0.0 0.9999847412109375 FORMAT "%7.4" /end CHARACTERISTIC
/begin CHARACTERISTIC K_ZMGENS0HZ4 "Zeitkonstante Generatorstator4 Aufheizung im Stand" VALUE 0x727EE TKW_VV_VV_UW 100.0 FORMULA_0460 0.0 0.9999847412109375 FORMAT "%7.4" /end CHARACTERISTIC
/begin CHARACTERISTIC K_ZMGENS0KL1 "Zeitkonstante Abkühlung Generator im Stand1" VALUE 0x727F0 TKW_VV_VV_UW 100.0 FORMULA_0460 0.0 0.9999847412109375 FORMAT "%7.4" /end CHARACTERISTIC
/begin CHARACTERISTIC K_ZMGENS0KL2 "Zeitkonstante Abkühlung Generator im Stand2" VALUE 0x727F2 TKW_VV_VV_UW 100.0 FORMULA_0460 0.0 0.9999847412109375 FORMAT "%7.4" /end CHARACTERISTIC
/begin CHARACTERISTIC K_ZMGENS0KL3 "Zeitkonstante Abkühlung Generator im Stand3" VALUE 0x727F4 TKW_VV_VV_UW 100.0 FORMULA_0460 0.0 0.9999847412109375 FORMAT "%7.4" /end CHARACTERISTIC
/begin CHARACTERISTIC K_ZMGENS0KL4 "Zeitkonstante Abkühlung Generator im Stand4" VALUE 0x727F6 TKW_VV_VV_UW 100.0 FORMULA_0460 0.0 0.9999847412109375 FORMAT "%7.4" /end CHARACTERISTIC
/begin CHARACTERISTIC K_ZMGENSTHZ1 "Zeitkonstante Generatorstator1 Aufheizung" VALUE 0x727F8 TKW_VV_VV_UW 100.0 FORMULA_0460 0.0 0.9999847412109375 FORMAT "%7.4" /end CHARACTERISTIC
/begin CHARACTERISTIC K_ZMGENSTHZ2 "Zeitkonstante Generatorstator2 Aufheizung" VALUE 0x727FA TKW_VV_VV_UW 100.0 FORMULA_0460 0.0 0.9999847412109375 FORMAT "%7.4" /end CHARACTERISTIC
/begin CHARACTERISTIC K_ZMGENSTHZ3 "Zeitkonstante Generatorstator3 Aufheizung" VALUE 0x727FC TKW_VV_VV_UW 100.0 FORMULA_0460 0.0 0.9999847412109375 FORMAT "%7.4" /end CHARACTERISTIC
/begin CHARACTERISTIC K_ZMGENSTHZ4 "Zeitkonstante Generatorstator4 Aufheizung" VALUE 0x727FE TKW_VV_VV_UW 100.0 FORMULA_0460 0.0 0.9999847412109375 FORMAT "%7.4" /end CHARACTERISTIC
/begin CHARACTERISTIC K_ZMGENSTKL1 "Zeitkonstante Abkühlung Generator1" VALUE 0x72800 TKW_VV_VV_UW 100.0 FORMULA_0460 0.0 0.9999847412109375 FORMAT "%7.4" /end CHARACTERISTIC
/begin CHARACTERISTIC K_ZMGENSTKL2 "Zeitkonstante Abkühlung Generator2" VALUE 0x72802 TKW_VV_VV_UW 100.0 FORMULA_0460 0.0 0.9999847412109375 FORMAT "%7.4" /end CHARACTERISTIC
/begin CHARACTERISTIC K_ZMGENSTKL3 "Zeitkonstante Abkühlung Generator3" VALUE 0x72804 TKW_VV_VV_UW 100.0 FORMULA_0460 0.0 0.9999847412109375 FORMAT "%7.4" /end CHARACTERISTIC
/begin CHARACTERISTIC K_ZMGENSTKL4 "Zeitkonstante Abkühlung Generator4" VALUE 0x72806 TKW_VV_VV_UW 100.0 FORMULA_0460 0.0 0.9999847412109375 FORMAT "%7.4" /end CHARACTERISTIC
/begin CHARACTERISTIC K_ZMGENTWA "" VALUE 0x72808 TKW_VV_VV_UW 100.0 FORMULA_0460 0.0 0.9999847412109375 FORMAT "%7.4" /end CHARACTERISTIC
/begin CHARACTERISTIC K_ZMGN0TANS1 "Zeitkonstante Generatoransaugluft1 bei vfzg = 0" VALUE 0x7280A TKW_VV_VV_UW 100.0 FORMULA_0460 0.0 0.9999847412109375 FORMAT "%7.4" /end CHARACTERISTIC
/begin CHARACTERISTIC K_ZMGN0TANS2 "Zeitkonstante Generatoransaugluft2 bei vfzg = 0" VALUE 0x7280C TKW_VV_VV_UW 100.0 FORMULA_0460 0.0 0.9999847412109375 FORMAT "%7.4" /end CHARACTERISTIC
/begin CHARACTERISTIC K_ZMGN0TANS3 "Zeitkonstante Generatoransaugluft3 bei vfzg = 0" VALUE 0x7280E TKW_VV_VV_UW 100.0 FORMULA_0460 0.0 0.9999847412109375 FORMAT "%7.4" /end CHARACTERISTIC
/begin CHARACTERISTIC K_ZMGN0TANS4 "Zeitkonstante Generatoransaugluft4 bei vfzg = 0" VALUE 0x72810 TKW_VV_VV_UW 100.0 FORMULA_0460 0.0 0.9999847412109375 FORMAT "%7.4" /end CHARACTERISTIC
/begin CHARACTERISTIC K_ZMGNTANS1 "Zeitkonstante Generatoransaugluft1" VALUE 0x72812 TKW_VV_VV_UW 100.0 FORMULA_0460 0.0 0.9999847412109375 FORMAT "%7.4" /end CHARACTERISTIC
/begin CHARACTERISTIC K_ZMGNTANS2 "Zeitkonstante Generatoransaugluft2" VALUE 0x72814 TKW_VV_VV_UW 100.0 FORMULA_0460 0.0 0.9999847412109375 FORMAT "%7.4" /end CHARACTERISTIC
/begin CHARACTERISTIC K_ZMGNTANS3 "Zeitkonstante Generatoransaugluft3" VALUE 0x72816 TKW_VV_VV_UW 100.0 FORMULA_0460 0.0 0.9999847412109375 FORMAT "%7.4" /end CHARACTERISTIC
/begin CHARACTERISTIC K_ZMGNTANS4 "Zeitkonstante Generatoransaugluft3" VALUE 0x72818 TKW_VV_VV_UW 100.0 FORMULA_0460 0.0 0.9999847412109375 FORMAT "%7.4" /end CHARACTERISTIC
/begin CHARACTERISTIC K_ZMIGMISCH "Zeitkonstante IG Mischung" VALUE 0x7281A TKW_VV_VV_UW 100.0 FORMULA_0460 0.0 0.9999847412109375 FORMAT "%7.4" /end CHARACTERISTIC
/begin CHARACTERISTIC K_ZMTESTFIL "" VALUE 0x7281C TKW_VV_VV_UW 100.0 FORMULA_0460 0.0 0.9999847412109375 FORMAT "%7.4" /end CHARACTERISTIC
/begin CHARACTERISTIC KF_FPLAU_OBD_AQ_DELTA_ML_MAX "Max. erlaubte Abweichung" MAP 0x72216 TKF_SW_SW_SW 100.0 FORMULA_0706 -200.0 255.0 FORMAT "%4.1" /begin AXIS_DESCR STD_AXIS n FORMULA_0006 8 0.0 10000.0 MAX_GRAD 0.0 /end AXIS_DESCR
 /begin AXIS_DESCR STD_AXIS rf_m FORMULA_0007 8 0.0 2.0 MAX_GRAD 0.0 FORMAT "%6.3" /end AXIS_DESCR
/end CHARACTERISTIC
/begin CHARACTERISTIC KF_FPLAU_OBD_HFM_DELTA_ML_MAX "Max. erlaubte Abweichung" MAP 0x72174 TKF_SW_SW_SW 100.0 FORMULA_0706 -200.0 255.0 FORMAT "%4.1" /begin AXIS_DESCR STD_AXIS n FORMULA_0006 8 0.0 10000.0 MAX_GRAD 0.0 /end AXIS_DESCR
 /begin AXIS_DESCR STD_AXIS rf_m FORMULA_0007 8 0.0 2.0 MAX_GRAD 0.0 FORMAT "%6.3" /end AXIS_DESCR
/end CHARACTERISTIC
/begin CHARACTERISTIC KF_FPLAU_OBD_LAM_DELTA_ML_MAX "Max. erlaubte Abweichung" MAP 0x722B8 TKF_SW_SW_SW 100.0 FORMULA_0706 -200.0 255.0 FORMAT "%4.1" /begin AXIS_DESCR STD_AXIS n FORMULA_0006 3 0.0 10000.0 MAX_GRAD 0.0 /end AXIS_DESCR
 /begin AXIS_DESCR STD_AXIS rf_m FORMULA_0007 8 0.0 2.0 MAX_GRAD 0.0 FORMAT "%6.3" /end AXIS_DESCR
/end CHARACTERISTIC
/begin CHARACTERISTIC KF_GENWETA1 "Wirkungsgrad1 Generator mit 2*PI" MAP 0x72B54 TKF_SW_UB_UB 100.0 FORMULA_0449 0.0 7.968699932098389 /begin AXIS_DESCR STD_AXIS I_gm FORMULA_0463 8 0.0 255.0 MAX_GRAD 0.0 /end AXIS_DESCR
 /begin AXIS_DESCR STD_AXIS N_gen FORMULA_0006 8 -32768.0 32767.0 MAX_GRAD 0.0 /end AXIS_DESCR
/end CHARACTERISTIC
/begin CHARACTERISTIC KF_GENWETA2 "Wirkungsgrad2 Generator mit 2*PI" MAP 0x72BAE TKF_SW_UB_UB 100.0 FORMULA_0449 0.0 7.968699932098389 /begin AXIS_DESCR STD_AXIS I_gm FORMULA_0463 8 0.0 255.0 MAX_GRAD 0.0 /end AXIS_DESCR
 /begin AXIS_DESCR STD_AXIS N_gen FORMULA_0006 8 -32768.0 32767.0 MAX_GRAD 0.0 /end AXIS_DESCR
/end CHARACTERISTIC
/begin CHARACTERISTIC KF_GENWETA3 "Wirkungsgrad3 Generator mit 2*PI" MAP 0x72CC4 TKF_SW_UB_UB 100.0 FORMULA_0449 0.0 7.968699932098389 /begin AXIS_DESCR STD_AXIS I_gm FORMULA_0463 8 0.0 255.0 MAX_GRAD 0.0 /end AXIS_DESCR
 /begin AXIS_DESCR STD_AXIS N_gen FORMULA_0006 8 -32768.0 32767.0 MAX_GRAD 0.0 /end AXIS_DESCR
/end CHARACTERISTIC
/begin CHARACTERISTIC KF_GENWETA4 "Wirkungsgrad4 Generator mit 2*PI" MAP 0x72C6A TKF_SW_UB_UB 100.0 FORMULA_0449 0.0 7.968699932098389 /begin AXIS_DESCR STD_AXIS I_gm FORMULA_0463 8 0.0 255.0 MAX_GRAD 0.0 /end AXIS_DESCR
 /begin AXIS_DESCR STD_AXIS N_gen FORMULA_0006 8 -32768.0 32767.0 MAX_GRAD 0.0 /end AXIS_DESCR
/end CHARACTERISTIC
/begin CHARACTERISTIC KF_IGENDF1 "Generatorstrom1 DF-Kennfeld" MAP 0x72D67 TKF_UB_UB_UB 100.0 FORMULA_0463 0.0 255.0
 /begin AXIS_DESCR STD_AXIS Dffgen FORMULA_0475 7 0.0 99.60929870605469 MAX_GRAD 0.0 /end AXIS_DESCR
 /begin AXIS_DESCR STD_AXIS I_genmax FORMULA_0463 8 0.0 255.0 MAX_GRAD 0.0 /end AXIS_DESCR
/end CHARACTERISTIC
/begin CHARACTERISTIC KF_IGENDF2 "Generatorstrom2 DF-Kennfeld" MAP 0x72D1E TKF_UB_UB_UB 100.0 FORMULA_0463 0.0 255.0
 /begin AXIS_DESCR STD_AXIS Dffgen FORMULA_0475 7 0.0 99.60929870605469 MAX_GRAD 0.0 /end AXIS_DESCR
 /begin AXIS_DESCR STD_AXIS I_genmax FORMULA_0463 8 0.0 255.0 MAX_GRAD 0.0 /end AXIS_DESCR
/end CHARACTERISTIC
/begin CHARACTERISTIC KF_IGENDF3 "Generatorstrom3 DF-Kennfeld" MAP 0x72DF9 TKF_UB_UB_UB 100.0 FORMULA_0463 0.0 255.0
 /begin AXIS_DESCR STD_AXIS Dffgen FORMULA_0475 7 0.0 99.60929870605469 MAX_GRAD 0.0 /end AXIS_DESCR
 /begin AXIS_DESCR STD_AXIS I_genmax FORMULA_0463 8 0.0 255.0 MAX_GRAD 0.0 /end AXIS_DESCR
/end CHARACTERISTIC
/begin CHARACTERISTIC KF_IGENDF4 "Generatorstrom4 DF-Kennfeld" MAP 0x72DB0 TKF_UB_UB_UB 100.0 FORMULA_0463 0.0 255.0
 /begin AXIS_DESCR STD_AXIS Dffgen FORMULA_0475 7 0.0 99.60929870605469 MAX_GRAD 0.0 /end AXIS_DESCR
 /begin AXIS_DESCR STD_AXIS I_genmax FORMULA_0463 8 0.0 255.0 MAX_GRAD 0.0 /end AXIS_DESCR
/end CHARACTERISTIC
/begin CHARACTERISTIC KF_IGENKA1 "Kaltkennfeld 1 Generator" MAP 0x72704 TKF_SW_UW_UB 100.0 FORMULA_0463 0.0 255.0
 /begin AXIS_DESCR STD_AXIS U_gen FORMULA_0466 7 0.0 6553.5 MAX_GRAD 0.0 FORMAT "%6.3" /end AXIS_DESCR
 /begin AXIS_DESCR STD_AXIS N_gen FORMULA_0006 9 -32768.0 32767.0 MAX_GRAD 0.0 /end AXIS_DESCR
/end CHARACTERISTIC
/begin CHARACTERISTIC KF_IGENKA2 "Kaltkennfeld 2 Generator" MAP 0x72540 TKF_SW_UW_UB 100.0 FORMULA_0463 0.0 255.0
 /begin AXIS_DESCR STD_AXIS U_gen FORMULA_0466 7 0.0 6553.5 MAX_GRAD 0.0 FORMAT "%6.3" /end AXIS_DESCR
 /begin AXIS_DESCR STD_AXIS N_gen FORMULA_0006 9 -32768.0 32767.0 MAX_GRAD 0.0 /end AXIS_DESCR
/end CHARACTERISTIC
/begin CHARACTERISTIC KF_IGENKA3 "Kaltkennfeld 3 Generator" MAP 0x72622 TKF_SW_UW_UB 100.0 FORMULA_0463 0.0 255.0
 /begin AXIS_DESCR STD_AXIS U_gen FORMULA_0466 7 0.0 6553.5 MAX_GRAD 0.0 FORMAT "%6.3" /end AXIS_DESCR
 /begin AXIS_DESCR STD_AXIS N_gen FORMULA_0006 9 -32768.0 32767.0 MAX_GRAD 0.0 /end AXIS_DESCR
/end CHARACTERISTIC
/begin CHARACTERISTIC KF_IGENKA4 "Kaltkennfeld 4 Generator" MAP 0x72766 TKF_SW_UW_UB 100.0 FORMULA_0463 0.0 255.0
 /begin AXIS_DESCR STD_AXIS U_gen FORMULA_0466 7 0.0 6553.5 MAX_GRAD 0.0 FORMAT "%6.3" /end AXIS_DESCR
 /begin AXIS_DESCR STD_AXIS N_gen FORMULA_0006 9 -32768.0 32767.0 MAX_GRAD 0.0 /end AXIS_DESCR
/end CHARACTERISTIC
/begin CHARACTERISTIC KF_IGENWA1 "Warmkennfeld 1 Generator" MAP 0x725E2 TKF_SW_UB_UB 100.0 FORMULA_0463 0.0 255.0
 /begin AXIS_DESCR STD_AXIS Gen_i_kaltun FORMULA_0463 6 0.0 255.0 MAX_GRAD 0.0 /end AXIS_DESCR
 /begin AXIS_DESCR STD_AXIS Tgen_end FORMULA_0431 7 -3276.800048828125 3276.699951171875 MAX_GRAD 0.0 /end AXIS_DESCR
/end CHARACTERISTIC
/begin CHARACTERISTIC KF_IGENWA2 "Warmkennfeld 2 Generator" MAP 0x725A2 TKF_SW_UB_UB 100.0 FORMULA_0463 0.0 255.0
 /begin AXIS_DESCR STD_AXIS Gen_i_kaltun FORMULA_0463 6 0.0 255.0 MAX_GRAD 0.0 /end AXIS_DESCR
 /begin AXIS_DESCR STD_AXIS Tgen_end FORMULA_0431 7 -3276.800048828125 3276.699951171875 MAX_GRAD 0.0 /end AXIS_DESCR
/end CHARACTERISTIC
/begin CHARACTERISTIC KF_IGENWA3 "Warmkennfeld 3 Generator" MAP 0x726C4 TKF_SW_UB_UB 100.0 FORMULA_0463 0.0 255.0
 /begin AXIS_DESCR STD_AXIS Gen_i_kaltun FORMULA_0463 6 0.0 255.0 MAX_GRAD 0.0 /end AXIS_DESCR
 /begin AXIS_DESCR STD_AXIS Tgen_end FORMULA_0431 7 -3276.800048828125 3276.699951171875 MAX_GRAD 0.0 /end AXIS_DESCR
/end CHARACTERISTIC
/begin CHARACTERISTIC KF_IGENWA4 "Warmkennfeld 4 Generator" MAP 0x72684 TKF_SW_UB_UB 100.0 FORMULA_0463 0.0 255.0
 /begin AXIS_DESCR STD_AXIS Gen_i_kaltun FORMULA_0463 6 0.0 255.0 MAX_GRAD 0.0 /end AXIS_DESCR
 /begin AXIS_DESCR STD_AXIS Tgen_end FORMULA_0431 7 -3276.800048828125 3276.699951171875 MAX_GRAD 0.0 /end AXIS_DESCR
/end CHARACTERISTIC
/begin CHARACTERISTIC KF_LORESP "Kennfeld Loadresponse ueber Motordrehzahl und rel. Luftmasse" MAP 0x74740 TKF_SW_SW_UB 100.0 FORMULA_0461 0.0 25.5 /begin AXIS_DESCR STD_AXIS Nkw FORMULA_0006 6 -32768.0 32767.0 MAX_GRAD 0.0 /end AXIS_DESCR
 /begin AXIS_DESCR STD_AXIS Rf FORMULA_0480 6 -327.6799926757813 327.6700134277344 MAX_GRAD 0.0 FORMAT "%7.4" /end AXIS_DESCR
/end CHARACTERISTIC
/begin CHARACTERISTIC KF_LRMAXG "Loadresponse bei begrenztem Generatormoment" MAP 0x746C4 TKF_SW_UB_UB 100.0 FORMULA_0461 0.0 25.5
 /begin AXIS_DESCR STD_AXIS Na_bnanteil FORMULA_0477 8 0.0 1.99210000038147 MAX_GRAD 0.0 /end AXIS_DESCR
 /begin AXIS_DESCR STD_AXIS Rf FORMULA_0480 8 -327.6799926757813 327.6700134277344 MAX_GRAD 0.0 FORMAT "%7.4" /end AXIS_DESCR
/end CHARACTERISTIC
/begin CHARACTERISTIC KF_MDGENFIL "Filterung Generatormoment" MAP 0x72C08 TKF_SW_SW_UW 100.0 FORMULA_0460 0.0 0.9999847412109375 FORMAT "%7.4"
 /begin AXIS_DESCR STD_AXIS Md_gennmufi FORMULA_0113 6 -3276.800048828125 3276.699951171875 MAX_GRAD 0.0 FORMAT "%5.2" /end AXIS_DESCR
 /begin AXIS_DESCR STD_AXIS Nkw FORMULA_0006 6 -32768.0 32767.0 MAX_GRAD 0.0 /end AXIS_DESCR
/end CHARACTERISTIC
/begin CHARACTERISTIC KF_ZLRESOF "Kennfeld Generatorausschaltzeit bei Stillstand" MAP 0x7471E TKF_UW_SW_UB 100.0 FORMULA_0481 0.0 255.0
 /begin AXIS_DESCR STD_AXIS Tmot_start FORMULA_0445 4 -327.6799926757813 327.6700134277344 MAX_GRAD 0.0 FORMAT "%5.2" /end AXIS_DESCR
 /begin AXIS_DESCR STD_AXIS Km_st FORMULA_0437 4 0.0 655350.0 MAX_GRAD 0.0 /end AXIS_DESCR
/end CHARACTERISTIC
/begin CHARACTERISTIC KF_ZLRRESOFV "Kennfeld Generatorausschaltzeit bei Fahrt" MAP 0x746A2 TKF_UW_SW_UB 100.0 FORMULA_0481 0.0 255.0
 /begin AXIS_DESCR STD_AXIS Tmot_start FORMULA_0445 4 -327.6799926757813 327.6700134277344 MAX_GRAD 0.0 FORMAT "%5.2" /end AXIS_DESCR
 /begin AXIS_DESCR STD_AXIS Km_st FORMULA_0437 4 0.0 655350.0 MAX_GRAD 0.0 /end AXIS_DESCR
/end CHARACTERISTIC
/begin CHARACTERISTIC KL_FPDIODE1 "Verlustleistungsfaktor eines Diodenpaars1" CURVE 0x72ADE TKL_SW_VV_UB 100.0 FORMULA_0477 0.0 1.99210000038147
 /begin AXIS_DESCR STD_AXIS Tgen FORMULA_0431 5 -3276.800048828125 3276.699951171875 MAX_GRAD 0.0 /end AXIS_DESCR
/end CHARACTERISTIC
/begin CHARACTERISTIC KL_FPDIODE2 "Verlustleistungsfaktor eines Diodenpaars2" CURVE 0x72B42 TKL_SW_VV_UB 100.0 FORMULA_0477 0.0 1.99210000038147
 /begin AXIS_DESCR STD_AXIS Tgen FORMULA_0431 5 -3276.800048828125 3276.699951171875 MAX_GRAD 0.0 /end AXIS_DESCR
/end CHARACTERISTIC
/begin CHARACTERISTIC KL_FPDIODE3 "Verlustleistungsfaktor eines Diodenpaars" CURVE 0x72AA6 TKL_SW_VV_UB 100.0 FORMULA_0477 0.0 1.99210000038147
 /begin AXIS_DESCR STD_AXIS Tgen FORMULA_0431 5 -3276.800048828125 3276.699951171875 MAX_GRAD 0.0 /end AXIS_DESCR
/end CHARACTERISTIC
/begin CHARACTERISTIC KL_FPDIODE4 "Verlustleistungsfaktor eines Diodenpaars4" CURVE 0x72B30 TKL_SW_VV_UB 100.0 FORMULA_0477 0.0 1.99210000038147
 /begin AXIS_DESCR STD_AXIS Tgen FORMULA_0431 5 -3276.800048828125 3276.699951171875 MAX_GRAD 0.0 /end AXIS_DESCR
/end CHARACTERISTIC
/begin CHARACTERISTIC KL_GENEXP1 "Abkühlkurve Generator1" CURVE 0x72950 TKL_UW_VV_UB 100.0 FORMULA_0455 0.0 0.9959999918937683
 /begin AXIS_DESCR STD_AXIS Tn_abstell FORMULA_0010 13 0.0 65535.0 MAX_GRAD 0.0 /end AXIS_DESCR
/end CHARACTERISTIC
/begin CHARACTERISTIC KL_GENEXP2 "Abkühlkurve Generator2" CURVE 0x728F4 TKL_UW_VV_UB 100.0 FORMULA_0455 0.0 0.9959999918937683
 /begin AXIS_DESCR STD_AXIS Tn_abstell FORMULA_0010 13 0.0 65535.0 MAX_GRAD 0.0 /end AXIS_DESCR
/end CHARACTERISTIC
/begin CHARACTERISTIC KL_GENEXP3 "Abkühlkurve Generator3" CURVE 0x72A7C TKL_UW_VV_UB 100.0 FORMULA_0455 0.0 0.9959999918937683
 /begin AXIS_DESCR STD_AXIS Tn_abstell FORMULA_0010 13 0.0 65535.0 MAX_GRAD 0.0 /end AXIS_DESCR
/end CHARACTERISTIC
/begin CHARACTERISTIC KL_GENEXP4 "Abkühlkurve Generator4" CURVE 0x729A4 TKL_UW_VV_UB 100.0 FORMULA_0455 0.0 0.9959999918937683
 /begin AXIS_DESCR STD_AXIS Tn_abstell FORMULA_0010 13 0.0 65535.0 MAX_GRAD 0.0 /end AXIS_DESCR
/end CHARACTERISTIC
/begin CHARACTERISTIC KL_GENLDST "Auslastungsgrad Generator" CURVE 0x74628 TKL_SW_VV_UB 100.0 FORMULA_0475 0.0 99.60929870605469
 /begin AXIS_DESCR STD_AXIS Tgen FORMULA_0431 6 -3276.800048828125 3276.699951171875 MAX_GRAD 0.0 /end AXIS_DESCR
/end CHARACTERISTIC
/begin CHARACTERISTIC KL_GENTETA1 "Temperatur_eta_faktor Generator1" CURVE 0x72AB8 TKL_SW_VV_UW 100.0 FORMULA_0024 0.0 1.999899983406067 FORMAT "%7.4"
 /begin AXIS_DESCR STD_AXIS Tgen FORMULA_0431 3 -3276.800048828125 3276.699951171875 MAX_GRAD 0.0 /end AXIS_DESCR
/end CHARACTERISTIC
/begin CHARACTERISTIC KL_GENTETA2 "Temperatur_eta_faktor Generator2" CURVE 0x72B0A TKL_SW_VV_UW 100.0 FORMULA_0024 0.0 1.999899983406067 FORMAT "%7.4"
 /begin AXIS_DESCR STD_AXIS Tgen FORMULA_0431 3 -3276.800048828125 3276.699951171875 MAX_GRAD 0.0 /end AXIS_DESCR
/end CHARACTERISTIC
/begin CHARACTERISTIC KL_GENTETA3 "Temperatur_eta_faktor Generator3" CURVE 0x7289C TKL_SW_VV_UW 100.0 FORMULA_0024 0.0 1.999899983406067 FORMAT "%7.4"
 /begin AXIS_DESCR STD_AXIS Tgen FORMULA_0431 3 -3276.800048828125 3276.699951171875 MAX_GRAD 0.0 /end AXIS_DESCR
/end CHARACTERISTIC
/begin CHARACTERISTIC KL_GENTETA4 "Temperatur_eta_faktor Generator4" CURVE 0x72874 TKL_SW_VV_UW 100.0 FORMULA_0024 0.0 1.999899983406067 FORMAT "%7.4"
 /begin AXIS_DESCR STD_AXIS Tgen FORMULA_0431 3 -3276.800048828125 3276.699951171875 MAX_GRAD 0.0 /end AXIS_DESCR
/end CHARACTERISTIC
/begin CHARACTERISTIC KL_LORESPM "Motorabhängiger Loadresponse-Faktor" CURVE 0x7468E TKL_SW_VV_UB 100.0 FORMULA_0465 0.0 3.984299898147583
 /begin AXIS_DESCR STD_AXIS Tmot FORMULA_0445 6 -327.6799926757813 327.6700134277344 MAX_GRAD 0.0 FORMAT "%5.2" /end AXIS_DESCR
/end CHARACTERISTIC
/begin CHARACTERISTIC KL_RTH0FAK1 "RTHfaktor1 ueber Generatorstrom" CURVE 0x728AA TKL_UB_VV_UB 100.0 FORMULA_0465 0.0 3.984299898147583 /begin AXIS_DESCR STD_AXIS I_gen_end FORMULA_0463 11 0.0 255.0 MAX_GRAD 0.0 /end AXIS_DESCR /end CHARACTERISTIC
/begin CHARACTERISTIC KL_RTH0FAK2 "RTHfaktor 2 ueber Generatorstrom" CURVE 0x72AC6 TKL_UB_VV_UB 100.0 FORMULA_0465 0.0 3.984299898147583 /begin AXIS_DESCR STD_AXIS I_gen_end FORMULA_0463 11 0.0 255.0 MAX_GRAD 0.0 /end AXIS_DESCR /end CHARACTERISTIC
/begin CHARACTERISTIC KL_RTH0FAK3 "RTHfaktor3 ueber Generatorstrom" CURVE 0x7285B TKL_UB_VV_UB 100.0 FORMULA_0465 0.0 3.984299898147583 /begin AXIS_DESCR STD_AXIS I_gen_end FORMULA_0463 11 0.0 255.0 MAX_GRAD 0.0 /end AXIS_DESCR /end CHARACTERISTIC
/begin CHARACTERISTIC KL_RTH0FAK4 "RTHfaktor4 ueber Generatorstrom" CURVE 0x728DC TKL_UB_VV_UB 100.0 FORMULA_0465 0.0 3.984299898147583 /begin AXIS_DESCR STD_AXIS I_gen_end FORMULA_0463 11 0.0 255.0 MAX_GRAD 0.0 /end AXIS_DESCR /end CHARACTERISTIC
/begin CHARACTERISTIC KL_RTHFAK1 "RTHfaktor ueber Generatorstrom" CURVE 0x72B18 TKL_UB_VV_UB 100.0 FORMULA_0465 0.0 3.984299898147583 /begin AXIS_DESCR STD_AXIS I_gen_end FORMULA_0463 11 0.0 255.0 MAX_GRAD 0.0 /end AXIS_DESCR /end CHARACTERISTIC
/begin CHARACTERISTIC KL_RTHFAK2 "RTHfaktor2 ueber Generatorstrom Fahrt" CURVE 0x72938 TKL_UB_VV_UB 100.0 FORMULA_0465 0.0 3.984299898147583 /begin AXIS_DESCR STD_AXIS I_gen_end FORMULA_0463 11 0.0 255.0 MAX_GRAD 0.0 /end AXIS_DESCR /end CHARACTERISTIC
/begin CHARACTERISTIC KL_RTHFAK3 "RTHfaktor3 ueber Generatorstrom Fahrt" CURVE 0x72A22 TKL_UB_VV_UB 100.0 FORMULA_0465 0.0 3.984299898147583 /begin AXIS_DESCR STD_AXIS I_gen_end FORMULA_0463 11 0.0 255.0 MAX_GRAD 0.0 /end AXIS_DESCR /end CHARACTERISTIC
/begin CHARACTERISTIC KL_RTHFAK4 "RTHfaktor4 ueber Generatorstrom Fahrt" CURVE 0x72A64 TKL_UB_VV_UB 100.0 FORMULA_0465 0.0 3.984299898147583 /begin AXIS_DESCR STD_AXIS I_gen_end FORMULA_0463 11 0.0 255.0 MAX_GRAD 0.0 /end AXIS_DESCR /end CHARACTERISTIC
/begin CHARACTERISTIC KL_RTHGEN1 "RTH-Kennfeld Generator1" CURVE 0x728C2 TKL_SW_VV_UW 100.0 FORMULA_0456 0.0 1.0 FORMAT "%7.4"
 /begin AXIS_DESCR STD_AXIS N_gen FORMULA_0006 6 -32768.0 32767.0 MAX_GRAD 0.0 /end AXIS_DESCR
/end CHARACTERISTIC
/begin CHARACTERISTIC KL_RTHGEN2 "RTH-Kennfeld Generator2" CURVE 0x72882 TKL_SW_VV_UW 100.0 FORMULA_0456 0.0 1.0 FORMAT "%7.4"
 /begin AXIS_DESCR STD_AXIS N_gen FORMULA_0006 6 -32768.0 32767.0 MAX_GRAD 0.0 /end AXIS_DESCR
/end CHARACTERISTIC
/begin CHARACTERISTIC KL_RTHGEN3 "RTH-Kennfeld Generator3" CURVE 0x7291E TKL_SW_VV_UW 100.0 FORMULA_0456 0.0 1.0 FORMAT "%7.4"
 /begin AXIS_DESCR STD_AXIS N_gen FORMULA_0006 6 -32768.0 32767.0 MAX_GRAD 0.0 /end AXIS_DESCR
/end CHARACTERISTIC
/begin CHARACTERISTIC KL_RTHGEN4 "RTH-Kennfeld Generator4" CURVE 0x72AF0 TKL_SW_VV_UW 100.0 FORMULA_0456 0.0 1.0 FORMAT "%7.4"
 /begin AXIS_DESCR STD_AXIS N_gen FORMULA_0006 6 -32768.0 32767.0 MAX_GRAD 0.0 /end AXIS_DESCR
/end CHARACTERISTIC
/begin CHARACTERISTIC KL_TANSGEN1 "Kennlinie Generatoransaugluft1" CURVE 0x729F8 TKL_UW_VV_SW 100.0 FORMULA_0431 -3276.800048828125 3276.699951171875 /begin AXIS_DESCR STD_AXIS V FORMULA_0474 10 0.0 360.0 MAX_GRAD 0.0 /end AXIS_DESCR /end CHARACTERISTIC
/begin CHARACTERISTIC KL_TANSGEN2 "Kennlinie Generatoransaugluft2" CURVE 0x72A3A TKL_UW_VV_SW 100.0 FORMULA_0431 -3276.800048828125 3276.699951171875 /begin AXIS_DESCR STD_AXIS V FORMULA_0474 10 0.0 360.0 MAX_GRAD 0.0 /end AXIS_DESCR /end CHARACTERISTIC
/begin CHARACTERISTIC KL_TANSGEN3 "Kennlinie Generatoransaugluft3" CURVE 0x729CE TKL_UW_VV_SW 100.0 FORMULA_0431 -3276.800048828125 3276.699951171875 /begin AXIS_DESCR STD_AXIS V FORMULA_0474 10 0.0 360.0 MAX_GRAD 0.0 /end AXIS_DESCR /end CHARACTERISTIC
/begin CHARACTERISTIC KL_TANSGEN4 "Kennlinie Generatoransaugluft4" CURVE 0x7297A TKL_UW_VV_SW 100.0 FORMULA_0431 -3276.800048828125 3276.699951171875 /begin AXIS_DESCR STD_AXIS V FORMULA_0474 10 0.0 360.0 MAX_GRAD 0.0 /end AXIS_DESCR /end CHARACTERISTIC
/begin CHARACTERISTIC KL_TGETR_NTC "Kennlinie Getriebetemperatur" CURVE 0x7792C TKL_SW_VV_SW 100.0 FORMULA_1167 -50.0 170.0 FORMAT "%6.3" /begin AXIS_DESCR STD_AXIS tgetr_ad FORMULA_0114 8 0.0 1023.0 MAX_GRAD 0.0 /end AXIS_DESCR /end CHARACTERISTIC
/begin CHARACTERISTIC KL_V_MAX_GANG_BEGRENZT "Maximalgeschwindigkeit" CURVE 0x795C8 TKL_SW_VV_SW 100.0 FORMULA_0076 -80.0 360.0 FORMAT "%4.1" /begin AXIS_DESCR STD_AXIS gang FORMULA_0660 8 -1.0 10.0 MAX_GRAD 0.0 /end AXIS_DESCR /end CHARACTERISTIC
/begin CHARACTERISTIC KL_V_MAX_GANG_CABRIO "Maximalgeschwindigkeit angehoben f. Cabrio" CURVE 0x795A6 TKL_SW_VV_SW 100.0 FORMULA_0076 -80.0 360.0 FORMAT "%4.1" /begin AXIS_DESCR STD_AXIS gang FORMULA_0660 8 -1.0 10.0 MAX_GRAD 0.0 /end AXIS_DESCR /end CHARACTERISTIC
/begin CHARACTERISTIC KL_V_MAX_GANG_COUPE "Maximalgeschwindigkeit angehoben f. Coupe" CURVE 0x79584 TKL_SW_VV_SW 100.0 FORMULA_0076 -80.0 360.0 FORMAT "%4.1" /begin AXIS_DESCR STD_AXIS gang FORMULA_0660 8 -1.0 10.0 MAX_GRAD 0.0 /end AXIS_DESCR /end CHARACTERISTIC
/begin CHARACTERISTIC KL_V_MAX_GANG_LIMOUSINE "Maximalgeschwindigkeit angehoben f. Limousine" CURVE 0x79540 TKL_SW_VV_SW 100.0 FORMULA_0076 -80.0 360.0 FORMAT "%4.1" /begin AXIS_DESCR STD_AXIS gang FORMULA_0660 8 -1.0 10.0 MAX_GRAD 0.0 /end AXIS_DESCR /end CHARACTERISTIC
/begin CHARACTERISTIC KL_V_MAX_GANG_TOURING "Maximalgeschwindigkeit angehoben f. Touring" CURVE 0x79562 TKL_SW_VV_SW 100.0 FORMULA_0076 -80.0 360.0 FORMAT "%4.1" /begin AXIS_DESCR STD_AXIS gang FORMULA_0660 8 -1.0 10.0 MAX_GRAD 0.0 /end AXIS_DESCR /end CHARACTERISTIC
/begin CHARACTERISTIC KL_V_MAX_SK "Maximalgeschwindigkeit bei SK-Fehler" CURVE 0x795EA TKL_UB_VV_SW 100.0 FORMULA_0076 -80.0 360.0 FORMAT "%4.1" /begin AXIS_DESCR STD_AXIS Stufe FORMULA_0003 6 0.0 255.0 MAX_GRAD 0.0 /end AXIS_DESCR /end CHARACTERISTIC
/begin CHARACTERISTIC S_ENTLENA "Schalter Generatorentlastungsrampe aktivieren" VALUE 0x7895E TKW_VV_VV_UB 100.0 FORMULA_0478 0.0 1.0 /end CHARACTERISTIC
/begin CHARACTERISTIC S_GENOFFSTART "Schalter zum Freischalten Startausschaltspannung" VALUE 0x7895F TKW_VV_VV_UB 100.0 FORMULA_0478 0.0 1.0 /end CHARACTERISTIC
/begin CHARACTERISTIC S_GOFFRAMP "Schalter Sprung auf 10,6V unverzoegert" VALUE 0x78960 TKW_VV_VV_UB 100.0 FORMULA_0003 0.0 255.0 /end CHARACTERISTIC
/begin CHARACTERISTIC S_IGMISCH "" VALUE 0x72838 TKW_VV_VV_UB 100.0 FORMULA_0478 0.0 1.0 /end CHARACTERISTIC
/begin CHARACTERISTIC S_IGRLOW "Schalter iGR Low Funktion aktiv" VALUE 0x78961 TKW_VV_VV_UB 100.0 FORMULA_0478 0.0 1.0 /end CHARACTERISTIC
/begin CHARACTERISTIC S_LORESLL "Schalter Kennlinienausschaltzeit " VALUE 0x74689 TKW_VV_VV_UB 100.0 FORMULA_0478 0.0 1.0 /end CHARACTERISTIC
/begin CHARACTERISTIC S_MGAPP "Schalter für Applikationswert Genratormaximalmoment" VALUE 0x7468A TKW_VV_VV_UB 100.0 FORMULA_0478 0.0 1.0 /end CHARACTERISTIC
/begin CHARACTERISTIC S_RDGENTYP "" VALUE 0x72839 TKW_VV_VV_UB 100.0 FORMULA_0003 0.0 255.0 /end CHARACTERISTIC
/begin CHARACTERISTIC S_SAPP "Schalter für Applikationswert Begrenzungsstrategie" VALUE 0x7468B TKW_VV_VV_UB 100.0 FORMULA_0478 0.0 1.0 /end CHARACTERISTIC
/begin CHARACTERISTIC S_TLACTIV "Schalter, um Grenzmoment in allen Motorzuständen freizugeben" VALUE 0x7468C TKW_VV_VV_UB 100.0 FORMULA_0478 0.0 1.0 /end CHARACTERISTIC
/begin MEASUREMENT ccp_aramStatus "CCP RAM-Status" UBYTE FORMULA_0364 0 0.0 0.0 255.0 READ_WRITE ECU_ADDRESS 0x3FB1DC /end MEASUREMENT
/begin MEASUREMENT ccp_checksum "CCP ChkSum" UWORD FORMULA_0010 0 0.0 0.0 65535.0 READ_WRITE ECU_ADDRESS 0x3FB1F4 /end MEASUREMENT
/begin MEASUREMENT ccp_moveStatus "CCP Move-Status" UBYTE FORMULA_0366 0 0.0 0.0 255.0 READ_WRITE ECU_ADDRESS 0x3FB200 /end MEASUREMENT
/begin MEASUREMENT ccp_reqSwitch "CCP Umschalt-Status" UBYTE FORMULA_0365 0 0.0 0.0 255.0 READ_WRITE ECU_ADDRESS 0x3FB1DD /end MEASUREMENT
/begin MEASUREMENT ccp_stateChecksum "CCP ChkSum-Status" UBYTE FORMULA_0366 0 0.0 0.0 255.0 READ_WRITE ECU_ADDRESS 0x3FB1F0 /end MEASUREMENT
/begin MEASUREMENT Dffgen "ss_msv.dat" UBYTE FORMULA_0475 0 0.0 0.0 99.60929870605469 READ_WRITE ECU_ADDRESS 0x3FC5F4 /end MEASUREMENT
/begin MEASUREMENT Dfmonitor "DF-Monitor für FASTA" UBYTE FORMULA_0475 0 0.0 0.0 99.60929870605469 READ_WRITE ECU_ADDRESS 0x3FA880 /end MEASUREMENT
/begin MEASUREMENT Dfpropval "" UWORD FORMULA_0472 0 0.0 0.0 31.9995002746582 READ_WRITE ECU_ADDRESS 0x3FC5F2 /end MEASUREMENT
/begin MEASUREMENT Dfsumme "DFMonitor Summe FASTA" FLOAT32_IEEE FORMULA_0044 0 0.0 1.0 3.402823466385289e+038 READ_WRITE ECU_ADDRESS 0x3FA878 /end MEASUREMENT
/begin MEASUREMENT Dfwanzahl "DF-Wertezähler" FLOAT32_IEEE FORMULA_0044 0 0.0 1.0 3.402823466385289e+038 READ_WRITE ECU_ADDRESS 0x3FA87C /end MEASUREMENT
/begin MEASUREMENT ews_st "Status EWS" UBYTE FORMULA_0680 0 0.0 0.0 255.0 READ_WRITE ECU_ADDRESS 0x3FBF06 /end MEASUREMENT
/begin MEASUREMENT ews_stw_st "EWS-STW-Status" UBYTE FORMULA_0681 0 0.0 0.0 255.0 READ_WRITE ECU_ADDRESS 0x3FBF07 /end MEASUREMENT
/begin MEASUREMENT Fdib_ig "" SWORD FORMULA_0469 0 0.0 -32768.0 32767.0 READ_WRITE ECU_ADDRESS 0x3FAD0E /end MEASUREMENT
/begin MEASUREMENT fplau_aq_obd_b1.abw "Prozentuale Abweichung des Luftmassenwertes vom MW" SWORD FORMULA_0706 0 0.0 -200.0 200.0 READ_WRITE ECU_ADDRESS 0x3FBF3A /end MEASUREMENT
/begin MEASUREMENT fplau_aq_obd_b1.cnt "Fehlerzähler Diagnose negativ" UWORD FORMULA_0010 0 0.0 0.0 65535.0 READ_WRITE ECU_ADDRESS 0x3FBF3C /end MEASUREMENT
/begin MEASUREMENT fplau_aq_obd_b1.st "Fuellungsplausibilitaets Statusbyte" UBYTE FORMULA_0707 0 0.0 0.0 255.0 READ_WRITE ECU_ADDRESS 0x3FBF40 /end MEASUREMENT
/begin MEASUREMENT fplau_aq_obd_b1.t "Zeit seit aktueller Diagnosezyklus negativ" UWORD FORMULA_0071 0 0.0 0.0 6553.5 READ_WRITE ECU_ADDRESS 0x3FBF3E /end MEASUREMENT
/begin MEASUREMENT fplau_aq_obd_b2.abw "Prozentuale Abweichung des Luftmassenwertes vom MW" SWORD FORMULA_0706 0 0.0 -200.0 200.0 READ_WRITE ECU_ADDRESS 0x3FBF44 /end MEASUREMENT
/begin MEASUREMENT fplau_aq_obd_b2.cnt "Fehlerzähler Diagnose negativ" UWORD FORMULA_0010 0 0.0 0.0 65535.0 READ_WRITE ECU_ADDRESS 0x3FBF46 /end MEASUREMENT
/begin MEASUREMENT fplau_aq_obd_b2.st "Fuellungsplausibilitaets Statusbyte" UBYTE FORMULA_0707 0 0.0 0.0 255.0 READ_WRITE ECU_ADDRESS 0x3FBF4A /end MEASUREMENT
/begin MEASUREMENT fplau_aq_obd_b2.t "Zeit seit aktueller Diagnosezyklus negativ" UWORD FORMULA_0071 0 0.0 0.0 6553.5 READ_WRITE ECU_ADDRESS 0x3FBF48 /end MEASUREMENT
/begin MEASUREMENT fplau_hfm_obd_b1.abw "Prozentuale Abweichung des Luftmassenwertes vom MW" SWORD FORMULA_0706 0 0.0 -200.0 200.0 READ_WRITE ECU_ADDRESS 0x3FBF12 /end MEASUREMENT
/begin MEASUREMENT fplau_hfm_obd_b1.cnt "Fehlerzähler Diagnose negativ" UWORD FORMULA_0010 0 0.0 0.0 65535.0 READ_WRITE ECU_ADDRESS 0x3FBF14 /end MEASUREMENT
/begin MEASUREMENT fplau_hfm_obd_b1.st "Fuellungsplausibilitaets Statusbyte" UBYTE FORMULA_0707 0 0.0 0.0 255.0 READ_WRITE ECU_ADDRESS 0x3FBF18 /end MEASUREMENT
/begin MEASUREMENT fplau_hfm_obd_b1.t "Zeit seit aktueller Diagnosezyklus negativ" UWORD FORMULA_0071 0 0.0 0.0 6553.5 READ_WRITE ECU_ADDRESS 0x3FBF16 /end MEASUREMENT
/begin MEASUREMENT fplau_hfm_obd_b2.abw "Prozentuale Abweichung des Luftmassenwertes vom MW" SWORD FORMULA_0706 0 0.0 -200.0 200.0 READ_WRITE ECU_ADDRESS 0x3FBF1C /end MEASUREMENT
/begin MEASUREMENT fplau_hfm_obd_b2.cnt "Fehlerzähler Diagnose negativ" UWORD FORMULA_0010 0 0.0 0.0 65535.0 READ_WRITE ECU_ADDRESS 0x3FBF1E /end MEASUREMENT
/begin MEASUREMENT fplau_hfm_obd_b2.st "Fuellungsplausibilitaets Statusbyte" UBYTE FORMULA_0707 0 0.0 0.0 255.0 READ_WRITE ECU_ADDRESS 0x3FBF22 /end MEASUREMENT
/begin MEASUREMENT fplau_hfm_obd_b2.t "Zeit seit aktueller Diagnosezyklus negativ" UWORD FORMULA_0071 0 0.0 0.0 6553.5 READ_WRITE ECU_ADDRESS 0x3FBF20 /end MEASUREMENT
/begin MEASUREMENT fplau_lam_obd_b1.abw "Prozentuale Abweichung des Luftmassenwertes vom MW" SWORD FORMULA_0706 0 0.0 -200.0 200.0 READ_WRITE ECU_ADDRESS 0x3FBF26 /end MEASUREMENT
/begin MEASUREMENT fplau_lam_obd_b1.cnt "Fehlerzähler Diagnose negativ" UWORD FORMULA_0010 0 0.0 0.0 65535.0 READ_WRITE ECU_ADDRESS 0x3FBF28 /end MEASUREMENT
/begin MEASUREMENT fplau_lam_obd_b1.st "Fuellungsplausibilitaets Statusbyte" UBYTE FORMULA_0708 0 0.0 0.0 255.0 READ_WRITE ECU_ADDRESS 0x3FBF2C /end MEASUREMENT
/begin MEASUREMENT fplau_lam_obd_b1.t "Zeit seit aktueller Diagnosezyklus negativ" UWORD FORMULA_0071 0 0.0 0.0 6553.5 READ_WRITE ECU_ADDRESS 0x3FBF2A /end MEASUREMENT
/begin MEASUREMENT fplau_lam_obd_b2.abw "Prozentuale Abweichung des Luftmassenwertes vom MW" SWORD FORMULA_0706 0 0.0 -200.0 200.0 READ_WRITE ECU_ADDRESS 0x3FBF30 /end MEASUREMENT
/begin MEASUREMENT fplau_lam_obd_b2.cnt "Fehlerzähler Diagnose negativ" UWORD FORMULA_0010 0 0.0 0.0 65535.0 READ_WRITE ECU_ADDRESS 0x3FBF32 /end MEASUREMENT
/begin MEASUREMENT fplau_lam_obd_b2.st "Fuellungsplausibilitaets Statusbyte" UBYTE FORMULA_0708 0 0.0 0.0 255.0 READ_WRITE ECU_ADDRESS 0x3FBF36 /end MEASUREMENT
/begin MEASUREMENT fplau_lam_obd_b2.t "Zeit seit aktueller Diagnosezyklus negativ" UWORD FORMULA_0071 0 0.0 0.0 6553.5 READ_WRITE ECU_ADDRESS 0x3FBF34 /end MEASUREMENT
/begin MEASUREMENT fplau_ml_obd_mw2_b1 "Mittelwert2 (IO-Quellen)" SWORD FORMULA_0103 0 0.0 -100.0 1400.0 READ_WRITE ECU_ADDRESS 0x3FBF50 /end MEASUREMENT
/begin MEASUREMENT fplau_ml_obd_mw2_b2 "Mittelwert2 (IO-Quellen)" SWORD FORMULA_0103 0 0.0 -100.0 1400.0 READ_WRITE ECU_ADDRESS 0x3FBF52 /end MEASUREMENT
/begin MEASUREMENT fplau_ml_obd_mw3_b1 "OBD ist doof!!!!" SWORD FORMULA_0103 0 0.0 -100.0 1400.0 READ_WRITE ECU_ADDRESS 0x3FBF4C /end MEASUREMENT
/begin MEASUREMENT fplau_ml_obd_mw3_b2 "OBD ist doof!!!!" SWORD FORMULA_0103 0 0.0 -100.0 1400.0 READ_WRITE ECU_ADDRESS 0x3FBF4E /end MEASUREMENT
/begin MEASUREMENT fplau_obd_t_delta_b1 "Zeit seit der die Diangose positiv lauft" UWORD FORMULA_0071 0 0.0 0.0 6553.5 READ_WRITE ECU_ADDRESS 0x3FBF54 /end MEASUREMENT
/begin MEASUREMENT fplau_obd_t_delta_b2 "Zeit seit der die Diangose positiv lauft" UWORD FORMULA_0071 0 0.0 0.0 6553.5 READ_WRITE ECU_ADDRESS 0x3FBF56 /end MEASUREMENT
/begin MEASUREMENT fplau_st_b1 "FPLAUSI Diagnose" ULONG FORMULA_0682 0 0.0 0.0 4294967295.0 READ_WRITE ECU_ADDRESS 0x3FBF08 /end MEASUREMENT
/begin MEASUREMENT fplau_st_b2 "FPLAUSI Diagnose" ULONG FORMULA_0682 0 0.0 0.0 4294967295.0 READ_WRITE ECU_ADDRESS 0x3FBF0C /end MEASUREMENT
/begin MEASUREMENT fplau_st_diagk_b1 "K_FPLAU_OBD_CFG -> aus" ULONG FORMULA_0701 0 0 0.0 255.0 READ_WRITE BIT_MASK 0x40000 ECU_ADDRESS 0x3FBF08 /end MEASUREMENT
/begin MEASUREMENT fplau_st_diagk_b2 "K_FPLAU_OBD_CFG -> aus" ULONG FORMULA_0701 0 0 0.0 255.0 READ_WRITE BIT_MASK 0x40000 ECU_ADDRESS 0x3FBF0C /end MEASUREMENT
/begin MEASUREMENT fplau_st_egas_dk_b1 "EGAS DK I.O." ULONG FORMULA_0694 0 0 0.0 255.0 READ_WRITE BIT_MASK 0x800 ECU_ADDRESS 0x3FBF08 /end MEASUREMENT
/begin MEASUREMENT fplau_st_egas_dk_b2 "EGAS DK I.O." ULONG FORMULA_0694 0 0 0.0 255.0 READ_WRITE BIT_MASK 0x800 ECU_ADDRESS 0x3FBF0C /end MEASUREMENT
/begin MEASUREMENT fplau_st_egas_wdk_b1 "EGAS WDK I.O." ULONG FORMULA_0693 0 0 0.0 255.0 READ_WRITE BIT_MASK 0x400 ECU_ADDRESS 0x3FBF08 /end MEASUREMENT
/begin MEASUREMENT fplau_st_egas_wdk_b2 "EGAS WDK I.O." ULONG FORMULA_0693 0 0 0.0 255.0 READ_WRITE BIT_MASK 0x400 ECU_ADDRESS 0x3FBF0C /end MEASUREMENT
/begin MEASUREMENT fplau_st_hfm_b1 "HFM I.O." ULONG FORMULA_0691 0 0 0.0 255.0 READ_WRITE BIT_MASK 0x100 ECU_ADDRESS 0x3FBF08 /end MEASUREMENT
/begin MEASUREMENT fplau_st_hfm_b2 "HFM I.O." ULONG FORMULA_0691 0 0 0.0 255.0 READ_WRITE BIT_MASK 0x100 ECU_ADDRESS 0x3FBF0C /end MEASUREMENT
/begin MEASUREMENT fplau_st_kh_b1 "kein KH" ULONG FORMULA_0700 0 0 0.0 255.0 READ_WRITE BIT_MASK 0x20000 ECU_ADDRESS 0x3FBF08 /end MEASUREMENT
/begin MEASUREMENT fplau_st_kh_b2 "kein KH" ULONG FORMULA_0700 0 0 0.0 255.0 READ_WRITE BIT_MASK 0x20000 ECU_ADDRESS 0x3FBF0C /end MEASUREMENT
/begin MEASUREMENT fplau_st_lam_b1 "LAMBDA I.O." ULONG FORMULA_0692 0 0 0.0 255.0 READ_WRITE BIT_MASK 0x200 ECU_ADDRESS 0x3FBF08 /end MEASUREMENT
/begin MEASUREMENT fplau_st_lam_b2 "LAMBDA I.O." ULONG FORMULA_0692 0 0 0.0 255.0 READ_WRITE BIT_MASK 0x200 ECU_ADDRESS 0x3FBF0C /end MEASUREMENT
/begin MEASUREMENT fplau_st_lls_b1 "LLS I.O." ULONG FORMULA_0696 0 0 0.0 255.0 READ_WRITE BIT_MASK 0x2000 ECU_ADDRESS 0x3FBF08 /end MEASUREMENT
/begin MEASUREMENT fplau_st_lls_b2 "LLS I.O." ULONG FORMULA_0696 0 0 0.0 255.0 READ_WRITE BIT_MASK 0x2000 ECU_ADDRESS 0x3FBF0C /end MEASUREMENT
/begin MEASUREMENT fplau_st_n_max_b1 "n > Schwelle" ULONG FORMULA_0688 0 0 0.0 255.0 READ_WRITE BIT_MASK 0x20 ECU_ADDRESS 0x3FBF08 /end MEASUREMENT
/begin MEASUREMENT fplau_st_n_max_b2 "n > Schwelle" ULONG FORMULA_0688 0 0 0.0 255.0 READ_WRITE BIT_MASK 0x20 ECU_ADDRESS 0x3FBF0C /end MEASUREMENT
/begin MEASUREMENT fplau_st_n_min_b1 "n < Schwelle" ULONG FORMULA_0687 0 0 0.0 255.0 READ_WRITE BIT_MASK 0x10 ECU_ADDRESS 0x3FBF08 /end MEASUREMENT
/begin MEASUREMENT fplau_st_n_min_b2 "n < Schwelle" ULONG FORMULA_0687 0 0 0.0 255.0 READ_WRITE BIT_MASK 0x10 ECU_ADDRESS 0x3FBF0C /end MEASUREMENT
/begin MEASUREMENT fplau_st_ndyn_b1 "N-Dynamik nicht aktive" ULONG FORMULA_0685 0 0 0.0 255.0 READ_WRITE BIT_MASK 0x4 ECU_ADDRESS 0x3FBF08 /end MEASUREMENT
/begin MEASUREMENT fplau_st_ndyn_b2 "N-Dynamik nicht aktive" ULONG FORMULA_0685 0 0 0.0 255.0 READ_WRITE BIT_MASK 0x4 ECU_ADDRESS 0x3FBF0C /end MEASUREMENT
/begin MEASUREMENT fplau_st_obd_mw_max_b1 "fplau_ml_obd_mw2 < Max Schwelle" ULONG FORMULA_0690 0 0 0.0 255.0 READ_WRITE BIT_MASK 0x80 ECU_ADDRESS 0x3FBF08 /end MEASUREMENT
/begin MEASUREMENT fplau_st_obd_mw_max_b2 "fplau_ml_obd_mw2 < Max Schwelle" ULONG FORMULA_0690 0 0 0.0 255.0 READ_WRITE BIT_MASK 0x80 ECU_ADDRESS 0x3FBF0C /end MEASUREMENT
/begin MEASUREMENT fplau_st_obd_mw_min_b1 "fplau_ml_obd_mw2 > Min Schwelle" ULONG FORMULA_0689 0 0 0.0 255.0 READ_WRITE BIT_MASK 0x40 ECU_ADDRESS 0x3FBF08 /end MEASUREMENT
/begin MEASUREMENT fplau_st_obd_mw_min_b2 "fplau_ml_obd_mw2 > Min Schwelle" ULONG FORMULA_0689 0 0 0.0 255.0 READ_WRITE BIT_MASK 0x40 ECU_ADDRESS 0x3FBF0C /end MEASUREMENT
/begin MEASUREMENT fplau_st_pumg_b1 "pumg I.O." ULONG FORMULA_0697 0 0 0.0 255.0 READ_WRITE BIT_MASK 0x4000 ECU_ADDRESS 0x3FBF08 /end MEASUREMENT
/begin MEASUREMENT fplau_st_pumg_b2 "pumg I.O." ULONG FORMULA_0697 0 0 0.0 255.0 READ_WRITE BIT_MASK 0x4000 ECU_ADDRESS 0x3FBF0C /end MEASUREMENT
/begin MEASUREMENT fplau_st_rfdyn_b1 "RF Dynamik nicht aktive" ULONG FORMULA_0684 0 0 0.0 255.0 READ_WRITE BIT_MASK 0x2 ECU_ADDRESS 0x3FBF08 /end MEASUREMENT
/begin MEASUREMENT fplau_st_rfdyn_b2 "RF Dynamik nicht aktive" ULONG FORMULA_0684 0 0 0.0 255.0 READ_WRITE BIT_MASK 0x2 ECU_ADDRESS 0x3FBF0C /end MEASUREMENT
/begin MEASUREMENT fplau_st_sa_b1 "kein SA" ULONG FORMULA_0699 0 0 0.0 255.0 READ_WRITE BIT_MASK 0x10000 ECU_ADDRESS 0x3FBF08 /end MEASUREMENT
/begin MEASUREMENT fplau_st_sa_b2 "kein SA" ULONG FORMULA_0699 0 0 0.0 255.0 READ_WRITE BIT_MASK 0x10000 ECU_ADDRESS 0x3FBF0C /end MEASUREMENT
/begin MEASUREMENT fplau_st_slp_b1 "keine SLP aktive" ULONG FORMULA_0702 0 0 0.0 255.0 READ_WRITE BIT_MASK 0x80000 ECU_ADDRESS 0x3FBF08 /end MEASUREMENT
/begin MEASUREMENT fplau_st_slp_b2 "keine SLP aktive" ULONG FORMULA_0702 0 0 0.0 255.0 READ_WRITE BIT_MASK 0x80000 ECU_ADDRESS 0x3FBF0C /end MEASUREMENT
/begin MEASUREMENT fplau_st_tan_b1 "tan I.O." ULONG FORMULA_0698 0 0 0.0 255.0 READ_WRITE BIT_MASK 0x8000 ECU_ADDRESS 0x3FBF08 /end MEASUREMENT
/begin MEASUREMENT fplau_st_tan_b2 "tan I.O." ULONG FORMULA_0698 0 0 0.0 255.0 READ_WRITE BIT_MASK 0x8000 ECU_ADDRESS 0x3FBF0C /end MEASUREMENT
/begin MEASUREMENT fplau_st_time_ml_b1 "time_ml ueber Schwelle" ULONG FORMULA_0686 0 0 0.0 255.0 READ_WRITE BIT_MASK 0x8 ECU_ADDRESS 0x3FBF08 /end MEASUREMENT
/begin MEASUREMENT fplau_st_time_ml_b2 "time_ml ueber Schwelle" ULONG FORMULA_0686 0 0 0.0 255.0 READ_WRITE BIT_MASK 0x8 ECU_ADDRESS 0x3FBF0C /end MEASUREMENT
/begin MEASUREMENT fplau_st_tmot_b1 "tmot ueber Schwelle" ULONG FORMULA_0683 0 0 0.0 255.0 READ_WRITE BIT_MASK 0x1 ECU_ADDRESS 0x3FBF08 /end MEASUREMENT
/begin MEASUREMENT fplau_st_tmot_b2 "tmot ueber Schwelle" ULONG FORMULA_0683 0 0 0.0 255.0 READ_WRITE BIT_MASK 0x1 ECU_ADDRESS 0x3FBF0C /end MEASUREMENT
/begin MEASUREMENT fplau_st_van_begr_b1 "Vanosbegrenzung aktive" ULONG FORMULA_0705 0 0 0.0 255.0 READ_WRITE BIT_MASK 0x400000 ECU_ADDRESS 0x3FBF08 /end MEASUREMENT
/begin MEASUREMENT fplau_st_van_begr_b2 "Vanosbegrenzung aktive" ULONG FORMULA_0705 0 0 0.0 255.0 READ_WRITE BIT_MASK 0x400000 ECU_ADDRESS 0x3FBF0C /end MEASUREMENT
/begin MEASUREMENT fplau_st_vanos_b1 "VANOS I.O." ULONG FORMULA_0695 0 0 0.0 255.0 READ_WRITE BIT_MASK 0x1000 ECU_ADDRESS 0x3FBF08 /end MEASUREMENT
/begin MEASUREMENT fplau_st_vanos_b2 "VANOS I.O." ULONG FORMULA_0695 0 0 0.0 255.0 READ_WRITE BIT_MASK 0x1000 ECU_ADDRESS 0x3FBF0C /end MEASUREMENT
/begin MEASUREMENT fplau_st_wdk_adapt_b1 "WDK Adaption" ULONG FORMULA_0704 0 0 0.0 255.0 READ_WRITE BIT_MASK 0x200000 ECU_ADDRESS 0x3FBF08 /end MEASUREMENT
/begin MEASUREMENT fplau_st_wdk_adapt_b2 "WDK Adaption" ULONG FORMULA_0704 0 0 0.0 255.0 READ_WRITE BIT_MASK 0x200000 ECU_ADDRESS 0x3FBF0C /end MEASUREMENT
/begin MEASUREMENT fplau_st_zyl_off_b1 "keine Zylinderausblendung" ULONG FORMULA_0703 0 0 0.0 255.0 READ_WRITE BIT_MASK 0x100000 ECU_ADDRESS 0x3FBF08 /end MEASUREMENT
/begin MEASUREMENT fplau_st_zyl_off_b2 "keine Zylinderausblendung" ULONG FORMULA_0703 0 0 0.0 255.0 READ_WRITE BIT_MASK 0x100000 ECU_ADDRESS 0x3FBF0C /end MEASUREMENT
/begin MEASUREMENT Gen_awnumm "Generatorkennfeldnummer" UBYTE FORMULA_0003 0 0.0 0.0 255.0 READ_WRITE ECU_ADDRESS 0x3FA870 /end MEASUREMENT
/begin MEASUREMENT Gen_dts "Temperaturerhoehung im Generatorstator" SWORD FORMULA_0431 0 0.0 -3276.800048828125 3276.699951171875 READ_WRITE ECU_ADDRESS 0x3FAD08 /end MEASUREMENT
/begin MEASUREMENT Gen_fbsak "BSD Uebertragungsfehler kodiert fuer FSPVDGEN" UBYTE FORMULA_0003 0 0.0 0.0 255.0 READ_WRITE ECU_ADDRESS 0x3FAA9E /end MEASUREMENT
/begin MEASUREMENT Gen_feta "Generatorwirkungsgrad Berechnnugsterm" ULONG FORMULA_0467 0 0.0 1.9073486328125e-006 5000.0 READ_WRITE ECU_ADDRESS 0x3FAD00 /end MEASUREMENT
/begin MEASUREMENT Gen_i_kaltun "DF korrektiert ueber Generatordrehzahl" UBYTE FORMULA_0463 0 0.0 0.0 255.0 READ_WRITE ECU_ADDRESS 0x3FAD32 /end MEASUREMENT
/begin MEASUREMENT Gen_nummer "Erkannte Generatornummer" UBYTE FORMULA_0003 0 0.0 0.0 255.0 READ_WRITE ECU_ADDRESS 0x3FAD33 /end MEASUREMENT
/begin MEASUREMENT Gen_rs "Statorwiderstand" UWORD FORMULA_0460 0 0.0 0.0 0.9999847412109375 READ_WRITE ECU_ADDRESS 0x3FAD20 /end MEASUREMENT
/begin MEASUREMENT Gen_spv "Generatorstatorverlustleistung" UWORD FORMULA_0470 0 0.0 0.0 2047.96875 READ_WRITE ECU_ADDRESS 0x3FAD22 /end MEASUREMENT
/begin MEASUREMENT Gen_statroh "Generatorfehler kodiert fuer FSPVDGEN" UBYTE FORMULA_0003 0 0.0 0.0 255.0 READ_WRITE ECU_ADDRESS 0x3FAA9F /end MEASUREMENT
/begin MEASUREMENT Gen_sttemp "Generatorstarttemperatur" SWORD FORMULA_0431 0 0.0 -3276.800048828125 3276.699951171875 READ_WRITE ECU_ADDRESS 0x3FAD10 /end MEASUREMENT
/begin MEASUREMENT Gen_tans "Generatoransauglufttemperatur" SWORD FORMULA_0431 0 0.0 -3276.800048828125 3276.699951171875 READ_WRITE ECU_ADDRESS 0x3FAD12 /end MEASUREMENT
/begin MEASUREMENT Gen_tansend "Generatoransaugluftendwert" SWORD FORMULA_0431 0 0.0 -3276.800048828125 3276.699951171875 READ_WRITE ECU_ADDRESS 0x3FAD0A /end MEASUREMENT
/begin MEASUREMENT Gen_teta "Wirkungsgrad Generator W*PI temperaturkompensiert" UWORD FORMULA_0472 0 0.0 0.0 31.9995002746582 READ_WRITE ECU_ADDRESS 0x3FAD28 /end MEASUREMENT
/begin MEASUREMENT Gen_weta "Wirkungsgrad Generator mit Omega*PI" UWORD FORMULA_0472 0 0.0 0.0 31.9995002746582 READ_WRITE ECU_ADDRESS 0x3FAD2A /end MEASUREMENT
/begin MEASUREMENT I_basis "Basis Strombedarf FZG mit SLP" UBYTE FORMULA_0463 0 0.0 0.0 255.0 READ_WRITE ECU_ADDRESS 0x3FAD34 /end MEASUREMENT
/begin MEASUREMENT I_gen "Generatorstrom" UBYTE FORMULA_0463 0 0.0 0.0 255.0 READ_WRITE ECU_ADDRESS 0x3FBFD4 /end MEASUREMENT
/begin MEASUREMENT I_gen_end "Generatorstrom gemessen / gerechnet" UBYTE FORMULA_0463 0 0.0 0.0 254.0 READ_WRITE ECU_ADDRESS 0x3FAD35 /end MEASUREMENT
/begin MEASUREMENT I_gen_g "Generatorstrom gesamt" UBYTE FORMULA_0463 0 0.0 0.0 255.0 READ_WRITE ECU_ADDRESS 0x3FAD36 /end MEASUREMENT
/begin MEASUREMENT I_gen_nafil "Generatorstrom nach Filter" UWORD FORMULA_0473 0 0.0 0.0 256.0 READ_WRITE ECU_ADDRESS 0x3FAD2C /end MEASUREMENT
/begin MEASUREMENT I_gen_vorfil "Generatorstrom vor Filter" UWORD FORMULA_0473 0 0.0 0.0 256.0 READ_WRITE ECU_ADDRESS 0x3FAD2E /end MEASUREMENT
/begin MEASUREMENT I_genmax "korrigiertes DF Signal ueber Temperatur, Generatordrehzahl, Generatorspannung" UBYTE FORMULA_0463 0 0.0 0.0 255.0 READ_WRITE ECU_ADDRESS 0x3FBFD5 /end MEASUREMENT
/begin MEASUREMENT I_gm "Generatormischstrom" UBYTE FORMULA_0463 0 0.0 0.0 255.0 READ_WRITE ECU_ADDRESS 0x3FAD37 /end MEASUREMENT
/begin MEASUREMENT I_gvor "Stromwert nach Überblendung" UBYTE FORMULA_0463 0 0.0 0.0 255.0 READ_WRITE ECU_ADDRESS 0x3FAD38 /end MEASUREMENT
/begin MEASUREMENT Ierr_fil "Gefilterter Erregerstrom" UBYTE FORMULA_0464 0 0.0 0.0 31.875 READ_WRITE ECU_ADDRESS 0x3FAF3C /end MEASUREMENT
/begin MEASUREMENT Ierrgrenz "Grenzertrregerstrom" UBYTE FORMULA_0464 0 0.0 0.0 31.875 READ_WRITE ECU_ADDRESS 0x3FBFD6 /end MEASUREMENT
/begin MEASUREMENT Loadresp "Loadresponse Zeit aus Kennfeldrechnung (alte Version)" UBYTE FORMULA_0461 0 0.0 0.0 25.5 READ_WRITE ECU_ADDRESS 0x3FAF42 /end MEASUREMENT
/begin MEASUREMENT Md_genfil "gefiltertes Generatormoment absolut" SWORD FORMULA_0113 0 0.0 -3276.800048828125 3276.699951171875 READ_WRITE ECU_ADDRESS 0x3FAD14 /end MEASUREMENT
/begin MEASUREMENT Md_gennm "gefiltertes Generatormoment absolut Ausgang" SWORD FORMULA_0113 0 0.0 -3276.800048828125 3276.699951171875 READ_WRITE ECU_ADDRESS 0x3FBFCC /end MEASUREMENT
/begin MEASUREMENT Md_gennmufi "Generatormoment absolut" SWORD FORMULA_0113 0 0.0 -3276.800048828125 3276.699951171875 READ_WRITE ECU_ADDRESS 0x3FAD16 /end MEASUREMENT
/begin MEASUREMENT Md_genrel "relatives Generatormoment Ausgang" UWORD FORMULA_0462 0 0.0 0.0 99.99839782714844 READ_WRITE ECU_ADDRESS 0x3FAD30 /end MEASUREMENT
/begin MEASUREMENT Md_genvf "relatives Generatordrehmoment" UWORD FORMULA_0462 0 0.0 0.0 99.99839782714844 READ_WRITE ECU_ADDRESS 0x3FBFD2 /end MEASUREMENT
/begin MEASUREMENT Md_grenz "Maximalmoment Generator an BSDII" SWORD FORMULA_0113 0 0.0 -3276.800048828125 3276.699951171875 READ_WRITE ECU_ADDRESS 0x3FC600 /end MEASUREMENT
/begin MEASUREMENT N_gen "Generatordrehzahl" SWORD FORMULA_0006 0 0.0 0.0 32767.0 READ_WRITE ECU_ADDRESS 0x3FAD18 /end MEASUREMENT
/begin MEASUREMENT N_nstart "Motordrehzahl nach Motorstart" SWORD FORMULA_0006 0 0.0 -32768.0 32767.0 READ_WRITE ECU_ADDRESS 0x3FC5F0 /end MEASUREMENT
/begin MEASUREMENT Nkw_s "Motordrehzahl U/s" SWORD FORMULA_0006 0 0.0 -32768.0 32767.0 READ_WRITE ECU_ADDRESS 0x3FAD1A /end MEASUREMENT
/begin MEASUREMENT Nslb "N_soll Korrektur von Ladebilanz Batterie" SWORD FORMULA_0006 0 0.0 0.0 32767.0 READ_WRITE ECU_ADDRESS 0x3FC5FA /end MEASUREMENT
/begin MEASUREMENT P_gen_ab "elektrische Generatorleistung" ULONG FORMULA_0468 0 0.0 0.0 4096.0 READ_WRITE ECU_ADDRESS 0x3FAD04 /end MEASUREMENT
/begin MEASUREMENT Pmigrlowctr "PM iGR Low Massnahmen Counter" UWORD FORMULA_0010 0 0.0 0.0 65535.0 READ_WRITE ECU_ADDRESS 0x3FB0B8 /end MEASUREMENT
/begin MEASUREMENT St_dgen0 "Statuswort" UBYTE FORMULA_0003 0 0.0 0.0 255.0 READ_WRITE ECU_ADDRESS 0x3FBDFC /end MEASUREMENT
/begin MEASUREMENT St_dgen0.B_1stbsder "" UBYTE FORMULA_0423 0 0 0.0 255.0 READ_WRITE BIT_MASK 0x1 ECU_ADDRESS 0x3FBDFC /end MEASUREMENT
/begin MEASUREMENT St_dgen0.B_genfprl "Bedingung Generatorfehler entprellt" UBYTE FORMULA_0425 0 0 0.0 255.0 READ_WRITE BIT_MASK 0x4 ECU_ADDRESS 0x3FBDFC /end MEASUREMENT
/begin MEASUREMENT St_dgen0.B_gfbsupak "Generator Typ unplausibel^aus Fehlerspeicher" UBYTE FORMULA_0426 0 0 0.0 255.0 READ_WRITE BIT_MASK 0x8 ECU_ADDRESS 0x3FBDFC /end MEASUREMENT
/begin MEASUREMENT St_dgen0.B_gfelak "Generatorfehler elektrisch aus Fehlerspeicher" UBYTE FORMULA_0427 0 0 0.0 255.0 READ_WRITE BIT_MASK 0x10 ECU_ADDRESS 0x3FBDFC /end MEASUREMENT
/begin MEASUREMENT St_dgen0.B_gfhtak "Generatorfehler Uebertemperatur aus Fehlerspeicher" UBYTE FORMULA_0428 0 0 0.0 255.0 READ_WRITE BIT_MASK 0x20 ECU_ADDRESS 0x3FBDFC /end MEASUREMENT
/begin MEASUREMENT St_dgen0.B_gfmeak "Generatorfehler mechanisch aus Fehlerspeicher" UBYTE FORMULA_0429 0 0 0.0 255.0 READ_WRITE BIT_MASK 0x40 ECU_ADDRESS 0x3FBDFC /end MEASUREMENT
/begin MEASUREMENT St_dgen0.B_gfnobsak "Generator BSD Kommunikationsverlust aus Fehlerspeicher" UBYTE FORMULA_0430 0 0 0.0 255.0 READ_WRITE BIT_MASK 0x80 ECU_ADDRESS 0x3FBDFC /end MEASUREMENT
/begin MEASUREMENT St_dgen0.B_kl61 "Bedingung Ladekontroll Laempchen an" UBYTE FORMULA_0424 0 0 0.0 255.0 READ_WRITE BIT_MASK 0x2 ECU_ADDRESS 0x3FBDFC /end MEASUREMENT
/begin MEASUREMENT St_dmdblock "Statuswort" UBYTE FORMULA_0003 0 0.0 0.0 255.0 READ_WRITE ECU_ADDRESS 0x3FC5FC /end MEASUREMENT
/begin MEASUREMENT St_dmdblock.B_dmd_frei "" UBYTE FORMULA_0425 0 0 0.0 255.0 READ_WRITE BIT_MASK 0x4 ECU_ADDRESS 0x3FC5FC /end MEASUREMENT
/begin MEASUREMENT St_dmdblock.B_timmax "" UBYTE FORMULA_0424 0 0 0.0 255.0 READ_WRITE BIT_MASK 0x2 ECU_ADDRESS 0x3FC5FC /end MEASUREMENT
/begin MEASUREMENT St_dmdblock.B_timmin "" UBYTE FORMULA_0423 0 0 0.0 255.0 READ_WRITE BIT_MASK 0x1 ECU_ADDRESS 0x3FC5FC /end MEASUREMENT
/begin MEASUREMENT St_gen "Generatorstatus" UBYTE FORMULA_0003 0 0.0 0.0 255.0 READ_WRITE ECU_ADDRESS 0x3FBDFD /end MEASUREMENT
/begin MEASUREMENT St_genbsd "" UWORD FORMULA_0010 0 0.0 0.0 65535.0 READ_WRITE ECU_ADDRESS 0x3FAA9A /end MEASUREMENT
/begin MEASUREMENT St_gengen "" UWORD FORMULA_0010 0 0.0 0.0 65535.0 READ_WRITE ECU_ADDRESS 0x3FAA9C /end MEASUREMENT
/begin MEASUREMENT St_imdgen_nv0 "Statuswort" UBYTE FORMULA_0003 0 0.0 0.0 255.0 READ_WRITE ECU_ADDRESS 0x3FBFCB /end MEASUREMENT
/begin MEASUREMENT St_imdgen_nv0.B_genfkupl "Generatortyp unplausibel" UBYTE FORMULA_0423 0 0 0.0 255.0 READ_WRITE BIT_MASK 0x1 ECU_ADDRESS 0x3FBFCB /end MEASUREMENT
/begin MEASUREMENT St_imdgen_nv0.B_heizen "Bedingung Generator in Heizphase" UBYTE FORMULA_0424 0 0 0.0 255.0 READ_WRITE BIT_MASK 0x2 ECU_ADDRESS 0x3FBFCB /end MEASUREMENT
/begin MEASUREMENT St_imdgen0 "Statuswort" UBYTE FORMULA_0003 0 0.0 0.0 255.0 READ_WRITE ECU_ADDRESS 0x3FBFCA /end MEASUREMENT
/begin MEASUREMENT St_imdgen0.B_firstemp "Bedingung Generatorstarttemperatur-Berechnung" UBYTE FORMULA_0423 0 0 0.0 255.0 READ_WRITE BIT_MASK 0x1 ECU_ADDRESS 0x3FBFCA /end MEASUREMENT
/begin MEASUREMENT St_imdgen0.B_gene "Generatormoment enable/disable" UBYTE FORMULA_0424 0 0 0.0 255.0 READ_WRITE BIT_MASK 0x2 ECU_ADDRESS 0x3FBFCA /end MEASUREMENT
/begin MEASUREMENT St_imdgen0.B_generken "" UBYTE FORMULA_0425 0 0 0.0 255.0 READ_WRITE BIT_MASK 0x4 ECU_ADDRESS 0x3FBFCA /end MEASUREMENT
/begin MEASUREMENT St_ldstgen "Lastzustand Generator elektrisch/thermisch" UBYTE FORMULA_0003 0 0.0 0.0 255.0 READ_WRITE ECU_ADDRESS 0x3FC5F5 /end MEASUREMENT
/begin MEASUREMENT St_llranh0 "Statuswort" UBYTE FORMULA_0003 0 0.0 0.0 255.0 READ_WRITE ECU_ADDRESS 0x3FC5F8 /end MEASUREMENT
/begin MEASUREMENT St_llranh0.B_idl_tp "Temporäres Berechnungsbit" UBYTE FORMULA_0425 0 0 0.0 255.0 READ_WRITE BIT_MASK 0x4 ECU_ADDRESS 0x3FC5F8 /end MEASUREMENT
/begin MEASUREMENT St_llranh0.B_idlgspec "" UBYTE FORMULA_0423 0 0 0.0 255.0 READ_WRITE BIT_MASK 0x1 ECU_ADDRESS 0x3FC5F8 /end MEASUREMENT
/begin MEASUREMENT St_llranh0.B_nsub "Bedingung für Solldrehzahlanhebung bei niedriger Batteriespannung" UBYTE FORMULA_0424 0 0 0.0 255.0 READ_WRITE BIT_MASK 0x2 ECU_ADDRESS 0x3FC5F8 /end MEASUREMENT
/begin MEASUREMENT St_loadresp "Statuswort" UBYTE FORMULA_0003 0 0.0 0.0 255.0 READ_WRITE ECU_ADDRESS 0x3FC5FD /end MEASUREMENT
/begin MEASUREMENT St_loadresp.B_lroff "" UBYTE FORMULA_0423 0 0 0.0 255.0 READ_WRITE BIT_MASK 0x1 ECU_ADDRESS 0x3FC5FD /end MEASUREMENT
/begin MEASUREMENT St_loadresp.B_lroff2 "" UBYTE FORMULA_0424 0 0 0.0 255.0 READ_WRITE BIT_MASK 0x2 ECU_ADDRESS 0x3FC5FD /end MEASUREMENT
/begin MEASUREMENT St_loadresp_nv0 "Statuswort" UBYTE FORMULA_0003 0 0.0 0.0 255.0 READ_WRITE ECU_ADDRESS 0x3FA881 /end MEASUREMENT
/begin MEASUREMENT St_loadresp_nv0.B_genoffvl "Bedingung Generatorabschaltung bei Vollast" UBYTE FORMULA_0423 0 0 0.0 255.0 READ_WRITE BIT_MASK 0x1 ECU_ADDRESS 0x3FA881 /end MEASUREMENT
/begin MEASUREMENT St_loadresp0 "Statuswort" UBYTE FORMULA_0003 0 0.0 0.0 255.0 READ_WRITE ECU_ADDRESS 0x3FC5FE /end MEASUREMENT
/begin MEASUREMENT St_loadresp0.B_fub "Bedingung: Fehler Batteriespannungssensor" UBYTE FORMULA_0425 0 0 0.0 255.0 READ_WRITE BIT_MASK 0x4 ECU_ADDRESS 0x3FC5FE /end MEASUREMENT
/begin MEASUREMENT St_loadresp0.B_genoffmd "Abschaltung Generator angefordert" UBYTE FORMULA_0424 0 0 0.0 255.0 READ_WRITE BIT_MASK 0x2 ECU_ADDRESS 0x3FC5FE /end MEASUREMENT
/begin MEASUREMENT St_loadresp0.B_genoffst "Bedingung Generatorabschaltung im Start" UBYTE FORMULA_0423 0 0 0.0 255.0 READ_WRITE BIT_MASK 0x1 ECU_ADDRESS 0x3FC5FE /end MEASUREMENT
/begin MEASUREMENT St_loadresp10ms "Statuswort" UBYTE FORMULA_0003 0 0.0 0.0 255.0 READ_WRITE ECU_ADDRESS 0x3FC5FF /end MEASUREMENT
/begin MEASUREMENT St_loadresp10ms.B_mdgrenz "Bedingung Generator im Modus Momentenbegrenzung" UBYTE FORMULA_0423 0 0 0.0 255.0 READ_WRITE BIT_MASK 0x1 ECU_ADDRESS 0x3FC5FF /end MEASUREMENT
/begin MEASUREMENT St_ugenkor0 "Statuswort" UBYTE FORMULA_0003 0 0.0 0.0 255.0 READ_WRITE ECU_ADDRESS 0x3FD2BA /end MEASUREMENT
/begin MEASUREMENT St_ugenkor0.B_1stugen "Bedingung ctrgenutar noch nicht gueltig" UBYTE FORMULA_0423 0 0 0.0 255.0 READ_WRITE BIT_MASK 0x1 ECU_ADDRESS 0x3FD2BA /end MEASUREMENT
/begin MEASUREMENT St_ugenkor0.B_genoff "Bedingung Generator ausgeschaltet" UBYTE FORMULA_0426 0 0 0.0 255.0 READ_WRITE BIT_MASK 0x8 ECU_ADDRESS 0x3FD2BA /end MEASUREMENT
/begin MEASUREMENT St_ugenkor0.B_genoff2 "Bedingung Generator2 ausgeschaltet" UBYTE FORMULA_0427 0 0 0.0 255.0 READ_WRITE BIT_MASK 0x10 ECU_ADDRESS 0x3FD2BA /end MEASUREMENT
/begin MEASUREMENT St_ugenkor0.B_genoffok "Bedingung Generatorabschaltfreigabe Sicherheitstimer" UBYTE FORMULA_0428 0 0 0.0 255.0 READ_WRITE BIT_MASK 0x20 ECU_ADDRESS 0x3FD2BA /end MEASUREMENT
/begin MEASUREMENT St_ugenkor0.B_genoffout "Bedingung Abschaltung Generator" UBYTE FORMULA_0424 0 0 0.0 255.0 READ_WRITE BIT_MASK 0x2 ECU_ADDRESS 0x3FD2BA /end MEASUREMENT
/begin MEASUREMENT St_ugenkor0.B_noctrgen "Bedingung Ladespannungvorgabe ignoriert" UBYTE FORMULA_0429 0 0 0.0 255.0 READ_WRITE BIT_MASK 0x40 ECU_ADDRESS 0x3FD2BA /end MEASUREMENT
/begin MEASUREMENT St_ugenkor0.B_ugenini "Initialisierung Generatorspannung" UBYTE FORMULA_0425 0 0 0.0 255.0 READ_WRITE BIT_MASK 0x4 ECU_ADDRESS 0x3FD2BA /end MEASUREMENT
/begin MEASUREMENT St_ugenkor0.B_verb_off "Bedingung elektr. Verbraucher AUS" UBYTE FORMULA_0430 0 0 0.0 255.0 READ_WRITE BIT_MASK 0x80 ECU_ADDRESS 0x3FD2BA /end MEASUREMENT
/begin MEASUREMENT St_ugenkor1 "Statuswort" UBYTE FORMULA_0003 0 0.0 0.0 255.0 READ_WRITE ECU_ADDRESS 0x3FA9A4 /end MEASUREMENT
/begin MEASUREMENT St_ugenkor1.B_gentoggl "Bedindung Toggel Generatorauswahl" UBYTE FORMULA_0423 0 0 0.0 255.0 READ_WRITE BIT_MASK 0x1 ECU_ADDRESS 0x3FA9A4 /end MEASUREMENT
/begin MEASUREMENT St_ugenkor2 "Statuswort" UBYTE FORMULA_0003 0 0.0 0.0 255.0 READ_WRITE ECU_ADDRESS 0x3FD2BB /end MEASUREMENT
/begin MEASUREMENT St_ugenkor2.B_saaktiv "Modulspezifische Bedingung für Schubabschalten" UBYTE FORMULA_0423 0 0 0.0 255.0 READ_WRITE BIT_MASK 0x1 ECU_ADDRESS 0x3FD2BB /end MEASUREMENT
/begin MEASUREMENT St_ugenkor2.B_saset "Freigabe für modulspezifisches Schubabschalten" UBYTE FORMULA_0424 0 0 0.0 255.0 READ_WRITE BIT_MASK 0x2 ECU_ADDRESS 0x3FD2BB /end MEASUREMENT
/begin MEASUREMENT stack_status "Stackstatus" ULONG FORMULA_0000 0 0.0 0.0 1000.0 READ_WRITE ECU_ADDRESS 0x3F9238 /end MEASUREMENT
/begin MEASUREMENT stack_usedErcosek "Ercosekstack" ULONG FORMULA_0000 0 0.0 0.0 1000.0 READ_WRITE ECU_ADDRESS 0x3F9240 /end MEASUREMENT
/begin MEASUREMENT stack_usedUser "Userstack" ULONG FORMULA_0000 0 0.0 0.0 1000.0 READ_WRITE ECU_ADDRESS 0x3F923C /end MEASUREMENT
/begin MEASUREMENT T_batt "Batterietemperatur" SWORD FORMULA_0431 0 0.0 -3276.800048828125 3276.699951171875 READ_WRITE ECU_ADDRESS 0x3FD2BC /end MEASUREMENT
/begin MEASUREMENT Tgen "Generatortemperatur" SWORD FORMULA_0431 0 0.0 -3276.800048828125 3276.699951171875 READ_WRITE ECU_ADDRESS 0x3FBFCE /end MEASUREMENT
/begin MEASUREMENT Tgen_ab "Abstelltemperatur Generator" SWORD FORMULA_0431 0 0.0 -3276.800048828125 3276.699951171875 READ_WRITE ECU_ADDRESS 0x3FA86E /end MEASUREMENT
/begin MEASUREMENT Tgen_dt "Temperaturdifferenz zwischen Abstelltemperatur und Umgebungstemperatur" SWORD FORMULA_0431 0 0.0 -48.0 384.0 READ_WRITE ECU_ADDRESS 0x3FAD1C /end MEASUREMENT
/begin MEASUREMENT Tgen_end "Generatortemperatur endgültig" SWORD FORMULA_0431 0 0.0 -3276.800048828125 3276.699951171875 READ_WRITE ECU_ADDRESS 0x3FBFD0 /end MEASUREMENT
/begin MEASUREMENT Tgen_exp "Delta Abkühltemperatur" SWORD FORMULA_0431 0 0.0 -48.0 384.0 READ_WRITE ECU_ADDRESS 0x3FAD1E /end MEASUREMENT
/begin MEASUREMENT Tgen_fil "gefilterte Generatortemperatur" SWORD FORMULA_0431 0 0.0 -3276.800048828125 3276.699951171875 READ_WRITE ECU_ADDRESS 0x3FAD0C /end MEASUREMENT
/begin MEASUREMENT tgetr_ad "Eingelesener Spannungswert fuer Getriebetemperatur" SWORD FORMULA_0114 0 0.0 0.0 1023.0 READ_WRITE ECU_ADDRESS 0x3FD004 /end MEASUREMENT
/begin MEASUREMENT tgetr_filter "Gefilterter Messwert der Getriebetemperatur" SWORD FORMULA_0114 0 0.0 0.0 1023.0 READ_WRITE ECU_ADDRESS 0x3FD006 /end MEASUREMENT
/begin MEASUREMENT tgetr_ipol "Ungefilterter Messwert der Getriebetemperatur" SWORD FORMULA_1167 0 0.0 -50.0 170.0 READ_WRITE ECU_ADDRESS 0x3FD008 /end MEASUREMENT
/begin MEASUREMENT tgetr_sta "Status Uebertemperaturanzeige" UBYTE FORMULA_1168 0 0.0 0.0 255.0 READ_WRITE ECU_ADDRESS 0x3FD00A /end MEASUREMENT
/begin MEASUREMENT Tlrgen "Sollwert Load- Response- Zeit Generator" UBYTE FORMULA_0461 0 0.0 0.0 25.5 READ_WRITE ECU_ADDRESS 0x3FC602 /end MEASUREMENT
/begin MEASUREMENT Tlrgen2 "Sollwert Load- Response- Zeit Generator2" UBYTE FORMULA_0461 0 0.0 0.0 25.5 READ_WRITE ECU_ADDRESS 0x3FC603 /end MEASUREMENT
/begin MEASUREMENT tm_100ms.dT "Maxzeit" ULONG FORMULA_0363 0 0.0 0.0 1000.0 READ_WRITE ECU_ADDRESS 0x3F90A0 /end MEASUREMENT
/begin MEASUREMENT tm_100ms.lastTask "vorherige Task" ULONG FORMULA_0000 0 0.0 0.0 1000.0 READ_WRITE ECU_ADDRESS 0x3F90A4 /end MEASUREMENT
/begin MEASUREMENT tm_100ms.maxTime "Maxzeit" ULONG FORMULA_0363 0 0.0 0.0 1000.0 READ_WRITE ECU_ADDRESS 0x3F909C /end MEASUREMENT
/begin MEASUREMENT tm_100ms.netTime "Netozeit" ULONG FORMULA_0363 0 0.0 0.0 1000.0 READ_WRITE ECU_ADDRESS 0x3F9094 /end MEASUREMENT
/begin MEASUREMENT tm_10ms.dT "Maxzeit" ULONG FORMULA_0363 0 0.0 0.0 1000.0 READ_WRITE ECU_ADDRESS 0x3F9078 /end MEASUREMENT
/begin MEASUREMENT tm_10ms.lastTask "vorherige Task" ULONG FORMULA_0000 0 0.0 0.0 1000.0 READ_WRITE ECU_ADDRESS 0x3F907C /end MEASUREMENT
/begin MEASUREMENT tm_10ms.maxTime "Maxzeit" ULONG FORMULA_0363 0 0.0 0.0 1000.0 READ_WRITE ECU_ADDRESS 0x3F9074 /end MEASUREMENT
/begin MEASUREMENT tm_10ms.netTime "Netozeit" ULONG FORMULA_0363 0 0.0 0.0 1000.0 READ_WRITE ECU_ADDRESS 0x3F906C /end MEASUREMENT
/begin MEASUREMENT tm_5ms.dT "Maxzeit" ULONG FORMULA_0363 0 0.0 0.0 1000.0 READ_WRITE ECU_ADDRESS 0x3F9050 /end MEASUREMENT
/begin MEASUREMENT tm_5ms.lastTask "vorherige Task" ULONG FORMULA_0000 0 0.0 0.0 1000.0 READ_WRITE ECU_ADDRESS 0x3F9054 /end MEASUREMENT
/begin MEASUREMENT tm_5ms.maxTime "Maxzeit" ULONG FORMULA_0363 0 0.0 0.0 1000.0 READ_WRITE ECU_ADDRESS 0x3F904C /end MEASUREMENT
/begin MEASUREMENT tm_5ms.netTime "Netozeit" ULONG FORMULA_0363 0 0.0 0.0 1000.0 READ_WRITE ECU_ADDRESS 0x3F9044 /end MEASUREMENT
/begin MEASUREMENT tm_bgnd.dT "Maxzeit" ULONG FORMULA_0363 0 0.0 0.0 1000.0 READ_WRITE ECU_ADDRESS 0x3F90F0 /end MEASUREMENT
/begin MEASUREMENT tm_bgnd.grossRunTime "grossRunTime" ULONG FORMULA_0363 0 0.0 0.0 1000.0 READ_WRITE ECU_ADDRESS 0x3F90E0 /end MEASUREMENT
/begin MEASUREMENT tm_bgnd.lastTask "vorherige Task" ULONG FORMULA_0000 0 0.0 0.0 1000.0 READ_WRITE ECU_ADDRESS 0x3F90F4 /end MEASUREMENT
/begin MEASUREMENT tm_bgnd.maxTime "Maxzeit" ULONG FORMULA_0363 0 0.0 0.0 1000.0 READ_WRITE ECU_ADDRESS 0x3F90EC /end MEASUREMENT
/begin MEASUREMENT tm_bgnd.netTime "Netozeit" ULONG FORMULA_0363 0 0.0 0.0 1000.0 READ_WRITE ECU_ADDRESS 0x3F90E4 /end MEASUREMENT
/begin MEASUREMENT tm_Sync1_S65.dT "Maxzeit" ULONG FORMULA_0363 0 0.0 0.0 1000.0 READ_WRITE ECU_ADDRESS 0x3F8F60 /end MEASUREMENT
/begin MEASUREMENT tm_Sync1_S65.lastTask "vorherige Task" ULONG FORMULA_0000 0 0.0 0.0 1000.0 READ_WRITE ECU_ADDRESS 0x3F8F64 /end MEASUREMENT
/begin MEASUREMENT tm_Sync1_S65.maxTime "Maxzeit" ULONG FORMULA_0363 0 0.0 0.0 1000.0 READ_WRITE ECU_ADDRESS 0x3F8F5C /end MEASUREMENT
/begin MEASUREMENT tm_Sync1_S65.netTime "Netozeit" ULONG FORMULA_0363 0 0.0 0.0 1000.0 READ_WRITE ECU_ADDRESS 0x3F8F54 /end MEASUREMENT
/begin MEASUREMENT tm_Sync1_S85.dT "Maxzeit" ULONG FORMULA_0363 0 0.0 0.0 1000.0 READ_WRITE ECU_ADDRESS 0x3F8F88 /end MEASUREMENT
/begin MEASUREMENT tm_Sync1_S85.lastTask "vorherige Task" ULONG FORMULA_0000 0 0.0 0.0 1000.0 READ_WRITE ECU_ADDRESS 0x3F8F8C /end MEASUREMENT
/begin MEASUREMENT tm_Sync1_S85.maxTime "Maxzeit" ULONG FORMULA_0363 0 0.0 0.0 1000.0 READ_WRITE ECU_ADDRESS 0x3F8F84 /end MEASUREMENT
/begin MEASUREMENT tm_Sync1_S85.netTime "Netozeit" ULONG FORMULA_0363 0 0.0 0.0 1000.0 READ_WRITE ECU_ADDRESS 0x3F8F7C /end MEASUREMENT
/begin MEASUREMENT tm_Sync2_S65.dT "Maxzeit" ULONG FORMULA_0363 0 0.0 0.0 1000.0 READ_WRITE ECU_ADDRESS 0x3F8FB0 /end MEASUREMENT
/begin MEASUREMENT tm_Sync2_S65.lastTask "vorherige Task" ULONG FORMULA_0000 0 0.0 0.0 1000.0 READ_WRITE ECU_ADDRESS 0x3F8FB4 /end MEASUREMENT
/begin MEASUREMENT tm_Sync2_S65.maxTime "Maxzeit" ULONG FORMULA_0363 0 0.0 0.0 1000.0 READ_WRITE ECU_ADDRESS 0x3F8FAC /end MEASUREMENT
/begin MEASUREMENT tm_Sync2_S65.netTime "Netozeit" ULONG FORMULA_0363 0 0.0 0.0 1000.0 READ_WRITE ECU_ADDRESS 0x3F8FA4 /end MEASUREMENT
/begin MEASUREMENT tm_Sync2_S85.dT "Maxzeit" ULONG FORMULA_0363 0 0.0 0.0 1000.0 READ_WRITE ECU_ADDRESS 0x3F8FD8 /end MEASUREMENT
/begin MEASUREMENT tm_Sync2_S85.lastTask "vorherige Task" ULONG FORMULA_0000 0 0.0 0.0 1000.0 READ_WRITE ECU_ADDRESS 0x3F8FDC /end MEASUREMENT
/begin MEASUREMENT tm_Sync2_S85.maxTime "Maxzeit" ULONG FORMULA_0363 0 0.0 0.0 1000.0 READ_WRITE ECU_ADDRESS 0x3F8FD4 /end MEASUREMENT
/begin MEASUREMENT tm_Sync2_S85.netTime "Netozeit" ULONG FORMULA_0363 0 0.0 0.0 1000.0 READ_WRITE ECU_ADDRESS 0x3F8FCC /end MEASUREMENT
/begin MEASUREMENT Tst_countv "Testcounter-Wert" UWORD FORMULA_0010 0 0.0 0.0 65535.0 READ_WRITE ECU_ADDRESS 0x3FAD24 /end MEASUREMENT
/begin MEASUREMENT Tst_fil_out "Testfilter Ausgang" UWORD FORMULA_0471 0 0.0 0.0 768.0 READ_WRITE ECU_ADDRESS 0x3FAD26 /end MEASUREMENT
/begin MEASUREMENT U_gen "Sollwert Generatorspannung" UWORD FORMULA_0466 0 0.0 0.0 6553.5 READ_WRITE ECU_ADDRESS 0x3FD2BE /end MEASUREMENT
/begin MEASUREMENT U_gen_igr "Leitungskompensierte Generatorspg für iGR" UWORD FORMULA_0466 0 0.0 0.0 6553.5 READ_WRITE ECU_ADDRESS 0x3FB0BA /end MEASUREMENT
/begin MEASUREMENT U_gen2 "Generatosspannungssollwert für Generator2" UWORD FORMULA_0466 0 0.0 0.0 16.0 READ_WRITE ECU_ADDRESS 0x3FD2C0 /end MEASUREMENT
/begin MEASUREMENT U_gsoll "Generatorsollspannung Basis" UWORD FORMULA_0466 0 0.0 0.0 6553.5 READ_WRITE ECU_ADDRESS 0x3FD2C2 /end MEASUREMENT
/begin MEASUREMENT U_gsoll_off "Generatorsollspannung Basis" UWORD FORMULA_0466 0 0.0 0.0 6553.5 READ_WRITE ECU_ADDRESS 0x3FD2C4 /end MEASUREMENT
/begin MEASUREMENT U_gsoll_tp "Generatorsollspannung Basis" UWORD FORMULA_0466 0 0.0 0.0 6553.5 READ_WRITE ECU_ADDRESS 0x3FD2C6 /end MEASUREMENT
/begin MEASUREMENT U_gsoll_tp2 "Generatorsollspannung Basis" UWORD FORMULA_0466 0 0.0 0.0 6553.5 READ_WRITE ECU_ADDRESS 0x3FB0BC /end MEASUREMENT
/begin MEASUREMENT U_gsoll_tp3 "Generatorsollspannung Basis 3" UWORD FORMULA_0466 0 0.0 0.0 6553.5 READ_WRITE ECU_ADDRESS 0x3FD2C8 /end MEASUREMENT
/begin MEASUREMENT U_gsollred "reduzierte Generatorsollspannung" UWORD FORMULA_0466 0 0.0 0.0 6553.5 READ_WRITE ECU_ADDRESS 0x3FB0BE /end MEASUREMENT
/begin MEASUREMENT U_gsolltmp "reduzierte Zwischengeneratorsollspannung" UWORD FORMULA_0466 0 0.0 0.0 6553.5 READ_WRITE ECU_ADDRESS 0x3FB0C0 /end MEASUREMENT
/begin MEASUREMENT v_max_schw_sk "Maximalgeschwindigkeit bei SK-Fehler" SWORD FORMULA_0076 0 0.0 -80.0 360.0 READ_WRITE ECU_ADDRESS 0x3FD4AA /end MEASUREMENT
/begin MEASUREMENT v_max_st "Status Maximalgeschwindigkeit" UBYTE FORMULA_1237 0 0.0 0.0 255.0 READ_WRITE ECU_ADDRESS 0x3FD4A8 /end MEASUREMENT
/begin MEASUREMENT v_rad_tol_hl "gefilt. RadToleranz HL" SBYTE FORMULA_0623 0 0.0 -12.80000019073486 12.69999980926514 READ_WRITE ECU_ADDRESS 0x3FD4AE /end MEASUREMENT
/begin MEASUREMENT v_rad_tol_hr "gefilt. RadToleranz HR" SBYTE FORMULA_0623 0 0.0 -12.80000019073486 12.69999980926514 READ_WRITE ECU_ADDRESS 0x3FD4AF /end MEASUREMENT
/begin MEASUREMENT v_rad_tol_vl "gefilt. RadToleranz VL" SBYTE FORMULA_0623 0 0.0 -12.80000019073486 12.69999980926514 READ_WRITE ECU_ADDRESS 0x3FD4AC /end MEASUREMENT
/begin MEASUREMENT v_rad_tol_vr "gefilt. RadToleranz VR" SBYTE FORMULA_0623 0 0.0 -12.80000019073486 12.69999980926514 READ_WRITE ECU_ADDRESS 0x3FD4AD /end MEASUREMENT
/begin MEASUREMENT v_st "Status Geschwindigkeit" UBYTE FORMULA_0003 0 0.0 0.0 255.0 READ_WRITE ECU_ADDRESS 0x3FD4A9 /end MEASUREMENT
/begin MEASUREMENT Z_dmdblock "" UBYTE FORMULA_0003 0 0.0 0.0 255.0 READ_WRITE ECU_ADDRESS 0x3FA882 /end MEASUREMENT
/begin COMPU_METHOD FORMULA_0000 "FORMULA_0000" RAT_FUNC "%7.0" "-" COEFFS 0 1 0 0 0 1 /end COMPU_METHOD
/begin COMPU_METHOD FORMULA_0003 "FORMULA_0003" RAT_FUNC "%3.0" "-" COEFFS 0 1 0 0 0 1 /end COMPU_METHOD
/begin COMPU_METHOD FORMULA_0006 "FORMULA_0006" RAT_FUNC "%5.0" "Upm" COEFFS 0 1 0 0 0 1 /end COMPU_METHOD
/begin COMPU_METHOD FORMULA_0007 "FORMULA_0007" RAT_FUNC "%8.3" "-" COEFFS 0 10000.0 0.0 0 0.0 1.0 /end COMPU_METHOD
/begin COMPU_METHOD FORMULA_0010 "FORMULA_0010" RAT_FUNC "%5.0" "-" COEFFS 0 1 0 0 0 1 /end COMPU_METHOD
/begin COMPU_METHOD FORMULA_0021 "FORMULA_0021" RAT_FUNC "%7.2" "s" COEFFS 0 100.0 0.0 0 0.0 1.0 /end COMPU_METHOD
/begin COMPU_METHOD FORMULA_0023 "FORMULA_0023" RAT_FUNC "%6.1" "°C" COEFFS 0 10.0 2732.0 0 0.0 1.0 /end COMPU_METHOD
/begin COMPU_METHOD FORMULA_0024 "FORMULA_0024" RAT_FUNC "%9.4" "-" COEFFS 0 32768.0 0.0 0 0.0 1.0 /end COMPU_METHOD
/begin COMPU_METHOD FORMULA_0044 "FORMULA_0044" RAT_FUNC "%9.2" "-" COEFFS 0 1 0 0 0 1 /end COMPU_METHOD
/begin COMPU_METHOD FORMULA_0071 "FORMULA_0071" RAT_FUNC "%6.1" "s" COEFFS 0 10.0 0.0 0 0.0 1.0 /end COMPU_METHOD
/begin COMPU_METHOD FORMULA_0073 "FORMULA_0073" RAT_FUNC "%8.3" "-" COEFFS 0 1024.0 0.0 0 0.0 1.0 /end COMPU_METHOD
/begin COMPU_METHOD FORMULA_0076 "FORMULA_0076" RAT_FUNC "%6.1" "km/h" COEFFS 0 16.0 0.0 0 0.0 1.0 /end COMPU_METHOD
/begin COMPU_METHOD FORMULA_0103 "FORMULA_0103" RAT_FUNC "%6.1" "kg/h" COEFFS 0 10.0 0.0 0 0.0 1.0 /end COMPU_METHOD
/begin COMPU_METHOD FORMULA_0113 "FORMULA_0113" RAT_FUNC "%7.2" "Nm" COEFFS 0 10.0 0.0 0 0.0 1.0 /end COMPU_METHOD
/begin COMPU_METHOD FORMULA_0114 "FORMULA_0114" RAT_FUNC "%5.0" "digit" COEFFS 0 1 0 0 0 1 /end COMPU_METHOD
/begin COMPU_METHOD FORMULA_0306 "FORMULA_0306" RAT_FUNC "%5.2" "s" COEFFS 0 100.0 0.0 0 0.0 1.0 /end COMPU_METHOD
/begin COMPU_METHOD FORMULA_0363 "FORMULA_0363" RAT_FUNC "%9.2" "ms" COEFFS 0 1000.0 0.0 0 0.0 1.0 /end COMPU_METHOD
/begin COMPU_METHOD FORMULA_0364 "FORMULA_0364" TAB_VERB "%5.2" "-" COMPU_TAB_REF FORMULA_0364_VTAB /end COMPU_METHOD
/begin COMPU_METHOD FORMULA_0365 "FORMULA_0365" TAB_VERB "%5.2" "-" COMPU_TAB_REF FORMULA_0365_VTAB /end COMPU_METHOD
/begin COMPU_METHOD FORMULA_0366 "FORMULA_0366" TAB_VERB "%5.2" "-" COMPU_TAB_REF FORMULA_0366_VTAB /end COMPU_METHOD
/begin COMPU_METHOD FORMULA_0423 "FORMULA_0423" TAB_VERB "%5.2" "-" COMPU_TAB_REF FORMULA_0423_VTAB /end COMPU_METHOD
/begin COMPU_METHOD FORMULA_0424 "FORMULA_0424" TAB_VERB "%5.2" "-" COMPU_TAB_REF FORMULA_0424_VTAB /end COMPU_METHOD
/begin COMPU_METHOD FORMULA_0425 "FORMULA_0425" TAB_VERB "%5.2" "-" COMPU_TAB_REF FORMULA_0425_VTAB /end COMPU_METHOD
/begin COMPU_METHOD FORMULA_0426 "FORMULA_0426" TAB_VERB "%5.2" "-" COMPU_TAB_REF FORMULA_0426_VTAB /end COMPU_METHOD
/begin COMPU_METHOD FORMULA_0427 "FORMULA_0427" TAB_VERB "%5.2" "-" COMPU_TAB_REF FORMULA_0427_VTAB /end COMPU_METHOD
/begin COMPU_METHOD FORMULA_0428 "FORMULA_0428" TAB_VERB "%5.2" "-" COMPU_TAB_REF FORMULA_0428_VTAB /end COMPU_METHOD
/begin COMPU_METHOD FORMULA_0429 "FORMULA_0429" TAB_VERB "%5.2" "-" COMPU_TAB_REF FORMULA_0429_VTAB /end COMPU_METHOD
/begin COMPU_METHOD FORMULA_0430 "FORMULA_0430" TAB_VERB "%5.2" "-" COMPU_TAB_REF FORMULA_0430_VTAB /end COMPU_METHOD
/begin COMPU_METHOD FORMULA_0431 "FORMULA_0431" RAT_FUNC "%5.0" "°C" COEFFS 0 10.0 0.0 0 0.0 1.0 /end COMPU_METHOD
/begin COMPU_METHOD FORMULA_0437 "FORMULA_0437" RAT_FUNC "%5.0" "km" COEFFS 0 0.1 0.0 0 0.0 1.0 /end COMPU_METHOD
/begin COMPU_METHOD FORMULA_0445 "FORMULA_0445" RAT_FUNC "%7.2" "°C" COEFFS 0 100.0 0.0 0 0.0 1.0 /end COMPU_METHOD
/begin COMPU_METHOD FORMULA_0449 "FORMULA_0449" RAT_FUNC "%5.2" "-" COEFFS 0 32.0 0.0 0 0.0 1.0 /end COMPU_METHOD
/begin COMPU_METHOD FORMULA_0455 "FORMULA_0455" RAT_FUNC "%5.2" "-" COEFFS 0 256.0 0.0 0 0.0 1.0 /end COMPU_METHOD
/begin COMPU_METHOD FORMULA_0456 "FORMULA_0456" RAT_FUNC "%9.4" "-" COEFFS 0 1024.0 0.0 0 0.0 1.0 /end COMPU_METHOD
/begin COMPU_METHOD FORMULA_0460 "FORMULA_0460" RAT_FUNC "%9.4" "-" COEFFS 0 65536.0 0.0 0 0.0 1.0 /end COMPU_METHOD
/begin COMPU_METHOD FORMULA_0461 "FORMULA_0461" RAT_FUNC "%4.1" "s" COEFFS 0 10.0 0.0 0 0.0 1.0 /end COMPU_METHOD
/begin COMPU_METHOD FORMULA_0462 "FORMULA_0462" RAT_FUNC "%7.2" "%" COEFFS 0 655.36 0.0 0 0.0 1.0 /end COMPU_METHOD
/begin COMPU_METHOD FORMULA_0463 "FORMULA_0463" RAT_FUNC "%6.3" "" COEFFS 0 1 0 0 0 1 /end COMPU_METHOD
/begin COMPU_METHOD FORMULA_0464 "FORMULA_0464" RAT_FUNC "%6.3" "A" COEFFS 0 8.0 0.0 0 0.0 1.0 /end COMPU_METHOD
/begin COMPU_METHOD FORMULA_0465 "FORMULA_0465" RAT_FUNC "%5.2" "-" COEFFS 0 64.0 0.0 0 0.0 1.0 /end COMPU_METHOD
/begin COMPU_METHOD FORMULA_0466 "FORMULA_0466" RAT_FUNC "%8.3" "V" COEFFS 0 10.0 0.0 0 0.0 1.0 /end COMPU_METHOD
/begin COMPU_METHOD FORMULA_0467 "FORMULA_0467" RAT_FUNC "%9.2" "-" COEFFS 0 524288.0 0.0 0 0.0 1.0 /end COMPU_METHOD
/begin COMPU_METHOD FORMULA_0468 "FORMULA_0468" RAT_FUNC "%10.3" "" COEFFS 0 32.0 0.0 0 0.0 1.0 /end COMPU_METHOD
/begin COMPU_METHOD FORMULA_0469 "FORMULA_0469" RAT_FUNC "%8.3" "A" COEFFS 0 1 0 0 0 1 /end COMPU_METHOD
/begin COMPU_METHOD FORMULA_0470 "FORMULA_0470" RAT_FUNC "%7.2" "%" COEFFS 0 32.0 0.0 0 0.0 1.0 /end COMPU_METHOD
/begin COMPU_METHOD FORMULA_0471 "FORMULA_0471" RAT_FUNC "%7.2" "°C" COEFFS 0 1.333333333333333 0.0 0 0.0 1.0 /end COMPU_METHOD
/begin COMPU_METHOD FORMULA_0472 "FORMULA_0472" RAT_FUNC "%8.3" "-" COEFFS 0 2048.0 0.0 0 0.0 1.0 /end COMPU_METHOD
/begin COMPU_METHOD FORMULA_0473 "FORMULA_0473" RAT_FUNC "%8.3" "A" COEFFS 0 32.0 0.0 0 0.0 1.0 /end COMPU_METHOD
/begin COMPU_METHOD FORMULA_0474 "FORMULA_0474" RAT_FUNC "%5.0" "km/h" COEFFS 0 1 0 0 0 1 /end COMPU_METHOD
/begin COMPU_METHOD FORMULA_0475 "FORMULA_0475" RAT_FUNC "%5.2" "%" COEFFS 0 2.56 0.0 0 0.0 1.0 /end COMPU_METHOD
/begin COMPU_METHOD FORMULA_0476 "FORMULA_0476" RAT_FUNC "%5.2" "min" COEFFS 0 1 0 0 0 1 /end COMPU_METHOD
/begin COMPU_METHOD FORMULA_0477 "FORMULA_0477" RAT_FUNC "%5.2" "-" COEFFS 0 128.0 0.0 0 0.0 1.0 /end COMPU_METHOD
/begin COMPU_METHOD FORMULA_0478 "FORMULA_0478" RAT_FUNC "%4.1" "-" COEFFS 0 1 0 0 0 1 /end COMPU_METHOD
/begin COMPU_METHOD FORMULA_0479 "FORMULA_0479" RAT_FUNC "%7.2" "-" COEFFS 0 327.68 0.0 0 0.0 1.0 /end COMPU_METHOD
/begin COMPU_METHOD FORMULA_0480 "FORMULA_0480" RAT_FUNC "%9.4" "%" COEFFS 0 100.0 0.0 0 0.0 1.0 /end COMPU_METHOD
/begin COMPU_METHOD FORMULA_0481 "FORMULA_0481" RAT_FUNC "%5.2" "sec" COEFFS 0 1 0 0 0 1 /end COMPU_METHOD
/begin COMPU_METHOD FORMULA_0613 "FORMULA_0613" RAT_FUNC "%5.0" "km" COEFFS 0 1 0 0 0 1 /end COMPU_METHOD
/begin COMPU_METHOD FORMULA_0623 "FORMULA_0623" RAT_FUNC "%4.1" "%" COEFFS 0 10.0 0.0 0 0.0 1.0 /end COMPU_METHOD
/begin COMPU_METHOD FORMULA_0645 "FORMULA_0645" RAT_FUNC "%6.3" "s" COEFFS 0 0 1.28 0 1 0 /end COMPU_METHOD
/begin COMPU_METHOD FORMULA_0660 "FORMULA_0660" RAT_FUNC "%5.0" ".Gang" COEFFS 0 1 0 0 0 1 /end COMPU_METHOD
/begin COMPU_METHOD FORMULA_0679 "FORMULA_0679" RAT_FUNC "%5.2" "s" COEFFS 0 0 25.6 0 1 0 /end COMPU_METHOD
/begin COMPU_METHOD FORMULA_0680 "FORMULA_0680" TAB_VERB "%5.2" "-" COMPU_TAB_REF FORMULA_0680_VTAB /end COMPU_METHOD
/begin COMPU_METHOD FORMULA_0681 "FORMULA_0681" TAB_VERB "%5.2" "-" COMPU_TAB_REF FORMULA_0681_VTAB /end COMPU_METHOD
/begin COMPU_METHOD FORMULA_0682 "FORMULA_0682" TAB_VERB "%9.2" "-" COMPU_TAB_REF FORMULA_0682_VTAB /end COMPU_METHOD
/begin COMPU_METHOD FORMULA_0683 "FORMULA_0683" TAB_VERB "%9.2" "-" COMPU_TAB_REF FORMULA_0683_VTAB /end COMPU_METHOD
/begin COMPU_METHOD FORMULA_0684 "FORMULA_0684" TAB_VERB "%9.2" "-" COMPU_TAB_REF FORMULA_0684_VTAB /end COMPU_METHOD
/begin COMPU_METHOD FORMULA_0685 "FORMULA_0685" TAB_VERB "%9.2" "-" COMPU_TAB_REF FORMULA_0685_VTAB /end COMPU_METHOD
/begin COMPU_METHOD FORMULA_0686 "FORMULA_0686" TAB_VERB "%9.2" "-" COMPU_TAB_REF FORMULA_0686_VTAB /end COMPU_METHOD
/begin COMPU_METHOD FORMULA_0687 "FORMULA_0687" TAB_VERB "%9.2" "-" COMPU_TAB_REF FORMULA_0687_VTAB /end COMPU_METHOD
/begin COMPU_METHOD FORMULA_0688 "FORMULA_0688" TAB_VERB "%9.2" "-" COMPU_TAB_REF FORMULA_0688_VTAB /end COMPU_METHOD
/begin COMPU_METHOD FORMULA_0689 "FORMULA_0689" TAB_VERB "%9.2" "-" COMPU_TAB_REF FORMULA_0689_VTAB /end COMPU_METHOD
/begin COMPU_METHOD FORMULA_0690 "FORMULA_0690" TAB_VERB "%9.2" "-" COMPU_TAB_REF FORMULA_0690_VTAB /end COMPU_METHOD
/begin COMPU_METHOD FORMULA_0691 "FORMULA_0691" TAB_VERB "%9.2" "-" COMPU_TAB_REF FORMULA_0691_VTAB /end COMPU_METHOD
/begin COMPU_METHOD FORMULA_0692 "FORMULA_0692" TAB_VERB "%9.2" "-" COMPU_TAB_REF FORMULA_0692_VTAB /end COMPU_METHOD
/begin COMPU_METHOD FORMULA_0693 "FORMULA_0693" TAB_VERB "%9.2" "-" COMPU_TAB_REF FORMULA_0693_VTAB /end COMPU_METHOD
/begin COMPU_METHOD FORMULA_0694 "FORMULA_0694" TAB_VERB "%9.2" "-" COMPU_TAB_REF FORMULA_0694_VTAB /end COMPU_METHOD
/begin COMPU_METHOD FORMULA_0695 "FORMULA_0695" TAB_VERB "%9.2" "-" COMPU_TAB_REF FORMULA_0695_VTAB /end COMPU_METHOD
/begin COMPU_METHOD FORMULA_0696 "FORMULA_0696" TAB_VERB "%9.2" "-" COMPU_TAB_REF FORMULA_0696_VTAB /end COMPU_METHOD
/begin COMPU_METHOD FORMULA_0697 "FORMULA_0697" TAB_VERB "%9.2" "-" COMPU_TAB_REF FORMULA_0697_VTAB /end COMPU_METHOD
/begin COMPU_METHOD FORMULA_0698 "FORMULA_0698" TAB_VERB "%9.2" "-" COMPU_TAB_REF FORMULA_0698_VTAB /end COMPU_METHOD
/begin COMPU_METHOD FORMULA_0699 "FORMULA_0699" TAB_VERB "%9.2" "-" COMPU_TAB_REF FORMULA_0699_VTAB /end COMPU_METHOD
/begin COMPU_METHOD FORMULA_0700 "FORMULA_0700" TAB_VERB "%9.2" "-" COMPU_TAB_REF FORMULA_0700_VTAB /end COMPU_METHOD
/begin COMPU_METHOD FORMULA_0701 "FORMULA_0701" TAB_VERB "%9.2" "-" COMPU_TAB_REF FORMULA_0701_VTAB /end COMPU_METHOD
/begin COMPU_METHOD FORMULA_0702 "FORMULA_0702" TAB_VERB "%9.2" "-" COMPU_TAB_REF FORMULA_0702_VTAB /end COMPU_METHOD
/begin COMPU_METHOD FORMULA_0703 "FORMULA_0703" TAB_VERB "%9.2" "-" COMPU_TAB_REF FORMULA_0703_VTAB /end COMPU_METHOD
/begin COMPU_METHOD FORMULA_0704 "FORMULA_0704" TAB_VERB "%9.2" "-" COMPU_TAB_REF FORMULA_0704_VTAB /end COMPU_METHOD
/begin COMPU_METHOD FORMULA_0705 "FORMULA_0705" TAB_VERB "%9.2" "-" COMPU_TAB_REF FORMULA_0705_VTAB /end COMPU_METHOD
/begin COMPU_METHOD FORMULA_0706 "FORMULA_0706" RAT_FUNC "%6.1" "%" COEFFS 0 100.0 0.0 0 0.0 1.0 /end COMPU_METHOD
/begin COMPU_METHOD FORMULA_0707 "FORMULA_0707" TAB_VERB "%5.2" "-" COMPU_TAB_REF FORMULA_0707_VTAB /end COMPU_METHOD
/begin COMPU_METHOD FORMULA_0708 "FORMULA_0708" TAB_VERB "%5.2" "-" COMPU_TAB_REF FORMULA_0708_VTAB /end COMPU_METHOD
/begin COMPU_METHOD FORMULA_0709 "FORMULA_0709" TAB_VERB "%5.2" "-" COMPU_TAB_REF FORMULA_0709_VTAB /end COMPU_METHOD
/begin COMPU_METHOD FORMULA_0998 "FORMULA_0998" TAB_VERB "%3.0" "-" COMPU_TAB_REF FORMULA_0998_VTAB /end COMPU_METHOD
/begin COMPU_METHOD FORMULA_1167 "FORMULA_1167" RAT_FUNC "%8.3" "°C" COEFFS 0 40.0 10926.0 0 0.0 1.0 /end COMPU_METHOD
/begin COMPU_METHOD FORMULA_1168 "FORMULA_1168" TAB_VERB "%3.0" "-" COMPU_TAB_REF FORMULA_1168_VTAB /end COMPU_METHOD
/begin COMPU_METHOD FORMULA_1169 "FORMULA_1169" RAT_FUNC "%8.3" "°C" COEFFS 0 40.0 0.0 0 0.0 1.0 /end COMPU_METHOD
/begin COMPU_METHOD FORMULA_1237 "FORMULA_1237" TAB_VERB "%3.0" "-" COMPU_TAB_REF FORMULA_1237_VTAB /end COMPU_METHOD
/begin COMPU_METHOD FORMULA_1238 "FORMULA_1238" TAB_VERB "%5.2" "-" COMPU_TAB_REF FORMULA_1238_VTAB /end COMPU_METHOD
/begin COMPU_VTAB FORMULA_0364_VTAB "FORMULA_0364_VTAB" TAB_VERB 2 0 "WorkPage" 16 "RefPage" DEFAULT_VALUE "Err/RefP" /end COMPU_VTAB
/begin COMPU_VTAB FORMULA_0365_VTAB "FORMULA_0365_VTAB" TAB_VERB 4 0 "idle" 1 "to WorkPage" 2 "to RefPage" 4 "ready" /end COMPU_VTAB
/begin COMPU_VTAB FORMULA_0366_VTAB "FORMULA_0366_VTAB" TAB_VERB 3 0 "idle" 1 "loop" 2 "ready" /end COMPU_VTAB
/begin COMPU_VTAB FORMULA_0423_VTAB "FORMULA_0423_VTAB" TAB_VERB 2 0 "FALSE" 1 "TRUE" DEFAULT_VALUE "TRUE" /end COMPU_VTAB
/begin COMPU_VTAB FORMULA_0424_VTAB "FORMULA_0424_VTAB" TAB_VERB 2 0 "FALSE" 1 "TRUE" DEFAULT_VALUE "TRUE" /end COMPU_VTAB
/begin COMPU_VTAB FORMULA_0425_VTAB "FORMULA_0425_VTAB" TAB_VERB 2 0 "FALSE" 1 "TRUE" DEFAULT_VALUE "TRUE" /end COMPU_VTAB
/begin COMPU_VTAB FORMULA_0426_VTAB "FORMULA_0426_VTAB" TAB_VERB 2 0 "FALSE" 1 "TRUE" DEFAULT_VALUE "TRUE" /end COMPU_VTAB
/begin COMPU_VTAB FORMULA_0427_VTAB "FORMULA_0427_VTAB" TAB_VERB 2 0 "FALSE" 1 "TRUE" DEFAULT_VALUE "TRUE" /end COMPU_VTAB
/begin COMPU_VTAB FORMULA_0428_VTAB "FORMULA_0428_VTAB" TAB_VERB 2 0 "FALSE" 1 "TRUE" DEFAULT_VALUE "TRUE" /end COMPU_VTAB
/begin COMPU_VTAB FORMULA_0429_VTAB "FORMULA_0429_VTAB" TAB_VERB 2 0 "FALSE" 1 "TRUE" DEFAULT_VALUE "TRUE" /end COMPU_VTAB
/begin COMPU_VTAB FORMULA_0430_VTAB "FORMULA_0430_VTAB" TAB_VERB 2 0 "FALSE" 1 "TRUE" DEFAULT_VALUE "TRUE" /end COMPU_VTAB
/begin COMPU_VTAB FORMULA_0680_VTAB "FORMULA_0680_VTAB" TAB_VERB 21 0 "RESET" 1 "GET_WC_IGN" 2 "WAIT_TEL" 130 "WAIT_TEL_NACHLAUF" 131 "FREI" 132 "WEITERGESCHALTEN" 133 "GESPEICHERT" 134 "NACHLAUF" 6 "WAIT_RESTART" 7 "MANIPULATION" 8 "JUNGFRAU" 9 "WAIT_STARTWERT1" 10 "WAIT_STARTWERT2" 11 "WAIT_SYNC" 12 "SYNC_ENDE" 13 "SYNC_STW_FALSCH" 14 "SYNC_Z1_FEHLER" 15 "SYNC_KEIN_STW" 16 "SYNC_TIMEOUT" 17 "DEFEKT" 18 "WC_DEFEKT" DEFAULT_VALUE "undef" /end COMPU_VTAB
/begin COMPU_VTAB FORMULA_0681_VTAB "FORMULA_0681_VTAB" TAB_VERB 3 0 "kein STW" 1 "STW defekt" 2 "STW o.k." /end COMPU_VTAB
/begin COMPU_VTAB FORMULA_0682_VTAB "FORMULA_0682_VTAB" TAB_VERB 1 0 "diag. laeuft" DEFAULT_VALUE "diag. inaktive" /end COMPU_VTAB
/begin COMPU_VTAB FORMULA_0683_VTAB "FORMULA_0683_VTAB" TAB_VERB 1 0 "ok" DEFAULT_VALUE "nok" /end COMPU_VTAB
/begin COMPU_VTAB FORMULA_0684_VTAB "FORMULA_0684_VTAB" TAB_VERB 1 0 "ok" DEFAULT_VALUE "nok" /end COMPU_VTAB
/begin COMPU_VTAB FORMULA_0685_VTAB "FORMULA_0685_VTAB" TAB_VERB 1 0 "ok" DEFAULT_VALUE "nok" /end COMPU_VTAB
/begin COMPU_VTAB FORMULA_0686_VTAB "FORMULA_0686_VTAB" TAB_VERB 1 0 "ok" DEFAULT_VALUE "nok" /end COMPU_VTAB
/begin COMPU_VTAB FORMULA_0687_VTAB "FORMULA_0687_VTAB" TAB_VERB 1 0 "ok" DEFAULT_VALUE "nok" /end COMPU_VTAB
/begin COMPU_VTAB FORMULA_0688_VTAB "FORMULA_0688_VTAB" TAB_VERB 1 0 "ok" DEFAULT_VALUE "nok" /end COMPU_VTAB
/begin COMPU_VTAB FORMULA_0689_VTAB "FORMULA_0689_VTAB" TAB_VERB 1 0 "ok" DEFAULT_VALUE "nok" /end COMPU_VTAB
/begin COMPU_VTAB FORMULA_0690_VTAB "FORMULA_0690_VTAB" TAB_VERB 1 0 "ok" DEFAULT_VALUE "nok" /end COMPU_VTAB
/begin COMPU_VTAB FORMULA_0691_VTAB "FORMULA_0691_VTAB" TAB_VERB 1 0 "ok" DEFAULT_VALUE "nok" /end COMPU_VTAB
/begin COMPU_VTAB FORMULA_0692_VTAB "FORMULA_0692_VTAB" TAB_VERB 1 0 "ok" DEFAULT_VALUE "nok" /end COMPU_VTAB
/begin COMPU_VTAB FORMULA_0693_VTAB "FORMULA_0693_VTAB" TAB_VERB 1 0 "ok" DEFAULT_VALUE "nok" /end COMPU_VTAB
/begin COMPU_VTAB FORMULA_0694_VTAB "FORMULA_0694_VTAB" TAB_VERB 1 0 "ok" DEFAULT_VALUE "nok" /end COMPU_VTAB
/begin COMPU_VTAB FORMULA_0695_VTAB "FORMULA_0695_VTAB" TAB_VERB 1 0 "ok" DEFAULT_VALUE "nok" /end COMPU_VTAB
/begin COMPU_VTAB FORMULA_0696_VTAB "FORMULA_0696_VTAB" TAB_VERB 1 0 "ok" DEFAULT_VALUE "nok" /end COMPU_VTAB
/begin COMPU_VTAB FORMULA_0697_VTAB "FORMULA_0697_VTAB" TAB_VERB 1 0 "ok" DEFAULT_VALUE "nok" /end COMPU_VTAB
/begin COMPU_VTAB FORMULA_0698_VTAB "FORMULA_0698_VTAB" TAB_VERB 1 0 "ok" DEFAULT_VALUE "nok" /end COMPU_VTAB
/begin COMPU_VTAB FORMULA_0699_VTAB "FORMULA_0699_VTAB" TAB_VERB 1 0 "ok" DEFAULT_VALUE "nok" /end COMPU_VTAB
/begin COMPU_VTAB FORMULA_0700_VTAB "FORMULA_0700_VTAB" TAB_VERB 1 0 "ok" DEFAULT_VALUE "nok" /end COMPU_VTAB
/begin COMPU_VTAB FORMULA_0701_VTAB "FORMULA_0701_VTAB" TAB_VERB 1 0 "ok" DEFAULT_VALUE "nok" /end COMPU_VTAB
/begin COMPU_VTAB FORMULA_0702_VTAB "FORMULA_0702_VTAB" TAB_VERB 1 0 "ok" DEFAULT_VALUE "nok" /end COMPU_VTAB
/begin COMPU_VTAB FORMULA_0703_VTAB "FORMULA_0703_VTAB" TAB_VERB 1 0 "ok" DEFAULT_VALUE "nok" /end COMPU_VTAB
/begin COMPU_VTAB FORMULA_0704_VTAB "FORMULA_0704_VTAB" TAB_VERB 1 0 "ok" DEFAULT_VALUE "nok" /end COMPU_VTAB
/begin COMPU_VTAB FORMULA_0705_VTAB "FORMULA_0705_VTAB" TAB_VERB 1 0 "ok" DEFAULT_VALUE "nok" /end COMPU_VTAB
/begin COMPU_VTAB FORMULA_0707_VTAB "FORMULA_0707_VTAB" TAB_VERB 5 0 "Inaktiv" 1 "Aktiv OK" 2 "Fehler" 4 "Fehler CNT" 8 "ED Eintrag" DEFAULT_VALUE "ugnueltig" /end COMPU_VTAB
/begin COMPU_VTAB FORMULA_0708_VTAB "FORMULA_0708_VTAB" TAB_VERB 6 0 "Inaktiv" 1 "Aktiv OK" 2 "Fehler" 4 "Fehler CNT" 8 "ED Eintrag" 16 "TE sperrt" DEFAULT_VALUE "ugnueltig" /end COMPU_VTAB
/begin COMPU_VTAB FORMULA_0709_VTAB "FORMULA_0709_VTAB" TAB_VERB 3 0 "Inaktiv" 1 "Aktiv" 2 "Aktiv Test" DEFAULT_VALUE "ungueltig" /end COMPU_VTAB
/begin COMPU_VTAB FORMULA_0998_VTAB "FORMULA_0998_VTAB" TAB_VERB 2 0 "Speichern" 1 "Reset" DEFAULT_VALUE "undef" /end COMPU_VTAB
/begin COMPU_VTAB FORMULA_1168_VTAB "FORMULA_1168_VTAB" TAB_VERB 2 0 "Lampe aus" 1 "Lampe an" /end COMPU_VTAB
/begin COMPU_VTAB FORMULA_1237_VTAB "FORMULA_1237_VTAB" TAB_VERB 2 0 "v_direkt" 1 "v_CAN" DEFAULT_VALUE "undef" /end COMPU_VTAB
/begin COMPU_VTAB FORMULA_1238_VTAB "FORMULA_1238_VTAB" TAB_VERB 2 0 "Inaktiv" 1 "Aktiv" DEFAULT_VALUE "undef" /end COMPU_VTAB
/begin FUNCTION Ercosek_SC "" /begin DEF_CHARACTERISTIC K_CODIER_INDEX K_DIAGNOSE_INDEX_HI K_DIAGNOSE_INDEX_LO /end DEF_CHARACTERISTIC
 /begin OUT_MEASUREMENT ccp_aramStatus ccp_checksum ccp_moveStatus ccp_reqSwitch ccp_stateChecksum stack_status stack_usedErcosek stack_usedUser tm_100ms.dT tm_100ms.lastTask tm_100ms.maxTime tm_100ms.netTime tm_10ms.dT tm_10ms.lastTask tm_10ms.maxTime tm_10ms.netTime tm_5ms.dT tm_5ms.lastTask tm_5ms.maxTime tm_5ms.netTime tm_bgnd.dT tm_bgnd.grossRunTime tm_bgnd.lastTask tm_bgnd.maxTime tm_bgnd.netTime tm_Sync1_S65.dT tm_Sync1_S65.lastTask tm_Sync1_S65.maxTime tm_Sync1_S65.netTime tm_Sync1_S85.dT tm_Sync1_S85.lastTask tm_Sync1_S85.maxTime tm_Sync1_S85.netTime tm_Sync2_S65.dT tm_Sync2_S65.lastTask tm_Sync2_S65.maxTime tm_Sync2_S65.netTime tm_Sync2_S85.dT tm_Sync2_S85.lastTask tm_Sync2_S85.maxTime tm_Sync2_S85.netTime /end OUT_MEASUREMENT
/end FUNCTION
/begin FUNCTION EWS "" /begin DEF_CHARACTERISTIC K_EWS_FETRAWE_WEG /end DEF_CHARACTERISTIC /begin OUT_MEASUREMENT ews_st ews_stw_st /end OUT_MEASUREMENT /end FUNCTION
/begin FUNCTION Fahrzeuggeschwindigkeit ""
 /begin DEF_CHARACTERISTIC K_V_MAX_ANH_KM_STAND K_V_MAX_ANH_MAX_CNT K_V_MAX_FF_RESET K_V_MAX_MAX K_V_RAD_TOL_CFG K_V_RAD_TOL_TAU KL_V_MAX_GANG_BEGRENZT KL_V_MAX_GANG_CABRIO KL_V_MAX_GANG_COUPE KL_V_MAX_GANG_LIMOUSINE KL_V_MAX_GANG_TOURING KL_V_MAX_SK /end DEF_CHARACTERISTIC
 /begin OUT_MEASUREMENT v_max_schw_sk v_max_st v_rad_tol_hl v_rad_tol_hr v_rad_tol_vl v_rad_tol_vr v_st /end OUT_MEASUREMENT
/end FUNCTION
/begin FUNCTION Flashservice "" /end FUNCTION
/begin FUNCTION fplau ""
 /begin DEF_CHARACTERISTIC K_FPLAU_AQ_OBD_CNT K_FPLAU_HFM_OBD_CNT K_FPLAU_LAM_OBD_CNT K_FPLAU_OBD_CFG K_FPLAU_OBD_DYN_DELTA_RF K_FPLAU_OBD_DYN_RF_T K_FPLAU_OBD_FR_ADAP_F K_FPLAU_OBD_ML_MAX K_FPLAU_OBD_ML_MIN K_FPLAU_OBD_N_MAX K_FPLAU_OBD_N_MIN K_FPLAU_OBD_T_DELTA K_FPLAU_OBD_T_MAX K_FPLAU_OBD_T_MIN K_FPLAU_OBD_TMOT_MIN KF_FPLAU_OBD_AQ_DELTA_ML_MAX KF_FPLAU_OBD_HFM_DELTA_ML_MAX KF_FPLAU_OBD_LAM_DELTA_ML_MAX /end DEF_CHARACTERISTIC
 /begin OUT_MEASUREMENT fplau_aq_obd_b1.abw fplau_aq_obd_b1.cnt fplau_aq_obd_b1.st fplau_aq_obd_b1.t fplau_aq_obd_b2.abw fplau_aq_obd_b2.cnt fplau_aq_obd_b2.st fplau_aq_obd_b2.t fplau_hfm_obd_b1.abw fplau_hfm_obd_b1.cnt fplau_hfm_obd_b1.st fplau_hfm_obd_b1.t fplau_hfm_obd_b2.abw fplau_hfm_obd_b2.cnt fplau_hfm_obd_b2.st fplau_hfm_obd_b2.t fplau_lam_obd_b1.abw fplau_lam_obd_b1.cnt fplau_lam_obd_b1.st fplau_lam_obd_b1.t fplau_lam_obd_b2.abw fplau_lam_obd_b2.cnt fplau_lam_obd_b2.st fplau_lam_obd_b2.t fplau_ml_obd_mw2_b1 fplau_ml_obd_mw2_b2 fplau_ml_obd_mw3_b1 fplau_ml_obd_mw3_b2 fplau_obd_t_delta_b1 fplau_obd_t_delta_b2 fplau_st_b1 fplau_st_b2 fplau_st_diagk_b1 fplau_st_diagk_b2 fplau_st_egas_dk_b1 fplau_st_egas_dk_b2 fplau_st_egas_wdk_b1 fplau_st_egas_wdk_b2 fplau_st_hfm_b1 fplau_st_hfm_b2 fplau_st_kh_b1 fplau_st_kh_b2 fplau_st_lam_b1 fplau_st_lam_b2 fplau_st_lls_b1 fplau_st_lls_b2 fplau_st_n_max_b1 fplau_st_n_max_b2 fplau_st_n_min_b1 fplau_st_n_min_b2 fplau_st_ndyn_b1 fplau_st_ndyn_b2 fplau_st_obd_mw_max_b1 fplau_st_obd_mw_max_b2 fplau_st_obd_mw_min_b1 fplau_st_obd_mw_min_b2 fplau_st_pumg_b1 fplau_st_pumg_b2 fplau_st_rfdyn_b1 fplau_st_rfdyn_b2 fplau_st_sa_b1 fplau_st_sa_b2 fplau_st_slp_b1 fplau_st_slp_b2 fplau_st_tan_b1 fplau_st_tan_b2 fplau_st_time_ml_b1 fplau_st_time_ml_b2 fplau_st_tmot_b1 fplau_st_tmot_b2 fplau_st_van_begr_b1 fplau_st_van_begr_b2 fplau_st_vanos_b1 fplau_st_vanos_b2 fplau_st_wdk_adapt_b1 fplau_st_wdk_adapt_b2 fplau_st_zyl_off_b1 fplau_st_zyl_off_b2 /end OUT_MEASUREMENT
/end FUNCTION
/begin FUNCTION Generator-Module ""
 /begin DEF_CHARACTERISTIC CW_BNS_LR CW_BNSUMAX CW_GENOFFSLP K_APP_LLAH K_APP_UGEN K_APPLROFF K_APPUPLLDST K_BGAPP K_DF_DEAKAPP K_DFMODE K_DFS_MAX K_DFS_MIN K_DFS_MITT K_DMDGEN_SCHMN K_DMDGEN_SCHMX K_DSOCMIN K_EN_MDGEN K_ENAPPLGOFF K_ENAPPLRESP K_ENGENTANS K_ENGENTOGGL K_FHOGNMN K_GEN_APPUG K_GEN_DNMIN K_GEN_IGOF K_GENDIFAK1 K_GENDIFAK2 K_GENDIFAK3 K_GENDIFAK4 K_GENITYP K_GENLDDFMAX K_GENLLAHAPP K_GENMDNMOF K_GENOFFTIME K_GENPDTIME K_GENRS0_1 K_GENRS0_2 K_GENRS0_3 K_GENRS0_4 K_GENSTFAK1 K_GENSTFAK2 K_GENSTFAK3 K_GENSTFAK4 K_GENTEMPAPP K_GENTEMPMAN K_GENTMOTDT K_GENTMOTOF1 K_GENTMOTOF2 K_GENTMOTOF3 K_GENTMOTOF4 K_GENTYP K_GENTYPFELD K_GENUEBSETZ1 K_GENUEBSETZ2 K_GENUEBSETZ3 K_GENUEBSETZ4 K_GENUMAX K_GENUMGTYP K_GENURAMP K_GENURAMPOF K_GENVFZGSW K_IERRFIL K_IGBASIS K_IGBASISOFF K_IGNOTWERT K_LRBNS K_LRESPAPP K_MANAWNUMM K_MDGNHYS K_MDGNMAX K_MGMAXAPP K_MSKGENDFP K_MSKGENKL61 K_NGENOFMN K_NGENOFMX K_NKW_SCH K_NMXGENOF K_NSUBO K_NSUBU K_PMSA_DEC K_PMSA_INC K_PMSA_RST K_PMSA_SET K_PRELLGTMOT K_RLMXGENOF K_SNMBSDKL61 K_T_IGRNACHL K_T_VERBON K_TABSTGNMN K_TABSTGNMX K_TATMGENOF K_TDGENOFFST K_TDMDGEN_VERZAUS K_TDMDGEN_VERZEIN K_TGENOFMN K_TGENOFMX K_TGENOFVL K_TIGMISCH K_TLORESPST K_TMOTABGNMN K_TNNSTART K_TSTCNTEN K_TSTFIL_IN K_TSTFIL_INI K_TUMGGNMN K_TUMGGNMX K_TVLOFHYST K_U_BNMAX K_U_IGRRAMP K_UBNS K_UDIODERMS1 K_UDIODERMS2 K_UDIODERMS3 K_UDIODERMS4 K_UGENDELTA K_UGENMAXE65 K_UGENOFF K_UGENOFFSTART K_UGENOFFV0 K_VGENOFMN K_VGENOGMX K_VZLORESOFV K_ZMGENIG K_ZMGENS0HZ1 K_ZMGENS0HZ2 K_ZMGENS0HZ3 K_ZMGENS0HZ4 K_ZMGENS0KL1 K_ZMGENS0KL2 K_ZMGENS0KL3 K_ZMGENS0KL4 K_ZMGENSTHZ1 K_ZMGENSTHZ2 K_ZMGENSTHZ3 K_ZMGENSTHZ4 K_ZMGENSTKL1 K_ZMGENSTKL2 K_ZMGENSTKL3 K_ZMGENSTKL4 K_ZMGENTWA K_ZMGN0TANS1 K_ZMGN0TANS2 K_ZMGN0TANS3 K_ZMGN0TANS4 K_ZMGNTANS1 K_ZMGNTANS2 K_ZMGNTANS3 K_ZMGNTANS4 K_ZMIGMISCH K_ZMTESTFIL KF_GENWETA1 KF_GENWETA2 KF_GENWETA3 KF_GENWETA4 KF_IGENDF1 KF_IGENDF2 KF_IGENDF3 KF_IGENDF4 KF_IGENKA1 KF_IGENKA2 KF_IGENKA3 KF_IGENKA4 KF_IGENWA1 KF_IGENWA2 KF_IGENWA3 KF_IGENWA4 KF_LORESP KF_LRMAXG KF_MDGENFIL KF_ZLRESOF KF_ZLRRESOFV KL_FPDIODE1 KL_FPDIODE2 KL_FPDIODE3 KL_FPDIODE4 KL_GENEXP1 KL_GENEXP2 KL_GENEXP3 KL_GENEXP4 KL_GENLDST KL_GENTETA1 KL_GENTETA2 KL_GENTETA3 KL_GENTETA4 KL_LORESPM KL_RTH0FAK1 KL_RTH0FAK2 KL_RTH0FAK3 KL_RTH0FAK4 KL_RTHFAK1 KL_RTHFAK2 KL_RTHFAK3 KL_RTHFAK4 KL_RTHGEN1 KL_RTHGEN2 KL_RTHGEN3 KL_RTHGEN4 KL_TANSGEN1 KL_TANSGEN2 KL_TANSGEN3 KL_TANSGEN4 S_ENTLENA S_GENOFFSTART S_GOFFRAMP S_IGMISCH S_IGRLOW S_LORESLL S_MGAPP S_RDGENTYP S_SAPP S_TLACTIV /end DEF_CHARACTERISTIC
 /begin OUT_MEASUREMENT Dffgen Dfmonitor Dfpropval Dfsumme Dfwanzahl Fdib_ig Gen_awnumm Gen_dts Gen_fbsak Gen_feta Gen_i_kaltun Gen_nummer Gen_rs Gen_spv Gen_statroh Gen_sttemp Gen_tans Gen_tansend Gen_teta Gen_weta I_basis I_gen I_gen_end I_gen_g I_gen_nafil I_gen_vorfil I_genmax I_gm I_gvor Ierr_fil Ierrgrenz Loadresp Md_genfil Md_gennm Md_gennmufi Md_genrel Md_genvf Md_grenz N_gen N_nstart Nkw_s Nslb P_gen_ab Pmigrlowctr St_dgen0 St_dgen0.B_1stbsder St_dgen0.B_genfprl St_dgen0.B_gfbsupak St_dgen0.B_gfelak St_dgen0.B_gfhtak St_dgen0.B_gfmeak St_dgen0.B_gfnobsak St_dgen0.B_kl61 St_dmdblock St_dmdblock.B_dmd_frei St_dmdblock.B_timmax St_dmdblock.B_timmin St_gen St_genbsd St_gengen St_imdgen_nv0 St_imdgen_nv0.B_genfkupl St_imdgen_nv0.B_heizen St_imdgen0 St_imdgen0.B_firstemp St_imdgen0.B_gene St_imdgen0.B_generken St_ldstgen St_llranh0 St_llranh0.B_idl_tp St_llranh0.B_idlgspec St_llranh0.B_nsub St_loadresp St_loadresp.B_lroff St_loadresp.B_lroff2 St_loadresp_nv0 St_loadresp_nv0.B_genoffvl St_loadresp0 St_loadresp0.B_fub St_loadresp0.B_genoffmd St_loadresp0.B_genoffst St_loadresp10ms St_loadresp10ms.B_mdgrenz St_ugenkor0 St_ugenkor0.B_1stugen St_ugenkor0.B_genoff St_ugenkor0.B_genoff2 St_ugenkor0.B_genoffok St_ugenkor0.B_genoffout St_ugenkor0.B_noctrgen St_ugenkor0.B_ugenini St_ugenkor0.B_verb_off St_ugenkor1 St_ugenkor1.B_gentoggl St_ugenkor2 St_ugenkor2.B_saaktiv St_ugenkor2.B_saset T_batt Tgen Tgen_ab Tgen_dt Tgen_end Tgen_exp Tgen_fil Tlrgen Tlrgen2 Tst_countv Tst_fil_out U_gen U_gen_igr U_gen2 U_gsoll U_gsoll_off U_gsoll_tp U_gsoll_tp2 U_gsoll_tp3 U_gsollred U_gsolltmp Z_dmdblock /end OUT_MEASUREMENT
/end FUNCTION
/begin FUNCTION Getriebetemperatur ""
 /begin DEF_CHARACTERISTIC K_TGETR_CC_HIGH K_TGETR_CC_HYST K_TGETR_DIAG_MAX K_TGETR_DIAG_MIN K_TGETR_DIAG_TUMG_MIN K_TGETR_TAU KL_TGETR_NTC /end DEF_CHARACTERISTIC
 /begin OUT_MEASUREMENT tgetr_ad tgetr_filter tgetr_ipol tgetr_sta /end OUT_MEASUREMENT
/end FUNCTION
/begin RECORD_LAYOUT TKF_SW_SW_SW FNC_VALUES 5 SWORD COLUMN_DIR DIRECT AXIS_PTS_X 3 SWORD INDEX_INCR DIRECT AXIS_PTS_Y 4 SWORD INDEX_INCR DIRECT NO_AXIS_PTS_X 1 UBYTE NO_AXIS_PTS_Y 2 UBYTE /end RECORD_LAYOUT
/begin RECORD_LAYOUT TKF_SW_SW_UB FNC_VALUES 5 UBYTE COLUMN_DIR DIRECT AXIS_PTS_X 3 SWORD INDEX_INCR DIRECT AXIS_PTS_Y 4 SWORD INDEX_INCR DIRECT NO_AXIS_PTS_X 1 UBYTE NO_AXIS_PTS_Y 2 UBYTE /end RECORD_LAYOUT
/begin RECORD_LAYOUT TKF_SW_SW_UW FNC_VALUES 5 UWORD COLUMN_DIR DIRECT AXIS_PTS_X 3 SWORD INDEX_INCR DIRECT AXIS_PTS_Y 4 SWORD INDEX_INCR DIRECT NO_AXIS_PTS_X 1 UBYTE NO_AXIS_PTS_Y 2 UBYTE /end RECORD_LAYOUT
/begin RECORD_LAYOUT TKF_SW_UB_UB FNC_VALUES 5 UBYTE COLUMN_DIR DIRECT AXIS_PTS_X 3 UBYTE INDEX_INCR DIRECT AXIS_PTS_Y 4 SWORD INDEX_INCR DIRECT NO_AXIS_PTS_X 1 UBYTE NO_AXIS_PTS_Y 2 UBYTE /end RECORD_LAYOUT
/begin RECORD_LAYOUT TKF_SW_UW_UB FNC_VALUES 5 UBYTE COLUMN_DIR DIRECT AXIS_PTS_X 3 UWORD INDEX_INCR DIRECT AXIS_PTS_Y 4 SWORD INDEX_INCR DIRECT NO_AXIS_PTS_X 1 UBYTE NO_AXIS_PTS_Y 2 UBYTE /end RECORD_LAYOUT
/begin RECORD_LAYOUT TKF_UB_UB_UB FNC_VALUES 5 UBYTE COLUMN_DIR DIRECT AXIS_PTS_X 3 UBYTE INDEX_INCR DIRECT AXIS_PTS_Y 4 UBYTE INDEX_INCR DIRECT NO_AXIS_PTS_X 1 UBYTE NO_AXIS_PTS_Y 2 UBYTE /end RECORD_LAYOUT
/begin RECORD_LAYOUT TKF_UW_SW_UB FNC_VALUES 5 UBYTE COLUMN_DIR DIRECT AXIS_PTS_X 3 SWORD INDEX_INCR DIRECT AXIS_PTS_Y 4 UWORD INDEX_INCR DIRECT NO_AXIS_PTS_X 1 UBYTE NO_AXIS_PTS_Y 2 UBYTE /end RECORD_LAYOUT
/begin RECORD_LAYOUT TKL_SW_VV_SW FNC_VALUES 4 SWORD COLUMN_DIR DIRECT AXIS_PTS_X 3 SWORD INDEX_INCR DIRECT NO_AXIS_PTS_X 1 UBYTE RESERVED 2 BYTE /end RECORD_LAYOUT
/begin RECORD_LAYOUT TKL_SW_VV_UB FNC_VALUES 4 UBYTE COLUMN_DIR DIRECT AXIS_PTS_X 3 SWORD INDEX_INCR DIRECT NO_AXIS_PTS_X 1 UBYTE RESERVED 2 BYTE /end RECORD_LAYOUT
/begin RECORD_LAYOUT TKL_SW_VV_UW FNC_VALUES 4 UWORD COLUMN_DIR DIRECT AXIS_PTS_X 3 SWORD INDEX_INCR DIRECT NO_AXIS_PTS_X 1 UBYTE RESERVED 2 BYTE /end RECORD_LAYOUT
/begin RECORD_LAYOUT TKL_UB_VV_SW FNC_VALUES 4 SWORD COLUMN_DIR DIRECT AXIS_PTS_X 3 UBYTE INDEX_INCR DIRECT NO_AXIS_PTS_X 1 UBYTE RESERVED 2 BYTE /end RECORD_LAYOUT
/begin RECORD_LAYOUT TKL_UB_VV_UB FNC_VALUES 4 UBYTE COLUMN_DIR DIRECT AXIS_PTS_X 3 UBYTE INDEX_INCR DIRECT NO_AXIS_PTS_X 1 UBYTE RESERVED 2 BYTE /end RECORD_LAYOUT
/begin RECORD_LAYOUT TKL_UW_VV_SW FNC_VALUES 4 SWORD COLUMN_DIR DIRECT AXIS_PTS_X 3 UWORD INDEX_INCR DIRECT NO_AXIS_PTS_X 1 UBYTE RESERVED 2 BYTE /end RECORD_LAYOUT
/begin RECORD_LAYOUT TKL_UW_VV_UB FNC_VALUES 4 UBYTE COLUMN_DIR DIRECT AXIS_PTS_X 3 UWORD INDEX_INCR DIRECT NO_AXIS_PTS_X 1 UBYTE RESERVED 2 BYTE /end RECORD_LAYOUT
/begin RECORD_LAYOUT TKW_VV_VV_SW FNC_VALUES 1 SWORD COLUMN_DIR DIRECT /end RECORD_LAYOUT
/begin RECORD_LAYOUT TKW_VV_VV_UB FNC_VALUES 1 UBYTE COLUMN_DIR DIRECT /end RECORD_LAYOUT
/begin RECORD_LAYOUT TKW_VV_VV_UW FNC_VALUES 1 UWORD COLUMN_DIR DIRECT /end RECORD_LAYOUT
/end MODULE
/end PROJECT
