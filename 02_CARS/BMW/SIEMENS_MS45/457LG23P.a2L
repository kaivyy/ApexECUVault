ASAP2_VERSION 1 31
/begin PROJECT MS45 "BMW Motorsteuerung R6"
/begin HEADER "_default_HeaderComment" PROJECT_NO _57 /end HEADER
/begin MODULE _default_ModuleName "_default_ModuleLongIdentifier"
/begin MOD_COMMON "_default_ModCommonComment" DEPOSIT ABSOLUTE BYTE_ORDER MSB_FIRST ALIGNMENT_BYTE 1 ALIGNMENT_WORD 2 ALIGNMENT_LONG 4 ALIGNMENT_FLOAT32_IEEE 4 ALIGNMENT_FLOAT64_IEEE 8 /end MOD_COMMON
/begin MEASUREMENT lv_byp_on "" UBYTE _CNV_S_2_RANGE______21_CM 1 100. 0. 1. DISPLAY_IDENTIFIER LV_BYP_ON ECU_ADDRESS 0x3fa489 /end MEASUREMENT
/begin CHARACTERISTIC c_byp_lih_cnt_max_A "" VALUE 0xffe40631 _REC_VAL_20_u1 255. _CNV_A_R_LINEAR_____0_CM 0. 255. DISPLAY_IDENTIFIER C_BYP_LIH_CNT_MAX_A FORMAT "%3.0" /end CHARACTERISTIC
/begin CHARACTERISTIC c_byp_lih_cnt_max_B "" VALUE 0xffe40632 _REC_VAL_20_u1 255. _CNV_A_R_LINEAR_____0_CM 0. 255. DISPLAY_IDENTIFIER C_BYP_LIH_CNT_MAX_B FORMAT "%3.0" /end CHARACTERISTIC
/begin CHARACTERISTIC c_byp_on "" VALUE 0xffe40633 _REC_VAL_20_u1 255. _CNV_A_R_LINEAR_____0_CM 0. 255. DISPLAY_IDENTIFIER C_BYP_ON FORMAT "%3.0" /end CHARACTERISTIC
/begin MEASUREMENT byp_cnt_A "" UBYTE _CNV_A_R_LINEAR_____0_CM 1 100. 0. 255. DISPLAY_IDENTIFIER BYP_CNT_A ECU_ADDRESS 0x3fa486 FORMAT "%3.0" /end MEASUREMENT
/begin MEASUREMENT byp_cnt_B "" UBYTE _CNV_A_R_LINEAR_____0_CM 1 100. 0. 255. DISPLAY_IDENTIFIER BYP_CNT_B ECU_ADDRESS 0x3fa487 FORMAT "%3.0" /end MEASUREMENT
/begin MEASUREMENT byp_error "" UBYTE _CNV_A_R_LINEAR_____0_CM 1 100. 0. 255. DISPLAY_IDENTIFIER BYP_ERROR ECU_ADDRESS 0x3fa488 FORMAT "%3.0" /end MEASUREMENT
/begin CHARACTERISTIC c_byp_func_A "" VALUE 0xffe41508 _REC_VAL_20_u2 65535. _CNV_A_R_LINEAR_____0_CM 0. 65535. DISPLAY_IDENTIFIER C_BYP_FUNC_A FORMAT "%5.0" /end CHARACTERISTIC
/begin CHARACTERISTIC c_byp_func_B "" VALUE 0xffe414a8 _REC_VAL_20_u4 4294967295. _CNV_A_R_LINEAR_____0_CM 0. 4294967295. DISPLAY_IDENTIFIER C_BYP_FUNC_B FORMAT "%10.0" /end CHARACTERISTIC
/begin CHARACTERISTIC c_t_err_vs_can "minimum threshold time for error of vehicle speed from CAN" VALUE 0xffe40899 _REC_VAL_20_u1 25.5 _CNV_A_R_LINEAR_____24_CM 0. 25.5 DISPLAY_IDENTIFIER C_T_ERR_VS_CAN FORMAT "%4.1" /end CHARACTERISTIC
/begin MEASUREMENT ac_cru "Vehicle acceleration in CRU" SWORD _CNV_A_R_LINEAR_____139_CM 1 100. -15.719999999972 15.71952 DISPLAY_IDENTIFIER AC_CRU ECU_ADDRESS 0x3fdfb0 BYTE_ORDER MSB_LAST FORMAT "%7.4" /end MEASUREMENT
/begin CHARACTERISTIC c_fac_vs_fil "Filter factor" VALUE 0xffe40753 _REC_VAL_20_u1 255. _CNV_A_R_LINEAR_____0_CM 0. 255. DISPLAY_IDENTIFIER C_FAC_VS_FIL FORMAT "%3.0" /end CHARACTERISTIC
/begin CHARACTERISTIC c_vs_max_diag "Max. allowed deviation between VS_FIL and VS" VALUE 0xffe409d7 _REC_VAL_20_u1 255. _CNV_A_R_LINEAR_____23_CM 0. 255. DISPLAY_IDENTIFIER C_VS_MAX_DIAG FORMAT "%3.0" /end CHARACTERISTIC
/begin MEASUREMENT lv_vs_diag_not_plaus "VS_FIL not plausible" UBYTE _CNV_S_2_RANGE______21_CM 1 100. 0. 1. DISPLAY_IDENTIFIER LV_VS_DIAG_NOT_PLAUS ECU_ADDRESS 0x3fec8d /end MEASUREMENT
/begin CHARACTERISTIC c_fac_tq_req_driv_mmv "Filtering of driver demand" VALUE 0xffe41644 _REC_VAL_20_u2 0.99998474 _CNV_A_R_LINEAR_____37_CM 0. 0.99998474 DISPLAY_IDENTIFIER C_FAC_TQ_REQ_DRIV_MMV FORMAT "%7.5" /end CHARACTERISTIC
/begin MEASUREMENT fac_tq_req_driv_mmv "MMV of driver torque demand" UWORD _CNV_A_R_LINEAR_____20_CM 1 100. 0. 1.99996948 DISPLAY_IDENTIFIER FAC_TQ_REQ_DRIV_MMV ECU_ADDRESS 0x3fdfb6 BYTE_ORDER MSB_LAST FORMAT "%7.5" /end MEASUREMENT
/begin MEASUREMENT n_vs_cru "Ratio between engine speed and vehicle speed" UWORD _CNV_A_R_LINEAR_____140_CM 1 100. 0. 16320. DISPLAY_IDENTIFIER N_VS_CRU ECU_ADDRESS 0x3fdfb2 BYTE_ORDER MSB_LAST FORMAT "%5.0" /end MEASUREMENT
/begin CHARACTERISTIC c_fac_ac_cru_mmv "Filtering AC_CRU" VALUE 0xffe415e8 _REC_VAL_20_u2 0.99998474 _CNV_A_R_LINEAR_____37_CM 0. 0.99998474 DISPLAY_IDENTIFIER C_FAC_AC_CRU_MMV FORMAT "%7.5" /end CHARACTERISTIC
/begin CHARACTERISTIC lc_vs_cru_fil "Filter factor activation" VALUE 0xffe4100a _REC_VAL_20_u1 1. _CNV_A_R_LINEAR_____22_CM 0. 1. DISPLAY_IDENTIFIER LC_VS_CRU_FIL FORMAT "%1.0" /end CHARACTERISTIC
/begin CHARACTERISTIC c_crlc_vs_cru_mmv "Filter factor" VALUE 0xffe41582 _REC_VAL_20_u2 0.99998474 _CNV_A_R_LINEAR_____141_CM 0. 0.99998474 DISPLAY_IDENTIFIER C_CRLC_VS_CRU_MMV FORMAT "%7.5" /end CHARACTERISTIC
/begin MEASUREMENT vs_fil "Filtered vehicle speed" UWORD _CNV_A_R_LINEAR_____85_CM 1 100. 0. 511.99218 DISPLAY_IDENTIFIER VS_FIL ECU_ADDRESS 0x3fdfaa BYTE_ORDER MSB_LAST FORMAT "%7.3" /end MEASUREMENT
/begin MEASUREMENT t_err_vs_can "Time to freeze VS_FIL before VS_FIL = 0" UWORD _CNV_A_R_LINEAR_____142_CM 1 100. 0. 65535. DISPLAY_IDENTIFIER T_ERR_VS_CAN ECU_ADDRESS 0x3fdfac BYTE_ORDER MSB_LAST FORMAT "%5.0" /end MEASUREMENT
/begin MEASUREMENT vs_cru "Filtered vehicle speed" UWORD _CNV_A_R_LINEAR_____85_CM 1 100. 0. 511.99218 DISPLAY_IDENTIFIER VS_CRU ECU_ADDRESS 0x3fdfae BYTE_ORDER MSB_LAST FORMAT "%7.3" /end MEASUREMENT
/begin MEASUREMENT vs_dif_icl_tcs "Difference of vehicle speed INSTR and TCS" SWORD _CNV_A_R_LINEAR_____143_CM 1 100. -256. 255.9921875 DISPLAY_IDENTIFIER VS_DIF_ICL_TCS ECU_ADDRESS 0x3fdfc0 BYTE_ORDER MSB_LAST FORMAT "%7.3" /end MEASUREMENT
/begin MEASUREMENT t_dly_cru "Time counter overtaking" UWORD _CNV_A_R_LINEAR_____4_CM 1 100. 0. 655.35 DISPLAY_IDENTIFIER T_DLY_CRU ECU_ADDRESS 0x3fdfc6 BYTE_ORDER MSB_LAST FORMAT "%5.2" /end MEASUREMENT
/begin MEASUREMENT lv_cru_over_act "Overtaking function active" UBYTE _CNV_S_2_RANGE______21_CM 1 100. 0. 1. DISPLAY_IDENTIFIER LV_CRU_OVER_ACT ECU_ADDRESS 0x3fec96 /end MEASUREMENT
/begin CHARACTERISTIC c_t_dly_max_cru "Delay threshold for start of the restart function" VALUE 0xffe41922 _REC_VAL_20_u2 655.35 _CNV_A_R_LINEAR_____4_CM 0. 655.35 DISPLAY_IDENTIFIER C_T_DLY_MAX_CRU FORMAT "%6.2" /end CHARACTERISTIC
/begin CHARACTERISTIC c_vs_sp_dif_min_cru "Min. deviation between target and actual speed" VALUE 0xffe4051c _REC_VAL_20_s2 511.9921875 _CNV_A_R_LINEAR_____143_CM -256. 255.9921875 DISPLAY_IDENTIFIER C_VS_SP_DIF_MIN_CRU FORMAT "%7.3" /end CHARACTERISTIC
/begin CHARACTERISTIC c_vs_sp_dif_max_cru "Max. deviation between target and actual speed" VALUE 0xffe4051a _REC_VAL_20_s2 511.9921875 _CNV_A_R_LINEAR_____143_CM -256. 255.9921875 DISPLAY_IDENTIFIER C_VS_SP_DIF_MAX_CRU FORMAT "%7.3" /end CHARACTERISTIC
/begin CHARACTERISTIC c_vs_dif_dly_cru_neg "Max. difference from VS_SP_DRIV_CRU and C_VS_DIF_DLY_CRU" VALUE 0xffe41ba0 _REC_VAL_20_u2 255.9921875 _CNV_A_R_LINEAR_____143_CM 0. 255.9921875 DISPLAY_IDENTIFIER C_VS_DIF_DLY_CRU_NEG FORMAT "%7.3" /end CHARACTERISTIC
/begin CHARACTERISTIC c_fac_tq_req_hys_cru "FAC_TQ_REQ hysteresis for start of the restart function" VALUE 0xffe41648 _REC_VAL_20_u2 1.99996948 _CNV_A_R_LINEAR_____20_CM 0. 1.99996948 DISPLAY_IDENTIFIER C_FAC_TQ_REQ_HYS_CRU FORMAT "%7.5" /end CHARACTERISTIC
/begin CHARACTERISTIC c_vs_dif_dly_cru_pos "Maximum difference from VS_SP_DRIV_CRU and C_VS_DIF_DLY_CRU" VALUE 0xffe4050e _REC_VAL_20_s2 255.9922 _CNV_A_R_LINEAR_____147_CM -255.9922 0. DISPLAY_IDENTIFIER C_VS_DIF_DLY_CRU_POS FORMAT "%7.3" /end CHARACTERISTIC
/begin CHARACTERISTIC c_vs_dif_min_cru_over "Vs_dif_cru min value vor finished overtaking function" VALUE 0xffe40516 _REC_VAL_20_s2 511.9921875 _CNV_A_R_LINEAR_____143_CM -256. 255.9921875 DISPLAY_IDENTIFIER C_VS_DIF_MIN_CRU_OVER FORMAT "%7.3" /end CHARACTERISTIC
/begin MEASUREMENT nr_step_on "Current vehicle speed step" UBYTE _CNV_A_R_LINEAR_____0_CM 1 100. 0. 255. DISPLAY_IDENTIFIER NR_STEP_ON ECU_ADDRESS 0x3feca7 FORMAT "%3.0" /end MEASUREMENT
/begin MEASUREMENT count_vs_step "Number of used vehicle speed steps" UBYTE _CNV_A_R_LINEAR_____0_CM 1 100. 0. 255. DISPLAY_IDENTIFIER COUNT_VS_STEP ECU_ADDRESS 0x3feca8 FORMAT "%3.0" /end MEASUREMENT
/begin MEASUREMENT vs_dif_step_prog "Differences between steps" UWORD _CNV_A_R_LINEAR_____68_CM 1 100. 0. 409.4 DISPLAY_IDENTIFIER VS_DIF_STEP_PROG ECU_ADDRESS 0x3fe00c BYTE_ORDER MSB_LAST FORMAT "%5.1" /end MEASUREMENT
/begin MEASUREMENT lv_prog_step_1 "Standing programming on" UBYTE _CNV_S_2_RANGE______2_CM 1 100. 0. 1. DISPLAY_IDENTIFIER LV_PROG_STEP_1 ECU_ADDRESS 0x3feca5 /end MEASUREMENT
/begin MEASUREMENT lv_step_on "Step display on" UBYTE _CNV_S_2_RANGE______2_CM 1 100. 0. 1. DISPLAY_IDENTIFIER LV_STEP_ON ECU_ADDRESS 0x3feca4 /end MEASUREMENT
/begin MEASUREMENT vs_sp_driv_step "Active vehicle speed step for the controller" UWORD _CNV_A_R_LINEAR_____85_CM 1 100. 0. 511.99218 DISPLAY_IDENTIFIER VS_SP_DRIV_STEP ECU_ADDRESS 0x3fe004 BYTE_ORDER MSB_LAST FORMAT "%7.3" /end MEASUREMENT
/begin MEASUREMENT nr_vs_cru "Cycle number of message IDX_NO" UBYTE _CNV_A_R_LINEAR_____0_CM 1 100. 0. 255. DISPLAY_IDENTIFIER NR_VS_CRU ECU_ADDRESS 0x3feca3 FORMAT "%3.0" /end MEASUREMENT
/begin MEASUREMENT vs_sp_driv_cru_can "Driver demand cruise control for INSTR" UWORD _CNV_A_R_LINEAR_____68_CM 1 100. 0. 409.4 DISPLAY_IDENTIFIER VS_SP_DRIV_CRU_CAN ECU_ADDRESS 0x3fe002 BYTE_ORDER MSB_LAST FORMAT "%5.1" /end MEASUREMENT
/begin MEASUREMENT vs_step_can_1 "Vehicle speed step to the CAN Nr.1" UWORD _CNV_A_R_LINEAR_____68_CM 1 100. 0. 409.4 DISPLAY_IDENTIFIER VS_STEP_CAN_1 ECU_ADDRESS 0x3fe006 BYTE_ORDER MSB_LAST FORMAT "%5.1" /end MEASUREMENT
/begin MEASUREMENT vs_step_can_2 "Vehicle speed step to the CAN Nr.2" UWORD _CNV_A_R_LINEAR_____68_CM 1 100. 0. 409.4 DISPLAY_IDENTIFIER VS_STEP_CAN_2 ECU_ADDRESS 0x3fe008 BYTE_ORDER MSB_LAST FORMAT "%5.1" /end MEASUREMENT
/begin MEASUREMENT vs_step_can_3 "Vehicle speed step to the CAN Nr.3" UWORD _CNV_A_R_LINEAR_____68_CM 1 100. 0. 409.4 DISPLAY_IDENTIFIER VS_STEP_CAN_3 ECU_ADDRESS 0x3fe00a BYTE_ORDER MSB_LAST FORMAT "%5.1" /end MEASUREMENT
/begin CHARACTERISTIC c_vs_dif_step_prog_m "M.p.h step calibration" VALUE 0xffe41ba8 _REC_VAL_20_u2 409.4 _CNV_A_R_LINEAR_____68_CM 0. 409.4 DISPLAY_IDENTIFIER C_VS_DIF_STEP_PROG_M FORMAT "%5.1" /end CHARACTERISTIC
/begin CHARACTERISTIC c_vs_dif_step_prog_k "Km.p.h step calibration" VALUE 0xffe41ba6 _REC_VAL_20_u2 409.4 _CNV_A_R_LINEAR_____68_CM 0. 409.4 DISPLAY_IDENTIFIER C_VS_DIF_STEP_PROG_K FORMAT "%5.1" /end CHARACTERISTIC
/begin CHARACTERISTIC c_vs_dif_step_min "Minimum between steps" VALUE 0xffe41ba4 _REC_VAL_20_u2 409.4 _CNV_A_R_LINEAR_____68_CM 0. 409.4 DISPLAY_IDENTIFIER C_VS_DIF_STEP_MIN FORMAT "%5.1" /end CHARACTERISTIC
/begin CHARACTERISTIC c_vs_dif_tip_prog "Difference between tip steps" VALUE 0xffe41baa _REC_VAL_20_u2 409.4 _CNV_A_R_LINEAR_____68_CM 0. 409.4 DISPLAY_IDENTIFIER C_VS_DIF_TIP_PROG FORMAT "%5.1" /end CHARACTERISTIC
/begin CHARACTERISTIC c_vs_min_prog "VS_CRU threshold stand programming detection" VALUE 0xffe41bb6 _REC_VAL_20_u2 511.99218 _CNV_A_R_LINEAR_____85_CM 0. 511.99218 DISPLAY_IDENTIFIER C_VS_MIN_PROG FORMAT "%7.3" /end CHARACTERISTIC
/begin CHARACTERISTIC c_max_step "Maximum number of steps" VALUE 0xffe4079c _REC_VAL_20_u1 255. _CNV_A_R_LINEAR_____0_CM 0. 255. DISPLAY_IDENTIFIER C_MAX_STEP FORMAT "%3.0" /end CHARACTERISTIC
/begin CHARACTERISTIC c_t_cru_flash_light "Flash light duration time" VALUE 0xffe40862 _REC_VAL_20_u1 2.55 _CNV_A_R_LINEAR_____4_CM 0. 2.55 DISPLAY_IDENTIFIER C_T_CRU_FLASH_LIGHT FORMAT "%4.2" /end CHARACTERISTIC
/begin CHARACTERISTIC c_t_dly_cru_tip "Time delay for display vehicle speed pointer" VALUE 0xffe40877 _REC_VAL_20_u1 2.55 _CNV_A_R_LINEAR_____4_CM 0. 2.55 DISPLAY_IDENTIFIER C_T_DLY_CRU_TIP FORMAT "%4.2" /end CHARACTERISTIC
/begin CHARACTERISTIC c_t_min_prog "Time for programming detection" VALUE 0xffe408b6 _REC_VAL_20_u1 2.55 _CNV_A_R_LINEAR_____4_CM 0. 2.55 DISPLAY_IDENTIFIER C_T_MIN_PROG FORMAT "%4.2" /end CHARACTERISTIC
/begin MEASUREMENT vls_cyl[0] "upstream oxygen sensor acquisition (cylinder individual)" UWORD _CNV_A_R_LINEAR_____3_CM 1 100. 0. 4.99511719 DISPLAY_IDENTIFIER VLS_CYL_0 ECU_ADDRESS 0x3fd498 BYTE_ORDER MSB_LAST FORMAT "%5.3" /end MEASUREMENT
/begin MEASUREMENT vls_cyl[1] "upstream oxygen sensor acquisition (cylinder individual)" UWORD _CNV_A_R_LINEAR_____3_CM 1 100. 0. 4.99511719 DISPLAY_IDENTIFIER VLS_CYL_1 ECU_ADDRESS 0x3fd49a BYTE_ORDER MSB_LAST FORMAT "%5.3" /end MEASUREMENT
/begin MEASUREMENT vls_cyl[2] "upstream oxygen sensor acquisition (cylinder individual)" UWORD _CNV_A_R_LINEAR_____3_CM 1 100. 0. 4.99511719 DISPLAY_IDENTIFIER VLS_CYL_2 ECU_ADDRESS 0x3fd49c BYTE_ORDER MSB_LAST FORMAT "%5.3" /end MEASUREMENT
/begin MEASUREMENT vls_cyl[3] "upstream oxygen sensor acquisition (cylinder individual)" UWORD _CNV_A_R_LINEAR_____3_CM 1 100. 0. 4.99511719 DISPLAY_IDENTIFIER VLS_CYL_3 ECU_ADDRESS 0x3fd49e BYTE_ORDER MSB_LAST FORMAT "%5.3" /end MEASUREMENT
/begin MEASUREMENT vls_cyl[4] "upstream oxygen sensor acquisition (cylinder individual)" UWORD _CNV_A_R_LINEAR_____3_CM 1 100. 0. 4.99511719 DISPLAY_IDENTIFIER VLS_CYL_4 ECU_ADDRESS 0x3fd4a0 BYTE_ORDER MSB_LAST FORMAT "%5.3" /end MEASUREMENT
/begin MEASUREMENT vls_cyl[5] "upstream oxygen sensor acquisition (cylinder individual)" UWORD _CNV_A_R_LINEAR_____3_CM 1 100. 0. 4.99511719 DISPLAY_IDENTIFIER VLS_CYL_5 ECU_ADDRESS 0x3fd4a2 BYTE_ORDER MSB_LAST FORMAT "%5.3" /end MEASUREMENT
/begin MEASUREMENT vls_cyl_trig[0] "cylinder selective update counter for trigger event" UBYTE _CNV_A_R_LINEAR_____0_CM 1 100. 0. 255. DISPLAY_IDENTIFIER VLS_CYL_TRIG_0 ECU_ADDRESS 0x3fe517 FORMAT "%3.0" /end MEASUREMENT
/begin MEASUREMENT vls_cyl_trig[1] "cylinder selective update counter for trigger event" UBYTE _CNV_A_R_LINEAR_____0_CM 1 100. 0. 255. DISPLAY_IDENTIFIER VLS_CYL_TRIG_1 ECU_ADDRESS 0x3fe518 FORMAT "%3.0" /end MEASUREMENT
/begin MEASUREMENT vls_cyl_trig[2] "cylinder selective update counter for trigger event" UBYTE _CNV_A_R_LINEAR_____0_CM 1 100. 0. 255. DISPLAY_IDENTIFIER VLS_CYL_TRIG_2 ECU_ADDRESS 0x3fe519 FORMAT "%3.0" /end MEASUREMENT
/begin MEASUREMENT vls_cyl_trig[3] "cylinder selective update counter for trigger event" UBYTE _CNV_A_R_LINEAR_____0_CM 1 100. 0. 255. DISPLAY_IDENTIFIER VLS_CYL_TRIG_3 ECU_ADDRESS 0x3fe51a FORMAT "%3.0" /end MEASUREMENT
/begin MEASUREMENT vls_cyl_trig[4] "cylinder selective update counter for trigger event" UBYTE _CNV_A_R_LINEAR_____0_CM 1 100. 0. 255. DISPLAY_IDENTIFIER VLS_CYL_TRIG_4 ECU_ADDRESS 0x3fe51b FORMAT "%3.0" /end MEASUREMENT
/begin MEASUREMENT vls_cyl_trig[5] "cylinder selective update counter for trigger event" UBYTE _CNV_A_R_LINEAR_____0_CM 1 100. 0. 255. DISPLAY_IDENTIFIER VLS_CYL_TRIG_5 ECU_ADDRESS 0x3fe51c FORMAT "%3.0" /end MEASUREMENT
/begin MEASUREMENT lv_err_isc "error at idle speed control diagnosis" UBYTE _CNV_S_2_RANGE______21_CM 1 100. 0. 1. DISPLAY_IDENTIFIER LV_ERR_ISC ECU_ADDRESS 0x3fb9a0 /end MEASUREMENT
/begin CHARACTERISTIC c_maf_max_diag_isc "Minimum mass air flow to perform idle speed valve Plausibility check" VALUE 0xffe40792 _REC_VAL_20_u1 1389. _CNV_A_R_LINEAR_____27_CM 0. 1389. DISPLAY_IDENTIFIER C_MAF_MAX_DIAG_ISC FORMAT "%4.0" /end CHARACTERISTIC
/begin CHARACTERISTIC c_n_dif_max_diag_isc "Maximum deviation above nominal idle speed" VALUE 0xffe417f6 _REC_VAL_20_u2 8160. _CNV_A_R_LINEAR_____10_CM 0. 8160. DISPLAY_IDENTIFIER C_N_DIF_MAX_DIAG_ISC FORMAT "%4.0" /end CHARACTERISTIC
/begin CHARACTERISTIC c_n_dif_min_diag_isc "Minimum deviation above nominal idle speed" VALUE 0xffe417f8 _REC_VAL_20_u2 8160. _CNV_A_R_LINEAR_____10_CM 0. 8160. DISPLAY_IDENTIFIER C_N_DIF_MIN_DIAG_ISC FORMAT "%4.0" /end CHARACTERISTIC
/begin CHARACTERISTIC c_t_dly_isc_diag "Time delay for diagnosis activation" VALUE 0xffe4191a _REC_VAL_20_u2 6553.5 _CNV_A_R_LINEAR_____24_CM 0. 6553.5 DISPLAY_IDENTIFIER C_T_DLY_ISC_DIAG FORMAT "%6.1" /end CHARACTERISTIC
/begin MEASUREMENT t_isc_diag "Time delay for diagnosis activation" UWORD _CNV_A_R_LINEAR_____24_CM 1 100. 0. 6553.5 DISPLAY_IDENTIFIER T_ISC_DIAG ECU_ADDRESS 0x3fda76 BYTE_ORDER MSB_LAST FORMAT "%6.1" /end MEASUREMENT
/begin CHARACTERISTIC c_abc_inc_isc "Anti-bounce counter increment for idle speed Plausibility check" VALUE 0xffe40575 _REC_VAL_20_u1 255. _CNV_A_R_LINEAR_____0_CM 0. 255. DISPLAY_IDENTIFIER C_ABC_INC_ISC FORMAT "%3.0" /end CHARACTERISTIC
/begin CHARACTERISTIC c_abc_dec_isc "Anti-bounce counter decrement for idle speed Plausibility check" VALUE 0xffe40544 _REC_VAL_20_u1 255. _CNV_A_R_LINEAR_____0_CM 0. 255. DISPLAY_IDENTIFIER C_ABC_DEC_ISC FORMAT "%3.0" /end CHARACTERISTIC
/begin CHARACTERISTIC c_flow_cps_max_diag_isc "maximum canister purge fuel flow from CPS to cylinder to perform idle speed plausibility check" VALUE 0xffe41658 _REC_VAL_20_u2 7.99987793 _CNV_A_R_LINEAR_____113_CM 0. 7.99987793 DISPLAY_IDENTIFIER C_FLOW_CPS_MAX_DIAG_ISC FORMAT "%7.4" /end CHARACTERISTIC
/begin CHARACTERISTIC c_abc_max_isc "Maximum value of the anti-bounce counter for idle speed Plausibility check" VALUE 0xffe405e8 _REC_VAL_20_u1 254. _CNV_A_R_LINEAR_____0_CM 1. 255. DISPLAY_IDENTIFIER C_ABC_MAX_ISC FORMAT "%3.0" /end CHARACTERISTIC
/begin CHARACTERISTIC lc_inh_diag_isc_man "Manual inhibition of ISC diagnosis" VALUE 0xffe40f71 _REC_VAL_20_u1 1. _CNV_A_R_LINEAR_____22_CM 0. 1. DISPLAY_IDENTIFIER LC_INH_DIAG_ISC_MAN FORMAT "%1.0" /end CHARACTERISTIC
/begin MEASUREMENT lv_req_eol_chk_ls_up_down_1 "LV for starting(01h) or stopping (00h) the function within the function module" UBYTE _CNV_S_2_RANGE______2_CM 1 100. 0. 1. DISPLAY_IDENTIFIER LV_REQ_EOL_CHK_LS_UP_DOWN_1 ECU_ADDRESS 0x3fecef /end MEASUREMENT
/begin MEASUREMENT lv_req_eol_chk_ls_up_down_2 "LV for starting(01h) or stopping (00h) the function within the function module" UBYTE _CNV_S_2_RANGE______2_CM 1 100. 0. 1. DISPLAY_IDENTIFIER LV_REQ_EOL_CHK_LS_UP_DOWN_2 ECU_ADDRESS 0x3fecf0 /end MEASUREMENT
/begin MEASUREMENT lamb_sp_ext_adj_1 "bank selective external lambda setpoint (EOL test)" UWORD _CNV_A_R_LINEAR_____206_CM 1 100. 0. 31.99902344 DISPLAY_IDENTIFIER LAMB_SP_EXT_ADJ_1 ECU_ADDRESS 0x3fe018 BYTE_ORDER MSB_LAST FORMAT "%7.4" /end MEASUREMENT
/begin MEASUREMENT lamb_sp_ext_adj_2 "bank selective external lambda setpoint (EOL test)" UWORD _CNV_A_R_LINEAR_____206_CM 1 100. 0. 31.99902344 DISPLAY_IDENTIFIER LAMB_SP_EXT_ADJ_2 ECU_ADDRESS 0x3fe01a BYTE_ORDER MSB_LAST FORMAT "%7.4" /end MEASUREMENT
/begin MEASUREMENT lv_lamb_sp_ext_adj_1 "FL<g to activate bank selective external lambda setpoint (EOL test)" UBYTE _CNV_S_2_RANGE______2_CM 1 100. 0. 1. DISPLAY_IDENTIFIER LV_LAMB_SP_EXT_ADJ_1 ECU_ADDRESS 0x3fecf2 /end MEASUREMENT
/begin MEASUREMENT lv_lamb_sp_ext_adj_2 "FL<g to activate bank selective external lambda setpoint (EOL test)" UBYTE _CNV_S_2_RANGE______2_CM 1 100. 0. 1. DISPLAY_IDENTIFIER LV_LAMB_SP_EXT_ADJ_2 ECU_ADDRESS 0x3fecf3 /end MEASUREMENT
/begin CHARACTERISTIC lc_ad_clr_knk "Logical constant for initializing KNK nvmy data" VALUE 0xffe40f21 _REC_VAL_20_u1 1. _CNV_A_R_LINEAR_____0_CM 0. 1. DISPLAY_IDENTIFIER LC_AD_CLR_KNK FORMAT "%2.0" /end CHARACTERISTIC
/begin CHARACTERISTIC lc_ad_clr_lam "Logical constant for initializing LAMBDA nvmy data" VALUE 0xffe40f22 _REC_VAL_20_u1 1. _CNV_A_R_LINEAR_____0_CM 0. 1. DISPLAY_IDENTIFIER LC_AD_CLR_LAM FORMAT "%2.0" /end CHARACTERISTIC
/begin CHARACTERISTIC lc_ad_clr_tco "Logical constant for initializing TCO nvmy data" VALUE 0xffe40f2c _REC_VAL_20_u1 1. _CNV_A_R_LINEAR_____0_CM 0. 1. DISPLAY_IDENTIFIER LC_AD_CLR_TCO FORMAT "%2.0" /end CHARACTERISTIC
/begin CHARACTERISTIC lc_ad_clr_tps "Logical constant for initializing TPS nvmy data" VALUE 0xffe40f30 _REC_VAL_20_u1 1. _CNV_A_R_LINEAR_____0_CM 0. 1. DISPLAY_IDENTIFIER LC_AD_CLR_TPS FORMAT "%2.0" /end CHARACTERISTIC
/begin CHARACTERISTIC lc_ad_clr_mis "Logical constant for initializing MISFIRE nvmy data" VALUE 0xffe40f24 _REC_VAL_20_u1 1. _CNV_A_R_LINEAR_____0_CM 0. 1. DISPLAY_IDENTIFIER LC_AD_CLR_MIS FORMAT "%2.0" /end CHARACTERISTIC
/begin CHARACTERISTIC lc_ad_clr_ivvt "Logical constant for initializing IVVT nvmy data" VALUE 0xffe40f20 _REC_VAL_20_u1 1. _CNV_A_R_LINEAR_____0_CM 0. 1. DISPLAY_IDENTIFIER LC_AD_CLR_IVVT FORMAT "%2.0" /end CHARACTERISTIC
/begin CHARACTERISTIC lc_ad_clr_imm "Logical constant for initializing IMM nvmy data" VALUE 0xffe40f1f _REC_VAL_20_u1 1. _CNV_A_R_LINEAR_____0_CM 0. 1. DISPLAY_IDENTIFIER LC_AD_CLR_IMM FORMAT "%2.0" /end CHARACTERISTIC
/begin CHARACTERISTIC lc_ad_clr_idle "Logical constant for initializing IDLE nvmy data" VALUE 0xffe40f1e _REC_VAL_20_u1 1. _CNV_A_R_LINEAR_____0_CM 0. 1. DISPLAY_IDENTIFIER LC_AD_CLR_IDLE FORMAT "%2.0" /end CHARACTERISTIC
/begin CHARACTERISTIC lc_ad_clr_ati "Logical constant for initializing ATI nvmy data" VALUE 0xffe40f19 _REC_VAL_20_u1 1. _CNV_A_R_LINEAR_____0_CM 0. 1. DISPLAY_IDENTIFIER LC_AD_CLR_ATI FORMAT "%2.0" /end CHARACTERISTIC
/begin CHARACTERISTIC lc_ad_clr_toil "Logical constant for initializing TOIL nvmy data" VALUE 0xffe40f2f _REC_VAL_20_u1 1. _CNV_A_R_LINEAR_____0_CM 0. 1. DISPLAY_IDENTIFIER LC_AD_CLR_TOIL FORMAT "%2.0" /end CHARACTERISTIC
/begin CHARACTERISTIC lc_ad_clr_ecf "Logical constant for initializing ECF nvmy data" VALUE 0xffe40f1d _REC_VAL_20_u1 1. _CNV_A_R_LINEAR_____0_CM 0. 1. DISPLAY_IDENTIFIER LC_AD_CLR_ECF FORMAT "%2.0" /end CHARACTERISTIC
/begin CHARACTERISTIC lc_ad_clr_sa "Logical constant for initializing SA nvmy data" VALUE 0xffe40f2a _REC_VAL_20_u1 1. _CNV_A_R_LINEAR_____0_CM 0. 1. DISPLAY_IDENTIFIER LC_AD_CLR_SA FORMAT "%2.0" /end CHARACTERISTIC
/begin CHARACTERISTIC lc_ad_clr_n_sp_is "Logical constant for initializing N_SP_IS nvmy data" VALUE 0xffe40f26 _REC_VAL_20_u1 1. _CNV_A_R_LINEAR_____0_CM 0. 1. DISPLAY_IDENTIFIER LC_AD_CLR_N_SP_IS FORMAT "%2.0" /end CHARACTERISTIC
/begin CHARACTERISTIC lc_ad_clr_ron "Logical constant for initializing RON nvmy data" VALUE 0xffe40f29 _REC_VAL_20_u1 1. _CNV_A_R_LINEAR_____0_CM 0. 1. DISPLAY_IDENTIFIER LC_AD_CLR_RON FORMAT "%2.0" /end CHARACTERISTIC
/begin CHARACTERISTIC lc_ad_clr_tecu "Logical constant for initializing TECU nvmy data" VALUE 0xffe40f2d _REC_VAL_20_u1 1. _CNV_A_R_LINEAR_____0_CM 0. 1. DISPLAY_IDENTIFIER LC_AD_CLR_TECU FORMAT "%2.0" /end CHARACTERISTIC
/begin CHARACTERISTIC lc_ad_clr_var "Logical constant for initializing VAR nvmy data" VALUE 0xffe40f32 _REC_VAL_20_u1 1. _CNV_A_R_LINEAR_____0_CM 0. 1. DISPLAY_IDENTIFIER LC_AD_CLR_VAR FORMAT "%2.0" /end CHARACTERISTIC
/begin CHARACTERISTIC lc_ad_clr_dmtl "Logical constant for initializing DMTL nvmy data" VALUE 0xffe40f1c _REC_VAL_20_u1 1. _CNV_A_R_LINEAR_____0_CM 0. 1. DISPLAY_IDENTIFIER LC_AD_CLR_DMTL FORMAT "%2.0" /end CHARACTERISTIC
/begin CHARACTERISTIC lc_ad_clr_sof "Logical constant for initializing the sound flap / sport switch" VALUE 0xffe40f2b _REC_VAL_20_u1 1. _CNV_A_R_LINEAR_____0_CM 0. 1. DISPLAY_IDENTIFIER LC_AD_CLR_SOF FORMAT "%2.0" /end CHARACTERISTIC
/begin CHARACTERISTIC lc_ad_clr_n_max "Logical constant for initializing the N_MAX nvmy data" VALUE 0xffe40f25 _REC_VAL_20_u1 1. _CNV_A_R_LINEAR_____0_CM 0. 1. DISPLAY_IDENTIFIER LC_AD_CLR_N_MAX FORMAT "%2.0" /end CHARACTERISTIC
/begin CHARACTERISTIC lc_ad_clr_lif "Logical constant for initializing LIF" VALUE 0xffe40f23 _REC_VAL_20_u1 1. _CNV_A_R_LINEAR_____0_CM 0. 1. DISPLAY_IDENTIFIER LC_AD_CLR_LIF FORMAT "%2.0" /end CHARACTERISTIC
/begin CHARACTERISTIC lc_ad_clr_oz "Logical constant for initializing OZ" VALUE 0xffe40f28 _REC_VAL_20_u1 1. _CNV_A_R_LINEAR_____0_CM 0. 1. DISPLAY_IDENTIFIER LC_AD_CLR_OZ FORMAT "%2.0" /end CHARACTERISTIC
/begin CHARACTERISTIC lc_ad_clr_tqi_lim "Logical constant for initializing TQI_LIM" VALUE 0xffe40f31 _REC_VAL_20_u1 1. _CNV_A_R_LINEAR_____0_CM 0. 1. DISPLAY_IDENTIFIER LC_AD_CLR_TQI_LIM FORMAT "%2.0" /end CHARACTERISTIC
/begin CHARACTERISTIC lc_ad_clr_teg "Logical constant for initializing TEG" VALUE 0xffe40f2e _REC_VAL_20_u1 1. _CNV_A_R_LINEAR_____0_CM 0. 1. DISPLAY_IDENTIFIER LC_AD_CLR_TEG FORMAT "%2.0" /end CHARACTERISTIC
/begin CHARACTERISTIC lc_ad_clr "Logical constant for initializing AD" VALUE 0xffe40f18 _REC_VAL_20_u1 1. _CNV_A_R_LINEAR_____0_CM 0. 1. DISPLAY_IDENTIFIER LC_AD_CLR FORMAT "%2.0" /end CHARACTERISTIC
/begin CHARACTERISTIC lc_ad_clr_obd2 "Logical constant for initializing OBDII" VALUE 0xffe40f27 _REC_VAL_20_u1 1. _CNV_A_R_LINEAR_____0_CM 0. 1. DISPLAY_IDENTIFIER LC_AD_CLR_OBD2 FORMAT "%2.0" /end CHARACTERISTIC
/begin CHARACTERISTIC lc_ad_clr_cru "Logical constant for initializing CRU" VALUE 0xffe40f1b _REC_VAL_20_u1 1. _CNV_A_R_LINEAR_____0_CM 0. 1. DISPLAY_IDENTIFIER LC_AD_CLR_CRU FORMAT "%2.0" /end CHARACTERISTIC
/begin CHARACTERISTIC c_nvmy_inst_chk "Address of instance" VALUE 0xffe40811 _REC_VAL_20_u1 255. _CNV_A_R_LINEAR_____0_CM 0. 255. DISPLAY_IDENTIFIER C_NVMY_INST_CHK FORMAT "%3.0" /end CHARACTERISTIC
/begin MEASUREMENT lv_nvmy_rd_failed "Reading from NVMY failed due to TRL or CHK error" UBYTE _CNV_S_2_RANGE______21_CM 1 100. 0. 1. DISPLAY_IDENTIFIER LV_NVMY_RD_FAILED ECU_ADDRESS 0x3fe6aa BIT_MASK 0x1 /end MEASUREMENT
/begin MEASUREMENT lv_nvmy_wr_failed "Writing to  NVMY failed due to TRL or CHK error" UBYTE _CNV_S_2_RANGE______2_CM 1 100. 0. 1. DISPLAY_IDENTIFIER LV_NVMY_WR_FAILED ECU_ADDRESS 0x3fe6ab BIT_MASK 0x1 /end MEASUREMENT
/begin MEASUREMENT nvmy_e2p_address "Address of instance" UWORD _CNV_A_R_LINEAR_____0_CM 1 100. 0. 65535. DISPLAY_IDENTIFIER NVMY_E2P_ADDRESS ECU_ADDRESS 0x3fd77c BYTE_ORDER MSB_LAST FORMAT "%5.0" /end MEASUREMENT
/begin CHARACTERISTIC lc_ad_clr_can "Logical constant for initializing CAN nvmy data" VALUE 0xffe40f1a _REC_VAL_20_u1 1. _CNV_A_R_LINEAR_____0_CM 0. 1. DISPLAY_IDENTIFIER LC_AD_CLR_CAN FORMAT "%2.0" /end CHARACTERISTIC
/begin MEASUREMENT B_doibdig1 "Anforderung Eintrag od. Heilung Ort 1" UBYTE _CNV_A_R_LINEAR_____22_CM 1 100. 0. 255. DISPLAY_IDENTIFIER B_DOIBDIG1 ECU_ADDRESS 0x3fab91 BIT_MASK 0x1 /end MEASUREMENT
/begin MEASUREMENT B_doibdig2 "Anforderung Eintrag od. Heilung Ort 2" UBYTE _CNV_A_R_LINEAR_____22_CM 1 100. 0. 255. DISPLAY_IDENTIFIER B_DOIBDIG2 ECU_ADDRESS 0x3fab92 BIT_MASK 0x1 /end MEASUREMENT
/begin MEASUREMENT B_doibdig3 "Anforderung Eintrag od. Heilung Ort 3" UBYTE _CNV_A_R_LINEAR_____22_CM 1 100. 0. 255. DISPLAY_IDENTIFIER B_DOIBDIG3 ECU_ADDRESS 0x3fab93 BIT_MASK 0x1 /end MEASUREMENT
/begin MEASUREMENT diberrctr1 "Entprellzaehler BSD Fehler" UBYTE _CNV_R_R_t100msxs_u_552_CM 1 100. 0. 25.5 DISPLAY_IDENTIFIER DIBERRCTR1 ECU_ADDRESS 0x3fab9c FORMAT "%8.4" /end MEASUREMENT
/begin MEASUREMENT diberrctr2 "Entprellzaehler EBSD" UBYTE _CNV_R_R_t100msxs_u_552_CM 1 100. 0. 25.5 DISPLAY_IDENTIFIER DIBERRCTR2 ECU_ADDRESS 0x3fab9d FORMAT "%8.4" /end MEASUREMENT
/begin MEASUREMENT diberrctr3 "Entprellzaehler IBS SW Fehler" UBYTE _CNV_R_R_t100msxs_u_552_CM 1 100. 0. 25.5 DISPLAY_IDENTIFIER DIBERRCTR3 ECU_ADDRESS 0x3fab9e FORMAT "%8.4" /end MEASUREMENT
/begin MEASUREMENT diberrctr4 "Entprellzaehler Stromfehler" UBYTE _CNV_R_R_t100msxs_u_552_CM 1 100. 0. 25.5 DISPLAY_IDENTIFIER DIBERRCTR4 ECU_ADDRESS 0x3fab9f FORMAT "%8.4" /end MEASUREMENT
/begin MEASUREMENT diberrctr5 "Entprellzaehler Spannungsfehler" UBYTE _CNV_R_R_t100msxs_u_552_CM 1 100. 0. 25.5 DISPLAY_IDENTIFIER DIBERRCTR5 ECU_ADDRESS 0x3faba0 FORMAT "%8.4" /end MEASUREMENT
/begin MEASUREMENT diberrctr6 "Entprellzaehler Temp.fehler" UBYTE _CNV_R_R_t100msxs_u_552_CM 1 100. 0. 25.5 DISPLAY_IDENTIFIER DIBERRCTR6 ECU_ADDRESS 0x3faba1 FORMAT "%8.4" /end MEASUREMENT
/begin MEASUREMENT diberrctr7 "Entprellzaehler IBS Systemfehler" UBYTE _CNV_R_R_t100msxs_u_552_CM 1 100. 0. 25.5 DISPLAY_IDENTIFIER DIBERRCTR7 ECU_ADDRESS 0x3faba2 FORMAT "%8.4" /end MEASUREMENT
/begin MEASUREMENT diberrctr8 "Entprellzaehler IBS KL20wu Fehler" UBYTE _CNV_R_R_t100msxs_u_552_CM 1 100. 0. 25.5 DISPLAY_IDENTIFIER DIBERRCTR8 ECU_ADDRESS 0x3faba3 FORMAT "%8.4" /end MEASUREMENT
/begin MEASUREMENT dibhealct1 "Entprellzaehler Fehlerheilung Ort 1" UBYTE _CNV_R_R_t100msxs_u_552_CM 1 100. 0. 25.5 DISPLAY_IDENTIFIER DIBHEALCT1 ECU_ADDRESS 0x3faba4 FORMAT "%8.4" /end MEASUREMENT
/begin MEASUREMENT dibhealct2 "Entprellzaehler Fehlerheilung Ort 2" UBYTE _CNV_R_R_t100msxs_u_552_CM 1 100. 0. 25.5 DISPLAY_IDENTIFIER DIBHEALCT2 ECU_ADDRESS 0x3faba5 FORMAT "%8.4" /end MEASUREMENT
/begin MEASUREMENT dibhealct3 "Entprellzaehler Fehlerheilung Ort 3" UBYTE _CNV_R_R_t100msxs_u_552_CM 1 100. 0. 25.5 DISPLAY_IDENTIFIER DIBHEALCT3 ECU_ADDRESS 0x3faba6 FORMAT "%8.4" /end MEASUREMENT
/begin MEASUREMENT ibfehlin1 "lokale Kopie Fehlerinput 1" UBYTE _CNV_A_R_LINEAR_____22_CM 1 100. 0. 255. DISPLAY_IDENTIFIER IBFEHLIN1 ECU_ADDRESS 0x3fab94 BIT_MASK 0x1 /end MEASUREMENT
/begin MEASUREMENT ibfehlin2 "lokale Kopie Fehlerinput 2" UBYTE _CNV_A_R_LINEAR_____22_CM 1 100. 0. 255. DISPLAY_IDENTIFIER IBFEHLIN2 ECU_ADDRESS 0x3fab95 BIT_MASK 0x1 /end MEASUREMENT
/begin MEASUREMENT ibfehlin3 "lokale Kopie Fehlerinput 3" UBYTE _CNV_A_R_LINEAR_____22_CM 1 100. 0. 255. DISPLAY_IDENTIFIER IBFEHLIN3 ECU_ADDRESS 0x3fab96 BIT_MASK 0x1 /end MEASUREMENT
/begin MEASUREMENT ibfehlin4 "lokale Kopie Fehlerinput 4" UBYTE _CNV_A_R_LINEAR_____22_CM 1 100. 0. 255. DISPLAY_IDENTIFIER IBFEHLIN4 ECU_ADDRESS 0x3fab97 BIT_MASK 0x1 /end MEASUREMENT
/begin MEASUREMENT ibfehlin5 "lokale Kopie Fehlerinput 5" UBYTE _CNV_A_R_LINEAR_____22_CM 1 100. 0. 255. DISPLAY_IDENTIFIER IBFEHLIN5 ECU_ADDRESS 0x3fab98 BIT_MASK 0x1 /end MEASUREMENT
/begin MEASUREMENT ibfehlin6 "lokale Kopie Fehlerinput 6" UBYTE _CNV_A_R_LINEAR_____22_CM 1 100. 0. 255. DISPLAY_IDENTIFIER IBFEHLIN6 ECU_ADDRESS 0x3fab99 BIT_MASK 0x1 /end MEASUREMENT
/begin MEASUREMENT ibfehlin7 "lokale Kopie Fehlerinput 7" UBYTE _CNV_A_R_LINEAR_____22_CM 1 100. 0. 255. DISPLAY_IDENTIFIER IBFEHLIN7 ECU_ADDRESS 0x3fab9a BIT_MASK 0x1 /end MEASUREMENT
/begin MEASUREMENT ibfehlin8 "lokale Kopie Fehlerinput 8" UBYTE _CNV_A_R_LINEAR_____22_CM 1 100. 0. 255. DISPLAY_IDENTIFIER IBFEHLIN8 ECU_ADDRESS 0x3fab9b BIT_MASK 0x1 /end MEASUREMENT
/begin MEASUREMENT ibsderrs1 "Test Fehlerzaehler BSD" UBYTE _CNV_R_R_dez_550_CM 1 100. 0. 255. DISPLAY_IDENTIFIER IBSDERRS1 ECU_ADDRESS 0x3facc3 FORMAT "%8.4" /end MEASUREMENT
/begin MEASUREMENT ibsderrs2 "Test Fehlerzaehler EBSD" UBYTE _CNV_R_R_dez_550_CM 1 100. 0. 255. DISPLAY_IDENTIFIER IBSDERRS2 ECU_ADDRESS 0x3facc4 FORMAT "%8.4" /end MEASUREMENT
/begin MEASUREMENT ibserstat1 "Fehlerstatus Ort 1" UBYTE _CNV_R_R_dez_550_CM 1 100. 0. 255. DISPLAY_IDENTIFIER IBSERSTAT1 ECU_ADDRESS 0x3faba7 FORMAT "%8.4" /end MEASUREMENT
/begin MEASUREMENT ibserstat2 "Fehlerstatus Ort 2" UBYTE _CNV_R_R_dez_550_CM 1 100. 0. 255. DISPLAY_IDENTIFIER IBSERSTAT2 ECU_ADDRESS 0x3faba8 FORMAT "%8.4" /end MEASUREMENT
/begin MEASUREMENT ibserstat3 "Fehlerstatus Ort 3" UBYTE _CNV_R_R_dez_550_CM 1 100. 0. 255. DISPLAY_IDENTIFIER IBSERSTAT3 ECU_ADDRESS 0x3faba9 FORMAT "%8.4" /end MEASUREMENT
/begin MEASUREMENT locerr0 "Loc.Fehler0 Flankenerkennung" UBYTE _CNV_A_R_LINEAR_____22_CM 1 100. 0. 255. DISPLAY_IDENTIFIER LOCERR0 ECU_ADDRESS 0x3facc1 BIT_MASK 0x1 /end MEASUREMENT
/begin MEASUREMENT locerr1 "Loc.Fehler1 Flankenerkennung" UBYTE _CNV_A_R_LINEAR_____22_CM 1 100. 0. 255. DISPLAY_IDENTIFIER LOCERR1 ECU_ADDRESS 0x3facc2 BIT_MASK 0x1 /end MEASUREMENT
/begin CHARACTERISTIC IBBSTERR1 "Entprellzeit Fehlereintrag f. keine Kommunikation" VALUE 0xffe5b84c _REC_VAL_20_u1 0. _CNV_R_R_t100msxs_u_552_CM 0.1 25.5 FORMAT "%8.4" /end CHARACTERISTIC
/begin CHARACTERISTIC IBBSTERR2 "Entprellzeit Fehlereintrag f. EBSD" VALUE 0xffe5b84d _REC_VAL_20_u1 0. _CNV_R_R_t100msxs_u_552_CM 0.1 25.5 FORMAT "%8.4" /end CHARACTERISTIC
/begin CHARACTERISTIC IBBSTERR3 "Entprellzeit Fehlereintrag IBS unplausibel" VALUE 0xffe5b84e _REC_VAL_20_u1 0. _CNV_R_R_t100msxs_u_552_CM 0.1 25.5 FORMAT "%8.4" /end CHARACTERISTIC
/begin CHARACTERISTIC IBBSTERR4 "Entprellzeit Fehlereintrag f.Stromfehler" VALUE 0xffe5b84f _REC_VAL_20_u1 0. _CNV_R_R_t100msxs_u_552_CM 0.1 25.5 FORMAT "%8.4" /end CHARACTERISTIC
/begin CHARACTERISTIC IBBSTERR5 "Entprellzeit Fehlereintrag f. Spannungsfehler" VALUE 0xffe5b850 _REC_VAL_20_u1 0. _CNV_R_R_t100msxs_u_552_CM 0.1 25.5 FORMAT "%8.4" /end CHARACTERISTIC
/begin CHARACTERISTIC IBBSTERR6 "Entprellzeit Fehlereintrag f. Temp.Fehler" VALUE 0xffe5b851 _REC_VAL_20_u1 0. _CNV_R_R_t100msxs_u_552_CM 0.1 25.5 FORMAT "%8.4" /end CHARACTERISTIC
/begin CHARACTERISTIC IBBSTERR7 "Entprellzeit Fehlereintrag f. IBS Systemfehler" VALUE 0xffe5b852 _REC_VAL_20_u1 0. _CNV_R_R_t100msxs_u_552_CM 0.1 25.5 FORMAT "%8.4" /end CHARACTERISTIC
/begin CHARACTERISTIC IBBSTERR8 "Entprellzeit Fehlereintrag f. KL15wu Stoerung" VALUE 0xffe5b853 _REC_VAL_20_u1 0. _CNV_R_R_t100msxs_u_552_CM 0.1 25.5 FORMAT "%8.4" /end CHARACTERISTIC
/begin CHARACTERISTIC IBBSTHEAL "Entprellzeit Fehlerheilung " VALUE 0xffe5b854 _REC_VAL_20_u1 0. _CNV_R_R_t100msxs_u_552_CM 0.1 25.5 FORMAT "%8.4" /end CHARACTERISTIC
/begin CHARACTERISTIC MSKIBSDFP "Bitmaske Generator Fehler-> DFP" VALUE 0xffe5b855 _REC_VAL_20_u1 0. _CNV_R_R_dez_550_CM 0. 255. FORMAT "%8.4" /end CHARACTERISTIC
/begin CHARACTERISTIC MSKIBSDIAG "Test AK disable Diagnose" VALUE 0xffe5b856 _REC_VAL_20_u1 0. _CNV_R_R_dez_550_CM 0. 255. FORMAT "%8.4" /end CHARACTERISTIC
/begin MEASUREMENT if_t_seg_mis "Engine roughness segment time for safety level 2" UWORD _CNV_A_R_LINEAR_____428_CM 1 100. 0. 65535. DISPLAY_IDENTIFIER IF_T_SEG_MIS ECU_ADDRESS 0x3fd7da BYTE_ORDER MSB_LAST FORMAT "%5.0" /end MEASUREMENT
/begin MEASUREMENT cur_seg_cor "Current ER corrected segment time value" UWORD _CNV_A_R_LINEAR_____428_CM 1 100. 0. 65535. DISPLAY_IDENTIFIER CUR_SEG_COR ECU_ADDRESS 0x3fd7dc BYTE_ORDER MSB_LAST FORMAT "%5.0" /end MEASUREMENT
/begin MEASUREMENT seg_t_cor_buf[0] "ER corrected segment times buffer (after adaptation)" UWORD _CNV_A_R_LINEAR_____428_CM 1 100. 0. 65535. DISPLAY_IDENTIFIER SEG_T_COR_0 ECU_ADDRESS 0x3fd7ce BYTE_ORDER MSB_LAST FORMAT "%5.0" /end MEASUREMENT
/begin MEASUREMENT seg_t_cor_buf[1] "ER corrected segment times buffer (after adaptation)" UWORD _CNV_A_R_LINEAR_____428_CM 1 100. 0. 65535. DISPLAY_IDENTIFIER SEG_T_COR_1 ECU_ADDRESS 0x3fd7d0 BYTE_ORDER MSB_LAST FORMAT "%5.0" /end MEASUREMENT
/begin MEASUREMENT seg_t_cor_buf[2] "ER corrected segment times buffer (after adaptation)" UWORD _CNV_A_R_LINEAR_____428_CM 1 100. 0. 65535. DISPLAY_IDENTIFIER SEG_T_COR_2 ECU_ADDRESS 0x3fd7d2 BYTE_ORDER MSB_LAST FORMAT "%5.0" /end MEASUREMENT
/begin MEASUREMENT seg_t_cor_buf[3] "ER corrected segment times buffer (after adaptation)" UWORD _CNV_A_R_LINEAR_____428_CM 1 100. 0. 65535. DISPLAY_IDENTIFIER SEG_T_COR_3 ECU_ADDRESS 0x3fd7d4 BYTE_ORDER MSB_LAST FORMAT "%5.0" /end MEASUREMENT
/begin MEASUREMENT seg_t_cor_buf[4] "ER corrected segment times buffer (after adaptation)" UWORD _CNV_A_R_LINEAR_____428_CM 1 100. 0. 65535. DISPLAY_IDENTIFIER SEG_T_COR_4 ECU_ADDRESS 0x3fd7d6 BYTE_ORDER MSB_LAST FORMAT "%5.0" /end MEASUREMENT
/begin MEASUREMENT seg_t_cor_buf[5] "ER corrected segment times buffer (after adaptation)" UWORD _CNV_A_R_LINEAR_____428_CM 1 100. 0. 65535. DISPLAY_IDENTIFIER SEG_T_COR_5 ECU_ADDRESS 0x3fd7d8 BYTE_ORDER MSB_LAST FORMAT "%5.0" /end MEASUREMENT
/begin MEASUREMENT drv0_er "Engine roughness static component" SLONG _CNV_A_R_LINEAR_____563_CM 1 100. -2147483647. 2147483648. DISPLAY_IDENTIFIER DRV0_ER ECU_ADDRESS 0x3fcf78 BYTE_ORDER MSB_LAST FORMAT "%11.0" /end MEASUREMENT
/begin MEASUREMENT drv2_mmv_er "Averaged engine roughness curvature component" UWORD _CNV_A_R_LINEAR_____428_CM 1 100. 0. 65535. DISPLAY_IDENTIFIER DRV2_MMV_ER ECU_ADDRESS 0x3fd7fc BYTE_ORDER MSB_LAST FORMAT "%5.0" /end MEASUREMENT
/begin MEASUREMENT drv1_er "Engine roughness dynamic component" SWORD _CNV_A_R_LINEAR_____428_CM 1 100. -32768. 32767. DISPLAY_IDENTIFIER DRV1_ER ECU_ADDRESS 0x3fd7e0 BYTE_ORDER MSB_LAST FORMAT "%6.0" /end MEASUREMENT
/begin MEASUREMENT er_raw "Engine roughness without curvature component" SWORD _CNV_A_R_LINEAR_____428_CM 1 100. -32768. 32767. DISPLAY_IDENTIFIER ER_RAW ECU_ADDRESS 0x3fd7e2 BYTE_ORDER MSB_LAST FORMAT "%6.0" /end MEASUREMENT
/begin MEASUREMENT lv_ena_er "Engine roughness enable flag" UBYTE _CNV_S_2_RANGE______21_CM 1 100. 0. 1. DISPLAY_IDENTIFIER LV_ENA_ER ECU_ADDRESS 0x3fe753 /end MEASUREMENT
/begin CHARACTERISTIC c_n_min_er "Minimum engine speed for engine roughness calculation" VALUE 0xffe402c0 _REC_VAL_20_u2 8160. _CNV_A_R_LINEAR_____10_CM 0. 8160. DISPLAY_IDENTIFIER C_N_MIN_ER FORMAT "%4.0" /end CHARACTERISTIC
/begin MEASUREMENT thd_ad_er "Engine roughness threshold correction factor during segment adaptation learning process" UWORD _CNV_A_R_LINEAR_____428_CM 1 100. 0. 65535. DISPLAY_IDENTIFIER THD_AD_ER ECU_ADDRESS 0x3fd7e4 BYTE_ORDER MSB_LAST FORMAT "%5.0" /end MEASUREMENT
/begin MEASUREMENT seg_t_ad_min_er "Calculated correlation factor for segment adaptation" UWORD _CNV_A_R_LINEAR_____0_CM 1 100. 0. 65535. DISPLAY_IDENTIFIER SEG_T_AD_MIN_ER ECU_ADDRESS 0x3fd7e8 BYTE_ORDER MSB_LAST FORMAT "%5.0" /end MEASUREMENT
/begin CHARACTERISTIC c_crk_dif_max_er "Limitation of adaptation range ( mechanical tolerance)" VALUE 0xffe402b6 _REC_VAL_20_u2 7.8125 _CNV_A_R_LINEAR_____564_CM 0. 7.8125 DISPLAY_IDENTIFIER C_CRK_DIF_MAX_ER FORMAT "%4.2" /end CHARACTERISTIC
/begin MEASUREMENT delta_crk_dif_max_er "Limitation of adaptation range (mech. Tolerance)" UWORD _CNV_A_R_LINEAR_____565_CM 1 100. 0. 245.3 DISPLAY_IDENTIFIER DELTA_CRK_DIF_MAX_ER ECU_ADDRESS 0x3fd7ea BYTE_ORDER MSB_LAST FORMAT "%7.3" /end MEASUREMENT
/begin MEASUREMENT lv_seg_ad_lim "Segment adaptation values at limit" UBYTE _CNV_S_2_RANGE______21_CM 1 100. 0. 1. DISPLAY_IDENTIFIER LV_SEG_AD_LIM ECU_ADDRESS 0x3fe754 /end MEASUREMENT
/begin MEASUREMENT cur_seg_mes "Current ER raw segment time measurement" UWORD _CNV_A_R_LINEAR_____428_CM 1 100. 0. 65535. DISPLAY_IDENTIFIER CUR_SEG_MES ECU_ADDRESS 0x3fd7f8 BYTE_ORDER MSB_LAST FORMAT "%5.0" /end MEASUREMENT
/begin MEASUREMENT seg_t_mes_buf[0] "ER  raw segment times buffer (before adaptation)" UWORD _CNV_A_R_LINEAR_____428_CM 1 100. 0. 65535. DISPLAY_IDENTIFIER SEG_T_MES_0 ECU_ADDRESS 0x3fd7ec BYTE_ORDER MSB_LAST FORMAT "%5.0" /end MEASUREMENT
/begin MEASUREMENT seg_t_mes_buf[1] "ER  raw segment times buffer (before adaptation)" UWORD _CNV_A_R_LINEAR_____428_CM 1 100. 0. 65535. DISPLAY_IDENTIFIER SEG_T_MES_1 ECU_ADDRESS 0x3fd7ee BYTE_ORDER MSB_LAST FORMAT "%5.0" /end MEASUREMENT
/begin MEASUREMENT seg_t_mes_buf[2] "ER  raw segment times buffer (before adaptation)" UWORD _CNV_A_R_LINEAR_____428_CM 1 100. 0. 65535. DISPLAY_IDENTIFIER SEG_T_MES_2 ECU_ADDRESS 0x3fd7f0 BYTE_ORDER MSB_LAST FORMAT "%5.0" /end MEASUREMENT
/begin MEASUREMENT seg_t_mes_buf[3] "ER  raw segment times buffer (before adaptation)" UWORD _CNV_A_R_LINEAR_____428_CM 1 100. 0. 65535. DISPLAY_IDENTIFIER SEG_T_MES_3 ECU_ADDRESS 0x3fd7f2 BYTE_ORDER MSB_LAST FORMAT "%5.0" /end MEASUREMENT
/begin MEASUREMENT seg_t_mes_buf[4] "ER  raw segment times buffer (before adaptation)" UWORD _CNV_A_R_LINEAR_____428_CM 1 100. 0. 65535. DISPLAY_IDENTIFIER SEG_T_MES_4 ECU_ADDRESS 0x3fd7f4 BYTE_ORDER MSB_LAST FORMAT "%5.0" /end MEASUREMENT
/begin MEASUREMENT seg_t_mes_buf[5] "ER  raw segment times buffer (before adaptation)" UWORD _CNV_A_R_LINEAR_____428_CM 1 100. 0. 65535. DISPLAY_IDENTIFIER SEG_T_MES_5 ECU_ADDRESS 0x3fd7f6 BYTE_ORDER MSB_LAST FORMAT "%5.0" /end MEASUREMENT
/begin MEASUREMENT drv2_er "Engine roughness curvature component" UWORD _CNV_A_R_LINEAR_____428_CM 1 100. 0. 65535. DISPLAY_IDENTIFIER DRV2_ER ECU_ADDRESS 0x3fd7fa BYTE_ORDER MSB_LAST FORMAT "%5.0" /end MEASUREMENT
/begin MEASUREMENT seg_t_ad_nr "Counter for segment adaptation" UWORD _CNV_A_R_LINEAR_____0_CM 1 100. 0. 65535. DISPLAY_IDENTIFIER SEG_T_AD_NR ECU_ADDRESS 0x3fd7e6 BYTE_ORDER MSB_LAST FORMAT "%5.0" /end MEASUREMENT
/begin MEASUREMENT lv_seg_ad_state "Segment adaptation process state : no adaptive process executed (=0) fast adaptive process executed (=1)" UBYTE _CNV_S_2_RANGE______21_CM 1 100. 0. 1. DISPLAY_IDENTIFIER LV_SEG_AD_STATE ECU_ADDRESS 0x3fe755 /end MEASUREMENT
/begin CHARACTERISTIC c_seg_t_ad_cor_drv1_max_er "Maximum value of DRV1_ER (dynamic part of engine roughness) for crankshaft target wheel learning" VALUE 0xffe402c4 _REC_VAL_20_u2 32767. _CNV_A_R_LINEAR_____428_CM 0. 32767. DISPLAY_IDENTIFIER C_SEG_T_AD_COR_DRV1_MAX_ER FORMAT "%5.0" /end CHARACTERISTIC
/begin CHARACTERISTIC c_nr_seg_ad_act_min "Minimum segments number in fuel cut-off mode before triggering ER segment adaptive learning process" VALUE 0xffe4024c _REC_VAL_20_u1 255. _CNV_A_R_LINEAR_____0_CM 0. 255. DISPLAY_IDENTIFIER C_NR_SEG_AD_ACT_MIN FORMAT "%3.0" /end CHARACTERISTIC
/begin CHARACTERISTIC c_nr_seg_drv1_er_min "Minimum number of segments for engine roughness dynamic part" VALUE 0xffe4024e _REC_VAL_20_u1 255. _CNV_A_R_LINEAR_____0_CM 0. 255. DISPLAY_IDENTIFIER C_NR_SEG_DRV1_ER_MIN FORMAT "%3.0" /end CHARACTERISTIC
/begin CHARACTERISTIC c_n_max_er "Maximum engine speed for engine roughness calculation" VALUE 0xffe402be _REC_VAL_20_u2 8160. _CNV_A_R_LINEAR_____10_CM 0. 8160. DISPLAY_IDENTIFIER C_N_MAX_ER FORMAT "%4.0" /end CHARACTERISTIC
/begin CHARACTERISTIC c_n_32_min_seg "Engine speed threshold to allow IF_T_SEG_MIS calculation during start phase" VALUE 0xffe40245 _REC_VAL_20_u1 8160. _CNV_A_R_LINEAR_____15_CM 0. 8160. DISPLAY_IDENTIFIER C_N_32_MIN_SEG FORMAT "%4.0" /end CHARACTERISTIC
/begin MEASUREMENT er "Engine roughness " SWORD _CNV_A_R_LINEAR_____428_CM 1 100. -32768. 32767. DISPLAY_IDENTIFIER ER ECU_ADDRESS 0x3fd7de BYTE_ORDER MSB_LAST FORMAT "%6.0" /end MEASUREMENT
/begin MEASUREMENT er_x[0] "Cylinder Engine roughness values" SWORD _CNV_A_R_LINEAR_____428_CM 1 100. -32768. 32767. DISPLAY_IDENTIFIER ER_0 ECU_ADDRESS 0x3fd7fe BYTE_ORDER MSB_LAST FORMAT "%6.0" /end MEASUREMENT
/begin MEASUREMENT er_x[1] "Cylinder Engine roughness values" SWORD _CNV_A_R_LINEAR_____428_CM 1 100. -32768. 32767. DISPLAY_IDENTIFIER ER_1 ECU_ADDRESS 0x3fd800 BYTE_ORDER MSB_LAST FORMAT "%6.0" /end MEASUREMENT
/begin MEASUREMENT er_x[2] "Cylinder Engine roughness values" SWORD _CNV_A_R_LINEAR_____428_CM 1 100. -32768. 32767. DISPLAY_IDENTIFIER ER_2 ECU_ADDRESS 0x3fd802 BYTE_ORDER MSB_LAST FORMAT "%6.0" /end MEASUREMENT
/begin MEASUREMENT er_x[3] "Cylinder Engine roughness values" SWORD _CNV_A_R_LINEAR_____428_CM 1 100. -32768. 32767. DISPLAY_IDENTIFIER ER_3 ECU_ADDRESS 0x3fd804 BYTE_ORDER MSB_LAST FORMAT "%6.0" /end MEASUREMENT
/begin MEASUREMENT er_x[4] "Cylinder Engine roughness values" SWORD _CNV_A_R_LINEAR_____428_CM 1 100. -32768. 32767. DISPLAY_IDENTIFIER ER_4 ECU_ADDRESS 0x3fd806 BYTE_ORDER MSB_LAST FORMAT "%6.0" /end MEASUREMENT
/begin MEASUREMENT er_x[5] "Cylinder Engine roughness values" SWORD _CNV_A_R_LINEAR_____428_CM 1 100. -32768. 32767. DISPLAY_IDENTIFIER ER_5 ECU_ADDRESS 0x3fd808 BYTE_ORDER MSB_LAST FORMAT "%6.0" /end MEASUREMENT
/begin MEASUREMENT seg_ad_mmv[0] "Filtered adaptive values used for learning process (for each segment)" SWORD _CNV_A_R_LINEAR_____566_CM 1 100. -7.8125 7.8123 DISPLAY_IDENTIFIER SEG_AD_MMV_0 ECU_ADDRESS 0x3fd7b6 BYTE_ORDER MSB_LAST FORMAT "%7.4" /end MEASUREMENT
/begin MEASUREMENT seg_ad_mmv[1] "Filtered adaptive values used for learning process (for each segment)" SWORD _CNV_A_R_LINEAR_____566_CM 1 100. -7.8125 7.8123 DISPLAY_IDENTIFIER SEG_AD_MMV_1 ECU_ADDRESS 0x3fd7b8 BYTE_ORDER MSB_LAST FORMAT "%7.4" /end MEASUREMENT
/begin MEASUREMENT seg_ad_mmv[2] "Filtered adaptive values used for learning process (for each segment)" SWORD _CNV_A_R_LINEAR_____566_CM 1 100. -7.8125 7.8123 DISPLAY_IDENTIFIER SEG_AD_MMV_2 ECU_ADDRESS 0x3fd7ba BYTE_ORDER MSB_LAST FORMAT "%7.4" /end MEASUREMENT
/begin MEASUREMENT seg_ad_mmv[3] "Filtered adaptive values used for learning process (for each segment)" SWORD _CNV_A_R_LINEAR_____566_CM 1 100. -7.8125 7.8123 DISPLAY_IDENTIFIER SEG_AD_MMV_3 ECU_ADDRESS 0x3fd7bc BYTE_ORDER MSB_LAST FORMAT "%7.4" /end MEASUREMENT
/begin MEASUREMENT seg_ad_mmv[4] "Filtered adaptive values used for learning process (for each segment)" SWORD _CNV_A_R_LINEAR_____566_CM 1 100. -7.8125 7.8123 DISPLAY_IDENTIFIER SEG_AD_MMV_4 ECU_ADDRESS 0x3fd7be BYTE_ORDER MSB_LAST FORMAT "%7.4" /end MEASUREMENT
/begin MEASUREMENT seg_ad_mmv[5] "Filtered adaptive values used for learning process (for each segment)" SWORD _CNV_A_R_LINEAR_____566_CM 1 100. -7.8125 7.8123 DISPLAY_IDENTIFIER SEG_AD_MMV_5 ECU_ADDRESS 0x3fd7c0 BYTE_ORDER MSB_LAST FORMAT "%7.4" /end MEASUREMENT
/begin MEASUREMENT seg_ad_raw_mmv[0] "Filtered adaptive values used for learning process monitoring (for each segment)" SWORD _CNV_A_R_LINEAR_____566_CM 1 100. -7.8125 7.8123 DISPLAY_IDENTIFIER SEG_AD_RAW_MMV_0 ECU_ADDRESS 0x3fd7c2 BYTE_ORDER MSB_LAST FORMAT "%7.4" /end MEASUREMENT
/begin MEASUREMENT seg_ad_raw_mmv[1] "Filtered adaptive values used for learning process monitoring (for each segment)" SWORD _CNV_A_R_LINEAR_____566_CM 1 100. -7.8125 7.8123 DISPLAY_IDENTIFIER SEG_AD_RAW_MMV_1 ECU_ADDRESS 0x3fd7c4 BYTE_ORDER MSB_LAST FORMAT "%7.4" /end MEASUREMENT
/begin MEASUREMENT seg_ad_raw_mmv[2] "Filtered adaptive values used for learning process monitoring (for each segment)" SWORD _CNV_A_R_LINEAR_____566_CM 1 100. -7.8125 7.8123 DISPLAY_IDENTIFIER SEG_AD_RAW_MMV_2 ECU_ADDRESS 0x3fd7c6 BYTE_ORDER MSB_LAST FORMAT "%7.4" /end MEASUREMENT
/begin MEASUREMENT seg_ad_raw_mmv[3] "Filtered adaptive values used for learning process monitoring (for each segment)" SWORD _CNV_A_R_LINEAR_____566_CM 1 100. -7.8125 7.8123 DISPLAY_IDENTIFIER SEG_AD_RAW_MMV_3 ECU_ADDRESS 0x3fd7c8 BYTE_ORDER MSB_LAST FORMAT "%7.4" /end MEASUREMENT
/begin MEASUREMENT seg_ad_raw_mmv[4] "Filtered adaptive values used for learning process monitoring (for each segment)" SWORD _CNV_A_R_LINEAR_____566_CM 1 100. -7.8125 7.8123 DISPLAY_IDENTIFIER SEG_AD_RAW_MMV_4 ECU_ADDRESS 0x3fd7ca BYTE_ORDER MSB_LAST FORMAT "%7.4" /end MEASUREMENT
/begin MEASUREMENT seg_ad_raw_mmv[5] "Filtered adaptive values used for learning process monitoring (for each segment)" SWORD _CNV_A_R_LINEAR_____566_CM 1 100. -7.8125 7.8123 DISPLAY_IDENTIFIER SEG_AD_RAW_MMV_5 ECU_ADDRESS 0x3fd7cc BYTE_ORDER MSB_LAST FORMAT "%7.4" /end MEASUREMENT
/begin MEASUREMENT lv_seg_ad_act_state "ER segment adaptation process enable" UBYTE _CNV_S_2_RANGE______21_CM 1 100. 0. 1. DISPLAY_IDENTIFIER LV_SEG_AD_ACT_STATE ECU_ADDRESS 0x3fe756 /end MEASUREMENT
/begin MEASUREMENT lv_seg_ad_raw_act_state "ER segment adaptation process monitoring enable" UBYTE _CNV_S_2_RANGE______21_CM 1 100. 0. 1. DISPLAY_IDENTIFIER LV_SEG_AD_RAW_ACT_STATE ECU_ADDRESS 0x3fe757 /end MEASUREMENT
/begin CHARACTERISTIC c_n_seg_t_ad_raw_min_er "Minimum engine speed threshold for crankshaft target wheel monitoring" VALUE 0xffe4024b _REC_VAL_20_u1 8160. _CNV_A_R_LINEAR_____15_CM 0. 8160. DISPLAY_IDENTIFIER C_N_SEG_T_AD_RAW_MIN_ER FORMAT "%4.0" /end CHARACTERISTIC
/begin CHARACTERISTIC c_n_seg_t_ad_min_er "Minimum engine speed threshold for crankshaft target wheel learning" VALUE 0xffe40248 _REC_VAL_20_u1 8160. _CNV_A_R_LINEAR_____15_CM 0. 8160. DISPLAY_IDENTIFIER C_N_SEG_T_AD_MIN_ER FORMAT "%4.0" /end CHARACTERISTIC
/begin CHARACTERISTIC c_n_seg_t_ad_max_er "Maximum engine speed threshold for crankshaft target wheel learning" VALUE 0xffe40246 _REC_VAL_20_u1 8160. _CNV_A_R_LINEAR_____15_CM 0. 8160. DISPLAY_IDENTIFIER C_N_SEG_T_AD_MAX_ER FORMAT "%4.0" /end CHARACTERISTIC
/begin CHARACTERISTIC c_n_seg_t_ad_raw_max_er "Maximum engine speed threshold for crankshaft target wheel monitoring" VALUE 0xffe4024a _REC_VAL_20_u1 8160. _CNV_A_R_LINEAR_____15_CM 0. 8160. DISPLAY_IDENTIFIER C_N_SEG_T_AD_RAW_MAX_ER FORMAT "%4.0" /end CHARACTERISTIC
/begin CHARACTERISTIC c_seg_t_ad_raw_crlc_er "ER segment adaptive values filtering coefficient for monitoring process" VALUE 0xffe402cc _REC_VAL_20_u2 0.99998474 _CNV_A_R_LINEAR_____37_CM 0. 0.99998474 DISPLAY_IDENTIFIER C_SEG_T_AD_RAW_CRLC_ER FORMAT "%7.5" /end CHARACTERISTIC
/begin MEASUREMENT seg_nr_er "ER segment counter for segment identification (0...NC_CYL_NR - 1)" UBYTE _CNV_A_R_LINEAR_____22_CM 1 100. 0. 12. DISPLAY_IDENTIFIER SEG_NR_ER ECU_ADDRESS 0x3fe752 FORMAT "%3.0" /end MEASUREMENT
/begin MEASUREMENT seg_nr_cbk_er "Cylinder bank i identification according actual ER segment NR" UBYTE _CNV_A_R_LINEAR_____22_CM 1 100. 0. 12. DISPLAY_IDENTIFIER SEG_NR_CBK_ER ECU_ADDRESS 0x3fe75e FORMAT "%3.0" /end MEASUREMENT
/begin AXIS_PTS ldp_seg_nr_er "" 0xffe4118f seg_nr_cbk_er _REC_AXS_20_u1 12. _CNV_A_R_LINEAR_____0_CM 6 0. 12. DISPLAY_IDENTIFIER LDP_SEG_NR_ER FORMAT "%3.0" /end AXIS_PTS
/begin CHARACTERISTIC id_seg_nr_cbk_er "Table for bankwise ER segment cylinder identification" CURVE 0xffe40a7b _REC_CUR_20_u1_u1 255. _CNV_A_R_LINEAR_____0_CM 0. 255. DISPLAY_IDENTIFIER ID_SEG_NR_CBK_ER FORMAT "%3.0"
 /begin AXIS_DESCR COM_AXIS seg_nr_cbk_er _CNV_A_R_LINEAR_____0_CM 6 0. 12. FORMAT "%3.0" AXIS_PTS_REF ldp_seg_nr_er /end AXIS_DESCR
/end CHARACTERISTIC
/begin CHARACTERISTIC c_tps_grd_dly_er_ad "Fade out duration when maximum throttle gradient has been detected" VALUE 0xffe402d6 _REC_VAL_20_u2 655.34 _CNV_A_R_LINEAR_____4_CM 1.e-002 655.35 DISPLAY_IDENTIFIER C_TPS_GRD_DLY_ER_AD FORMAT "%5.2" /end CHARACTERISTIC
/begin CHARACTERISTIC c_seg_t_mes_min "ER minimum valid segment time" VALUE 0xffe402d2 _REC_VAL_20_u2 65535. _CNV_A_R_LINEAR_____428_CM 0. 65535. DISPLAY_IDENTIFIER C_SEG_T_MES_MIN FORMAT "%5.0" /end CHARACTERISTIC
/begin CHARACTERISTIC c_seg_t_mes_max "ER maximum valid segment time" VALUE 0xffe402d0 _REC_VAL_20_u2 65535. _CNV_A_R_LINEAR_____428_CM 0. 65535. DISPLAY_IDENTIFIER C_SEG_T_MES_MAX FORMAT "%5.0" /end CHARACTERISTIC
/begin CHARACTERISTIC c_seg_t_fast_ad_crlc_er "Fast ER segment adaptive values filtering coefficient (fast learning phase)" VALUE 0xffe402ce _REC_VAL_20_u2 0.99998474 _CNV_A_R_LINEAR_____37_CM 0. 0.99998474 DISPLAY_IDENTIFIER C_SEG_T_FAST_AD_CRLC_ER FORMAT "%7.5" /end CHARACTERISTIC
/begin CHARACTERISTIC c_seg_t_ad_crlc_er_eol "EOL specific filtering coefficient for ER segment adaptive values learning process" VALUE 0xffe402ca _REC_VAL_20_u2 0.99998474 _CNV_A_R_LINEAR_____37_CM 0. 0.99998474 DISPLAY_IDENTIFIER C_SEG_T_AD_CRLC_ER_EOL FORMAT "%7.5" /end CHARACTERISTIC
/begin CHARACTERISTIC c_seg_t_ad_crlc_er "Nominal ER segment adaptive values filtering coefficient" VALUE 0xffe402c8 _REC_VAL_20_u2 0.99998474 _CNV_A_R_LINEAR_____37_CM 0. 0.99998474 DISPLAY_IDENTIFIER C_SEG_T_AD_CRLC_ER FORMAT "%7.5" /end CHARACTERISTIC
/begin CHARACTERISTIC c_seg_t_ad_cor_drv1_max_er_eol "Maximum value of DRV1_ER (dynamic part of engine roughness) for crankshaft target wheel learning for EOL request mode" VALUE 0xffe402c6 _REC_VAL_20_u2 32767. _CNV_A_R_LINEAR_____428_CM 0. 32767. DISPLAY_IDENTIFIER C_SEG_T_AD_COR_DRV1_MAX_ER_EOL FORMAT "%5.0" /end CHARACTERISTIC
/begin CHARACTERISTIC c_seg_ad_dif_max_er "Maximum range for difference between same physical segment adaptive values" VALUE 0xffe402c2 _REC_VAL_20_u2 7.8123 _CNV_A_R_LINEAR_____567_CM 0. 7.8123 DISPLAY_IDENTIFIER C_SEG_AD_DIF_MAX_ER FORMAT "%6.4" /end CHARACTERISTIC
/begin CHARACTERISTIC c_nr_seg_drv1_er_min_eol "Minimum number of segments for engine roughness dynamic part for EOL request mode" VALUE 0xffe4024f _REC_VAL_20_u1 255. _CNV_A_R_LINEAR_____0_CM 0. 255. DISPLAY_IDENTIFIER C_NR_SEG_DRV1_ER_MIN_EOL FORMAT "%3.0" /end CHARACTERISTIC
/begin CHARACTERISTIC c_nr_seg_ad_act_min_eol "Minimum segments number in fuel cut-off mode before triggering ER segment adaptive learning process for EOL request mode" VALUE 0xffe4024d _REC_VAL_20_u1 255. _CNV_A_R_LINEAR_____0_CM 0. 255. DISPLAY_IDENTIFIER C_NR_SEG_AD_ACT_MIN_EOL FORMAT "%3.0" /end CHARACTERISTIC
/begin CHARACTERISTIC c_n_seg_t_ad_min_er_eol "Minimum engine speed threshold for crankshaft target wheel learning for EOL request mode" VALUE 0xffe40249 _REC_VAL_20_u1 8160. _CNV_A_R_LINEAR_____15_CM 0. 8160. DISPLAY_IDENTIFIER C_N_SEG_T_AD_MIN_ER_EOL FORMAT "%4.0" /end CHARACTERISTIC
/begin CHARACTERISTIC c_n_seg_t_ad_max_er_eol "Maximum engine speed threshold for crankshaft target wheel learning for EOL request mode" VALUE 0xffe40247 _REC_VAL_20_u1 8160. _CNV_A_R_LINEAR_____15_CM 0. 8160. DISPLAY_IDENTIFIER C_N_SEG_T_AD_MAX_ER_EOL FORMAT "%4.0" /end CHARACTERISTIC
/begin CHARACTERISTIC c_maf_dif_dly_er_ad "Fade out duration when maximum air-mass gradient has been detected" VALUE 0xffe402bc _REC_VAL_20_u2 655.34 _CNV_A_R_LINEAR_____4_CM 1.e-002 655.35 DISPLAY_IDENTIFIER C_MAF_DIF_DLY_ER_AD FORMAT "%5.2" /end CHARACTERISTIC
/begin CHARACTERISTIC c_load_mis_dif_dly_er_ad "Fade out duration when maximum actual torque gradient has been detected" VALUE 0xffe402ba _REC_VAL_20_u2 655.35 _CNV_A_R_LINEAR_____4_CM 0. 655.35 DISPLAY_IDENTIFIER C_LOAD_MIS_DIF_DLY_ER_AD FORMAT "%5.2" /end CHARACTERISTIC
/begin CHARACTERISTIC c_fac_drv2_zdly_er "Weighting factor for engine roughness curvative component calculation (correction amount) after start" VALUE 0xffe402b8 _REC_VAL_20_u2 4. _CNV_A_R_LINEAR_____568_CM 0. 4. DISPLAY_IDENTIFIER C_FAC_DRV2_ZDLY_ER FORMAT "%6.5" /end CHARACTERISTIC
/begin CHARACTERISTIC c_crlc_drv2_zdly_er "Correlation factor for engine roughness curvature component calculation after start" VALUE 0xffe40244 _REC_VAL_20_u1 0.9960940000000002 _CNV_A_R_LINEAR_____50_CM 0. 0.996094 DISPLAY_IDENTIFIER C_CRLC_DRV2_ZDLY_ER FORMAT "%5.3" /end CHARACTERISTIC
/begin MEASUREMENT fac_gain_er[0] "ER multiplicative correction components" UWORD _CNV_A_R_LINEAR_____569_CM 1 100. 0. 2. DISPLAY_IDENTIFIER FAC_GAIN_ER_0 ECU_ADDRESS 0x3fd80a BYTE_ORDER MSB_LAST FORMAT "%6.5" /end MEASUREMENT
/begin MEASUREMENT fac_gain_er[1] "ER multiplicative correction components" UWORD _CNV_A_R_LINEAR_____569_CM 1 100. 0. 2. DISPLAY_IDENTIFIER FAC_GAIN_ER_1 ECU_ADDRESS 0x3fd80c BYTE_ORDER MSB_LAST FORMAT "%6.5" /end MEASUREMENT
/begin MEASUREMENT fac_gain_er[2] "ER multiplicative correction components" UWORD _CNV_A_R_LINEAR_____569_CM 1 100. 0. 2. DISPLAY_IDENTIFIER FAC_GAIN_ER_2 ECU_ADDRESS 0x3fd80e BYTE_ORDER MSB_LAST FORMAT "%6.5" /end MEASUREMENT
/begin MEASUREMENT fac_gain_er[3] "ER multiplicative correction components" UWORD _CNV_A_R_LINEAR_____569_CM 1 100. 0. 2. DISPLAY_IDENTIFIER FAC_GAIN_ER_3 ECU_ADDRESS 0x3fd810 BYTE_ORDER MSB_LAST FORMAT "%6.5" /end MEASUREMENT
/begin MEASUREMENT fac_gain_er[4] "ER multiplicative correction components" UWORD _CNV_A_R_LINEAR_____569_CM 1 100. 0. 2. DISPLAY_IDENTIFIER FAC_GAIN_ER_4 ECU_ADDRESS 0x3fd812 BYTE_ORDER MSB_LAST FORMAT "%6.5" /end MEASUREMENT
/begin MEASUREMENT fac_gain_er[5] "ER multiplicative correction components" UWORD _CNV_A_R_LINEAR_____569_CM 1 100. 0. 2. DISPLAY_IDENTIFIER FAC_GAIN_ER_5 ECU_ADDRESS 0x3fd814 BYTE_ORDER MSB_LAST FORMAT "%6.5" /end MEASUREMENT
/begin MEASUREMENT fac_drv2_er "Weighting factor for engine roughness curvative component calculation (correction amount)" UWORD _CNV_A_R_LINEAR_____568_CM 1 100. 0. 4. DISPLAY_IDENTIFIER FAC_DRV2_ER ECU_ADDRESS 0x3fd826 BYTE_ORDER MSB_LAST FORMAT "%6.5" /end MEASUREMENT
/begin MEASUREMENT fac_add_er[0] "ER additive correction components" SWORD _CNV_A_R_LINEAR_____428_CM 1 100. -32768. 32767. DISPLAY_IDENTIFIER FAC_ADD_ER_0 ECU_ADDRESS 0x3fd816 BYTE_ORDER MSB_LAST FORMAT "%6.0" /end MEASUREMENT
/begin MEASUREMENT fac_add_er[1] "ER additive correction components" SWORD _CNV_A_R_LINEAR_____428_CM 1 100. -32768. 32767. DISPLAY_IDENTIFIER FAC_ADD_ER_1 ECU_ADDRESS 0x3fd818 BYTE_ORDER MSB_LAST FORMAT "%6.0" /end MEASUREMENT
/begin MEASUREMENT fac_add_er[2] "ER additive correction components" SWORD _CNV_A_R_LINEAR_____428_CM 1 100. -32768. 32767. DISPLAY_IDENTIFIER FAC_ADD_ER_2 ECU_ADDRESS 0x3fd81a BYTE_ORDER MSB_LAST FORMAT "%6.0" /end MEASUREMENT
/begin MEASUREMENT fac_add_er[3] "ER additive correction components" SWORD _CNV_A_R_LINEAR_____428_CM 1 100. -32768. 32767. DISPLAY_IDENTIFIER FAC_ADD_ER_3 ECU_ADDRESS 0x3fd81c BYTE_ORDER MSB_LAST FORMAT "%6.0" /end MEASUREMENT
/begin MEASUREMENT fac_add_er[4] "ER additive correction components" SWORD _CNV_A_R_LINEAR_____428_CM 1 100. -32768. 32767. DISPLAY_IDENTIFIER FAC_ADD_ER_4 ECU_ADDRESS 0x3fd81e BYTE_ORDER MSB_LAST FORMAT "%6.0" /end MEASUREMENT
/begin MEASUREMENT fac_add_er[5] "ER additive correction components" SWORD _CNV_A_R_LINEAR_____428_CM 1 100. -32768. 32767. DISPLAY_IDENTIFIER FAC_ADD_ER_5 ECU_ADDRESS 0x3fd820 BYTE_ORDER MSB_LAST FORMAT "%6.0" /end MEASUREMENT
/begin MEASUREMENT crlc_drv2_er "Correlation factor for engine roughness curvature component calculation" UBYTE _CNV_A_R_LINEAR_____50_CM 1 100. 0. 0.996094 DISPLAY_IDENTIFIER CRLC_DRV2_ER ECU_ADDRESS 0x3fe75d FORMAT "%5.3" /end MEASUREMENT
/begin CHARACTERISTIC ip_seg_2_ad_cor "Adaptive value correction versus engine speed for segment 2 & 5" CURVE 0xffe43464 _REC_CUR_20_u2_u1 15.6248 _CNV_A_R_LINEAR_____570_CM -7.8125 7.8123 DISPLAY_IDENTIFIER IP_SEG_2_AD_COR FORMAT "%7.4"
 /begin AXIS_DESCR COM_AXIS n_32 _CNV_A_R_LINEAR_____15_CM 6 0. 8160. FORMAT "%4.0" AXIS_PTS_REF ldpm_n_32__seg_ad_cor /end AXIS_DESCR
/end CHARACTERISTIC
/begin CHARACTERISTIC ip_seg_1_ad_cor "Adaptive value correction versus engine speed for segment 1 & 4" CURVE 0xffe43458 _REC_CUR_20_u2_u1 15.6248 _CNV_A_R_LINEAR_____570_CM -7.8125 7.8123 DISPLAY_IDENTIFIER IP_SEG_1_AD_COR FORMAT "%7.4"
 /begin AXIS_DESCR COM_AXIS n_32 _CNV_A_R_LINEAR_____15_CM 6 0. 8160. FORMAT "%4.0" AXIS_PTS_REF ldpm_n_32__seg_ad_cor /end AXIS_DESCR
/end CHARACTERISTIC
/begin CHARACTERISTIC ip_maf_dif_max_er_ad__maf "Maximum air-mass gradient per SEG for fade out condition" CURVE 0xffe4344c _REC_CUR_20_u2_u2 1389. _CNV_A_R_LINEAR_____108_CM 0. 1389. DISPLAY_IDENTIFIER IP_MAF_DIF_MAX_ER_AD__MAF FORMAT "%7.2"
 /begin AXIS_DESCR COM_AXIS maf _CNV_A_R_LINEAR_____108_CM 6 0. 1389. FORMAT "%7.2" AXIS_PTS_REF ldp_maf__maf_dif_max_er_ad /end AXIS_DESCR
/end CHARACTERISTIC
/begin CHARACTERISTIC ip_fac_load_drv2_er_mt "Weighting factor for DRV2 component calculation (engine load dependent correction amount) - MT vehicle" CURVE 0xffe42ff8 _REC_CUR_20_u1_u2 1.99220002 _CNV_A_R_LINEAR_____39_CM 0. 1.99220002 DISPLAY_IDENTIFIER IP_FAC_LOAD_DRV2_ER_MT FORMAT "%5.3"
 /begin AXIS_DESCR COM_AXIS load_mis _CNV_A_R_LINEAR_____571_CM 12 0. 99.99694824 AXIS_PTS_REF ldp_load_ip_fac_load_drv2_er_mt /end AXIS_DESCR
/end CHARACTERISTIC
/begin CHARACTERISTIC ip_fac_load_drv2_er_at "Weighting factor for DRV2 component calculation (engine load dependent correction amount)  - AT vehicle" CURVE 0xffe42fec _REC_CUR_20_u1_u2 1.99220002 _CNV_A_R_LINEAR_____39_CM 0. 1.99220002 DISPLAY_IDENTIFIER IP_FAC_LOAD_DRV2_ER_AT FORMAT "%5.3"
 /begin AXIS_DESCR COM_AXIS load_mis _CNV_A_R_LINEAR_____571_CM 12 0. 99.99694824 AXIS_PTS_REF ldp_load_ip_fac_load_drv2_er_at /end AXIS_DESCR
/end CHARACTERISTIC
/begin CHARACTERISTIC ip_fac_gain_er_5_mt "ER cylinder 5 multiplicative segment dependent factor for torsion correction with MT" CURVE 0xffe43434 _REC_CUR_20_u2_u1 2. _CNV_A_R_LINEAR_____569_CM 0. 2. DISPLAY_IDENTIFIER IP_FAC_GAIN_ER_5_MT FORMAT "%6.5"
 /begin AXIS_DESCR COM_AXIS n_32 _CNV_A_R_LINEAR_____15_CM 6 0. 8160. FORMAT "%4.0" AXIS_PTS_REF ldpm_n_32__fac_er_5_mt /end AXIS_DESCR
/end CHARACTERISTIC
/begin CHARACTERISTIC ip_fac_gain_er_5_at "ER cylinder 5 multiplicative segment dependent factor for torsion correction with AT" CURVE 0xffe43428 _REC_CUR_20_u2_u1 2. _CNV_A_R_LINEAR_____569_CM 0. 2. DISPLAY_IDENTIFIER IP_FAC_GAIN_ER_5_AT FORMAT "%6.5"
 /begin AXIS_DESCR COM_AXIS n_32 _CNV_A_R_LINEAR_____15_CM 6 0. 8160. FORMAT "%4.0" AXIS_PTS_REF ldpm_n_32__fac_er_5_at /end AXIS_DESCR
/end CHARACTERISTIC
/begin CHARACTERISTIC ip_fac_gain_er_4_mt "ER cylinder 4 multiplicative segment dependent factor for torsion correction with MT" CURVE 0xffe4341c _REC_CUR_20_u2_u1 2. _CNV_A_R_LINEAR_____569_CM 0. 2. DISPLAY_IDENTIFIER IP_FAC_GAIN_ER_4_MT FORMAT "%6.5"
 /begin AXIS_DESCR COM_AXIS n_32 _CNV_A_R_LINEAR_____15_CM 6 0. 8160. FORMAT "%4.0" AXIS_PTS_REF ldpm_n_32__fac_er_4_mt /end AXIS_DESCR
/end CHARACTERISTIC
/begin CHARACTERISTIC ip_fac_gain_er_4_at "ER cylinder 4 multiplicative segment dependent factor for torsion correction with AT" CURVE 0xffe43410 _REC_CUR_20_u2_u1 2. _CNV_A_R_LINEAR_____569_CM 0. 2. DISPLAY_IDENTIFIER IP_FAC_GAIN_ER_4_AT FORMAT "%6.5"
 /begin AXIS_DESCR COM_AXIS n_32 _CNV_A_R_LINEAR_____15_CM 6 0. 8160. FORMAT "%4.0" AXIS_PTS_REF ldpm_n_32__fac_er_4_at /end AXIS_DESCR
/end CHARACTERISTIC
/begin CHARACTERISTIC ip_fac_gain_er_3_mt "ER cylinder 3 multiplicative segment dependent factor for torsion correction with MT" CURVE 0xffe43404 _REC_CUR_20_u2_u1 2. _CNV_A_R_LINEAR_____569_CM 0. 2. DISPLAY_IDENTIFIER IP_FAC_GAIN_ER_3_MT FORMAT "%6.5"
 /begin AXIS_DESCR COM_AXIS n_32 _CNV_A_R_LINEAR_____15_CM 6 0. 8160. FORMAT "%4.0" AXIS_PTS_REF ldpm_n_32__fac_er_3_mt /end AXIS_DESCR
/end CHARACTERISTIC
/begin CHARACTERISTIC ip_fac_gain_er_3_at "ER cylinder 3 multiplicative segment dependent factor for torsion correction with AT" CURVE 0xffe433f8 _REC_CUR_20_u2_u1 2. _CNV_A_R_LINEAR_____569_CM 0. 2. DISPLAY_IDENTIFIER IP_FAC_GAIN_ER_3_AT FORMAT "%6.5"
 /begin AXIS_DESCR COM_AXIS n_32 _CNV_A_R_LINEAR_____15_CM 6 0. 8160. FORMAT "%4.0" AXIS_PTS_REF ldpm_n_32__fac_er_3_at /end AXIS_DESCR
/end CHARACTERISTIC
/begin CHARACTERISTIC ip_fac_gain_er_2_mt "ER cylinder 2 multiplicative segment dependent factor for torsion correction with MT" CURVE 0xffe433ec _REC_CUR_20_u2_u1 2. _CNV_A_R_LINEAR_____569_CM 0. 2. DISPLAY_IDENTIFIER IP_FAC_GAIN_ER_2_MT FORMAT "%6.5"
 /begin AXIS_DESCR COM_AXIS n_32 _CNV_A_R_LINEAR_____15_CM 6 0. 8160. FORMAT "%4.0" AXIS_PTS_REF ldpm_n_32__fac_er_2_mt /end AXIS_DESCR
/end CHARACTERISTIC
/begin CHARACTERISTIC ip_fac_gain_er_2_at "ER cylinder 2 multiplicative segment dependent factor for torsion correction with AT" CURVE 0xffe433e0 _REC_CUR_20_u2_u1 2. _CNV_A_R_LINEAR_____569_CM 0. 2. DISPLAY_IDENTIFIER IP_FAC_GAIN_ER_2_AT FORMAT "%6.5"
 /begin AXIS_DESCR COM_AXIS n_32 _CNV_A_R_LINEAR_____15_CM 6 0. 8160. FORMAT "%4.0" AXIS_PTS_REF ldpm_n_32__fac_er_2_at /end AXIS_DESCR
/end CHARACTERISTIC
/begin CHARACTERISTIC ip_fac_gain_er_1_mt "ER cylinder 1 multiplicative segment dependent factor for torsion correction with MT" CURVE 0xffe433d4 _REC_CUR_20_u2_u1 2. _CNV_A_R_LINEAR_____569_CM 0. 2. DISPLAY_IDENTIFIER IP_FAC_GAIN_ER_1_MT FORMAT "%6.5"
 /begin AXIS_DESCR COM_AXIS n_32 _CNV_A_R_LINEAR_____15_CM 6 0. 8160. FORMAT "%4.0" AXIS_PTS_REF ldpm_n_32__fac_er_1_mt /end AXIS_DESCR
/end CHARACTERISTIC
/begin CHARACTERISTIC ip_fac_gain_er_1_at "ER cylinder 1 multiplicative segment dependent factor for torsion correction with AT" CURVE 0xffe433c8 _REC_CUR_20_u2_u1 2. _CNV_A_R_LINEAR_____569_CM 0. 2. DISPLAY_IDENTIFIER IP_FAC_GAIN_ER_1_AT FORMAT "%6.5"
 /begin AXIS_DESCR COM_AXIS n_32 _CNV_A_R_LINEAR_____15_CM 6 0. 8160. FORMAT "%4.0" AXIS_PTS_REF ldpm_n_32__fac_er_1_at /end AXIS_DESCR
/end CHARACTERISTIC
/begin CHARACTERISTIC ip_fac_gain_er_0_mt "ER cylinder 0 multiplicative segment dependent factor for torsion correction with MT" CURVE 0xffe433bc _REC_CUR_20_u2_u1 2. _CNV_A_R_LINEAR_____569_CM 0. 2. DISPLAY_IDENTIFIER IP_FAC_GAIN_ER_0_MT FORMAT "%6.5"
 /begin AXIS_DESCR COM_AXIS n_32 _CNV_A_R_LINEAR_____15_CM 6 0. 8160. FORMAT "%4.0" AXIS_PTS_REF ldpm_n_32__fac_er_0_mt /end AXIS_DESCR
/end CHARACTERISTIC
/begin CHARACTERISTIC ip_fac_gain_er_0_at "ER cylinder 0 multiplicative segment dependent factor for torsion correction with AT" CURVE 0xffe433b0 _REC_CUR_20_u2_u1 2. _CNV_A_R_LINEAR_____569_CM 0. 2. DISPLAY_IDENTIFIER IP_FAC_GAIN_ER_0_AT FORMAT "%6.5"
 /begin AXIS_DESCR COM_AXIS n_32 _CNV_A_R_LINEAR_____15_CM 6 0. 8160. FORMAT "%4.0" AXIS_PTS_REF ldpm_n_32__fac_er_0_at /end AXIS_DESCR
/end CHARACTERISTIC
/begin CHARACTERISTIC ip_fac_add_er_4_at "ER cylinder 4 additive segment dependet factor for torsion correction with AT" MAP 0xffe43290 _REC_MAP_20_u2_u1_u2 65535. _CNV_A_R_LINEAR_____572_CM -32768. 32767. DISPLAY_IDENTIFIER IP_FAC_ADD_ER_4_AT FORMAT "%6.0"
 /begin AXIS_DESCR COM_AXIS n_32 _CNV_A_R_LINEAR_____15_CM 6 0. 8160. FORMAT "%4.0" AXIS_PTS_REF ldpm_n_32__fac_er_4_at /end AXIS_DESCR
 /begin AXIS_DESCR COM_AXIS load_mis _CNV_A_R_LINEAR_____571_CM 6 0. 99.99694824 AXIS_PTS_REF ldp_load_mis__fac_add_er_4_at /end AXIS_DESCR
/end CHARACTERISTIC
/begin CHARACTERISTIC ip_fac_add_er_4_mt "ER cylinder 4 additive segment dependent factor for torsion correction with MT" MAP 0xffe432d8 _REC_MAP_20_u2_u1_u2 65535. _CNV_A_R_LINEAR_____572_CM -32768. 32767. DISPLAY_IDENTIFIER IP_FAC_ADD_ER_4_MT FORMAT "%6.0"
 /begin AXIS_DESCR COM_AXIS n_32 _CNV_A_R_LINEAR_____15_CM 6 0. 8160. FORMAT "%4.0" AXIS_PTS_REF ldpm_n_32__fac_er_4_mt /end AXIS_DESCR
 /begin AXIS_DESCR COM_AXIS load_mis _CNV_A_R_LINEAR_____571_CM 6 0. 99.99694824 AXIS_PTS_REF ldp_load_mis__fac_add_er_4_mt /end AXIS_DESCR
/end CHARACTERISTIC
/begin CHARACTERISTIC ip_fac_add_er_3_mt "ER cylinder 3 additive segment dependent factor for torsion correction with MT" MAP 0xffe43248 _REC_MAP_20_u2_u1_u2 65535. _CNV_A_R_LINEAR_____572_CM -32768. 32767. DISPLAY_IDENTIFIER IP_FAC_ADD_ER_3_MT FORMAT "%6.0"
 /begin AXIS_DESCR COM_AXIS n_32 _CNV_A_R_LINEAR_____15_CM 6 0. 8160. FORMAT "%4.0" AXIS_PTS_REF ldpm_n_32__fac_er_3_mt /end AXIS_DESCR
 /begin AXIS_DESCR COM_AXIS load_mis _CNV_A_R_LINEAR_____571_CM 6 0. 99.99694824 AXIS_PTS_REF ldp_load_mis__fac_add_er_3_mt /end AXIS_DESCR
/end CHARACTERISTIC
/begin CHARACTERISTIC ip_fac_add_er_3_at "ER cylinder 3 additive segment dependent factor for torsion correction with AT" MAP 0xffe43200 _REC_MAP_20_u2_u1_u2 65535. _CNV_A_R_LINEAR_____572_CM -32768. 32767. DISPLAY_IDENTIFIER IP_FAC_ADD_ER_3_AT FORMAT "%6.0"
 /begin AXIS_DESCR COM_AXIS n_32 _CNV_A_R_LINEAR_____15_CM 6 0. 8160. FORMAT "%4.0" AXIS_PTS_REF ldpm_n_32__fac_er_3_at /end AXIS_DESCR
 /begin AXIS_DESCR COM_AXIS load_mis _CNV_A_R_LINEAR_____571_CM 6 0. 99.99694824 AXIS_PTS_REF ldp_load_mis__fac_add_er_3_at /end AXIS_DESCR
/end CHARACTERISTIC
/begin CHARACTERISTIC ip_fac_add_er_5_at "ER cylinder 5 additive segment dependent factor for torsion correction with AT" MAP 0xffe43320 _REC_MAP_20_u2_u1_u2 65535. _CNV_A_R_LINEAR_____572_CM -32768. 32767. DISPLAY_IDENTIFIER IP_FAC_ADD_ER_5_AT FORMAT "%6.0"
 /begin AXIS_DESCR COM_AXIS n_32 _CNV_A_R_LINEAR_____15_CM 6 0. 8160. FORMAT "%4.0" AXIS_PTS_REF ldpm_n_32__fac_er_5_at /end AXIS_DESCR
 /begin AXIS_DESCR COM_AXIS load_mis _CNV_A_R_LINEAR_____571_CM 6 0. 99.99694824 AXIS_PTS_REF ldp_load_mis__fac_add_er_5_at /end AXIS_DESCR
/end CHARACTERISTIC
/begin CHARACTERISTIC ip_fac_add_er_5_mt "ER cylinder 5 additive segment dependent factor for torsion correction with MT" MAP 0xffe43368 _REC_MAP_20_u2_u1_u2 65535. _CNV_A_R_LINEAR_____572_CM -32768. 32767. DISPLAY_IDENTIFIER IP_FAC_ADD_ER_5_MT FORMAT "%6.0"
 /begin AXIS_DESCR COM_AXIS n_32 _CNV_A_R_LINEAR_____15_CM 6 0. 8160. FORMAT "%4.0" AXIS_PTS_REF ldpm_n_32__fac_er_5_mt /end AXIS_DESCR
 /begin AXIS_DESCR COM_AXIS load_mis _CNV_A_R_LINEAR_____571_CM 6 0. 99.99694824 AXIS_PTS_REF ldp_load_mis__fac_add_er_5_mt /end AXIS_DESCR
/end CHARACTERISTIC
/begin CHARACTERISTIC ip_fac_add_er_1_at "ER cylinder 1 additive segment dependent factor for torsion correction with AT" MAP 0xffe430e0 _REC_MAP_20_u2_u1_u2 65535. _CNV_A_R_LINEAR_____572_CM -32768. 32767. DISPLAY_IDENTIFIER IP_FAC_ADD_ER_1_AT FORMAT "%6.0"
 /begin AXIS_DESCR COM_AXIS n_32 _CNV_A_R_LINEAR_____15_CM 6 0. 8160. FORMAT "%4.0" AXIS_PTS_REF ldpm_n_32__fac_er_1_at /end AXIS_DESCR
 /begin AXIS_DESCR COM_AXIS load_mis _CNV_A_R_LINEAR_____571_CM 6 0. 99.99694824 AXIS_PTS_REF ldp_load_mis__fac_add_er_1_at /end AXIS_DESCR
/end CHARACTERISTIC
/begin CHARACTERISTIC ip_fac_add_er_2_mt "ER cylinder 2 additive segment dependent factor for torsion correction with MT" MAP 0xffe431b8 _REC_MAP_20_u2_u1_u2 65535. _CNV_A_R_LINEAR_____572_CM -32768. 32767. DISPLAY_IDENTIFIER IP_FAC_ADD_ER_2_MT FORMAT "%6.0"
 /begin AXIS_DESCR COM_AXIS n_32 _CNV_A_R_LINEAR_____15_CM 6 0. 8160. FORMAT "%4.0" AXIS_PTS_REF ldpm_n_32__fac_er_2_mt /end AXIS_DESCR
 /begin AXIS_DESCR COM_AXIS load_mis _CNV_A_R_LINEAR_____571_CM 6 0. 99.99694824 AXIS_PTS_REF ldp_load_mis__fac_add_er_2_mt /end AXIS_DESCR
/end CHARACTERISTIC
/begin CHARACTERISTIC ip_fac_add_er_2_at "ER cylinder 2 additive segment dependent factor for torsion correction with AT" MAP 0xffe43170 _REC_MAP_20_u2_u1_u2 65535. _CNV_A_R_LINEAR_____572_CM -32768. 32767. DISPLAY_IDENTIFIER IP_FAC_ADD_ER_2_AT FORMAT "%6.0"
 /begin AXIS_DESCR COM_AXIS n_32 _CNV_A_R_LINEAR_____15_CM 6 0. 8160. FORMAT "%4.0" AXIS_PTS_REF ldpm_n_32__fac_er_2_at /end AXIS_DESCR
 /begin AXIS_DESCR COM_AXIS load_mis _CNV_A_R_LINEAR_____571_CM 6 0. 99.99694824 AXIS_PTS_REF ldp_load_mis__fac_add_er_2_at /end AXIS_DESCR
/end CHARACTERISTIC
/begin CHARACTERISTIC ip_fac_add_er_1_mt "ER cylinder 1 additive segment dependent factor for torsion correction with MT" MAP 0xffe43128 _REC_MAP_20_u2_u1_u2 65535. _CNV_A_R_LINEAR_____572_CM -32768. 32767. DISPLAY_IDENTIFIER IP_FAC_ADD_ER_1_MT FORMAT "%6.0"
 /begin AXIS_DESCR COM_AXIS n_32 _CNV_A_R_LINEAR_____15_CM 6 0. 8160. FORMAT "%4.0" AXIS_PTS_REF ldpm_n_32__fac_er_1_mt /end AXIS_DESCR
 /begin AXIS_DESCR COM_AXIS load_mis _CNV_A_R_LINEAR_____571_CM 6 0. 99.99694824 AXIS_PTS_REF ldp_load_mis__fac_add_er_1_mt /end AXIS_DESCR
/end CHARACTERISTIC
/begin CHARACTERISTIC ip_crlc_drv2_er_at "Correlation factor for engine roughness curvature component calculation (correction duration) - AT vehicle" CURVE 0xffe42fd4 _REC_CUR_20_u1_u1 0.9960940000000002 _CNV_A_R_LINEAR_____50_CM 0. 0.996094 DISPLAY_IDENTIFIER IP_CRLC_DRV2_ER_AT FORMAT "%5.3"
 /begin AXIS_DESCR COM_AXIS n_32 _CNV_A_R_LINEAR_____15_CM 12 0. 8160. FORMAT "%4.0" AXIS_PTS_REF ldp_n_32_ip_crlc_drv2_er_at /end AXIS_DESCR
/end CHARACTERISTIC
/begin CHARACTERISTIC ip_crlc_drv2_er_mt "Correlation factor for engine roughness curvature component calculation (correction duration) - MT vehicle" CURVE 0xffe42fe0 _REC_CUR_20_u1_u1 0.9960940000000002 _CNV_A_R_LINEAR_____50_CM 0. 0.996094 DISPLAY_IDENTIFIER IP_CRLC_DRV2_ER_MT FORMAT "%5.3"
 /begin AXIS_DESCR COM_AXIS n_32 _CNV_A_R_LINEAR_____15_CM 12 0. 8160. FORMAT "%4.0" AXIS_PTS_REF ldp_n_32_ip_crlc_drv2_er_mt /end AXIS_DESCR
/end CHARACTERISTIC
/begin CHARACTERISTIC ip_fac_add_er_0_at "ER cylinder 0 additive segment dependent factor for torsion correction with AT" MAP 0xffe43050 _REC_MAP_20_u2_u1_u2 65535. _CNV_A_R_LINEAR_____572_CM -32768. 32767. DISPLAY_IDENTIFIER IP_FAC_ADD_ER_0_AT FORMAT "%6.0"
 /begin AXIS_DESCR COM_AXIS n_32 _CNV_A_R_LINEAR_____15_CM 6 0. 8160. FORMAT "%4.0" AXIS_PTS_REF ldpm_n_32__fac_er_0_at /end AXIS_DESCR
 /begin AXIS_DESCR COM_AXIS load_mis _CNV_A_R_LINEAR_____571_CM 6 0. 99.99694824 AXIS_PTS_REF ldp_load_mis__fac_add_er_0_at /end AXIS_DESCR
/end CHARACTERISTIC
/begin CHARACTERISTIC ip_fac_add_er_0_mt "ER cylinder 0 additive segment dependent factor for torsion correction with MT" MAP 0xffe43098 _REC_MAP_20_u2_u1_u2 65535. _CNV_A_R_LINEAR_____572_CM -32768. 32767. DISPLAY_IDENTIFIER IP_FAC_ADD_ER_0_MT FORMAT "%6.0"
 /begin AXIS_DESCR COM_AXIS n_32 _CNV_A_R_LINEAR_____15_CM 6 0. 8160. FORMAT "%4.0" AXIS_PTS_REF ldpm_n_32__fac_er_0_mt /end AXIS_DESCR
 /begin AXIS_DESCR COM_AXIS load_mis _CNV_A_R_LINEAR_____571_CM 6 0. 99.99694824 AXIS_PTS_REF ldp_load_mis__fac_add_er_0_mt /end AXIS_DESCR
/end CHARACTERISTIC
/begin CHARACTERISTIC c_t_drv2_zdly_er "Delay for specific curvative component calculation during after start" VALUE 0xffe402d4 _REC_VAL_20_u2 655.35 _CNV_A_R_LINEAR_____4_CM 0. 655.35 DISPLAY_IDENTIFIER C_T_DRV2_ZDLY_ER FORMAT "%5.2" /end CHARACTERISTIC
/begin CHARACTERISTIC c_accout_dly_er_ad "Fade out duration when air-conditioning compressor has been switched on or off" VALUE 0xffe402b4 _REC_VAL_20_u2 655.34 _CNV_A_R_LINEAR_____4_CM 1.e-002 655.35 DISPLAY_IDENTIFIER C_ACCOUT_DLY_ER_AD FORMAT "%5.2" /end CHARACTERISTIC
/begin CHARACTERISTIC ip_tps_grd_max_er_ad__tps_av "Maximum throttle gradient threshold for fade out condition" CURVE 0xffe40250 _REC_CUR_20_u1_u2 2987.5 _CNV_A_R_LINEAR_____52_CM 0. 2987.5 DISPLAY_IDENTIFIER IP_TPS_GRD_MAX_ER_AD__TPS_AV FORMAT "%6.1"
 /begin AXIS_DESCR COM_AXIS tps_av _CNV_A_R_LINEAR_____53_CM 6 0. 119.5 FORMAT "%7.3" AXIS_PTS_REF ldp_tps_av__tps_grd_max_er_ad /end AXIS_DESCR
/end CHARACTERISTIC
/begin CHARACTERISTIC ip_load_mis_dif_max_er_ad "Maximum actual torque gradient fade out condition" CURVE 0xffe43440 _REC_CUR_20_u2_u2 100. _CNV_A_R_LINEAR_____415_CM 0. 100. DISPLAY_IDENTIFIER IP_LOAD_MIS_DIF_MAX_ER_AD FORMAT "%7.3"
 /begin AXIS_DESCR COM_AXIS load_mis _CNV_A_R_LINEAR_____415_CM 6 0. 100. FORMAT "%7.3" AXIS_PTS_REF ldp_load_mis__load_mis_dif_max /end AXIS_DESCR
/end CHARACTERISTIC
/begin MEASUREMENT lv_seg_ad_req_eol "EOL specific request for ER segment adaptive learning process" UBYTE _CNV_S_2_RANGE______21_CM 1 100. 0. 1. DISPLAY_IDENTIFIER LV_SEG_AD_REQ_EOL ECU_ADDRESS 0x3fe763 /end MEASUREMENT
/begin MEASUREMENT lv_seg_ad_rst_eol "EOL specific request to reset ER segment adaptive values" UBYTE _CNV_S_2_RANGE______21_CM 1 100. 0. 1. DISPLAY_IDENTIFIER LV_SEG_AD_RST_EOL ECU_ADDRESS 0x3fe764 /end MEASUREMENT
/begin MEASUREMENT lv_err_det_crk "Crankshaft signal detected error (before debouncing)" UBYTE _CNV_S_2_RANGE______21_CM 1 100. 0. 1. DISPLAY_IDENTIFIER LV_ERR_DET_CRK ECU_ADDRESS 0x3fe761 /end MEASUREMENT
/begin MEASUREMENT seg_t_mes "Engine roughness segment time (Applicative software)" UWORD _CNV_A_R_LINEAR_____428_CM 1 100. 0. 65535. DISPLAY_IDENTIFIER SEG_T_MES ECU_ADDRESS 0x3fd824 BYTE_ORDER MSB_LAST FORMAT "%5.0" /end MEASUREMENT
/begin MEASUREMENT lv_ena_seg_t_mes "Engine roughness segment time validity flag" UBYTE _CNV_S_2_RANGE______21_CM 1 100. 0. 1. DISPLAY_IDENTIFIER LV_ENA_SEG_T_MES ECU_ADDRESS 0x3fe75f /end MEASUREMENT
/begin MEASUREMENT lv_seg_ad_fdout "Boolean for segment adaptation fade out condition" UBYTE _CNV_S_2_RANGE______21_CM 1 100. 0. 1. DISPLAY_IDENTIFIER LV_SEG_AD_FDOUT ECU_ADDRESS 0x3fe760 /end MEASUREMENT
/begin MEASUREMENT seg_ad_cor "Segment adaptive values correction versus engine speed (for each segment)" SWORD _CNV_A_R_LINEAR_____566_CM 1 100. -7.8125 7.8123 DISPLAY_IDENTIFIER SEG_AD_COR ECU_ADDRESS 0x3fd822 BYTE_ORDER MSB_LAST FORMAT "%7.4" /end MEASUREMENT
/begin MEASUREMENT seg_ad_dif_1 "ER adaptive values difference on same physical segment (Segment 1 & 4)" UWORD _CNV_A_R_LINEAR_____567_CM 1 100. 0. 7.8123 DISPLAY_IDENTIFIER SEG_AD_DIF_1 ECU_ADDRESS 0x3fd82c BYTE_ORDER MSB_LAST FORMAT "%6.4" /end MEASUREMENT
/begin MEASUREMENT seg_ad_dif_0 "ER adaptive values difference on same physical segment (Segment 0 & 3)" UWORD _CNV_A_R_LINEAR_____567_CM 1 100. 0. 7.8123 DISPLAY_IDENTIFIER SEG_AD_DIF_0 ECU_ADDRESS 0x3fd82a BYTE_ORDER MSB_LAST FORMAT "%6.4" /end MEASUREMENT
/begin MEASUREMENT seg_ad_dif_2 "ER adaptive values difference on same physical segment (Segment 2 & 5)" UWORD _CNV_A_R_LINEAR_____567_CM 1 100. 0. 7.8123 DISPLAY_IDENTIFIER SEG_AD_DIF_2 ECU_ADDRESS 0x3fd82e BYTE_ORDER MSB_LAST FORMAT "%6.4" /end MEASUREMENT
/begin MEASUREMENT seg_t_ad_crlc_er "ER segment adaptive values filtering coefficient" UWORD _CNV_A_R_LINEAR_____37_CM 1 100. 0. 0.99998474 DISPLAY_IDENTIFIER SEG_T_AD_CRLC_ER ECU_ADDRESS 0x3fd828 BYTE_ORDER MSB_LAST FORMAT "%7.6" /end MEASUREMENT
/begin CHARACTERISTIC lc_seg_ad_rst_ena_eol "Specific EOL request enable flag to reset ER segment adaptive values & learning process" VALUE 0xffe40258 _REC_VAL_20_u1 1. _CNV_A_R_LINEAR_____0_CM 0. 1. DISPLAY_IDENTIFIER LC_SEG_AD_RST_ENA_EOL FORMAT "%2.0" /end CHARACTERISTIC
/begin CHARACTERISTIC lc_seg_ad_req_ena_eol "Specific EOL request enable flag for ER segment adaptive value learning process" VALUE 0xffe40257 _REC_VAL_20_u1 1. _CNV_A_R_LINEAR_____0_CM 0. 1. DISPLAY_IDENTIFIER LC_SEG_AD_REQ_ENA_EOL FORMAT "%2.0" /end CHARACTERISTIC
/begin CHARACTERISTIC lc_conf_gain_add_er "ER gain/additive correction enable flag" VALUE 0xffe40256 _REC_VAL_20_u1 1. _CNV_A_R_LINEAR_____0_CM 0. 1. DISPLAY_IDENTIFIER LC_CONF_GAIN_ADD_ER FORMAT "%2.0" /end CHARACTERISTIC
/begin AXIS_PTS ldpm_n_32__seg_ad_cor "" 0xffe402ad n_32 _REC_AXS_20_u1 8160. _CNV_A_R_LINEAR_____15_CM 6 0. 8160. DISPLAY_IDENTIFIER LDPM_N_32__SEG_AD_COR FORMAT "%4.0" /end AXIS_PTS
/begin AXIS_PTS ldp_maf__maf_dif_max_er_ad "" 0xffe4355a maf _REC_AXS_20_u2 1389. _CNV_A_R_LINEAR_____108_CM 6 0. 1389. DISPLAY_IDENTIFIER LDP_MAF__MAF_DIF_MAX_ER_AD FORMAT "%7.2" /end AXIS_PTS
/begin AXIS_PTS ldp_tps_av__tps_grd_max_er_ad "" 0xffe43568 tps_av _REC_AXS_20_u2 119.5 _CNV_A_R_LINEAR_____53_CM 6 0. 119.5 DISPLAY_IDENTIFIER LDP_TPS_AV__TPS_GRD_MAX_ER_AD FORMAT "%7.3" /end AXIS_PTS
/begin MEASUREMENT lv_inh_seg_ad "ER segment adaptive process inhibition flag" UBYTE _CNV_S_2_RANGE______21_CM 1 100. 0. 1. DISPLAY_IDENTIFIER LV_INH_SEG_AD ECU_ADDRESS 0x3fe762 /end MEASUREMENT
/begin MEASUREMENT lv_err_seg_t "Prsent failure for segment time adaptive values" UBYTE _CNV_S_2_RANGE______21_CM 1 100. 0. 1. DISPLAY_IDENTIFIER LV_ERR_SEG_T ECU_ADDRESS 0x3fb9c4 /end MEASUREMENT
/begin MEASUREMENT lv_err_seg_t_ad "Prsent failure for segment time adaptive values" UBYTE _CNV_S_2_RANGE______21_CM 1 100. 0. 1. DISPLAY_IDENTIFIER LV_ERR_SEG_T_AD ECU_ADDRESS 0x3fb9c0 /end MEASUREMENT
/begin AXIS_PTS ldp_load_mis__load_mis_dif_max "" 0xffe4354c load_mis _REC_AXS_20_u2 100. _CNV_A_R_LINEAR_____415_CM 6 0. 100. DISPLAY_IDENTIFIER LDP_LOAD_MIS__LOAD_MIS_DIF_MAX FORMAT "%7.3" /end AXIS_PTS
/begin CHARACTERISTIC ip_fac_n_drv2_er_at "Weighting factor for DRV2 component calculation (engine speed dependent correction amount) - AT vehicle" CURVE 0xffe43004 _REC_CUR_20_u1_u1 1.99220002 _CNV_A_R_LINEAR_____39_CM 0. 1.99220002 DISPLAY_IDENTIFIER IP_FAC_N_DRV2_ER_AT FORMAT "%5.3"
 /begin AXIS_DESCR COM_AXIS n_32 _CNV_A_R_LINEAR_____15_CM 12 0. 8160. FORMAT "%4.0" AXIS_PTS_REF ldp_n_32_ip_fac_n_drv2_er_at /end AXIS_DESCR
/end CHARACTERISTIC
/begin CHARACTERISTIC ip_fac_n_drv2_er_mt "Weighting factor for DRV2 component calculation (engine speed dependent correction amount) - MT vehicle" CURVE 0xffe43010 _REC_CUR_20_u1_u1 1.99220002 _CNV_A_R_LINEAR_____39_CM 0. 1.99220002 DISPLAY_IDENTIFIER IP_FAC_N_DRV2_ER_MT FORMAT "%5.3"
 /begin AXIS_DESCR COM_AXIS n_32 _CNV_A_R_LINEAR_____15_CM 12 0. 8160. FORMAT "%4.0" AXIS_PTS_REF ldp_n_32_ip_fac_n_drv2_er_mt /end AXIS_DESCR
/end CHARACTERISTIC
/begin AXIS_PTS ldp_load_mis__fac_add_er_0_at "" 0xffe434a4 load_mis _REC_AXS_20_u2 99.99694824000001 _CNV_A_R_LINEAR_____571_CM 6 0. 99.99694824 DISPLAY_IDENTIFIER LDP_LOAD_MIS__FAC_ADD_ER_0_AT /end AXIS_PTS
/begin AXIS_PTS ldp_load_mis__fac_add_er_0_mt "" 0xffe434b2 load_mis _REC_AXS_20_u2 99.99694824000001 _CNV_A_R_LINEAR_____571_CM 6 0. 99.99694824 DISPLAY_IDENTIFIER LDP_LOAD_MIS__FAC_ADD_ER_0_MT /end AXIS_PTS
/begin AXIS_PTS ldp_load_mis__fac_add_er_1_at "" 0xffe434c0 load_mis _REC_AXS_20_u2 99.99694824000001 _CNV_A_R_LINEAR_____571_CM 6 0. 99.99694824 DISPLAY_IDENTIFIER LDP_LOAD_MIS__FAC_ADD_ER_1_AT /end AXIS_PTS
/begin AXIS_PTS ldp_load_mis__fac_add_er_1_mt "" 0xffe434ce load_mis _REC_AXS_20_u2 99.99694824000001 _CNV_A_R_LINEAR_____571_CM 6 0. 99.99694824 DISPLAY_IDENTIFIER LDP_LOAD_MIS__FAC_ADD_ER_1_MT /end AXIS_PTS
/begin AXIS_PTS ldp_load_mis__fac_add_er_2_at "" 0xffe434dc load_mis _REC_AXS_20_u2 99.99694824000001 _CNV_A_R_LINEAR_____571_CM 6 0. 99.99694824 DISPLAY_IDENTIFIER LDP_LOAD_MIS__FAC_ADD_ER_2_AT /end AXIS_PTS
/begin AXIS_PTS ldp_load_mis__fac_add_er_2_mt "" 0xffe434ea load_mis _REC_AXS_20_u2 99.99694824000001 _CNV_A_R_LINEAR_____571_CM 6 0. 99.99694824 DISPLAY_IDENTIFIER LDP_LOAD_MIS__FAC_ADD_ER_2_MT /end AXIS_PTS
/begin AXIS_PTS ldp_load_mis__fac_add_er_3_at "" 0xffe434f8 load_mis _REC_AXS_20_u2 99.99694824000001 _CNV_A_R_LINEAR_____571_CM 6 0. 99.99694824 DISPLAY_IDENTIFIER LDP_LOAD_MIS__FAC_ADD_ER_3_AT /end AXIS_PTS
/begin AXIS_PTS ldp_load_mis__fac_add_er_3_mt "" 0xffe43506 load_mis _REC_AXS_20_u2 99.99694824000001 _CNV_A_R_LINEAR_____571_CM 6 0. 99.99694824 DISPLAY_IDENTIFIER LDP_LOAD_MIS__FAC_ADD_ER_3_MT /end AXIS_PTS
/begin AXIS_PTS ldp_load_mis__fac_add_er_4_at "" 0xffe43514 load_mis _REC_AXS_20_u2 99.99694824000001 _CNV_A_R_LINEAR_____571_CM 6 0. 99.99694824 DISPLAY_IDENTIFIER LDP_LOAD_MIS__FAC_ADD_ER_4_AT /end AXIS_PTS
/begin AXIS_PTS ldp_load_mis__fac_add_er_4_mt "" 0xffe43522 load_mis _REC_AXS_20_u2 99.99694824000001 _CNV_A_R_LINEAR_____571_CM 6 0. 99.99694824 DISPLAY_IDENTIFIER LDP_LOAD_MIS__FAC_ADD_ER_4_MT /end AXIS_PTS
/begin AXIS_PTS ldp_load_mis__fac_add_er_5_at "" 0xffe43530 load_mis _REC_AXS_20_u2 99.99694824000001 _CNV_A_R_LINEAR_____571_CM 6 0. 99.99694824 DISPLAY_IDENTIFIER LDP_LOAD_MIS__FAC_ADD_ER_5_AT /end AXIS_PTS
/begin AXIS_PTS ldp_load_mis__fac_add_er_5_mt "" 0xffe4353e load_mis _REC_AXS_20_u2 99.99694824000001 _CNV_A_R_LINEAR_____571_CM 6 0. 99.99694824 DISPLAY_IDENTIFIER LDP_LOAD_MIS__FAC_ADD_ER_5_MT /end AXIS_PTS
/begin AXIS_PTS ldp_load_ip_fac_load_drv2_er_at "" 0xffe43470 load_mis _REC_AXS_20_u2 99.99694824000001 _CNV_A_R_LINEAR_____571_CM 12 0. 99.99694824 DISPLAY_IDENTIFIER LDP_LOAD_IP_FAC_LOAD_DRV2_ER_AT /end AXIS_PTS
/begin AXIS_PTS ldp_load_ip_fac_load_drv2_er_mt "" 0xffe4348a load_mis _REC_AXS_20_u2 99.99694824000001 _CNV_A_R_LINEAR_____571_CM 12 0. 99.99694824 DISPLAY_IDENTIFIER LDP_LOAD_IP_FAC_LOAD_DRV2_ER_MT /end AXIS_PTS
/begin AXIS_PTS ldp_n_32_ip_fac_n_drv2_er_at "" 0xffe43036 n_32 _REC_AXS_20_u1 8160. _CNV_A_R_LINEAR_____15_CM 12 0. 8160. DISPLAY_IDENTIFIER LDP_N_32_IP_FAC_N_DRV2_ER_AT FORMAT "%4.0" /end AXIS_PTS
/begin AXIS_PTS ldp_n_32_ip_fac_n_drv2_er_mt "" 0xffe43043 n_32 _REC_AXS_20_u1 8160. _CNV_A_R_LINEAR_____15_CM 12 0. 8160. DISPLAY_IDENTIFIER LDP_N_32_IP_FAC_N_DRV2_ER_MT FORMAT "%4.0" /end AXIS_PTS
/begin AXIS_PTS ldp_n_32_ip_crlc_drv2_er_at "" 0xffe4301c n_32 _REC_AXS_20_u1 8160. _CNV_A_R_LINEAR_____15_CM 12 0. 8160. DISPLAY_IDENTIFIER LDP_N_32_IP_CRLC_DRV2_ER_AT FORMAT "%4.0" /end AXIS_PTS
/begin AXIS_PTS ldp_n_32_ip_crlc_drv2_er_mt "" 0xffe43029 n_32 _REC_AXS_20_u1 8160. _CNV_A_R_LINEAR_____15_CM 12 0. 8160. DISPLAY_IDENTIFIER LDP_N_32_IP_CRLC_DRV2_ER_MT FORMAT "%4.0" /end AXIS_PTS
/begin AXIS_PTS ldpm_n_32__fac_er_0_at "" 0xffe40259 n_32 _REC_AXS_20_u1 8160. _CNV_A_R_LINEAR_____15_CM 6 0. 8160. DISPLAY_IDENTIFIER LDPM_N_32__FAC_ER_0_AT FORMAT "%4.0" /end AXIS_PTS
/begin AXIS_PTS ldpm_n_32__fac_er_0_mt "" 0xffe40260 n_32 _REC_AXS_20_u1 8160. _CNV_A_R_LINEAR_____15_CM 6 0. 8160. DISPLAY_IDENTIFIER LDPM_N_32__FAC_ER_0_MT FORMAT "%4.0" /end AXIS_PTS
/begin AXIS_PTS ldpm_n_32__fac_er_1_at "" 0xffe40267 n_32 _REC_AXS_20_u1 8160. _CNV_A_R_LINEAR_____15_CM 6 0. 8160. DISPLAY_IDENTIFIER LDPM_N_32__FAC_ER_1_AT FORMAT "%4.0" /end AXIS_PTS
/begin AXIS_PTS ldpm_n_32__fac_er_1_mt "" 0xffe4026e n_32 _REC_AXS_20_u1 8160. _CNV_A_R_LINEAR_____15_CM 6 0. 8160. DISPLAY_IDENTIFIER LDPM_N_32__FAC_ER_1_MT FORMAT "%4.0" /end AXIS_PTS
/begin AXIS_PTS ldpm_n_32__fac_er_2_at "" 0xffe40275 n_32 _REC_AXS_20_u1 8160. _CNV_A_R_LINEAR_____15_CM 6 0. 8160. DISPLAY_IDENTIFIER LDPM_N_32__FAC_ER_2_AT FORMAT "%4.0" /end AXIS_PTS
/begin AXIS_PTS ldpm_n_32__fac_er_2_mt "" 0xffe4027c n_32 _REC_AXS_20_u1 8160. _CNV_A_R_LINEAR_____15_CM 6 0. 8160. DISPLAY_IDENTIFIER LDPM_N_32__FAC_ER_2_MT FORMAT "%4.0" /end AXIS_PTS
/begin AXIS_PTS ldpm_n_32__fac_er_3_at "" 0xffe40283 n_32 _REC_AXS_20_u1 8160. _CNV_A_R_LINEAR_____15_CM 6 0. 8160. DISPLAY_IDENTIFIER LDPM_N_32__FAC_ER_3_AT FORMAT "%4.0" /end AXIS_PTS
/begin AXIS_PTS ldpm_n_32__fac_er_3_mt "" 0xffe4028a n_32 _REC_AXS_20_u1 8160. _CNV_A_R_LINEAR_____15_CM 6 0. 8160. DISPLAY_IDENTIFIER LDPM_N_32__FAC_ER_3_MT FORMAT "%4.0" /end AXIS_PTS
/begin AXIS_PTS ldpm_n_32__fac_er_4_at "" 0xffe40291 n_32 _REC_AXS_20_u1 8160. _CNV_A_R_LINEAR_____15_CM 6 0. 8160. DISPLAY_IDENTIFIER LDPM_N_32__FAC_ER_4_AT FORMAT "%4.0" /end AXIS_PTS
/begin AXIS_PTS ldpm_n_32__fac_er_4_mt "" 0xffe40298 n_32 _REC_AXS_20_u1 8160. _CNV_A_R_LINEAR_____15_CM 6 0. 8160. DISPLAY_IDENTIFIER LDPM_N_32__FAC_ER_4_MT FORMAT "%4.0" /end AXIS_PTS
/begin AXIS_PTS ldpm_n_32__fac_er_5_at "" 0xffe4029f n_32 _REC_AXS_20_u1 8160. _CNV_A_R_LINEAR_____15_CM 6 0. 8160. DISPLAY_IDENTIFIER LDPM_N_32__FAC_ER_5_AT FORMAT "%4.0" /end AXIS_PTS
/begin AXIS_PTS ldpm_n_32__fac_er_5_mt "" 0xffe402a6 n_32 _REC_AXS_20_u1 8160. _CNV_A_R_LINEAR_____15_CM 6 0. 8160. DISPLAY_IDENTIFIER LDPM_N_32__FAC_ER_5_MT FORMAT "%4.0" /end AXIS_PTS
/begin MEASUREMENT B_eb_busy "" UBYTE _CNV_S_2_B_TRUE_582_CM 1 100. 0. 1. DISPLAY_IDENTIFIER B_EB_BUSY ECU_ADDRESS 0x3fab2a BIT_MASK 0x1 /end MEASUREMENT
/begin MEASUREMENT B_eb_txok "" UBYTE _CNV_S_2_B_TRUE_582_CM 1 100. 0. 1. DISPLAY_IDENTIFIER B_EB_TXOK ECU_ADDRESS 0x3fab2e BIT_MASK 0x1 /end MEASUREMENT
/begin MEASUREMENT B_eb_write "" UBYTE _CNV_S_2_B_TRUE_582_CM 1 100. 0. 1. DISPLAY_IDENTIFIER B_EB_WRITE ECU_ADDRESS 0x3fab2f BIT_MASK 0x1 /end MEASUREMENT
/begin MEASUREMENT B_ibfbsd "" UBYTE _CNV_S_2_B_TRUE_582_CM 1 100. 0. 1. DISPLAY_IDENTIFIER B_IBFBSD ECU_ADDRESS 0x3fab30 BIT_MASK 0x1 /end MEASUREMENT
/begin MEASUREMENT B_ibfebsd "" UBYTE _CNV_S_2_B_TRUE_582_CM 1 100. 0. 1. DISPLAY_IDENTIFIER B_IBFEBSD ECU_ADDRESS 0x3fab2b BIT_MASK 0x1 /end MEASUREMENT
/begin MEASUREMENT B_ibunplau "" UBYTE _CNV_S_2_B_TRUE_582_CM 1 100. 0. 1. DISPLAY_IDENTIFIER B_IBUNPLAU ECU_ADDRESS 0x3fab31 BIT_MASK 0x1 /end MEASUREMENT
/begin MEASUREMENT B_startfgk "" UBYTE _CNV_S_2_B_TRUE_582_CM 1 100. 0. 1. DISPLAY_IDENTIFIER B_STARTFGK ECU_ADDRESS 0x3fab32 BIT_MASK 0x1 /end MEASUREMENT
/begin MEASUREMENT chk16_erom "" UWORD _CNV_R_R_dez_550_CM 1 100. 0. 65535. DISPLAY_IDENTIFIER CHK16_EROM ECU_ADDRESS 0x3fab36 BYTE_ORDER MSB_LAST FORMAT "%6.2" /end MEASUREMENT
/begin MEASUREMENT chkpara "" UWORD _CNV_R_R_dez_550_CM 1 100. 0. 65535. DISPLAY_IDENTIFIER CHKPARA ECU_ADDRESS 0x3fab38 BYTE_ORDER MSB_LAST FORMAT "%6.2" /end MEASUREMENT
/begin MEASUREMENT ebsd_adr "" UBYTE _CNV_R_R_dez_550_CM 1 100. 0. 255. DISPLAY_IDENTIFIER EBSD_ADR ECU_ADDRESS 0x3fab2c FORMAT "%6.2" /end MEASUREMENT
/begin MEASUREMENT ebsd_errdir "" UBYTE _CNV_S_2_B_TRUE_582_CM 1 100. 0. 1. DISPLAY_IDENTIFIER EBSD_ERRDIR ECU_ADDRESS 0x3fab33 BIT_MASK 0x1 /end MEASUREMENT
/begin MEASUREMENT ebsd_errep "" UBYTE _CNV_R_R_dez_550_CM 1 100. 0. 255. DISPLAY_IDENTIFIER EBSD_ERREP ECU_ADDRESS 0x3fab76 FORMAT "%6.2" /end MEASUREMENT
/begin MEASUREMENT ebsd_errin "" UBYTE _CNV_R_R_dez_550_CM 1 100. 0. 255. DISPLAY_IDENTIFIER EBSD_ERRIN ECU_ADDRESS 0x3fab77 FORMAT "%6.2" /end MEASUREMENT
/begin MEASUREMENT ebsd_nbyt "" UBYTE _CNV_R_R_dez_550_CM 1 100. 0. 255. DISPLAY_IDENTIFIER EBSD_NBYT ECU_ADDRESS 0x3fab2d FORMAT "%6.2" /end MEASUREMENT
/begin MEASUREMENT ebsd_varin "" UBYTE _CNV_R_R_dez_550_CM 1 100. 0. 255. DISPLAY_IDENTIFIER EBSD_VARIN ECU_ADDRESS 0x3fab78 FORMAT "%6.2" /end MEASUREMENT
/begin MEASUREMENT ercntchksu "" UWORD _CNV_R_R_dez_550_CM 1 100. 0. 65535. DISPLAY_IDENTIFIER ERCNTCHKSU ECU_ADDRESS 0x3fab3a BYTE_ORDER MSB_LAST FORMAT "%6.2" /end MEASUREMENT
/begin MEASUREMENT ercntcksub "" UBYTE _CNV_R_R_dez_550_CM 1 100. 0. 255. DISPLAY_IDENTIFIER ERCNTCKSUB ECU_ADDRESS 0x3fab79 FORMAT "%6.2" /end MEASUREMENT
/begin MEASUREMENT ercntparib "" UBYTE _CNV_R_R_dez_550_CM 1 100. 0. 255. DISPLAY_IDENTIFIER ERCNTPARIB ECU_ADDRESS 0x3fab7a FORMAT "%6.2" /end MEASUREMENT
/begin MEASUREMENT ercntparit "" UWORD _CNV_R_R_dez_550_CM 1 100. 0. 65535. DISPLAY_IDENTIFIER ERCNTPARIT ECU_ADDRESS 0x3fab3c BYTE_ORDER MSB_LAST FORMAT "%6.2" /end MEASUREMENT
/begin MEASUREMENT ercntunteb "" UBYTE _CNV_R_R_dez_550_CM 1 100. 0. 255. DISPLAY_IDENTIFIER ERCNTUNTEB ECU_ADDRESS 0x3fab7b FORMAT "%6.2" /end MEASUREMENT
/begin MEASUREMENT ercntunter "" UWORD _CNV_R_R_dez_550_CM 1 100. 0. 65535. DISPLAY_IDENTIFIER ERCNTUNTER ECU_ADDRESS 0x3fab3e BYTE_ORDER MSB_LAST FORMAT "%6.2" /end MEASUREMENT
/begin MEASUREMENT ibatt_10 "" UWORD _CNV_R_R_dez_550_CM 1 100. 0. 65535. DISPLAY_IDENTIFIER IBATT_10 ECU_ADDRESS 0x3fab40 BYTE_ORDER MSB_LAST FORMAT "%6.2" /end MEASUREMENT
/begin MEASUREMENT ibatt_1000 "" UWORD _CNV_R_R_dez_550_CM 1 100. 0. 65535. DISPLAY_IDENTIFIER IBATT_1000 ECU_ADDRESS 0x3fab42 BYTE_ORDER MSB_LAST FORMAT "%6.2" /end MEASUREMENT
/begin MEASUREMENT ibatt_200 "" UWORD _CNV_R_R_dez_550_CM 1 100. 0. 65535. DISPLAY_IDENTIFIER IBATT_200 ECU_ADDRESS 0x3fab44 BYTE_ORDER MSB_LAST FORMAT "%6.2" /end MEASUREMENT
/begin MEASUREMENT ibatt_w "" UWORD _CNV_R_R_i_uw_q0p08_587_CM 1 100. -200. 5042.8 DISPLAY_IDENTIFIER IBATT_W ECU_ADDRESS 0x3fab46 BYTE_ORDER MSB_LAST FORMAT "%7.2" /end MEASUREMENT
/begin MEASUREMENT ibcntreseb "" UBYTE _CNV_R_R_dez_550_CM 1 100. 0. 255. DISPLAY_IDENTIFIER IBCNTRESEB ECU_ADDRESS 0x3fab7c FORMAT "%6.2" /end MEASUREMENT
/begin MEASUREMENT ibcntreset "" UWORD _CNV_R_R_dez_550_CM 1 100. 0. 65535. DISPLAY_IDENTIFIER IBCNTRESET ECU_ADDRESS 0x3fab48 BYTE_ORDER MSB_LAST FORMAT "%6.2" /end MEASUREMENT
/begin MEASUREMENT ibcntupdat "" UBYTE _CNV_R_R_dez_550_CM 1 100. 0. 255. DISPLAY_IDENTIFIER IBCNTUPDAT ECU_ADDRESS 0x3fab7d FORMAT "%6.2" /end MEASUREMENT
/begin MEASUREMENT ibhwversi "" UBYTE _CNV_R_R_dez_550_CM 1 100. 0. 255. DISPLAY_IDENTIFIER IBHWVERSI ECU_ADDRESS 0x3fab7e FORMAT "%6.2" /end MEASUREMENT
/begin MEASUREMENT ibswbase "" UBYTE _CNV_R_R_dez_550_CM 1 100. 0. 255. DISPLAY_IDENTIFIER IBSWBASE ECU_ADDRESS 0x3fab7f FORMAT "%6.2" /end MEASUREMENT
/begin MEASUREMENT ibswchang "" UBYTE _CNV_R_R_dez_550_CM 1 100. 0. 255. DISPLAY_IDENTIFIER IBSWCHANG ECU_ADDRESS 0x3fab80 FORMAT "%6.2" /end MEASUREMENT
/begin MEASUREMENT ibs_errors "" UBYTE _CNV_R_R_dez_550_CM 1 100. 0. 255. DISPLAY_IDENTIFIER IBS_ERRORS ECU_ADDRESS 0x3fab81 FORMAT "%6.2" /end MEASUREMENT
/begin MEASUREMENT ibs_msgind "" UBYTE _CNV_R_R_dez_550_CM 1 100. 0. 255. DISPLAY_IDENTIFIER IBS_MSGIND ECU_ADDRESS 0x3fab82 FORMAT "%6.2" /end MEASUREMENT
/begin MEASUREMENT ibs_msgrdy "" UBYTE _CNV_S_2_B_TRUE_582_CM 1 100. 0. 1. DISPLAY_IDENTIFIER IBS_MSGRDY ECU_ADDRESS 0x3fab34 BIT_MASK 0x1 /end MEASUREMENT
/begin MEASUREMENT ibs_msgsta "" UBYTE _CNV_R_R_dez_550_CM 1 100. 0. 255. DISPLAY_IDENTIFIER IBS_MSGSTA ECU_ADDRESS 0x3fab83 FORMAT "%6.2" /end MEASUREMENT
/begin MEASUREMENT ibs_msgwri "" UBYTE _CNV_S_2_B_TRUE_582_CM 1 100. 0. 1. DISPLAY_IDENTIFIER IBS_MSGWRI ECU_ADDRESS 0x3fab35 BIT_MASK 0x1 /end MEASUREMENT
/begin MEASUREMENT ibs_reg4 "" UBYTE _CNV_R_R_dez_550_CM 1 100. 0. 255. DISPLAY_IDENTIFIER IBS_REG4 ECU_ADDRESS 0x3fab84 FORMAT "%6.2" /end MEASUREMENT
/begin MEASUREMENT ibs_reg5 "" UBYTE _CNV_R_R_dez_550_CM 1 100. 0. 255. DISPLAY_IDENTIFIER IBS_REG5 ECU_ADDRESS 0x3fab85 FORMAT "%6.2" /end MEASUREMENT
/begin MEASUREMENT ibs_start "" UBYTE _CNV_R_R_dez_550_CM 1 100. 0. 255. DISPLAY_IDENTIFIER IBS_START ECU_ADDRESS 0x3fab86 FORMAT "%6.2" /end MEASUREMENT
/begin MEASUREMENT ib_chk16 "" UWORD _CNV_R_R_dez_550_CM 1 100. 0. 65535. DISPLAY_IDENTIFIER IB_CHK16 ECU_ADDRESS 0x3fab4a BYTE_ORDER MSB_LAST FORMAT "%6.2" /end MEASUREMENT
/begin MEASUREMENT ib_parlen "" UBYTE _CNV_R_R_dez_550_CM 1 100. 0. 255. DISPLAY_IDENTIFIER IB_PARLEN ECU_ADDRESS 0x3fab87 FORMAT "%6.2" /end MEASUREMENT
/begin MEASUREMENT isoc0 "" UWORD _CNV_R_R_i_uw_q0p02_588_CM 1 100. -200. 1110.7 DISPLAY_IDENTIFIER ISOC0 ECU_ADDRESS 0x3fab4c BYTE_ORDER MSB_LAST FORMAT "%6.1" /end MEASUREMENT
/begin MEASUREMENT itnstart "" UWORD _CNV_R_R_i_ub_q0p02_589_CM 1 100. 0. 1310.7 DISPLAY_IDENTIFIER ITNSTART ECU_ADDRESS 0x3fab4e BYTE_ORDER MSB_LAST FORMAT "%7.4" /end MEASUREMENT
/begin MEASUREMENT ivorstart "" UWORD _CNV_R_R_i_uw_q0p02_588_CM 1 100. -200. 1110.7 DISPLAY_IDENTIFIER IVORSTART ECU_ADDRESS 0x3fab50 BYTE_ORDER MSB_LAST FORMAT "%6.1" /end MEASUREMENT
/begin MEASUREMENT ktib_chk16 "" UWORD _CNV_R_R_dez_550_CM 1 100. 0. 65535. DISPLAY_IDENTIFIER KTIB_CHK16 ECU_ADDRESS 0x3fab52 BYTE_ORDER MSB_LAST FORMAT "%6.2" /end MEASUREMENT
/begin MEASUREMENT kt_IbsStatus "" UBYTE _CNV_R_R_dez_550_CM 1 100. 0. 255. DISPLAY_IDENTIFIER KT_IBSSTATUS ECU_ADDRESS 0x3fab88 FORMAT "%6.2" /end MEASUREMENT
/begin MEASUREMENT kt_OldIbsStatus "" UBYTE _CNV_R_R_dez_550_CM 1 100. 0. 255. DISPLAY_IDENTIFIER KT_OLDIBSSTATUS ECU_ADDRESS 0x3fab89 FORMAT "%6.2" /end MEASUREMENT
/begin MEASUREMENT qelad "" UWORD _CNV_R_R_qlad_uw_q0_590_CM 1 100. 0. 1193.03 DISPLAY_IDENTIFIER QELAD ECU_ADDRESS 0x3fab54 BYTE_ORDER MSB_LAST FORMAT "%6.4" /end MEASUREMENT
/begin MEASUREMENT qeladsoc0 "" UWORD _CNV_R_R_qlad_uw_q0_590_CM 1 100. 0. 1193.03 DISPLAY_IDENTIFIER QELADSOC0 ECU_ADDRESS 0x3fab56 BYTE_ORDER MSB_LAST FORMAT "%6.4" /end MEASUREMENT
/begin MEASUREMENT qlad "" UWORD _CNV_R_R_qlad_uw_q0_590_CM 1 100. 0. 1193.03 DISPLAY_IDENTIFIER QLAD ECU_ADDRESS 0x3fab58 BYTE_ORDER MSB_LAST FORMAT "%6.4" /end MEASUREMENT
/begin MEASUREMENT qladsoc0 "" UWORD _CNV_R_R_qlad_uw_q0_590_CM 1 100. 0. 1193.03 DISPLAY_IDENTIFIER QLADSOC0 ECU_ADDRESS 0x3fab5a BYTE_ORDER MSB_LAST FORMAT "%6.4" /end MEASUREMENT
/begin MEASUREMENT t1histiruh "" UWORD _CNV_R_R_dez_550_CM 1 100. 0. 65535. DISPLAY_IDENTIFIER T1HISTIRUH ECU_ADDRESS 0x3fab5c BYTE_ORDER MSB_LAST FORMAT "%6.2" /end MEASUREMENT
/begin MEASUREMENT t2histiruh "" UWORD _CNV_R_R_dez_550_CM 1 100. 0. 65535. DISPLAY_IDENTIFIER T2HISTIRUH ECU_ADDRESS 0x3fab5e BYTE_ORDER MSB_LAST FORMAT "%6.2" /end MEASUREMENT
/begin MEASUREMENT t3histiruh "" UWORD _CNV_R_R_dez_550_CM 1 100. 0. 65535. DISPLAY_IDENTIFIER T3HISTIRUH ECU_ADDRESS 0x3fab60 BYTE_ORDER MSB_LAST FORMAT "%6.2" /end MEASUREMENT
/begin MEASUREMENT t4histiruh "" UWORD _CNV_R_R_dez_550_CM 1 100. 0. 65535. DISPLAY_IDENTIFIER T4HISTIRUH ECU_ADDRESS 0x3fab62 BYTE_ORDER MSB_LAST FORMAT "%6.2" /end MEASUREMENT
/begin MEASUREMENT tbatt "" UBYTE _CNV_R_R_temp_uw_q0_577_CM 1 100. -48. 143.25 DISPLAY_IDENTIFIER TBATT ECU_ADDRESS 0x3faa4c FORMAT "%6.2" /end MEASUREMENT
/begin MEASUREMENT tbattroh "" UWORD _CNV_R_R_dez_550_CM 1 100. 0. 65535. DISPLAY_IDENTIFIER TBATTROH ECU_ADDRESS 0x3fab64 BYTE_ORDER MSB_LAST FORMAT "%6.2" /end MEASUREMENT
/begin MEASUREMENT tbattsoc0 "" UBYTE _CNV_R_R_temp_uw_q0_577_CM 1 100. -48. 143.25 DISPLAY_IDENTIFIER TBATTSOC0 ECU_ADDRESS 0x3fab8a FORMAT "%6.2" /end MEASUREMENT
/begin MEASUREMENT tbatt_max "" UBYTE _CNV_R_R_temp_uw_q0_577_CM 1 100. -48. 143.25 DISPLAY_IDENTIFIER TBATT_MAX ECU_ADDRESS 0x3fab8b FORMAT "%6.2" /end MEASUREMENT
/begin MEASUREMENT tbatt_maxi "" UBYTE _CNV_R_R_dez_550_CM 1 100. 0. 255. DISPLAY_IDENTIFIER TBATT_MAXI ECU_ADDRESS 0x3fab8c FORMAT "%6.2" /end MEASUREMENT
/begin MEASUREMENT tbatt_min "" UBYTE _CNV_R_R_temp_uw_q0_577_CM 1 100. -48. 143.25 DISPLAY_IDENTIFIER TBATT_MIN ECU_ADDRESS 0x3fab8d FORMAT "%6.2" /end MEASUREMENT
/begin MEASUREMENT tbatt_mini "" UBYTE _CNV_R_R_dez_550_CM 1 100. 0. 255. DISPLAY_IDENTIFIER TBATT_MINI ECU_ADDRESS 0x3fab8e FORMAT "%6.2" /end MEASUREMENT
/begin MEASUREMENT tbatt_tmp "" UBYTE _CNV_R_R_dez_550_CM 1 100. 0. 255. DISPLAY_IDENTIFIER TBATT_TMP ECU_ADDRESS 0x3fab8f FORMAT "%6.2" /end MEASUREMENT
/begin MEASUREMENT u1soc0 "" UWORD _CNV_R_R_spg_uw_q0p_591_CM 1 100. 6. 22.3837 DISPLAY_IDENTIFIER U1SOC0 ECU_ADDRESS 0x3fab66 BYTE_ORDER MSB_LAST FORMAT "%9.5" /end MEASUREMENT
/begin MEASUREMENT u2soc0 "" UWORD _CNV_R_R_spg_uw_q0p_591_CM 1 100. 6. 22.3837 DISPLAY_IDENTIFIER U2SOC0 ECU_ADDRESS 0x3fab68 BYTE_ORDER MSB_LAST FORMAT "%9.5" /end MEASUREMENT
/begin MEASUREMENT u3soc0 "" UWORD _CNV_R_R_spg_uw_q0p_591_CM 1 100. 6. 22.3837 DISPLAY_IDENTIFIER U3SOC0 ECU_ADDRESS 0x3fab6a BYTE_ORDER MSB_LAST FORMAT "%9.5" /end MEASUREMENT
/begin MEASUREMENT ubatthiroh "" UWORD _CNV_R_R_dez_550_CM 1 100. 0. 65535. DISPLAY_IDENTIFIER UBATTHIROH ECU_ADDRESS 0x3fab6c BYTE_ORDER MSB_LAST FORMAT "%6.2" /end MEASUREMENT
/begin MEASUREMENT ubattloroh "" UWORD _CNV_R_R_dez_550_CM 1 100. 0. 65535. DISPLAY_IDENTIFIER UBATTLOROH ECU_ADDRESS 0x3fab6e BYTE_ORDER MSB_LAST FORMAT "%6.2" /end MEASUREMENT
/begin MEASUREMENT ubatt_w "" UWORD _CNV_R_R_spg_uw_q0p_591_CM 1 100. 6. 22.3837 DISPLAY_IDENTIFIER UBATT_W ECU_ADDRESS 0x3fab70 BYTE_ORDER MSB_LAST FORMAT "%9.5" /end MEASUREMENT
/begin MEASUREMENT unind "" UBYTE _CNV_R_R_dez_550_CM 1 100. 0. 255. DISPLAY_IDENTIFIER UNIND ECU_ADDRESS 0x3fab90 FORMAT "%6.2" /end MEASUREMENT
/begin MEASUREMENT utnstart "" UWORD _CNV_R_R_spg_uw_q0p_591_CM 1 100. 6. 22.3837 DISPLAY_IDENTIFIER UTNSTART ECU_ADDRESS 0x3fab72 BYTE_ORDER MSB_LAST FORMAT "%9.5" /end MEASUREMENT
/begin MEASUREMENT uvorstart "" UWORD _CNV_R_R_spg_uw_q0p_591_CM 1 100. 6. 22.3837 DISPLAY_IDENTIFIER UVORSTART ECU_ADDRESS 0x3fab74 BYTE_ORDER MSB_LAST FORMAT "%9.5" /end MEASUREMENT
/begin CHARACTERISTIC ENABSDIBS "" VALUE 0xffe5a082 _REC_VAL_20_u1 255. _CNV_R_R_dez_550_CM 0. 255. FORMAT "%6.2" /end CHARACTERISTIC
/begin CHARACTERISTIC ENISOC0 "" VALUE 0xffe5a083 _REC_VAL_20_u1 255. _CNV_R_R_dez_550_CM 0. 255. FORMAT "%6.2" /end CHARACTERISTIC
/begin CHARACTERISTIC ENUSOC0 "" VALUE 0xffe5a084 _REC_VAL_20_u1 255. _CNV_R_R_dez_550_CM 0. 255. FORMAT "%6.2" /end CHARACTERISTIC
/begin CHARACTERISTIC ERREPEAT "" VALUE 0xffe5a085 _REC_VAL_20_u1 255. _CNV_R_R_dez_550_CM 0. 255. FORMAT "%6.2" /end CHARACTERISTIC
/begin CHARACTERISTIC IBSTSTERR "" VALUE 0xffe5a086 _REC_VAL_20_u1 255. _CNV_R_R_dez_550_CM 0. 255. FORMAT "%6.2" /end CHARACTERISTIC
/begin CHARACTERISTIC IBSVERSION "" VAL_BLK 0xffe5b839 _REC_VAL_2_u1 255. _CNV_R_R_dez_550_CM 0. 255. FORMAT "%6.2" NUMBER 16 /end CHARACTERISTIC
/begin CHARACTERISTIC IBUNPLADEL "" VALUE 0xffe5a087 _REC_VAL_20_u1 255. _CNV_R_R_dez_550_CM 0. 255. FORMAT "%6.2" /end CHARACTERISTIC
/begin CHARACTERISTIC ISLEEPGRZ "" VALUE 0xffe5a088 _REC_VAL_20_u1 255. _CNV_R_R_dez_550_CM 0. 255. FORMAT "%6.2" /end CHARACTERISTIC
/begin CHARACTERISTIC ISTARTTRIG "" VALUE 0xffe5a089 _REC_VAL_20_u1 255. _CNV_R_R_dez_550_CM 0. 255. FORMAT "%6.2" /end CHARACTERISTIC
/begin CHARACTERISTIC IWAKEUPGRZ "" VALUE 0xffe5a08a _REC_VAL_20_u1 255. _CNV_R_R_dez_550_CM 0. 255. FORMAT "%6.2" /end CHARACTERISTIC
/begin CHARACTERISTIC KLIBSTEMP1 "" CURVE 0xffe5b82e _REC_CUR_32_u1_u1 191.3 _CNV_R_R_temp_uw_q0_577_CM -48. 143.3 FORMAT "%6.2"
 /begin AXIS_DESCR STD_AXIS tbatt_tmp _CNV_R_R_dez_550_CM 5 0. 255. FORMAT "%6.2" /end AXIS_DESCR
/end CHARACTERISTIC
/begin CHARACTERISTIC T1SCHWELLE "" VALUE 0xffe5a08b _REC_VAL_20_u1 255. _CNV_R_R_dez_550_CM 0. 255. FORMAT "%6.2" /end CHARACTERISTIC
/begin CHARACTERISTIC T1SOC0 "" VALUE 0xffe5a08c _REC_VAL_20_u1 255. _CNV_R_R_dez_550_CM 0. 255. FORMAT "%6.2" /end CHARACTERISTIC
/begin CHARACTERISTIC T2SCHWELLE "" VALUE 0xffe5a08d _REC_VAL_20_u1 255. _CNV_R_R_dez_550_CM 0. 255. FORMAT "%6.2" /end CHARACTERISTIC
/begin CHARACTERISTIC T2SOC0 "" VALUE 0xffe5a08e _REC_VAL_20_u1 255. _CNV_R_R_dez_550_CM 0. 255. FORMAT "%6.2" /end CHARACTERISTIC
/begin CHARACTERISTIC T3SCHWELLE "" VALUE 0xffe5a08f _REC_VAL_20_u1 255. _CNV_R_R_dez_550_CM 0. 255. FORMAT "%6.2" /end CHARACTERISTIC
/begin CHARACTERISTIC T3SOC0 "" VALUE 0xffe5a090 _REC_VAL_20_u1 255. _CNV_R_R_dez_550_CM 0. 255. FORMAT "%6.2" /end CHARACTERISTIC
/begin CHARACTERISTIC TNUSTART "" VALUE 0xffe5a091 _REC_VAL_20_u1 255. _CNV_R_R_dez_550_CM 0. 255. FORMAT "%6.2" /end CHARACTERISTIC
/begin CHARACTERISTIC TNUSTARTFL "" VALUE 0xffe5a092 _REC_VAL_20_u1 255. _CNV_R_R_dez_550_CM 0. 255. FORMAT "%6.2" /end CHARACTERISTIC
/begin CHARACTERISTIC TPT1TICO "" VALUE 0xffe5b84a _REC_VAL_20_u2 65535. _CNV_R_R_dez_550_CM 0. 65535. FORMAT "%6.2" /end CHARACTERISTIC
/begin CHARACTERISTIC TPT1USTFGK "" VALUE 0xffe5a093 _REC_VAL_20_u1 255. _CNV_R_R_dez_550_CM 0. 255. FORMAT "%6.2" /end CHARACTERISTIC
/begin CHARACTERISTIC TSLEEPRUH "" VALUE 0xffe5a094 _REC_VAL_20_u1 255. _CNV_R_R_dez_550_CM 0. 255. FORMAT "%6.2" /end CHARACTERISTIC
/begin CHARACTERISTIC TUPT1SOC0 "" VALUE 0xffe5a095 _REC_VAL_20_u1 255. _CNV_R_R_dez_550_CM 0. 255. FORMAT "%6.2" /end CHARACTERISTIC
/begin CHARACTERISTIC USOC0GRENZ "" VALUE 0xffe5a096 _REC_VAL_20_u1 255. _CNV_R_R_dez_550_CM 0. 255. FORMAT "%6.2" /end CHARACTERISTIC
/begin CHARACTERISTIC ENAPPLGOFF "Enable Generatorauschaltsteuerung" VALUE 0xffe5b782 _REC_VAL_20_u1 255. _CNV_R_R_dez_550_CM 0. 255. FORMAT "%8.4" /end CHARACTERISTIC
/begin CHARACTERISTIC ENAPPLRESP "Enable Handsteuerung Loadresponse" VALUE 0xffe5b783 _REC_VAL_20_u1 255. _CNV_R_R_dez_550_CM 0. 255. FORMAT "%8.4" /end CHARACTERISTIC
/begin CHARACTERISTIC KFLORESP "Kennfeld Loadresponse ueber Motordrehzahl und rel. Luftmasse" MAP 0xffe5b73e _REC_MAP_52_UBYTE_u1_u1_u1 25.5 _CNV_R_R_t100msxs_u_552_CM 0. 25.5 FORMAT "%8.4"
 /begin AXIS_DESCR STD_AXIS nmot _CNV_R_R_nmot_ub_q4_560_CM 6 0. 10200. FORMAT "%8.4" /end AXIS_DESCR
 /begin AXIS_DESCR STD_AXIS rl _CNV_R_R_rel_ub_q0p_597_CM 6 0. 191.25 FORMAT "%8.4" /end AXIS_DESCR
/end CHARACTERISTIC
/begin CHARACTERISTIC KLLORESPM "Motorabhängiger Loadresponse-Faktor" CURVE 0xffe5b770 _REC_CUR_52_UBYTE_u1_u1 3.984375 _CNV_R_R_fak_ub_b4_598_CM 0. 3.984375 FORMAT "%8.4"
 /begin AXIS_DESCR STD_AXIS tmot _CNV_R_R_temp_uw_q0_547_CM 6 -48. 143.25 FORMAT "%8.4" /end AXIS_DESCR
/end CHARACTERISTIC
/begin CHARACTERISTIC LRESPAPP "Load-Response Applikation" VALUE 0xffe5b785 _REC_VAL_20_u1 25.5 _CNV_R_R_t100msxs_u_552_CM 0. 25.5 FORMAT "%8.4" /end CHARACTERISTIC
/begin CHARACTERISTIC RLMXGENOF "relative Luftfüllungschwelle für Generatorzuschaltung" VALUE 0xffe5b787 _REC_VAL_20_u1 191.25 _CNV_R_R_rel_ub_q0p_597_CM 0. 191.25 FORMAT "%8.4" /end CHARACTERISTIC
/begin CHARACTERISTIC TGENOFVL "Generatorsabschaltzeit bei Vollastbeschleunigung" VALUE 0xffe5b78a _REC_VAL_20_u1 255. _CNV_R_R_dez_550_CM 0. 255. FORMAT "%8.4" /end CHARACTERISTIC
/begin CHARACTERISTIC TLORESPST "Startloadresponse" VALUE 0xffe5b78b _REC_VAL_20_u1 25.5 _CNV_R_R_t100msxs_u_552_CM 0. 25.5 FORMAT "%8.4" /end CHARACTERISTIC
/begin CHARACTERISTIC TVLOFHYST "Hysterese Generatorvollastabschaltung" VALUE 0xffe5b78f _REC_VAL_20_u1 255. _CNV_R_R_dez_550_CM 0. 255. FORMAT "%8.4" /end CHARACTERISTIC
/begin CHARACTERISTIC VGENOFMN "Geschwindigkeitgeneratorabschaltschwelle bei Vollastbeschleunigung" VALUE 0xffe5b790 _REC_VAL_20_u1 318.75 _CNV_R_R_vfzg_ub_q1_545_CM 0. 318.75 FORMAT "%8.4" /end CHARACTERISTIC
/begin CHARACTERISTIC VGENOGMX "Geschwindigkeitgeneratorzuschaltschwelle bei Vollastbeschleunigung" VALUE 0xffe5b791 _REC_VAL_20_u1 318.75 _CNV_R_R_vfzg_ub_q1_545_CM 0. 318.75 FORMAT "%8.4" /end CHARACTERISTIC
/begin CHARACTERISTIC NMXGENOF "Motordrehzahlschwelle für Generatorzuschaltung" VALUE 0xffe5b786 _REC_VAL_20_u1 10200. _CNV_R_R_nmot_ub_q4_560_CM 0. 10200. FORMAT "%8.4" /end CHARACTERISTIC
/begin CHARACTERISTIC S_LORESLL "Schalter Kennlinienausschaltzeit " VALUE 0xffe5b788 _REC_VAL_20_u1 255. _CNV_A_R_LINEAR_____22_CM 0. 255. BIT_MASK 0x1 /end CHARACTERISTIC
/begin CHARACTERISTIC TATMGENOF "Motordrehzahlschwelle  Katalysatortemperatur" VALUE 0xffe5b789 _REC_VAL_20_u1 1275. _CNV_R_R_temp_ub_q5_599_CM -50. 1225. FORMAT "%8.4" /end CHARACTERISTIC
/begin CHARACTERISTIC VZLORESOFV "Geschwindigkeitsschwelle für Generatorzuschaltung" VALUE 0xffe5b792 _REC_VAL_20_u1 318.75 _CNV_R_R_vfzg_ub_q1_545_CM 0. 318.75 FORMAT "%8.4" /end CHARACTERISTIC
/begin MEASUREMENT tlrgen "Sollwert Load- Response- Zeit Generator" UBYTE _CNV_R_R_t100msxs_u_552_CM 1 100. 0. 25.5 DISPLAY_IDENTIFIER TLRGEN ECU_ADDRESS 0x3fa431 FORMAT "%8.4" /end MEASUREMENT
/begin MEASUREMENT loadresp "gerechnete Loadresponse" UBYTE _CNV_R_R_t100msxs_u_552_CM 1 100. 0. 25.5 DISPLAY_IDENTIFIER LOADRESP ECU_ADDRESS 0x3fa430 FORMAT "%8.4" /end MEASUREMENT
/begin MEASUREMENT B_genoffst "Bedingung Generatorabschaltung im Start" UBYTE _CNV_A_R_LINEAR_____22_CM 1 100. 0. 255. DISPLAY_IDENTIFIER B_GENOFFST ECU_ADDRESS 0x3fa42e BIT_MASK 0x1 /end MEASUREMENT
/begin MEASUREMENT B_genoffvl "Bedingung Generatorabschaltung bei Vollast" UBYTE _CNV_A_R_LINEAR_____22_CM 1 100. 0. 255. DISPLAY_IDENTIFIER B_GENOFFVL ECU_ADDRESS 0x3fa42f BIT_MASK 0x1 /end MEASUREMENT
/begin MEASUREMENT nmot "Motordrehzahl" UBYTE _CNV_R_R_nmot_ub_q4_560_CM 1 100. 0. 10200. DISPLAY_IDENTIFIER NMOT ECU_ADDRESS 0x3fe3cf FORMAT "%8.4" /end MEASUREMENT
/begin MEASUREMENT kmstand "Kilometerstand" UWORD _CNV_R_R_nmot_ub_q1_596_CM 1 100. 0. 655350. DISPLAY_IDENTIFIER KMSTAND ECU_ADDRESS 0x3fd20a BYTE_ORDER MSB_LAST FORMAT "%8.4" /end MEASUREMENT
/begin MEASUREMENT tkatm "Katalysatortemperatur aus Modell" UBYTE _CNV_R_R_temp_ub_q5_599_CM 1 100. -50. 1225. DISPLAY_IDENTIFIER TKATM ECU_ADDRESS 0x3fe3f5 FORMAT "%8.4" /end MEASUREMENT
/begin MEASUREMENT rl "relative Luftfüllung" UBYTE _CNV_R_R_rel_ub_q0p_597_CM 1 100. 0. 191.25 DISPLAY_IDENTIFIER RL ECU_ADDRESS 0x3fe3d1 FORMAT "%8.4" /end MEASUREMENT
/begin MEASUREMENT B_llrein "Bedingung LLR ist aktiv" UBYTE _CNV_A_R_LINEAR_____22_CM 1 100. 0. 255. DISPLAY_IDENTIFIER B_LLREIN ECU_ADDRESS 0x3fe3de BIT_MASK 0x1 /end MEASUREMENT
/begin MEASUREMENT B_vl "Bedingung Vollast" UBYTE _CNV_A_R_LINEAR_____22_CM 1 100. 0. 255. DISPLAY_IDENTIFIER B_VL ECU_ADDRESS 0x3fe3dd BIT_MASK 0x1 /end MEASUREMENT
/begin MEASUREMENT tmst "Motorstarttemperatur" UBYTE _CNV_R_R_temp_uw_q0_547_CM 1 100. -48. 143.25 DISPLAY_IDENTIFIER TMST ECU_ADDRESS 0x3fe3df FORMAT "%8.4" /end MEASUREMENT
/begin MEASUREMENT B_stend "Bedingung Startende" UBYTE _CNV_A_R_LINEAR_____22_CM 1 100. 0. 255. DISPLAY_IDENTIFIER B_STEND ECU_ADDRESS 0x3fe3d2 BIT_MASK 0x1 /end MEASUREMENT
/begin MEASUREMENT tmot "Motortemperatur" UBYTE _CNV_R_R_temp_uw_q0_547_CM 1 100. -48. 143.25 DISPLAY_IDENTIFIER TMOT ECU_ADDRESS 0x3fe3d0 FORMAT "%8.4" /end MEASUREMENT
/begin MEASUREMENT tumg "Umgebungstemperatur" UBYTE _CNV_R_R_temp_uw_q0_547_CM 1 100. -48. 143.25 DISPLAY_IDENTIFIER TUMG ECU_ADDRESS 0x3fe40b FORMAT "%8.4" /end MEASUREMENT
/begin MEASUREMENT vfzg "Fahrzeuggeschwindigkeit" UBYTE _CNV_R_R_vfzg_ub_q1_545_CM 1 100. 0. 318.75 DISPLAY_IDENTIFIER VFZG ECU_ADDRESS 0x3fe3d8 FORMAT "%8.4" /end MEASUREMENT
/begin MEASUREMENT fho "Wichtungsfaktor fuer minimale HFM-Luftmassen Schwelle in Abhaengigkeit von d.Hoehe" UBYTE _CNV_R_R_fak_ub_b4_598_CM 1 100. 0. 3.984375 DISPLAY_IDENTIFIER FHO ECU_ADDRESS 0x3fe40a FORMAT "%8.4" /end MEASUREMENT
/begin MEASUREMENT tlrgen2 "Sollwert Load- Response- Zeit Generator2" UBYTE _CNV_R_R_t100msxs_u_552_CM 1 100. 0. 25.5 DISPLAY_IDENTIFIER TLRGEN2 ECU_ADDRESS 0x3faa58 FORMAT "%8.4" /end MEASUREMENT
/begin MEASUREMENT tmotab "Motortemperatur beim Abstellen" UBYTE _CNV_R_R_temp_uw_q0_547_CM 1 100. -48. 143.25 DISPLAY_IDENTIFIER TMOTAB ECU_ADDRESS 0x3fe409 FORMAT "%8.4" /end MEASUREMENT
/begin CHARACTERISTIC FHOGNMN "minimaler Wichtungsfaktor fuer minimale HFM-Luftmassen Schwelle in Abhaengigkeit von d.Hoehe fuer Generatorreduzierung" VALUE 0xffe5b784 _REC_VAL_20_u1 3.984375 _CNV_R_R_fak_ub_b4_598_CM 0. 3.984375 FORMAT "%8.4" /end CHARACTERISTIC
/begin CHARACTERISTIC TABSTGNMN "minimale Abstellzeit für Generatorreduzierung" VALUE 0xffe5b77e _REC_VAL_20_u2 65535. _CNV_R_R_dez_550_CM 0. 65535. FORMAT "%8.4" /end CHARACTERISTIC
/begin CHARACTERISTIC TABSTGNMX "maximale Abstellzeit für Generatorreduzierung" VALUE 0xffe5b780 _REC_VAL_20_u2 65535. _CNV_R_R_dez_550_CM 0. 65535. FORMAT "%8.4" /end CHARACTERISTIC
/begin CHARACTERISTIC TMOTABGNMN "minimale Motorabstelltemperatur für Generatorreduzierung" VALUE 0xffe5b78c _REC_VAL_20_u1 191.25 _CNV_R_R_temp_uw_q0_547_CM -48. 143.25 FORMAT "%8.4" /end CHARACTERISTIC
/begin CHARACTERISTIC TUMGGNMN "minimale Umgebungstemperatur für Generatorreduzierung" VALUE 0xffe5b78d _REC_VAL_20_u1 191.25 _CNV_R_R_temp_uw_q0_547_CM -48. 143.25 FORMAT "%8.4" /end CHARACTERISTIC
/begin CHARACTERISTIC TUMGGNMX "maximale Umgebungstemperatur für Generatorreduzierung" VALUE 0xffe5b78e _REC_VAL_20_u1 191.25 _CNV_R_R_temp_uw_q0_547_CM -48. 143.25 FORMAT "%8.4" /end CHARACTERISTIC
/begin CHARACTERISTIC KFZLRESOF "Kennfeld Generatorausschaltzeit bei Stillstand" MAP 0xffe5b6ee _REC_MAP_52_UBYTE_u1_u1_u2 255. _CNV_R_R_dez_550_CM 0. 255. FORMAT "%8.4"
 /begin AXIS_DESCR STD_AXIS tmst _CNV_R_R_temp_uw_q0_547_CM 6 -48. 143.25 FORMAT "%8.4" /end AXIS_DESCR
 /begin AXIS_DESCR STD_AXIS kmstand _CNV_R_R_nmot_ub_q1_596_CM 4 0. 655350. FORMAT "%8.4" /end AXIS_DESCR
/end CHARACTERISTIC
/begin CHARACTERISTIC KFZLRRESOFV "Kennfeld Generatorausschaltzeit bei Fahrt" MAP 0xffe5b716 _REC_MAP_52_UBYTE_u1_u1_u2 255. _CNV_R_R_dez_550_CM 0. 255. FORMAT "%8.4"
 /begin AXIS_DESCR STD_AXIS tmst _CNV_R_R_temp_uw_q0_547_CM 6 -48. 143.25 FORMAT "%8.4" /end AXIS_DESCR
 /begin AXIS_DESCR STD_AXIS kmstand _CNV_R_R_nmot_ub_q1_596_CM 4 0. 655350. FORMAT "%8.4" /end AXIS_DESCR
/end CHARACTERISTIC
/begin MEASUREMENT tabsmn_w "Abstellzeit in Minuten" UWORD _CNV_A_R_LINEAR_____97_CM 1 100. 0. 65535. DISPLAY_IDENTIFIER TABSMN_W ECU_ADDRESS 0x3fd200 BYTE_ORDER MSB_LAST FORMAT "%5.0" /end MEASUREMENT
/begin MEASUREMENT tabst_w "Abstellzeit in Sekunden" UWORD _CNV_A_R_LINEAR_____30_CM 1 100. 0. 65535. DISPLAY_IDENTIFIER TABST_W ECU_ADDRESS 0x3fd1fe BYTE_ORDER MSB_LAST FORMAT "%5.0" /end MEASUREMENT
/begin MEASUREMENT lv_det_mis "Single misfire detected (TDC occurence)" UBYTE _CNV_S_2_RANGE______21_CM 1 100. 0. 1. DISPLAY_IDENTIFIER LV_DET_MIS ECU_ADDRESS 0x3fe59a /end MEASUREMENT
/begin MEASUREMENT mis_state_er "Status carrier byte of actual detected misfire through engine roughness index - 1 bit / cylinder." UWORD _CNV_A_R_LINEAR_____0_CM 1 100. 0. 65535. DISPLAY_IDENTIFIER MIS_STATE_ER ECU_ADDRESS 0x3fd55a BYTE_ORDER MSB_LAST FORMAT "%5.0" /end MEASUREMENT
/begin CHARACTERISTIC c_fac_sca_er_stnd "Scaling factor used for normalized engine roughness calculation" VALUE 0xffe402d8 _REC_VAL_20_u1 255. _CNV_A_R_LINEAR_____0_CM 0. 255. DISPLAY_IDENTIFIER C_FAC_SCA_ER_STND FORMAT "%3.0" /end CHARACTERISTIC
/begin CHARACTERISTIC c_n_max_er_stnd "Maximum engine speed for normalized ER index (ER_STND)" VALUE 0xffe40358 _REC_VAL_20_u2 8160. _CNV_A_R_LINEAR_____10_CM 0. 8160. DISPLAY_IDENTIFIER C_N_MAX_ER_STND FORMAT "%4.0" /end CHARACTERISTIC
/begin CHARACTERISTIC lc_er_stnd_conf "Selection between classical ER index (=0) & normalized ER index (ER_STND) (=1) to execute misfire detection" VALUE 0xffe402ff _REC_VAL_20_u1 1. _CNV_S_2_RANGE______21_CM 0. 1. DISPLAY_IDENTIFIER LC_ER_STND_CONF /end CHARACTERISTIC
/begin MEASUREMENT er_stnd "Normalized engine roughness (versus engine speed - including DRV2_MMV component)" SWORD _CNV_A_R_LINEAR_____600_CM 1 100. -32768. 32767. DISPLAY_IDENTIFIER ER_STND ECU_ADDRESS 0x3fd558 BYTE_ORDER MSB_LAST FORMAT "%6.0" /end MEASUREMENT
/begin MEASUREMENT er_stnd_x[0] "Cylinder normalized engine roughness values" SWORD _CNV_A_R_LINEAR_____600_CM 1 100. -32768. 32767. DISPLAY_IDENTIFIER ER_STND_0 ECU_ADDRESS 0x3fd55c BYTE_ORDER MSB_LAST FORMAT "%6.0" /end MEASUREMENT
/begin MEASUREMENT er_stnd_x[1] "Cylinder normalized engine roughness values" SWORD _CNV_A_R_LINEAR_____600_CM 1 100. -32768. 32767. DISPLAY_IDENTIFIER ER_STND_1 ECU_ADDRESS 0x3fd55e BYTE_ORDER MSB_LAST FORMAT "%6.0" /end MEASUREMENT
/begin MEASUREMENT er_stnd_x[2] "Cylinder normalized engine roughness values" SWORD _CNV_A_R_LINEAR_____600_CM 1 100. -32768. 32767. DISPLAY_IDENTIFIER ER_STND_2 ECU_ADDRESS 0x3fd560 BYTE_ORDER MSB_LAST FORMAT "%6.0" /end MEASUREMENT
/begin MEASUREMENT er_stnd_x[3] "Cylinder normalized engine roughness values" SWORD _CNV_A_R_LINEAR_____600_CM 1 100. -32768. 32767. DISPLAY_IDENTIFIER ER_STND_3 ECU_ADDRESS 0x3fd562 BYTE_ORDER MSB_LAST FORMAT "%6.0" /end MEASUREMENT
/begin MEASUREMENT er_stnd_x[4] "Cylinder normalized engine roughness values" SWORD _CNV_A_R_LINEAR_____600_CM 1 100. -32768. 32767. DISPLAY_IDENTIFIER ER_STND_4 ECU_ADDRESS 0x3fd564 BYTE_ORDER MSB_LAST FORMAT "%6.0" /end MEASUREMENT
/begin MEASUREMENT er_stnd_x[5] "Cylinder normalized engine roughness values" SWORD _CNV_A_R_LINEAR_____600_CM 1 100. -32768. 32767. DISPLAY_IDENTIFIER ER_STND_5 ECU_ADDRESS 0x3fd566 BYTE_ORDER MSB_LAST FORMAT "%6.0" /end MEASUREMENT
/begin MEASUREMENT state_diag_mis "Misfire detection phase state machine" UBYTE _CNV_S_5_RANGE_STAT_605_CM 1 100. 0. 4. DISPLAY_IDENTIFIER STATE_DIAG_MIS ECU_ADDRESS 0x3fe59c /end MEASUREMENT
/begin MEASUREMENT mis_det_cyl_inh "Cylinder misfiring detection inhibition carrier byte when a fade out condition occurred (after masking & delay)" UWORD _CNV_A_R_LINEAR_____0_CM 1 100. 0. 65535. DISPLAY_IDENTIFIER MIS_DET_CYL_INH ECU_ADDRESS 0x3fd570 BYTE_ORDER MSB_LAST FORMAT "%5.0" /end MEASUREMENT
/begin MEASUREMENT mis_det_cdn_inh_nr "Misfiring detection fade out requests number (after masking)" UBYTE _CNV_A_R_LINEAR_____0_CM 1 100. 0. 255. DISPLAY_IDENTIFIER MIS_DET_CDN_INH_NR ECU_ADDRESS 0x3fe59e FORMAT "%3.0" /end MEASUREMENT
/begin MEASUREMENT ctr_tdc_zdly_mis "TDC decounter for disabled diagnostic" UWORD _CNV_A_R_LINEAR_____603_CM 1 100. 0. 65535. DISPLAY_IDENTIFIER CTR_TDC_ZDLY_MIS ECU_ADDRESS 0x3fd56e BYTE_ORDER MSB_LAST FORMAT "%5.0" /end MEASUREMENT
/begin MEASUREMENT ctr_t_zdly_mis "10 ms decounter for diagnostic fade out (general purpose)" UWORD _CNV_A_R_LINEAR_____4_CM 1 100. 0. 655.35 DISPLAY_IDENTIFIER CTR_T_ZDLY_MIS ECU_ADDRESS 0x3fd568 BYTE_ORDER MSB_LAST FORMAT "%5.2" /end MEASUREMENT
/begin MEASUREMENT lv_diag_mis "Nominal Misfire Monitoring Phase" UBYTE _CNV_S_2_RANGE______21_CM 1 100. 0. 1. DISPLAY_IDENTIFIER LV_DIAG_MIS ECU_ADDRESS 0x3fe5a0 /end MEASUREMENT
/begin CHARACTERISTIC c_mask_inh_det_zdly_mis "MIS_DET_CDN_INH carrier structure fade out configuration mask (misfire detection zero delay phase)" VALUE 0xffe402da _REC_VAL_20_u1 255. _CNV_A_R_LINEAR_____0_CM 0. 255. DISPLAY_IDENTIFIER C_MASK_INH_DET_ZDLY_MIS FORMAT "%3.0" /end CHARACTERISTIC
/begin CHARACTERISTIC c_n_min_zdly_mis "Minimum engine speed for zero delay misfire monitoring activation" VALUE 0xffe40360 _REC_VAL_20_u2 8160. _CNV_A_R_LINEAR_____10_CM 0. 8160. DISPLAY_IDENTIFIER C_N_MIN_ZDLY_MIS FORMAT "%4.0" /end CHARACTERISTIC
/begin CHARACTERISTIC c_t_zdly_mis "Duration for engine start specific misfire monitoring (5s according CARB)" VALUE 0xffe40378 _REC_VAL_20_u2 655.35 _CNV_A_R_LINEAR_____4_CM 0. 655.35 DISPLAY_IDENTIFIER C_T_ZDLY_MIS FORMAT "%5.2" /end CHARACTERISTIC
/begin CHARACTERISTIC c_nr_tdc_zdly_mis "Standard TDC count disablement tdc number before monitoring (engine start phase)" VALUE 0xffe402e9 _REC_VAL_20_u1 255. _CNV_A_R_LINEAR_____603_CM 0. 255. DISPLAY_IDENTIFIER C_NR_TDC_ZDLY_MIS FORMAT "%3.0" /end CHARACTERISTIC
/begin CHARACTERISTIC c_n_min_mis "Minimum engine speed for misfire detection" VALUE 0xffe4035e _REC_VAL_20_u2 8160. _CNV_A_R_LINEAR_____10_CM 0. 8160. DISPLAY_IDENTIFIER C_N_MIN_MIS FORMAT "%4.0" /end CHARACTERISTIC
/begin CHARACTERISTIC c_n_max_mis_at "Maximum engine speed for misfire detection / automatic transmission" VALUE 0xffe4035a _REC_VAL_20_u2 8160. _CNV_A_R_LINEAR_____10_CM 0. 8160. DISPLAY_IDENTIFIER C_N_MAX_MIS_AT FORMAT "%4.0" /end CHARACTERISTIC
/begin CHARACTERISTIC c_n_max_mis_mt "Maximum engine speed for misfire detection / manual transmission" VALUE 0xffe4035c _REC_VAL_20_u2 8160. _CNV_A_R_LINEAR_____10_CM 0. 8160. DISPLAY_IDENTIFIER C_N_MAX_MIS_MT FORMAT "%4.0" /end CHARACTERISTIC
/begin MEASUREMENT mis_det_cdn_inh "Misfiring detection fade out requests carrier byte (before masking)" UBYTE _CNV_A_R_LINEAR_____0_CM 1 100. 0. 255. DISPLAY_IDENTIFIER MIS_DET_CDN_INH ECU_ADDRESS 0x3fe59d FORMAT "%3.0" /end MEASUREMENT
/begin MEASUREMENT mis_det_cdn_inh.lv_inh_n_det_mis "Misfire detection fade out request flag due to engine speed condition" UBYTE _CNV_A_R_LINEAR_____0_CM 1 100. 0. 255. DISPLAY_IDENTIFIER LV_INH_N_DET_MIS ECU_ADDRESS 0x3fe59d FORMAT "%3.0" BIT_MASK 0x1 /end MEASUREMENT
/begin MEASUREMENT mis_det_cdn_inh.lv_inh_load_min_det_mis "Misfire detection fade out request flag due to zero load line condition" UBYTE _CNV_A_R_LINEAR_____0_CM 1 100. 0. 255. DISPLAY_IDENTIFIER LV_INH_LOAD_MIN_DET_MIS ECU_ADDRESS 0x3fe59d FORMAT "%3.0" BIT_MASK 0x2 /end MEASUREMENT
/begin MEASUREMENT mis_det_cdn_inh.lv_inh_tco_min_det_mis "Misfire detection fade out request flag due to minimum temperature condition" UBYTE _CNV_A_R_LINEAR_____0_CM 1 100. 0. 255. DISPLAY_IDENTIFIER LV_INH_TCO_MIN_DET_MIS ECU_ADDRESS 0x3fe59d FORMAT "%3.0" BIT_MASK 0x4 /end MEASUREMENT
/begin MEASUREMENT mis_det_cdn_inh.lv_inh_amp_min_det_mis "Misfire detection fade out request flag due to minimum atmospheric pressure condition" UBYTE _CNV_A_R_LINEAR_____0_CM 1 100. 0. 255. DISPLAY_IDENTIFIER LV_INH_AMP_MIN_DET_MIS ECU_ADDRESS 0x3fe59d FORMAT "%3.0" BIT_MASK 0x8 /end MEASUREMENT
/begin MEASUREMENT mis_det_cdn_inh.lv_inh_st_det_mis "Misfire detection fade out request flag due to engine start condition" UBYTE _CNV_A_R_LINEAR_____0_CM 1 100. 0. 255. DISPLAY_IDENTIFIER LV_INH_ST_DET_MIS ECU_ADDRESS 0x3fe59d FORMAT "%3.0" BIT_MASK 0x10 /end MEASUREMENT
/begin MEASUREMENT mis_det_cdn_inh.lv_inh_iv_off_det_mis "Misfire detection fade out request flag due to cylinder shut-off condition" UBYTE _CNV_A_R_LINEAR_____0_CM 1 100. 0. 255. DISPLAY_IDENTIFIER LV_INH_IV_OFF_DET_MIS ECU_ADDRESS 0x3fe59d FORMAT "%3.0" BIT_MASK 0x20 /end MEASUREMENT
/begin MEASUREMENT lv_req_inh_mis "Misfire detection fade out request flag" UBYTE _CNV_S_2_RANGE______21_CM 1 100. 0. 1. DISPLAY_IDENTIFIER LV_REQ_INH_MIS ECU_ADDRESS 0x3fe59b /end MEASUREMENT
/begin CHARACTERISTIC c_mask_inh_det_mis "MIS_DET_CDN_INH carrier structure fade out configuration mask (misfire detection nominal phase)" VALUE 0xffe402d9 _REC_VAL_20_u1 255. _CNV_A_R_LINEAR_____0_CM 0. 255. DISPLAY_IDENTIFIER C_MASK_INH_DET_MIS FORMAT "%3.0" /end CHARACTERISTIC
/begin CHARACTERISTIC c_nr_tdc_inh_mis "Fade out duration in TDC when engine speed rise up to C_N_MIN_ZDLY_MIS" VALUE 0xffe402e8 _REC_VAL_20_u1 255. _CNV_A_R_LINEAR_____603_CM 0. 255. DISPLAY_IDENTIFIER C_NR_TDC_INH_MIS FORMAT "%3.0" /end CHARACTERISTIC
/begin CHARACTERISTIC lc_req_zdly_mis "Activation of CARB required 0 delay monitoring" VALUE 0xffe40302 _REC_VAL_20_u1 1. _CNV_S_2_RANGE______21_CM 0. 1. DISPLAY_IDENTIFIER LC_REQ_ZDLY_MIS /end CHARACTERISTIC
/begin CHARACTERISTIC c_amp_min_mis "Minimum amp for misfire detection" VALUE 0xffe4033a _REC_VAL_20_u2 5434. _CNV_A_R_LINEAR_____49_CM 0. 5434. DISPLAY_IDENTIFIER C_AMP_MIN_MIS FORMAT "%7.2" /end CHARACTERISTIC
/begin CHARACTERISTIC c_tco_min_mis "Minimum coolant temperature for misfire detection" VALUE 0xffe402ec _REC_VAL_20_u1 28.575 _CNV_A_R_LINEAR_____11_CM -48. 142.5 DISPLAY_IDENTIFIER C_TCO_MIN_MIS FORMAT "%5.1" /end CHARACTERISTIC
/begin CHARACTERISTIC c_t_dly_st_mis "Fade out duration when engine operating state start LV_ST has been exited" VALUE 0xffe4036a _REC_VAL_20_u2 655.35 _CNV_A_R_LINEAR_____4_CM 0. 655.35 DISPLAY_IDENTIFIER C_T_DLY_ST_MIS FORMAT "%5.2" /end CHARACTERISTIC
/begin CHARACTERISTIC c_t_dly_iv_off_mis "Fade out duration after injection is back on" VALUE 0xffe40368 _REC_VAL_20_u2 655.35 _CNV_A_R_LINEAR_____4_CM 0. 655.35 DISPLAY_IDENTIFIER C_T_DLY_IV_OFF_MIS FORMAT "%5.2" /end CHARACTERISTIC
/begin MEASUREMENT lv_zdly_diag_mis "Zero delay misfire monitoring phase" UBYTE _CNV_S_2_RANGE______21_CM 1 100. 0. 1. DISPLAY_IDENTIFIER LV_ZDLY_DIAG_MIS ECU_ADDRESS 0x3fe5a1 /end MEASUREMENT
/begin MEASUREMENT lv_puc_det_mis "Fuel Cut-Off dedicated to misfire detection, including a delay time for fuel reactivation" UBYTE _CNV_S_2_RANGE______21_CM 1 100. 0. 1. DISPLAY_IDENTIFIER LV_PUC_DET_MIS ECU_ADDRESS 0x3fe5a2 /end MEASUREMENT
/begin CHARACTERISTIC c_load_mis_ftp "FTP cycle engine load threshold" VALUE 0xffe4033c _REC_VAL_20_u2 99.99694824000001 _CNV_A_R_LINEAR_____571_CM 0. 99.99694824 DISPLAY_IDENTIFIER C_LOAD_MIS_FTP /end CHARACTERISTIC
/begin CHARACTERISTIC c_n_mis_ftp "FTP cycle engine speed threshold" VALUE 0xffe40362 _REC_VAL_20_u2 8160. _CNV_A_R_LINEAR_____10_CM 0. 8160. DISPLAY_IDENTIFIER C_N_MIS_FTP FORMAT "%4.0" /end CHARACTERISTIC
/begin CHARACTERISTIC c_mis_a_ind_thd "Cylinder individual threshold used for cylinder shut-off during CARB A criteria window" VALUE 0xffe40346 _REC_VAL_20_u2 65535. _CNV_A_R_LINEAR_____0_CM 0. 65535. DISPLAY_IDENTIFIER C_MIS_A_IND_THD FORMAT "%5.0" /end CHARACTERISTIC
/begin CHARACTERISTIC c_mis_a_min_nr "Cylinder identification ratio for CARB A criteria detection" VALUE 0xffe402db _REC_VAL_20_u1 99.609375 _CNV_A_R_LINEAR_____9_CM 0. 99.609375 DISPLAY_IDENTIFIER C_MIS_A_MIN_NR FORMAT "%4.1" /end CHARACTERISTIC
/begin CHARACTERISTIC c_mis_sum_a_thd "Cylinder global threshold for misfire status CARB A detection" VALUE 0xffe4034a _REC_VAL_20_u2 65535. _CNV_A_R_LINEAR_____0_CM 0. 65535. DISPLAY_IDENTIFIER C_MIS_SUM_A_THD FORMAT "%5.0" /end CHARACTERISTIC
/begin CHARACTERISTIC c_mis_sum_a_cbk_thd "Cylinder bank threshold for misfire status CARB A detection" VALUE 0xffe40348 _REC_VAL_20_u2 65535. _CNV_A_R_LINEAR_____0_CM 0. 65535. DISPLAY_IDENTIFIER C_MIS_SUM_A_CBK_THD FORMAT "%5.0" /end CHARACTERISTIC
/begin CHARACTERISTIC c_mis_max_nr_off_iv "Maximum number of allowed cylinder to be shut-off after detection of the misfire status CARB A." VALUE 0xffe402de _REC_VAL_20_u1 4. _CNV_A_R_LINEAR_____606_CM 0. 4. DISPLAY_IDENTIFIER C_MIS_MAX_NR_OFF_IV FORMAT "%2.0" /end CHARACTERISTIC
/begin CHARACTERISTIC c_mis_min_nr_puc "Minimum number of trailing throttle fuel cut-off phases LV_PUC before cancelling cylinder(s) shut-off. " VALUE 0xffe402df _REC_VAL_20_u1 254. _CNV_A_R_LINEAR_____0_CM 1. 255. DISPLAY_IDENTIFIER C_MIS_MIN_NR_PUC FORMAT "%3.0" /end CHARACTERISTIC
/begin CHARACTERISTIC c_t_mis_min_puc "Minimum duration of trailing throttle fuel cut-off phase to be validated like this." VALUE 0xffe40372 _REC_VAL_20_u2 99.90000000000001 _CNV_A_R_LINEAR_____24_CM 0.1 100. DISPLAY_IDENTIFIER C_T_MIS_MIN_PUC FORMAT "%5.1" /end CHARACTERISTIC
/begin CHARACTERISTIC c_mis_sum_b1_thd_mt "Global threshold for CARB B1 misfire criteria detection, LV_AT = 0" VALUE 0xffe40350 _REC_VAL_20_u2 65535. _CNV_A_R_LINEAR_____0_CM 0. 65535. DISPLAY_IDENTIFIER C_MIS_SUM_B1_THD_MT FORMAT "%5.0" /end CHARACTERISTIC
/begin CHARACTERISTIC c_mis_sum_b1_thd_at "Global threshold for  CARB B1 misfire criteria detection, LV_AT = 1" VALUE 0xffe4034e _REC_VAL_20_u2 65535. _CNV_A_R_LINEAR_____0_CM 0. 65535. DISPLAY_IDENTIFIER C_MIS_SUM_B1_THD_AT FORMAT "%5.0" /end CHARACTERISTIC
/begin CHARACTERISTIC c_mis_sum_b4_thd_mt "Global threshold for CARB B4 misfire criteria detection, LV_AT = 0" VALUE 0xffe40356 _REC_VAL_20_u2 65535. _CNV_A_R_LINEAR_____0_CM 0. 65535. DISPLAY_IDENTIFIER C_MIS_SUM_B4_THD_MT FORMAT "%5.0" /end CHARACTERISTIC
/begin CHARACTERISTIC c_mis_sum_b4_thd_at "Global hreshold for CARB B4 misfire criteria detection, LV_AT = 1" VALUE 0xffe40354 _REC_VAL_20_u2 65535. _CNV_A_R_LINEAR_____0_CM 0. 65535. DISPLAY_IDENTIFIER C_MIS_SUM_B4_THD_AT FORMAT "%5.0" /end CHARACTERISTIC
/begin CHARACTERISTIC c_mis_b1_min_nr "Cylinder indentification ratio for CARB B1 criteria detection" VALUE 0xffe402dc _REC_VAL_20_u1 99.609375 _CNV_A_R_LINEAR_____9_CM 0. 99.609375 DISPLAY_IDENTIFIER C_MIS_B1_MIN_NR FORMAT "%4.1" /end CHARACTERISTIC
/begin CHARACTERISTIC c_mis_b4_min_nr "Cylinder indentification ratio for CARB B4 criteria detection" VALUE 0xffe402dd _REC_VAL_20_u1 99.609375 _CNV_A_R_LINEAR_____9_CM 0. 99.609375 DISPLAY_IDENTIFIER C_MIS_B4_MIN_NR FORMAT "%4.1" /end CHARACTERISTIC
/begin CHARACTERISTIC c_mis_sum_b1_cbk_thd "Cylinder bank threshold for CARB B1 misfire criteria detection" VALUE 0xffe4034c _REC_VAL_20_u2 65535. _CNV_A_R_LINEAR_____0_CM 0. 65535. DISPLAY_IDENTIFIER C_MIS_SUM_B1_CBK_THD FORMAT "%5.0" /end CHARACTERISTIC
/begin CHARACTERISTIC c_mis_sum_b4_cbk_thd "Cylinder bank threshold for CARB B4 misfire criteria detection" VALUE 0xffe40352 _REC_VAL_20_u2 65535. _CNV_A_R_LINEAR_____0_CM 0. 65535. DISPLAY_IDENTIFIER C_MIS_SUM_B4_CBK_THD FORMAT "%5.0" /end CHARACTERISTIC
/begin MEASUREMENT lv_ftp_mis_a "Boolean for FTP emission cycle condition status CARB A" UBYTE _CNV_S_2_RANGE______21_CM 1 100. 0. 1. DISPLAY_IDENTIFIER LV_FTP_MIS_A ECU_ADDRESS 0x3fe5b7 /end MEASUREMENT
/begin MEASUREMENT inh_iv_mis "Idendification of cylinders shut off by misfire Carb A" UBYTE _CNV_A_R_LINEAR_____0_CM 1 100. 0. 255. DISPLAY_IDENTIFIER INH_IV_MIS ECU_ADDRESS 0x3fe5a3 FORMAT "%3.0" /end MEASUREMENT
/begin MEASUREMENT mis_nr_tdc_a "TDC counter CARB A window (200 crankshaft revolutions)." UWORD _CNV_A_R_LINEAR_____0_CM 1 100. 0. 65535. DISPLAY_IDENTIFIER MIS_NR_TDC_A ECU_ADDRESS 0x3fd598 BYTE_ORDER MSB_LAST FORMAT "%5.0" /end MEASUREMENT
/begin MEASUREMENT mis_sum_a "CARB A misfire sum (global)" UWORD _CNV_A_R_LINEAR_____0_CM 1 100. 0. 65535. DISPLAY_IDENTIFIER MIS_SUM_A ECU_ADDRESS 0x3fd59c BYTE_ORDER MSB_LAST FORMAT "%5.0" /end MEASUREMENT
/begin MEASUREMENT mis_sum_a_cbk_1 "CARB A misfire sum (dedicated to cylinder bank)" UWORD _CNV_A_R_LINEAR_____0_CM 1 100. 0. 65535. DISPLAY_IDENTIFIER MIS_SUM_A_CBK_1 ECU_ADDRESS 0x3fd58a BYTE_ORDER MSB_LAST FORMAT "%5.0" /end MEASUREMENT
/begin MEASUREMENT mis_sum_a_cbk_2 "CARB A misfire sum (dedicated to cylinder bank)" UWORD _CNV_A_R_LINEAR_____0_CM 1 100. 0. 65535. DISPLAY_IDENTIFIER MIS_SUM_A_CBK_2 ECU_ADDRESS 0x3fd58c BYTE_ORDER MSB_LAST FORMAT "%5.0" /end MEASUREMENT
/begin MEASUREMENT ctr_chk_mis_a "CARB A diagnosis occurence counter" UBYTE _CNV_A_R_LINEAR_____0_CM 1 100. 0. 255. DISPLAY_IDENTIFIER CTR_CHK_MIS_A ECU_ADDRESS 0x3fe5b3 FORMAT "%3.0" /end MEASUREMENT
/begin MEASUREMENT ctr_ftp_cdn_mis_a "TDC counter for FTP condition detection" UWORD _CNV_A_R_LINEAR_____0_CM 1 100. 0. 65535. DISPLAY_IDENTIFIER CTR_FTP_CDN_MIS_A ECU_ADDRESS 0x3fd5a0 BYTE_ORDER MSB_LAST FORMAT "%5.0" /end MEASUREMENT
/begin MEASUREMENT mis_ctr_a[0] "Misfire sums (cylinder individual) after combination and weighting in CARB A window." UWORD _CNV_A_R_LINEAR_____0_CM 1 100. 0. 65535. DISPLAY_IDENTIFIER MIS_CTR_A_0 ECU_ADDRESS 0x3fd572 BYTE_ORDER MSB_LAST FORMAT "%5.0" /end MEASUREMENT
/begin MEASUREMENT mis_ctr_a[1] "Misfire sums (cylinder individual) after combination and weighting in CARB A window." UWORD _CNV_A_R_LINEAR_____0_CM 1 100. 0. 65535. DISPLAY_IDENTIFIER MIS_CTR_A_1 ECU_ADDRESS 0x3fd574 BYTE_ORDER MSB_LAST FORMAT "%5.0" /end MEASUREMENT
/begin MEASUREMENT mis_ctr_a[2] "Misfire sums (cylinder individual) after combination and weighting in CARB A window." UWORD _CNV_A_R_LINEAR_____0_CM 1 100. 0. 65535. DISPLAY_IDENTIFIER MIS_CTR_A_2 ECU_ADDRESS 0x3fd576 BYTE_ORDER MSB_LAST FORMAT "%5.0" /end MEASUREMENT
/begin MEASUREMENT mis_ctr_a[3] "Misfire sums (cylinder individual) after combination and weighting in CARB A window." UWORD _CNV_A_R_LINEAR_____0_CM 1 100. 0. 65535. DISPLAY_IDENTIFIER MIS_CTR_A_3 ECU_ADDRESS 0x3fd578 BYTE_ORDER MSB_LAST FORMAT "%5.0" /end MEASUREMENT
/begin MEASUREMENT mis_ctr_a[4] "Misfire sums (cylinder individual) after combination and weighting in CARB A window." UWORD _CNV_A_R_LINEAR_____0_CM 1 100. 0. 65535. DISPLAY_IDENTIFIER MIS_CTR_A_4 ECU_ADDRESS 0x3fd57a BYTE_ORDER MSB_LAST FORMAT "%5.0" /end MEASUREMENT
/begin MEASUREMENT mis_ctr_a[5] "Misfire sums (cylinder individual) after combination and weighting in CARB A window." UWORD _CNV_A_R_LINEAR_____0_CM 1 100. 0. 65535. DISPLAY_IDENTIFIER MIS_CTR_A_5 ECU_ADDRESS 0x3fd57c BYTE_ORDER MSB_LAST FORMAT "%5.0" /end MEASUREMENT
/begin MEASUREMENT mis_ctr_b[0] "Misfire sums (cylinder individual) after combination and weighting in CARB B window." UWORD _CNV_A_R_LINEAR_____0_CM 1 100. 0. 65535. DISPLAY_IDENTIFIER MIS_CTR_B_0 ECU_ADDRESS 0x3fd57e BYTE_ORDER MSB_LAST FORMAT "%5.0" /end MEASUREMENT
/begin MEASUREMENT mis_ctr_b[1] "Misfire sums (cylinder individual) after combination and weighting in CARB B window." UWORD _CNV_A_R_LINEAR_____0_CM 1 100. 0. 65535. DISPLAY_IDENTIFIER MIS_CTR_B_1 ECU_ADDRESS 0x3fd580 BYTE_ORDER MSB_LAST FORMAT "%5.0" /end MEASUREMENT
/begin MEASUREMENT mis_ctr_b[2] "Misfire sums (cylinder individual) after combination and weighting in CARB B window." UWORD _CNV_A_R_LINEAR_____0_CM 1 100. 0. 65535. DISPLAY_IDENTIFIER MIS_CTR_B_2 ECU_ADDRESS 0x3fd582 BYTE_ORDER MSB_LAST FORMAT "%5.0" /end MEASUREMENT
/begin MEASUREMENT mis_ctr_b[3] "Misfire sums (cylinder individual) after combination and weighting in CARB B window." UWORD _CNV_A_R_LINEAR_____0_CM 1 100. 0. 65535. DISPLAY_IDENTIFIER MIS_CTR_B_3 ECU_ADDRESS 0x3fd584 BYTE_ORDER MSB_LAST FORMAT "%5.0" /end MEASUREMENT
/begin MEASUREMENT mis_ctr_b[4] "Misfire sums (cylinder individual) after combination and weighting in CARB B window." UWORD _CNV_A_R_LINEAR_____0_CM 1 100. 0. 65535. DISPLAY_IDENTIFIER MIS_CTR_B_4 ECU_ADDRESS 0x3fd586 BYTE_ORDER MSB_LAST FORMAT "%5.0" /end MEASUREMENT
/begin MEASUREMENT mis_ctr_b[5] "Misfire sums (cylinder individual) after combination and weighting in CARB B window." UWORD _CNV_A_R_LINEAR_____0_CM 1 100. 0. 65535. DISPLAY_IDENTIFIER MIS_CTR_B_5 ECU_ADDRESS 0x3fd588 BYTE_ORDER MSB_LAST FORMAT "%5.0" /end MEASUREMENT
/begin MEASUREMENT mis_nr_tdc_b "TDC counter CARB B window (1000 crankshaft revolutions)." UWORD _CNV_A_R_LINEAR_____0_CM 1 100. 0. 65535. DISPLAY_IDENTIFIER MIS_NR_TDC_B ECU_ADDRESS 0x3fd59a BYTE_ORDER MSB_LAST FORMAT "%5.0" /end MEASUREMENT
/begin MEASUREMENT mis_sum_b "CARB B misfire sum (global)" UWORD _CNV_A_R_LINEAR_____0_CM 1 100. 0. 65535. DISPLAY_IDENTIFIER MIS_SUM_B ECU_ADDRESS 0x3fd59e BYTE_ORDER MSB_LAST FORMAT "%5.0" /end MEASUREMENT
/begin MEASUREMENT mis_sum_b_cbk_1 "CARB B misfire sum (cylinder bank dedicated)" UWORD _CNV_A_R_LINEAR_____0_CM 1 100. 0. 65535. DISPLAY_IDENTIFIER MIS_SUM_B_CBK_1 ECU_ADDRESS 0x3fd58e BYTE_ORDER MSB_LAST FORMAT "%5.0" /end MEASUREMENT
/begin MEASUREMENT mis_sum_b_cbk_2 "CARB B misfire sum (cylinder bank dedicated)" UWORD _CNV_A_R_LINEAR_____0_CM 1 100. 0. 65535. DISPLAY_IDENTIFIER MIS_SUM_B_CBK_2 ECU_ADDRESS 0x3fd590 BYTE_ORDER MSB_LAST FORMAT "%5.0" /end MEASUREMENT
/begin MEASUREMENT ctr_chk_mis_b4 "CARB B4 diagnosis occurence counter" UBYTE _CNV_A_R_LINEAR_____0_CM 1 100. 0. 255. DISPLAY_IDENTIFIER CTR_CHK_MIS_B4 ECU_ADDRESS 0x3fe5b4 FORMAT "%3.0" /end MEASUREMENT
/begin MEASUREMENT sym_cyl_mis_a "CARB A misfire criteria symptoms" UWORD _CNV_A_R_LINEAR_____0_CM 1 100. 0. 65535. DISPLAY_IDENTIFIER SYM_CYL_MIS_A ECU_ADDRESS 0x3fd592 BYTE_ORDER MSB_LAST FORMAT "%5.0" /end MEASUREMENT
/begin MEASUREMENT sym_cyl_mis_b1 "CARB B1 misfire criteria symptoms" UWORD _CNV_A_R_LINEAR_____0_CM 1 100. 0. 65535. DISPLAY_IDENTIFIER SYM_CYL_MIS_B1 ECU_ADDRESS 0x3fd594 BYTE_ORDER MSB_LAST FORMAT "%5.0" /end MEASUREMENT
/begin MEASUREMENT sym_cyl_mis_b4 "CARB B4 misfire criteria symptoms" UWORD _CNV_A_R_LINEAR_____0_CM 1 100. 0. 65535. DISPLAY_IDENTIFIER SYM_CYL_MIS_B4 ECU_ADDRESS 0x3fd596 BYTE_ORDER MSB_LAST FORMAT "%5.0" /end MEASUREMENT
/begin CHARACTERISTIC lc_mis_inh "Global switch to disable all misfire monitoring related modules" VALUE 0xffe40301 _REC_VAL_20_u1 1. _CNV_S_2_RANGE______21_CM 0. 1. DISPLAY_IDENTIFIER LC_MIS_INH /end CHARACTERISTIC
/begin CHARACTERISTIC lc_conf_rnd_det_mis_b "Configuration for random cylinder detection when no specific cylinder counter  > C_MIS_B1_MIN_NR * MIS_SUM_B or > C_MIS_B4_MIN_NR * MIS_SUM_B" VALUE 0xffe402fd _REC_VAL_20_u1 1. _CNV_S_2_RANGE______21_CM 0. 1. DISPLAY_IDENTIFIER LC_CONF_RND_DET_MIS_B /end CHARACTERISTIC
/begin CHARACTERISTIC lc_conf_inh_iv_mis "Cylinder switch back on configuration mode : switch back on at the end of driving cycle  (=0) or after a defined number of fuel cut-off phases (=1)" VALUE 0xffe402f7 _REC_VAL_20_u1 1. _CNV_S_2_RANGE______21_CM 0. 1. DISPLAY_IDENTIFIER LC_CONF_INH_IV_MIS /end CHARACTERISTIC
/begin CHARACTERISTIC lc_conf_rnd_det_mis_a "Configuration for random cylinder detection when no specific cylinder counter  > C_MIS_A_MIN_NR * MIS_SUM_A : cylinder with the highest MIS_CTR_A value is updated in SYM_CYL_MIS_A (=0) or RND bit is set to 1 in SYM_CYL_MIS_A (=1)" VALUE 0xffe402fc _REC_VAL_20_u1 1. _CNV_S_2_RANGE______21_CM 0. 1. DISPLAY_IDENTIFIER LC_CONF_RND_DET_MIS_A /end CHARACTERISTIC
/begin CHARACTERISTIC lc_conf_mis_a_lih "Configuration to select MIL mode in case of cylinder shut-off(=0, LV_ERR_MIS_A=0, MIL is not set by cylinder shut-off function), (=1, LV_ERR_MIS_A=1, MIL is ON until end of cylinder shut-off, see mode chosen with LC_CONF_INH_IV_MIS)" VALUE 0xffe402f9 _REC_VAL_20_u1 1. _CNV_S_2_RANGE______21_CM 0. 1. DISPLAY_IDENTIFIER LC_CONF_MIS_A_LIH /end CHARACTERISTIC
/begin CHARACTERISTIC c_nr_cyl_mpl_mis_a "Number of cylinder in MIS_A to set the multiple misfire CARB A status (typical: 2)" VALUE 0xffe402e1 _REC_VAL_20_u1 255. _CNV_A_R_LINEAR_____0_CM 0. 255. DISPLAY_IDENTIFIER C_NR_CYL_MPL_MIS_A FORMAT "%3.0" /end CHARACTERISTIC
/begin CHARACTERISTIC c_nr_cyl_mpl_mis_b "Number of cylinder in MIS_Bx to set the multiple misfire CARB Bx status (typical: 2)" VALUE 0xffe402e2 _REC_VAL_20_u1 255. _CNV_A_R_LINEAR_____0_CM 0. 255. DISPLAY_IDENTIFIER C_NR_CYL_MPL_MIS_B FORMAT "%3.0" /end CHARACTERISTIC
/begin CHARACTERISTIC lc_conf_mpl_det_mis_a "Configuration for multiple cylinder status set in SYM_CYL_MIS_A (multiple misfire pattern Pcode saved) (=1)" VALUE 0xffe402fa _REC_VAL_20_u1 1. _CNV_S_2_RANGE______21_CM 0. 1. DISPLAY_IDENTIFIER LC_CONF_MPL_DET_MIS_A /end CHARACTERISTIC
/begin CHARACTERISTIC lc_conf_mpl_det_mis_b "Configuration for multiple cylinder status set in SYM_CYL_MIS_Bx (multiple misfire pattern Pcode saved) (=1)" VALUE 0xffe402fb _REC_VAL_20_u1 1. _CNV_S_2_RANGE______21_CM 0. 1. DISPLAY_IDENTIFIER LC_CONF_MPL_DET_MIS_B /end CHARACTERISTIC
/begin MEASUREMENT lv_det_mis_a "CARB A misfire criteria detected in actual 200 rev. window (not debounced)" UBYTE _CNV_S_2_RANGE______21_CM 1 100. 0. 1. DISPLAY_IDENTIFIER LV_DET_MIS_A ECU_ADDRESS 0x3fe5a7 /end MEASUREMENT
/begin MEASUREMENT lv_inh_iv_mis_a "At least one cylinder is shut-off by a CARB A misfire criterion confirmed" UBYTE _CNV_S_2_RANGE______21_CM 1 100. 0. 1. DISPLAY_IDENTIFIER LV_INH_IV_MIS_A ECU_ADDRESS 0x3fe5ac /end MEASUREMENT
/begin MEASUREMENT ctr_det_mis_a "CARB A misfire criteria detected counter" UBYTE _CNV_A_R_LINEAR_____0_CM 1 100. 0. 255. DISPLAY_IDENTIFIER CTR_DET_MIS_A ECU_ADDRESS 0x3fe5a4 FORMAT "%3.0" /end MEASUREMENT
/begin CHARACTERISTIC c_nr_det_max_mis_a "Maximum value of CTR_ERR_DET_MIS_A for misfire CARB A status detection (typical: 3)" VALUE 0xffe402e3 _REC_VAL_20_u1 255. _CNV_A_R_LINEAR_____0_CM 0. 255. DISPLAY_IDENTIFIER C_NR_DET_MAX_MIS_A FORMAT "%3.0" /end CHARACTERISTIC
/begin MEASUREMENT lv_end_win_mis_a "CARB A misfire criteria diagnosis end for similar condition window" UBYTE _CNV_S_2_RANGE______21_CM 1 100. 0. 1. DISPLAY_IDENTIFIER LV_END_WIN_MIS_A ECU_ADDRESS 0x3fe5ad /end MEASUREMENT
/begin CHARACTERISTIC c_ratio_ftp_cdn_ind_mis_a "Coverting ratio to detect FTP conditions for short term protection" VALUE 0xffe402ea _REC_VAL_20_u1 99.609375 _CNV_A_R_LINEAR_____9_CM 0. 99.609375 DISPLAY_IDENTIFIER C_RATIO_FTP_CDN_IND_MIS_A FORMAT "%5.1" /end CHARACTERISTIC
/begin CHARACTERISTIC c_ratio_ftp_cdn_mis_a "Coverting ratio to detect FTP conditions for long term protection" VALUE 0xffe402eb _REC_VAL_20_u1 99.609375 _CNV_A_R_LINEAR_____9_CM 0. 99.609375 DISPLAY_IDENTIFIER C_RATIO_FTP_CDN_MIS_A FORMAT "%5.1" /end CHARACTERISTIC
/begin MEASUREMENT lv_det_mis_b4 "CARB B4 misfire criteria detected in actual 1000 rev. window, (not debounced)" UBYTE _CNV_S_2_RANGE______21_CM 1 100. 0. 1. DISPLAY_IDENTIFIER LV_DET_MIS_B4 ECU_ADDRESS 0x3fe5ab /end MEASUREMENT
/begin MEASUREMENT lv_mis_state_b1 "CARB B1 misfire criterion confirmed" UBYTE _CNV_S_2_RANGE______21_CM 1 100. 0. 1. DISPLAY_IDENTIFIER LV_MIS_STATE_B1 ECU_ADDRESS 0x3fe5a9 /end MEASUREMENT
/begin MEASUREMENT lv_mis_state_b4 "CARB B4 misfire criterion confirmed (debounced)" UBYTE _CNV_S_2_RANGE______21_CM 1 100. 0. 1. DISPLAY_IDENTIFIER LV_MIS_STATE_B4 ECU_ADDRESS 0x3fe5aa /end MEASUREMENT
/begin MEASUREMENT ctr_det_mis_b4 "CARB B4 misfire criteria detected counter" UBYTE _CNV_A_R_LINEAR_____0_CM 1 100. 0. 255. DISPLAY_IDENTIFIER CTR_DET_MIS_B4 ECU_ADDRESS 0x3fe5a5 FORMAT "%3.0" /end MEASUREMENT
/begin MEASUREMENT lv_end_win_mis_b1 "End of CARB B1 window for similar condition" UBYTE _CNV_S_2_RANGE______21_CM 1 100. 0. 1. DISPLAY_IDENTIFIER LV_END_WIN_MIS_B1 ECU_ADDRESS 0x3fe5af /end MEASUREMENT
/begin MEASUREMENT lv_end_win_mis_b4 "End of CARB B4 window for similar condition" UBYTE _CNV_S_2_RANGE______21_CM 1 100. 0. 1. DISPLAY_IDENTIFIER LV_END_WIN_MIS_B4 ECU_ADDRESS 0x3fe5b1 /end MEASUREMENT
/begin MEASUREMENT lv_end_mis_b1 "CARB B1 misfire criteria determination end" UBYTE _CNV_S_2_RANGE______21_CM 1 100. 0. 1. DISPLAY_IDENTIFIER LV_END_MIS_B1 ECU_ADDRESS 0x3fe5b0 /end MEASUREMENT
/begin MEASUREMENT lv_end_mis_a "CARB A misfire criteria determination end" UBYTE _CNV_S_2_RANGE______21_CM 1 100. 0. 1. DISPLAY_IDENTIFIER LV_END_MIS_A ECU_ADDRESS 0x3fe5ae /end MEASUREMENT
/begin MEASUREMENT lv_end_mis_b4 "CARB B4 misfire criteria determination end" UBYTE _CNV_S_2_RANGE______21_CM 1 100. 0. 1. DISPLAY_IDENTIFIER LV_END_MIS_B4 ECU_ADDRESS 0x3fe5b2 /end MEASUREMENT
/begin CHARACTERISTIC c_nr_det_max_mis_b4 "Maximum value of CTR_ERR_DET_MIS_B4 for misfire CARB B4 status detection (typical: 4)" VALUE 0xffe402e4 _REC_VAL_20_u1 255. _CNV_A_R_LINEAR_____0_CM 0. 255. DISPLAY_IDENTIFIER C_NR_DET_MAX_MIS_B4 FORMAT "%3.0" /end CHARACTERISTIC
/begin MEASUREMENT lv_mis_state_a "Project specific name for misfire carb A detected, debounced" UBYTE _CNV_S_2_RANGE______21_CM 1 100. 0. 1. DISPLAY_IDENTIFIER LV_MIS_STATE_A ECU_ADDRESS 0x3fe5a8 /end MEASUREMENT
/begin MEASUREMENT lv_act_sa_eol "Activation bit for secondary air EOL test" UBYTE _CNV_S_2_RANGE______2_CM 1 100. 0. 1. DISPLAY_IDENTIFIER LV_ACT_SA_EOL ECU_ADDRESS 0x3fecf4 /end MEASUREMENT
/begin CHARACTERISTIC c_tco_min_sa_eol "TCO threshold for EOL activation" VALUE 0xffe40920 _REC_VAL_20_u1 190.5 _CNV_A_R_LINEAR_____11_CM -48. 142.5 DISPLAY_IDENTIFIER C_TCO_MIN_SA_EOL FORMAT "%5.1" /end CHARACTERISTIC
/begin COMPU_METHOD _CNV_A_R_LINEAR_____0_CM "" RAT_FUNC "%6.3" "-" COEFFS 0 1. 0. 0 0 1 /end COMPU_METHOD
/begin COMPU_METHOD _CNV_S_2_RANGE______2_CM "" TAB_VERB "%6.3" "[-]" COMPU_TAB_REF _CNV_S_2_RANGE______2 /end COMPU_METHOD
/begin COMPU_VTAB _CNV_S_2_RANGE______2 "" TAB_VERB 2 0 "0" 1 "1" /end COMPU_VTAB
/begin COMPU_METHOD _CNV_A_R_LINEAR_____3_CM "" RAT_FUNC "%6.3" "V" COEFFS 0 204.7999998974999 0. 0 0 1 /end COMPU_METHOD
/begin COMPU_METHOD _CNV_A_R_LINEAR_____4_CM "" RAT_FUNC "%6.3" "s" COEFFS 0 100. 0. 0 0 1 /end COMPU_METHOD
/begin COMPU_METHOD _CNV_A_R_LINEAR_____9_CM "" RAT_FUNC "%6.3" "%" COEFFS 0 2.56 0. 0 0 1 /end COMPU_METHOD
/begin COMPU_METHOD _CNV_A_R_LINEAR_____10_CM "" RAT_FUNC "%6.3" "rpm" COEFFS 0 1. 0. 0 0 1 /end COMPU_METHOD
/begin COMPU_METHOD _CNV_A_R_LINEAR_____11_CM "" RAT_FUNC "%6.3" "°C" COEFFS 0 1.333333333333333 64. 0 0 1 /end COMPU_METHOD
/begin COMPU_METHOD _CNV_A_R_LINEAR_____15_CM "" RAT_FUNC "%6.3" "rpm" COEFFS 0 3.125e-002 0. 0 0 1 /end COMPU_METHOD
/begin COMPU_METHOD _CNV_A_R_LINEAR_____20_CM "" RAT_FUNC "%6.3" "-" COEFFS 0 32768.00003968061 0. 0 0 1 /end COMPU_METHOD
/begin COMPU_METHOD _CNV_S_2_RANGE______21_CM "" TAB_VERB "%6.3" "-" COMPU_TAB_REF _CNV_S_2_RANGE______21 /end COMPU_METHOD
/begin COMPU_VTAB _CNV_S_2_RANGE______21 "" TAB_VERB 2 0 "0" 1 "1" /end COMPU_VTAB
/begin COMPU_METHOD _CNV_A_R_LINEAR_____22_CM "" RAT_FUNC "%6.3" "[-]" COEFFS 0 1. 0. 0 0 1 /end COMPU_METHOD
/begin COMPU_METHOD _CNV_A_R_LINEAR_____23_CM "" RAT_FUNC "%6.3" "km/h" COEFFS 0 1. 0. 0 0 1 /end COMPU_METHOD
/begin COMPU_METHOD _CNV_A_R_LINEAR_____24_CM "" RAT_FUNC "%6.3" "s" COEFFS 0 10. 0. 0 0 1 /end COMPU_METHOD
/begin COMPU_METHOD _CNV_A_R_LINEAR_____27_CM "" RAT_FUNC "%6.3" "mg/stk" COEFFS 0 0.183585313174946 0. 0 0 1 /end COMPU_METHOD
/begin COMPU_METHOD _CNV_A_R_LINEAR_____30_CM "" RAT_FUNC "%6.3" "s" COEFFS 0 1. 0. 0 0 1 /end COMPU_METHOD
/begin COMPU_METHOD _CNV_A_R_LINEAR_____37_CM "" RAT_FUNC "%6.3" "-" COEFFS 0 65536.00007936121 0. 0 0 1 /end COMPU_METHOD
/begin COMPU_METHOD _CNV_A_R_LINEAR_____39_CM "" RAT_FUNC "%6.3" "-" COEFFS 0 127.9991955827809 0. 0 0 1 /end COMPU_METHOD
/begin COMPU_METHOD _CNV_A_R_LINEAR_____49_CM "" RAT_FUNC "%6.3" "hPa" COEFFS 0 12.06017666543982 0. 0 0 1 /end COMPU_METHOD
/begin COMPU_METHOD _CNV_A_R_LINEAR_____50_CM "" RAT_FUNC "%6.3" "[-]" COEFFS 0 255.9999357490357 0. 0 0 1 /end COMPU_METHOD
/begin COMPU_METHOD _CNV_A_R_LINEAR_____52_CM "" RAT_FUNC "%6.3" "°TPS/s" COEFFS 0 8.535564853556485e-002 0. 0 0 1 /end COMPU_METHOD
/begin COMPU_METHOD _CNV_A_R_LINEAR_____53_CM "" RAT_FUNC "%6.3" "°TPS" COEFFS 0 137.0962343096234 0. 0 0 1 /end COMPU_METHOD
/begin COMPU_METHOD _CNV_A_R_LINEAR_____68_CM "" RAT_FUNC "%6.3" "km/h" COEFFS 0 10. 0. 0 0 1 /end COMPU_METHOD
/begin COMPU_METHOD _CNV_A_R_LINEAR_____85_CM "" RAT_FUNC "%6.3" "km/h" COEFFS 0 128.0000018750286 0. 0 0 1 /end COMPU_METHOD
/begin COMPU_METHOD _CNV_A_R_LINEAR_____97_CM "" RAT_FUNC "%6.3" "min" COEFFS 0 1. 0. 0 0 1 /end COMPU_METHOD
/begin COMPU_METHOD _CNV_A_R_LINEAR_____108_CM "" RAT_FUNC "%6.3" "mg/stk" COEFFS 0 47.18142548596112 0. 0 0 1 /end COMPU_METHOD
/begin COMPU_METHOD _CNV_A_R_LINEAR_____113_CM "" RAT_FUNC "%6.3" "kg/h" COEFFS 0 8191.999999679995 0. 0 0 1 /end COMPU_METHOD
/begin COMPU_METHOD _CNV_A_R_LINEAR_____139_CM "" RAT_FUNC "%6.3" "m/s²" COEFFS 0 2084.478388984895 2.74784179055132e-004 0 0 1 /end COMPU_METHOD
/begin COMPU_METHOD _CNV_A_R_LINEAR_____140_CM "" RAT_FUNC "%6.3" "rpm/(km/h)" COEFFS 0 0.5 0. 0 0 1 /end COMPU_METHOD
/begin COMPU_METHOD _CNV_A_R_LINEAR_____141_CM "" RAT_FUNC "%6.3" "km/h" COEFFS 0 65536.00007936121 0. 0 0 1 /end COMPU_METHOD
/begin COMPU_METHOD _CNV_A_R_LINEAR_____142_CM "" RAT_FUNC "%6.3" "ms" COEFFS 0 1. 0. 0 0 1 /end COMPU_METHOD
/begin COMPU_METHOD _CNV_A_R_LINEAR_____143_CM "" RAT_FUNC "%6.3" "km/h" COEFFS 0 128. 0. 0 0 1 /end COMPU_METHOD
/begin COMPU_METHOD _CNV_A_R_LINEAR_____147_CM "" RAT_FUNC "%6.3" "km/h" COEFFS 0 128.0039001188318 0. 0 0 1 /end COMPU_METHOD
/begin COMPU_METHOD _CNV_A_R_LINEAR_____206_CM "" RAT_FUNC "%6.3" "-" COEFFS 0 1023.999999919998 0. 0 0 1 /end COMPU_METHOD
/begin COMPU_METHOD _CNV_A_R_LINEAR_____415_CM "" RAT_FUNC "%6.3" "%" COEFFS 0 327.67 0. 0 0 1 /end COMPU_METHOD
/begin COMPU_METHOD _CNV_A_R_LINEAR_____428_CM "" RAT_FUNC "%6.3" "µs" COEFFS 0 1. 0. 0 0 1 /end COMPU_METHOD
/begin COMPU_METHOD _CNV_R_R_vfzg_ub_q1_545_CM "" RAT_FUNC "%6.3" "[-]" COEFFS 0. 1. 0. 0. 0. 1.25 /end COMPU_METHOD
/begin COMPU_METHOD _CNV_R_R_temp_uw_q0_547_CM "" RAT_FUNC "%6.3" "[-]" COEFFS 0. 1. 48. 0. 0. 0.75 /end COMPU_METHOD
/begin COMPU_METHOD _CNV_R_R_dez_550_CM "" RAT_FUNC "%6.3" "[-]" COEFFS 0. 1. 0. 0. 0. 1. /end COMPU_METHOD
/begin COMPU_METHOD _CNV_R_R_t100msxs_u_552_CM "" RAT_FUNC "%6.3" "[-]" COEFFS 0. 1. 0. 0. 0. 0.1 /end COMPU_METHOD
/begin COMPU_METHOD _CNV_R_R_nmot_ub_q4_560_CM "" RAT_FUNC "%6.3" "[-]" COEFFS 0. 1. 0. 0. 0. 40. /end COMPU_METHOD
/begin COMPU_METHOD _CNV_A_R_LINEAR_____563_CM "" RAT_FUNC "%6.3" "µs" COEFFS 0 1. -1. 0 0 1 /end COMPU_METHOD
/begin COMPU_METHOD _CNV_A_R_LINEAR_____564_CM "" RAT_FUNC "%6.3" "%." COEFFS 0 65.408 0. 0 0 1 /end COMPU_METHOD
/begin COMPU_METHOD _CNV_A_R_LINEAR_____565_CM "" RAT_FUNC "%6.3" "%." COEFFS 0 66.66123114553608 0. 0 0 1 /end COMPU_METHOD
/begin COMPU_METHOD _CNV_A_R_LINEAR_____566_CM "" RAT_FUNC "%6.3" "%." COEFFS 0 4194.293686959193 -8.057063130399911e-002 0 0 1 /end COMPU_METHOD
/begin COMPU_METHOD _CNV_A_R_LINEAR_____567_CM "" RAT_FUNC "%6.3" "%." COEFFS 0 4194.283373654366 0. 0 0 1 /end COMPU_METHOD
/begin COMPU_METHOD _CNV_A_R_LINEAR_____568_CM "" RAT_FUNC "%6.3" "-" COEFFS 0 255. 0. 0 0 1 /end COMPU_METHOD
/begin COMPU_METHOD _CNV_A_R_LINEAR_____569_CM "" RAT_FUNC "%6.3" "-" COEFFS 0 255.5 0. 0 0 1 /end COMPU_METHOD
/begin COMPU_METHOD _CNV_A_R_LINEAR_____570_CM "" RAT_FUNC "%6.3" "%." COEFFS 0 4194.293686959193 32767.9194293687 0 0 1 /end COMPU_METHOD
/begin COMPU_METHOD _CNV_A_R_LINEAR_____571_CM "" RAT_FUNC "%6.3" "%" COEFFS 0 327.6800000071683 0. 0 0 1 /end COMPU_METHOD
/begin COMPU_METHOD _CNV_A_R_LINEAR_____572_CM "" RAT_FUNC "%6.3" "µs" COEFFS 0 1. 32768. 0 0 1 /end COMPU_METHOD
/begin COMPU_METHOD _CNV_R_R_temp_uw_q0_577_CM "" RAT_FUNC "%6.3" "Grad C" COEFFS 0. 1. 48. 0. 0. 0.75 /end COMPU_METHOD
/begin COMPU_METHOD _CNV_S_2_B_TRUE_582_CM "" TAB_VERB "%6.3" "[-]" COMPU_TAB_REF _CNV_S_2_B_TRUE_582 /end COMPU_METHOD
/begin COMPU_VTAB _CNV_S_2_B_TRUE_582 "" TAB_VERB 2 0 "----" 1 "TRUE" /end COMPU_VTAB
/begin COMPU_METHOD _CNV_R_R_i_uw_q0p08_587_CM "" RAT_FUNC "%6.3" "A" COEFFS 0. 1. 200. 0. 0. 8.e-002 /end COMPU_METHOD
/begin COMPU_METHOD _CNV_R_R_i_uw_q0p02_588_CM "" RAT_FUNC "%6.3" "A" COEFFS 0. 1. 200. 0. 0. 2.e-002 /end COMPU_METHOD
/begin COMPU_METHOD _CNV_R_R_i_ub_q0p02_589_CM "" RAT_FUNC "%6.3" "A" COEFFS 0. 1. 0. 0. 0. 2.e-002 /end COMPU_METHOD
/begin COMPU_METHOD _CNV_R_R_qlad_uw_q0_590_CM "" RAT_FUNC "%6.3" "Ah" COEFFS 0. 3600000. 0. 0. 0. 65536. /end COMPU_METHOD
/begin COMPU_METHOD _CNV_R_R_spg_uw_q0p_591_CM "" RAT_FUNC "%6.3" "V" COEFFS 0. 1. -6. 0. 0. 2.5e-004 /end COMPU_METHOD
/begin COMPU_METHOD _CNV_R_R_nmot_ub_q1_596_CM "" RAT_FUNC "%6.3" "[-]" COEFFS 0. 1. 0. 0. 0. 10. /end COMPU_METHOD
/begin COMPU_METHOD _CNV_R_R_rel_ub_q0p_597_CM "" RAT_FUNC "%6.3" "[-]" COEFFS 0. 1. 0. 0. 0. 0.75 /end COMPU_METHOD
/begin COMPU_METHOD _CNV_R_R_fak_ub_b4_598_CM "" RAT_FUNC "%6.3" "[-]" COEFFS 0. 256. 0. 0. 0. 4. /end COMPU_METHOD
/begin COMPU_METHOD _CNV_R_R_temp_ub_q5_599_CM "" RAT_FUNC "%6.3" "[-]" COEFFS 0. 1. 50. 0. 0. 5. /end COMPU_METHOD
/begin COMPU_METHOD _CNV_A_R_LINEAR_____600_CM "" RAT_FUNC "%6.3" "1/s^2" COEFFS 0 1. 0. 0 0 1 /end COMPU_METHOD
/begin COMPU_METHOD _CNV_A_R_LINEAR_____603_CM "" RAT_FUNC "%6.3" "tdc" COEFFS 0 1. 0. 0 0 1 /end COMPU_METHOD
/begin COMPU_METHOD _CNV_S_5_RANGE_STAT_605_CM "" TAB_VERB "%6.3" "-" COMPU_TAB_REF _CNV_S_5_RANGE_STAT_605 /end COMPU_METHOD
/begin COMPU_VTAB _CNV_S_5_RANGE_STAT_605 "" TAB_VERB 5 0 "Init Phase" 1 "Prepa. 0 delay" 2 "0 delay monit." 3 "Prepa nominal" 4 "Nominal monit." /end COMPU_VTAB
/begin COMPU_METHOD _CNV_A_R_LINEAR_____606_CM "" RAT_FUNC "%6.3" "cyl" COEFFS 0 1. 0. 0 0 1 /end COMPU_METHOD
/begin RECORD_LAYOUT _REC_VAL_20_u1 FNC_VALUES 1 UBYTE COLUMN_DIR DIRECT /end RECORD_LAYOUT
/begin RECORD_LAYOUT _REC_VAL_20_u2 FNC_VALUES 1 UWORD COLUMN_DIR DIRECT /end RECORD_LAYOUT
/begin RECORD_LAYOUT _REC_CUR_20_u2_u1 FNC_VALUES 1 UWORD COLUMN_DIR DIRECT /end RECORD_LAYOUT
/begin RECORD_LAYOUT _REC_AXS_20_u1 NO_AXIS_PTS_X 1 UBYTE AXIS_PTS_X 2 UBYTE INDEX_INCR DIRECT /end RECORD_LAYOUT
/begin RECORD_LAYOUT _REC_CUR_20_u1_u1 FNC_VALUES 1 UBYTE COLUMN_DIR DIRECT /end RECORD_LAYOUT
/begin RECORD_LAYOUT _REC_AXS_20_u2 NO_AXIS_PTS_X 1 UWORD AXIS_PTS_X 2 UWORD INDEX_INCR DIRECT /end RECORD_LAYOUT
/begin RECORD_LAYOUT _REC_CUR_20_u1_u2 FNC_VALUES 1 UBYTE COLUMN_DIR DIRECT /end RECORD_LAYOUT
/begin RECORD_LAYOUT _REC_CUR_20_u2_u2 FNC_VALUES 1 UWORD COLUMN_DIR DIRECT /end RECORD_LAYOUT
/begin RECORD_LAYOUT _REC_VAL_20_u4 FNC_VALUES 1 ULONG COLUMN_DIR DIRECT /end RECORD_LAYOUT
/begin RECORD_LAYOUT _REC_VAL_20_s2 FNC_VALUES 1 SWORD COLUMN_DIR DIRECT /end RECORD_LAYOUT
/begin RECORD_LAYOUT _REC_MAP_20_u2_u1_u2 FNC_VALUES 1 UWORD COLUMN_DIR DIRECT /end RECORD_LAYOUT
/begin RECORD_LAYOUT _REC_VAL_2_u1 FNC_VALUES 1 UBYTE COLUMN_DIR DIRECT /end RECORD_LAYOUT
/begin RECORD_LAYOUT _REC_CUR_32_u1_u1 NO_AXIS_PTS_X 1 UBYTE AXIS_PTS_X 2 UBYTE INDEX_INCR DIRECT FNC_VALUES 3 UBYTE COLUMN_DIR DIRECT /end RECORD_LAYOUT
/begin RECORD_LAYOUT _REC_MAP_52_UBYTE_u1_u1_u1 NO_AXIS_PTS_X 1 UBYTE NO_AXIS_PTS_Y 2 UBYTE AXIS_PTS_X 3 UBYTE INDEX_INCR DIRECT AXIS_PTS_Y 4 UBYTE INDEX_INCR DIRECT FNC_VALUES 5 UBYTE COLUMN_DIR DIRECT /end RECORD_LAYOUT
/begin RECORD_LAYOUT _REC_CUR_52_UBYTE_u1_u1 NO_AXIS_PTS_X 1 UBYTE AXIS_PTS_X 2 UBYTE INDEX_INCR DIRECT FNC_VALUES 3 UBYTE COLUMN_DIR DIRECT /end RECORD_LAYOUT
/begin RECORD_LAYOUT _REC_MAP_52_UBYTE_u1_u1_u2 NO_AXIS_PTS_X 1 UBYTE NO_AXIS_PTS_Y 2 UBYTE AXIS_PTS_X 3 UBYTE INDEX_INCR DIRECT AXIS_PTS_Y 4 UWORD INDEX_INCR DIRECT FNC_VALUES 5 UBYTE COLUMN_DIR DIRECT /end RECORD_LAYOUT
/begin FUNCTION CRU_Additional_functions "_Additional functions"
 /begin DEF_CHARACTERISTIC c_t_err_vs_can c_fac_vs_fil c_vs_max_diag c_fac_tq_req_driv_mmv c_fac_ac_cru_mmv lc_vs_cru_fil c_crlc_vs_cru_mmv c_t_dly_max_cru c_vs_sp_dif_min_cru c_vs_sp_dif_max_cru c_vs_dif_dly_cru_neg c_fac_tq_req_hys_cru c_vs_dif_dly_cru_pos c_vs_dif_min_cru_over /end DEF_CHARACTERISTIC
 /begin OUT_MEASUREMENT ac_cru lv_vs_diag_not_plaus fac_tq_req_driv_mmv n_vs_cru vs_fil t_err_vs_can vs_cru vs_dif_icl_tcs t_dly_cru lv_cru_over_act /end OUT_MEASUREMENT
/end FUNCTION
/begin FUNCTION CRU_Step_cruise_control "_Step cruise control"
 /begin DEF_CHARACTERISTIC c_vs_dif_step_prog_m c_vs_dif_step_prog_k c_vs_dif_step_min c_vs_dif_tip_prog c_vs_min_prog c_max_step c_t_cru_flash_light c_t_dly_cru_tip c_t_min_prog /end DEF_CHARACTERISTIC
 /begin OUT_MEASUREMENT nr_step_on count_vs_step vs_dif_step_prog lv_prog_step_1 lv_step_on vs_sp_driv_step nr_vs_cru vs_sp_driv_cru_can vs_step_can_1 vs_step_can_2 vs_step_can_3 /end OUT_MEASUREMENT
/end FUNCTION
/begin FUNCTION BGO_Basic_SW_General_Operation "BGO" /begin SUB_FUNCTION BGO_Non_volatile_datas BGO_Signal_acquisition_for_cylin /end SUB_FUNCTION /end FUNCTION
/begin FUNCTION BGO_Non_volatile_datas "_Non volatile datas"
 /begin DEF_CHARACTERISTIC lc_ad_clr_knk lc_ad_clr_lam lc_ad_clr_tco lc_ad_clr_tps lc_ad_clr_mis lc_ad_clr_ivvt lc_ad_clr_imm lc_ad_clr_idle lc_ad_clr_ati lc_ad_clr_toil lc_ad_clr_ecf lc_ad_clr_sa lc_ad_clr_n_sp_is lc_ad_clr_ron lc_ad_clr_tecu lc_ad_clr_var lc_ad_clr_dmtl lc_ad_clr_sof lc_ad_clr_n_max lc_ad_clr_lif lc_ad_clr_oz lc_ad_clr_tqi_lim lc_ad_clr_teg lc_ad_clr lc_ad_clr_obd2 lc_ad_clr_cru c_nvmy_inst_chk lc_ad_clr_can /end DEF_CHARACTERISTIC
 /begin OUT_MEASUREMENT lv_nvmy_rd_failed lv_nvmy_wr_failed nvmy_e2p_address /end OUT_MEASUREMENT
/end FUNCTION
/begin FUNCTION BGO_Signal_acquisition_for_cylin "_Signal acquisition for cylinder individual lambda control"
 /begin OUT_MEASUREMENT vls_cyl[0] vls_cyl[1] vls_cyl[2] vls_cyl[3] vls_cyl[4] vls_cyl[5] vls_cyl_trig[0] vls_cyl_trig[1] vls_cyl_trig[2] vls_cyl_trig[3] vls_cyl_trig[4] vls_cyl_trig[5] /end OUT_MEASUREMENT
/end FUNCTION
/begin FUNCTION EOL_End_of_line_test "_End of line test"
 /begin SUB_FUNCTION EOL_End_of_line_test_Lambda_sens EOL_Lambda_setpoint_for_external EOL_SA_System_test /end SUB_FUNCTION
/end FUNCTION
/begin FUNCTION EOL_End_of_line_test_Lambda_sens "_End of line test Lambda sensors confused wrong wired" /begin OUT_MEASUREMENT lv_req_eol_chk_ls_up_down_1 lv_req_eol_chk_ls_up_down_2 /end OUT_MEASUREMENT /end FUNCTION
/begin FUNCTION EOL_Lambda_setpoint_for_external "_Lambda setpoint for external adjustment"
 /begin OUT_MEASUREMENT lamb_sp_ext_adj_1 lamb_sp_ext_adj_2 lv_lamb_sp_ext_adj_1 lv_lamb_sp_ext_adj_2 /end OUT_MEASUREMENT
/end FUNCTION
/begin FUNCTION EOL_SA_System_test "_SA System test" /begin DEF_CHARACTERISTIC c_tco_min_sa_eol /end DEF_CHARACTERISTIC /begin OUT_MEASUREMENT lv_act_sa_eol /end OUT_MEASUREMENT /end FUNCTION
/begin FUNCTION C_Y_Byp_Sim "" /begin SUB_FUNCTION Bypass_Simulation /end SUB_FUNCTION /end FUNCTION
/begin FUNCTION Bypass_Simulation "Bypass_Simulation"
 /begin DEF_CHARACTERISTIC c_byp_lih_cnt_max_A c_byp_lih_cnt_max_B c_byp_on c_byp_func_A c_byp_func_B /end DEF_CHARACTERISTIC
 /begin OUT_MEASUREMENT lv_byp_on byp_cnt_A byp_cnt_B byp_error /end OUT_MEASUREMENT
/end FUNCTION
/begin FUNCTION C_A_DIA "" /begin SUB_FUNCTION DIA_IS_Control_Diag DIA_IS_Control_Diag__AI /end SUB_FUNCTION /end FUNCTION
/begin FUNCTION DIA_IS_Control_Diag "_IS_Control_Diag"
 /begin DEF_CHARACTERISTIC c_maf_max_diag_isc c_n_dif_max_diag_isc c_n_dif_min_diag_isc c_t_dly_isc_diag c_abc_inc_isc c_abc_dec_isc c_flow_cps_max_diag_isc c_abc_max_isc lc_inh_diag_isc_man /end DEF_CHARACTERISTIC
 /begin OUT_MEASUREMENT t_isc_diag /end OUT_MEASUREMENT
/end FUNCTION
/begin FUNCTION DIA_IS_Control_Diag__AI "_IS_Control_Diag__AI" /begin OUT_MEASUREMENT lv_err_isc /end OUT_MEASUREMENT /end FUNCTION
/begin FUNCTION DIBS ""
 /begin DEF_CHARACTERISTIC IBBSTERR1 IBBSTERR2 IBBSTERR3 IBBSTERR4 IBBSTERR5 IBBSTERR6 IBBSTERR7 IBBSTERR8 IBBSTHEAL MSKIBSDFP MSKIBSDIAG /end DEF_CHARACTERISTIC
 /begin OUT_MEASUREMENT B_doibdig1 B_doibdig2 B_doibdig3 diberrctr1 diberrctr2 diberrctr3 diberrctr4 diberrctr5 diberrctr6 diberrctr7 diberrctr8 dibhealct1 dibhealct2 dibhealct3 ibfehlin1 ibfehlin2 ibfehlin3 ibfehlin4 ibfehlin5 ibfehlin6 ibfehlin7 ibfehlin8 ibsderrs1 ibsderrs2 ibserstat1 ibserstat2 ibserstat3 locerr0 locerr1 /end OUT_MEASUREMENT
/end FUNCTION
/begin FUNCTION ENRD "" /begin SUB_FUNCTION ENRD_Calculation ENRD_Calculation_Appli_Inci /end SUB_FUNCTION /end FUNCTION
/begin FUNCTION ENRD_Calculation ""
 /begin DEF_CHARACTERISTIC c_n_min_er c_crk_dif_max_er c_seg_t_ad_cor_drv1_max_er c_nr_seg_ad_act_min c_nr_seg_drv1_er_min c_n_max_er c_n_32_min_seg c_n_seg_t_ad_raw_min_er c_n_seg_t_ad_min_er c_n_seg_t_ad_max_er c_n_seg_t_ad_raw_max_er ldp_seg_nr_er id_seg_nr_cbk_er /end DEF_CHARACTERISTIC
 /begin OUT_MEASUREMENT if_t_seg_mis cur_seg_cor seg_t_cor_buf[0] seg_t_cor_buf[1] seg_t_cor_buf[2] seg_t_cor_buf[3] seg_t_cor_buf[4] seg_t_cor_buf[5] drv0_er drv2_mmv_er drv1_er er_raw lv_ena_er thd_ad_er seg_t_ad_min_er delta_crk_dif_max_er lv_seg_ad_lim cur_seg_mes seg_t_mes_buf[0] seg_t_mes_buf[1] seg_t_mes_buf[2] seg_t_mes_buf[3] seg_t_mes_buf[4] seg_t_mes_buf[5] drv2_er seg_t_ad_nr lv_seg_ad_state er er_x[0] er_x[1] er_x[2] er_x[3] er_x[4] er_x[5] seg_ad_mmv[0] seg_ad_mmv[1] seg_ad_mmv[2] seg_ad_mmv[3] seg_ad_mmv[4] seg_ad_mmv[5] seg_ad_raw_mmv[0] seg_ad_raw_mmv[1] seg_ad_raw_mmv[2] seg_ad_raw_mmv[3] seg_ad_raw_mmv[4] seg_ad_raw_mmv[5] lv_seg_ad_act_state lv_seg_ad_raw_act_state seg_nr_er seg_nr_cbk_er /end OUT_MEASUREMENT
/end FUNCTION
/begin FUNCTION ENRD_Calculation_Appli_Inci ""
 /begin DEF_CHARACTERISTIC c_seg_t_ad_raw_crlc_er c_tps_grd_dly_er_ad c_seg_t_mes_min c_seg_t_mes_max c_seg_t_fast_ad_crlc_er c_seg_t_ad_crlc_er_eol c_seg_t_ad_crlc_er c_seg_t_ad_cor_drv1_max_er_eol c_seg_ad_dif_max_er c_nr_seg_drv1_er_min_eol c_nr_seg_ad_act_min_eol c_n_seg_t_ad_min_er_eol c_n_seg_t_ad_max_er_eol c_maf_dif_dly_er_ad c_load_mis_dif_dly_er_ad c_fac_drv2_zdly_er c_crlc_drv2_zdly_er ip_seg_2_ad_cor ip_seg_1_ad_cor ip_maf_dif_max_er_ad__maf ip_fac_load_drv2_er_mt ip_fac_load_drv2_er_at ip_fac_gain_er_5_mt ip_fac_gain_er_5_at ip_fac_gain_er_4_mt ip_fac_gain_er_4_at ip_fac_gain_er_3_mt ip_fac_gain_er_3_at ip_fac_gain_er_2_mt ip_fac_gain_er_2_at ip_fac_gain_er_1_mt ip_fac_gain_er_1_at ip_fac_gain_er_0_mt ip_fac_gain_er_0_at ip_fac_add_er_4_at ip_fac_add_er_4_mt ip_fac_add_er_3_mt ip_fac_add_er_3_at ip_fac_add_er_5_at ip_fac_add_er_5_mt ip_fac_add_er_1_at ip_fac_add_er_2_mt ip_fac_add_er_2_at ip_fac_add_er_1_mt ip_crlc_drv2_er_at ip_crlc_drv2_er_mt ip_fac_add_er_0_at ip_fac_add_er_0_mt c_t_drv2_zdly_er c_accout_dly_er_ad ip_tps_grd_max_er_ad__tps_av ip_load_mis_dif_max_er_ad lc_seg_ad_rst_ena_eol lc_seg_ad_req_ena_eol lc_conf_gain_add_er ip_fac_n_drv2_er_at ip_fac_n_drv2_er_mt /end DEF_CHARACTERISTIC
 /begin OUT_MEASUREMENT fac_gain_er[0] fac_gain_er[1] fac_gain_er[2] fac_gain_er[3] fac_gain_er[4] fac_gain_er[5] fac_drv2_er fac_add_er[0] fac_add_er[1] fac_add_er[2] fac_add_er[3] fac_add_er[4] fac_add_er[5] crlc_drv2_er lv_seg_ad_req_eol lv_seg_ad_rst_eol lv_err_det_crk seg_t_mes lv_ena_seg_t_mes lv_seg_ad_fdout seg_ad_cor seg_ad_dif_1 seg_ad_dif_0 seg_ad_dif_2 seg_t_ad_crlc_er lv_inh_seg_ad lv_err_seg_t lv_err_seg_t_ad /end OUT_MEASUREMENT
/end FUNCTION
/begin FUNCTION KT_IBS ""
 /begin DEF_CHARACTERISTIC ENABSDIBS ENISOC0 ENUSOC0 ERREPEAT IBSTSTERR IBSVERSION IBUNPLADEL ISLEEPGRZ ISTARTTRIG IWAKEUPGRZ KLIBSTEMP1 T1SCHWELLE T1SOC0 T2SCHWELLE T2SOC0 T3SCHWELLE T3SOC0 TNUSTART TNUSTARTFL TPT1TICO TPT1USTFGK TSLEEPRUH TUPT1SOC0 USOC0GRENZ /end DEF_CHARACTERISTIC
 /begin OUT_MEASUREMENT B_eb_busy B_eb_txok B_eb_write B_ibfbsd B_ibfebsd B_ibunplau B_startfgk chk16_erom chkpara ebsd_adr ebsd_errdir ebsd_errep ebsd_errin ebsd_nbyt ebsd_varin ercntchksu ercntcksub ercntparib ercntparit ercntunteb ercntunter ibatt_10 ibatt_1000 ibatt_200 ibatt_w ibcntreseb ibcntreset ibcntupdat ibhwversi ibswbase ibswchang ibs_errors ibs_msgind ibs_msgrdy ibs_msgsta ibs_msgwri ibs_reg4 ibs_reg5 ibs_start ib_chk16 ib_parlen isoc0 itnstart ivorstart ktib_chk16 kt_IbsStatus kt_OldIbsStatus qelad qeladsoc0 qlad qladsoc0 t1histiruh t2histiruh t3histiruh t4histiruh tbatt tbattroh tbattsoc0 tbatt_max tbatt_maxi tbatt_min tbatt_mini tbatt_tmp u1soc0 u2soc0 u3soc0 ubatthiroh ubattloroh ubatt_w unind utnstart uvorstart /end OUT_MEASUREMENT
/end FUNCTION
/begin FUNCTION LOADRESP ""
 /begin DEF_CHARACTERISTIC ENAPPLGOFF ENAPPLRESP KFLORESP KLLORESPM LRESPAPP RLMXGENOF TGENOFVL TLORESPST TVLOFHYST VGENOFMN VGENOGMX NMXGENOF S_LORESLL TATMGENOF VZLORESOFV FHOGNMN TABSTGNMN TABSTGNMX TMOTABGNMN TUMGGNMN TUMGGNMX KFZLRESOF KFZLRRESOFV /end DEF_CHARACTERISTIC
 /begin OUT_MEASUREMENT tlrgen loadresp B_genoffst B_genoffvl nmot kmstand tkatm rl B_llrein B_vl tmst B_stend tmot tumg vfzg fho tlrgen2 tmotab tabsmn_w tabst_w /end OUT_MEASUREMENT
/end FUNCTION
/begin FUNCTION MISF ""
 /begin SUB_FUNCTION MISF_Det_ENRD_Based MISF_Legal_Misf_Det_Fade_Out_Cnd MISF_Rate_Err_Mngt MISF_Det_ENRD_Based_Appli_Inci MISF_Rate_Err_Mngt_Appli_Inci /end SUB_FUNCTION
/end FUNCTION
/begin FUNCTION MISF_Det_ENRD_Based "" /begin DEF_CHARACTERISTIC c_fac_sca_er_stnd c_n_max_er_stnd lc_er_stnd_conf /end DEF_CHARACTERISTIC
 /begin OUT_MEASUREMENT lv_det_mis mis_state_er er_stnd er_stnd_x[0] er_stnd_x[1] er_stnd_x[2] er_stnd_x[3] er_stnd_x[4] er_stnd_x[5] /end OUT_MEASUREMENT
/end FUNCTION
/begin FUNCTION MISF_Legal_Misf_Det_Fade_Out_Cnd ""
 /begin DEF_CHARACTERISTIC c_mask_inh_det_zdly_mis c_n_min_zdly_mis c_t_zdly_mis c_nr_tdc_zdly_mis c_n_min_mis c_n_max_mis_at c_n_max_mis_mt c_mask_inh_det_mis c_nr_tdc_inh_mis lc_req_zdly_mis c_amp_min_mis c_tco_min_mis c_t_dly_st_mis c_t_dly_iv_off_mis /end DEF_CHARACTERISTIC
 /begin OUT_MEASUREMENT state_diag_mis mis_det_cyl_inh mis_det_cdn_inh_nr ctr_tdc_zdly_mis ctr_t_zdly_mis lv_diag_mis mis_det_cdn_inh mis_det_cdn_inh.lv_inh_n_det_mis mis_det_cdn_inh.lv_inh_load_min_det_mis mis_det_cdn_inh.lv_inh_tco_min_det_mis mis_det_cdn_inh.lv_inh_amp_min_det_mis mis_det_cdn_inh.lv_inh_st_det_mis mis_det_cdn_inh.lv_inh_iv_off_det_mis lv_req_inh_mis lv_zdly_diag_mis lv_puc_det_mis /end OUT_MEASUREMENT
/end FUNCTION
/begin FUNCTION MISF_Rate_Err_Mngt ""
 /begin DEF_CHARACTERISTIC c_load_mis_ftp c_n_mis_ftp c_mis_a_ind_thd c_mis_a_min_nr c_mis_sum_a_thd c_mis_sum_a_cbk_thd c_mis_max_nr_off_iv c_mis_min_nr_puc c_t_mis_min_puc c_mis_sum_b1_thd_mt c_mis_sum_b1_thd_at c_mis_sum_b4_thd_mt c_mis_sum_b4_thd_at c_mis_b1_min_nr c_mis_b4_min_nr c_mis_sum_b1_cbk_thd c_mis_sum_b4_cbk_thd lc_mis_inh lc_conf_rnd_det_mis_b lc_conf_inh_iv_mis lc_conf_rnd_det_mis_a lc_conf_mis_a_lih c_nr_cyl_mpl_mis_a c_nr_cyl_mpl_mis_b lc_conf_mpl_det_mis_a lc_conf_mpl_det_mis_b c_nr_det_max_mis_a c_ratio_ftp_cdn_ind_mis_a c_ratio_ftp_cdn_mis_a c_nr_det_max_mis_b4 /end DEF_CHARACTERISTIC
 /begin OUT_MEASUREMENT lv_ftp_mis_a inh_iv_mis mis_nr_tdc_a mis_sum_a mis_sum_a_cbk_1 mis_sum_a_cbk_2 ctr_chk_mis_a ctr_ftp_cdn_mis_a mis_ctr_a[0] mis_ctr_a[1] mis_ctr_a[2] mis_ctr_a[3] mis_ctr_a[4] mis_ctr_a[5] mis_ctr_b[0] mis_ctr_b[1] mis_ctr_b[2] mis_ctr_b[3] mis_ctr_b[4] mis_ctr_b[5] mis_nr_tdc_b mis_sum_b mis_sum_b_cbk_1 mis_sum_b_cbk_2 ctr_chk_mis_b4 sym_cyl_mis_a sym_cyl_mis_b1 sym_cyl_mis_b4 lv_det_mis_a lv_inh_iv_mis_a ctr_det_mis_a lv_end_win_mis_a lv_det_mis_b4 lv_mis_state_b1 lv_mis_state_b4 ctr_det_mis_b4 lv_end_win_mis_b1 lv_end_win_mis_b4 lv_end_mis_b1 lv_end_mis_a lv_end_mis_b4 lv_mis_state_a /end OUT_MEASUREMENT
/end FUNCTION
/end MODULE
/end PROJECT
