ASAP2_VERSION 1 3
/begin PROJECT P411 "BMW DDE6.0 6-Zylinder V96.2 14.10.2004"
/begin HEADER "" VERSION "V96.2_6Z" PROJECT_NO P411 /end HEADER
/begin MODULE DIM ""
/begin MOD_COMMON "" BYTE_ORDER MSB_FIRST ALIGNMENT_BYTE 1 ALIGNMENT_WORD 2 ALIGNMENT_LONG 4 ALIGNMENT_FLOAT32_IEEE 4 /end MOD_COMMON
/begin CHARACTERISTIC DSM_DInDfp_Layer_TANS_C "Verzögerung Ersatzreaktion für Fehlerpfad Dfp_Layer_TANS" VALUE 0xCEBB6 Kw_Wu16 655350.0 Time_ms 0.00 655350.0 FORMAT "%8.1" /end CHARACTERISTIC
/begin CHARACTERISTIC DSM_DInDfp_ACCDCmpr_C "Verzögerung Ersatzreaktion für Fehlerpfad Dfp_ACCDCmpr" VALUE 0xCEBB8 Kw_Wu16 655350.0 Time_ms 0.00 655350.0 FORMAT "%8.1" /end CHARACTERISTIC
/begin CHARACTERISTIC DSM_DInDfp_ACCDPres_C "Verzögerung Ersatzreaktion für Fehlerpfad Dfp_ACCDPres" VALUE 0xCEBBA Kw_Wu16 655350.0 Time_ms 0.00 655350.0 FORMAT "%8.1" /end CHARACTERISTIC
/begin CHARACTERISTIC DSM_DInDfp_ACCDPres1_C "Verzögerung Ersatzreaktion für Fehlerpfad Dfp_ACCDPres1" VALUE 0xCEBBC Kw_Wu16 655350.0 Time_ms 0.00 655350.0 FORMAT "%8.1" /end CHARACTERISTIC
/begin CHARACTERISTIC DSM_DInDfp_ACCDPresAna_C "Verzögerung Ersatzreaktion für Fehlerpfad Dfp_ACCDPresAna" VALUE 0xCEBBE Kw_Wu16 655350.0 Time_ms 0.00 655350.0 FORMAT "%8.1" /end CHARACTERISTIC
/begin CHARACTERISTIC DSM_DInDfp_ACCDSwtin_C "Verzögerung Ersatzreaktion für Fehlerpfad Dfp_ACCDSwtin" VALUE 0xCEBC0 Kw_Wu16 655350.0 Time_ms 0.00 655350.0 FORMAT "%8.1" /end CHARACTERISTIC
/begin CHARACTERISTIC DSM_DInDfp_ACC_PlausTrqDes_C "Verzögerung Ersatzreaktion für Fehlerpfad Dfp_ACC_PlausTrqDes" VALUE 0xCEBC2 Kw_Wu16 655350.0 Time_ms 0.00 655350.0 FORMAT "%8.1" /end CHARACTERISTIC
/begin CHARACTERISTIC DSM_DInDfp_ACC_trqInr_C "Verzögerung Ersatzreaktion für Fehlerpfad Dfp_ACC_trqInr" VALUE 0xCEBC4 Kw_Wu16 655350.0 Time_ms 0.00 655350.0 FORMAT "%8.1" /end CHARACTERISTIC
/begin CHARACTERISTIC DSM_DInDfp_ACTrq_C "Verzögerung Ersatzreaktion für Fehlerpfad Dfp_ACTrq" VALUE 0xCEBC6 Kw_Wu16 655350.0 Time_ms 0.00 655350.0 FORMAT "%8.1" /end CHARACTERISTIC
/begin CHARACTERISTIC DSM_DInDfp_ADCMon_C "#SSD Verzögerung Ersatzreaktion für Fehlerpfad Dfp_ADCMon" VALUE 0xCEBC8 Kw_Wu16 655350.0 Time_ms 0.00 655350.0 FORMAT "%8.1" /end CHARACTERISTIC
/begin CHARACTERISTIC DSM_DInDfp_AFSCDIdlAdjVal_C "Verzögerung Ersatzreaktion für Fehlerpfad Dfp_AFSCDIdlAdjVal" VALUE 0xCEBCA Kw_Wu16 655350.0 Time_ms 0.00 655350.0 FORMAT "%8.1" /end CHARACTERISTIC
/begin CHARACTERISTIC DSM_DInDfp_AFSCDLdAdjVal_C "Verzögerung Ersatzreaktion für Fehlerpfad Dfp_AFSCDLdAdjVal" VALUE 0xCEBCC Kw_Wu16 655350.0 Time_ms 0.00 655350.0 FORMAT "%8.1" /end CHARACTERISTIC
/begin CHARACTERISTIC DSM_DInDfp_AFSCD_AirTempDcyc_C "Verzögerung Ersatzreaktion für Fehlerpfad Dfp_AFSCD_AirTempDcyc" VALUE 0xCEBCE Kw_Wu16 655350.0 Time_ms 0.00 655350.0 FORMAT "%8.1" /end CHARACTERISTIC
/begin CHARACTERISTIC DSM_DInDfp_AFSCD_PlOffsDrft_C "Verzögerung Ersatzreaktion für Fehlerpfad Dfp_AFSCD_PlOffsDrft" VALUE 0xCEBD0 Kw_Wu16 655350.0 Time_ms 0.00 655350.0 FORMAT "%8.1" /end CHARACTERISTIC
/begin CHARACTERISTIC DSM_DInDfp_AFSCD_PlSetyDrft_C "Verzögerung Ersatzreaktion für Fehlerpfad Dfp_AFSCD_PlSetyDrft" VALUE 0xCEBD2 Kw_Wu16 655350.0 Time_ms 0.00 655350.0 FORMAT "%8.1" /end CHARACTERISTIC
/begin CHARACTERISTIC DSM_DInDfp_AFSCD_SRCAirTemp_C "Verzögerung Ersatzreaktion für Fehlerpfad Dfp_AFSCD_SRCAirTemp" VALUE 0xCEBD4 Kw_Wu16 655350.0 Time_ms 0.00 655350.0 FORMAT "%8.1" /end CHARACTERISTIC
/begin CHARACTERISTIC DSM_DInDfp_AFSCD_SRCBatt_C "Verzögerung Ersatzreaktion für Fehlerpfad Dfp_AFSCD_SRCBatt" VALUE 0xCEBD6 Kw_Wu16 655350.0 Time_ms 0.00 655350.0 FORMAT "%8.1" /end CHARACTERISTIC
/begin CHARACTERISTIC DSM_DInDfp_AFSCD_SRCCorrAirm_C "Verzögerung Ersatzreaktion für Fehlerpfad Dfp_AFSCD_SRCCorrAirm" VALUE 0xCEBD8 Kw_Wu16 655350.0 Time_ms 0.00 655350.0 FORMAT "%8.1" /end CHARACTERISTIC
/begin CHARACTERISTIC DSM_DInDfp_AFSCD_SRCRawAirm_C "Verzögerung Ersatzreaktion für Fehlerpfad Dfp_AFSCD_SRCRawAirm" VALUE 0xCEBDA Kw_Wu16 655350.0 Time_ms 0.00 655350.0 FORMAT "%8.1" /end CHARACTERISTIC
/begin CHARACTERISTIC DSM_DInDfp_Layer_TUMG_C "Verzögerung Ersatzreaktion für Fehlerpfad Dfp_Layer_TUMG" VALUE 0xCEBDC Kw_Wu16 655350.0 Time_ms 0.00 655350.0 FORMAT "%8.1" /end CHARACTERISTIC
/begin CHARACTERISTIC DSM_DInDfp_AFSCD_SRCRefSigPer_C "Verzögerung Ersatzreaktion für Fehlerpfad Dfp_AFSCD_SRCRefSigPer" VALUE 0xCEBDE Kw_Wu16 655350.0 Time_ms 0.00 655350.0 FORMAT "%8.1" /end CHARACTERISTIC
/begin CHARACTERISTIC DSM_DInDfp_AOHtCD_C "Verzögerung Ersatzreaktion für Fehlerpfad Dfp_AOHtCD" VALUE 0xCEBE0 Kw_Wu16 655350.0 Time_ms 0.00 655350.0 FORMAT "%8.1" /end CHARACTERISTIC
/begin CHARACTERISTIC DSM_DInDfp_Layer_GEN_C "Verzögerung Ersatzreaktion für Fehlerpfad Dfp_Layer_GEN" VALUE 0xCEBE2 Kw_Wu16 655350.0 Time_ms 0.00 655350.0 FORMAT "%8.1" /end CHARACTERISTIC
/begin CHARACTERISTIC DSM_DInDfp_Layer_BSD_C "Verzögerung Ersatzreaktion für Fehlerpfad Dfp_Layer_BSD" VALUE 0xCEBE4 Kw_Wu16 655350.0 Time_ms 0.00 655350.0 FORMAT "%8.1" /end CHARACTERISTIC
/begin CHARACTERISTIC DSM_DInDfp_AOHtCD_AOHtDia1_C "Verzögerung Ersatzreaktion für Fehlerpfad Dfp_AOHtCD_AOHtDia1" VALUE 0xCEBE6 Kw_Wu16 655350.0 Time_ms 0.00 655350.0 FORMAT "%8.1" /end CHARACTERISTIC
/begin CHARACTERISTIC DSM_DInDfp_AOHtCD_AOHtDia2_C "Verzögerung Ersatzreaktion für Fehlerpfad Dfp_AOHtCD_AOHtDia2" VALUE 0xCEBE8 Kw_Wu16 655350.0 Time_ms 0.00 655350.0 FORMAT "%8.1" /end CHARACTERISTIC
/begin CHARACTERISTIC DSM_DInDfp_AOHtCD_AOHtDia3_C "Verzögerung Ersatzreaktion für Fehlerpfad Dfp_AOHtCD_AOHtDia3" VALUE 0xCEBEA Kw_Wu16 655350.0 Time_ms 0.00 655350.0 FORMAT "%8.1" /end CHARACTERISTIC
/begin CHARACTERISTIC DSM_DInDfp_APP1_C "Verzögerung Ersatzreaktion für Fehlerpfad Dfp_APP1" VALUE 0xCEBEC Kw_Wu16 655350.0 Time_ms 0.00 655350.0 FORMAT "%8.1" /end CHARACTERISTIC
/begin CHARACTERISTIC DSM_DInDfp_APP2_C "Verzögerung Ersatzreaktion für Fehlerpfad Dfp_APP2" VALUE 0xCEBEE Kw_Wu16 655350.0 Time_ms 0.00 655350.0 FORMAT "%8.1" /end CHARACTERISTIC
/begin CHARACTERISTIC DSM_DInDfp_APPCDCmpd_C "Verzögerung Ersatzreaktion für Fehlerpfad Dfp_APPCDCmpd" VALUE 0xCEBF0 Kw_Wu16 655350.0 Time_ms 0.00 655350.0 FORMAT "%8.1" /end CHARACTERISTIC
/begin CHARACTERISTIC DSM_DInDfp_APPSync_C "Verzögerung Ersatzreaktion für Fehlerpfad Dfp_APPSync" VALUE 0xCEBF2 Kw_Wu16 655350.0 Time_ms 0.00 655350.0 FORMAT "%8.1" /end CHARACTERISTIC
/begin CHARACTERISTIC DSM_DInDfp_APSCD_C "Verzögerung Ersatzreaktion für Fehlerpfad Dfp_APSCD" VALUE 0xCEBF4 Kw_Wu16 655350.0 Time_ms 0.00 655350.0 FORMAT "%8.1" /end CHARACTERISTIC
/begin CHARACTERISTIC DSM_DInDfp_ARS_C "Verzögerung Ersatzreaktion für Fehlerpfad Dfp_ARS" VALUE 0xCEBF6 Kw_Wu16 655350.0 Time_ms 0.00 655350.0 FORMAT "%8.1" /end CHARACTERISTIC
/begin CHARACTERISTIC DSM_DInDfp_AccPedPlausBrk_C "Verzögerung Ersatzreaktion für Fehlerpfad Dfp_AccPedPlausBrk" VALUE 0xCEBF8 Kw_Wu16 655350.0 Time_ms 0.00 655350.0 FORMAT "%8.1" /end CHARACTERISTIC
/begin CHARACTERISTIC DSM_DInDfp_Layer_QLT_C "Verzögerung Ersatzreaktion für Fehlerpfad Dfp_Layer_QLT" VALUE 0xCEBFA Kw_Wu16 655350.0 Time_ms 0.00 655350.0 FORMAT "%8.1" /end CHARACTERISTIC
/begin CHARACTERISTIC DSM_DInDfp_AirCtlGvnrDvtRgnMax_C "Verzögerung Ersatzreaktion für Fehlerpfad Dfp_AirCtlGvnrDvtRgnMax" VALUE 0xCEBFC Kw_Wu16 655350.0 Time_ms 0.00 655350.0 FORMAT "%8.1" /end CHARACTERISTIC
/begin CHARACTERISTIC DSM_DInDfp_Layer_IBS1_C "Verzögerung Ersatzreaktion für Fehlerpfad Dfp_Layer_IBS1" VALUE 0xCEBFE Kw_Wu16 655350.0 Time_ms 0.00 655350.0 FORMAT "%8.1" /end CHARACTERISTIC
/begin CHARACTERISTIC DSM_DInDfp_Layer_IBS2_C "Verzögerung Ersatzreaktion für Fehlerpfad Dfp_Layer_IBS2" VALUE 0xCEC00 Kw_Wu16 655350.0 Time_ms 0.00 655350.0 FORMAT "%8.1" /end CHARACTERISTIC
/begin CHARACTERISTIC DSM_DInDfp_Layer_IBS3_C "Verzögerung Ersatzreaktion für Fehlerpfad Dfp_Layer_IBS3" VALUE 0xCEC02 Kw_Wu16 655350.0 Time_ms 0.00 655350.0 FORMAT "%8.1" /end CHARACTERISTIC
/begin CHARACTERISTIC DSM_DInDfp_Layer_PMBN_C "Verzögerung Ersatzreaktion für Fehlerpfad Dfp_Layer_PMBN" VALUE 0xCEC04 Kw_Wu16 655350.0 Time_ms 0.00 655350.0 FORMAT "%8.1" /end CHARACTERISTIC
/begin CHARACTERISTIC DSM_DInDfp_Layer_PMBATT_C "Verzögerung Ersatzreaktion für Fehlerpfad Dfp_Layer_PMBATT" VALUE 0xCEC06 Kw_Wu16 655350.0 Time_ms 0.00 655350.0 FORMAT "%8.1" /end CHARACTERISTIC
/begin CHARACTERISTIC DSM_DInDfp_AirCtlGvnrDvtRgnMin_C "Verzögerung Ersatzreaktion für Fehlerpfad Dfp_AirCtlGvnrDvtRgnMin" VALUE 0xCEC08 Kw_Wu16 655350.0 Time_ms 0.00 655350.0 FORMAT "%8.1" /end CHARACTERISTIC
/begin CHARACTERISTIC DSM_DInDfp_AirCtlGvnrDvtRgnMn2_C "Verzögerung Ersatzreaktion für Fehlerpfad Dfp_AirCtlGvnrDvtRgnMn2" VALUE 0xCEC0A Kw_Wu16 655350.0 Time_ms 0.00 655350.0 FORMAT "%8.1" /end CHARACTERISTIC
/begin CHARACTERISTIC DSM_DInDfp_AirCtlGvnrDvtRgnMx2_C "Verzögerung Ersatzreaktion für Fehlerpfad Dfp_AirCtlGvnrDvtRgnMx2" VALUE 0xCEC0C Kw_Wu16 655350.0 Time_ms 0.00 655350.0 FORMAT "%8.1" /end CHARACTERISTIC
/begin CHARACTERISTIC DSM_DInDfp_AirCtlPlateBreak_C "DSM variable for Dfp_AirCtlPlateBreak_mp" VALUE 0xCEC0E Kw_Wu16 655350.0 Time_ms 0.00 655350.0 FORMAT "%8.1" /end CHARACTERISTIC
/begin CHARACTERISTIC DSM_DInDfp_AirCtlRmpTO_C "Verzögerung Ersatzreaktion für Fehlerpfad Dfp_AirCtlRmpTO" VALUE 0xCEC10 Kw_Wu16 655350.0 Time_ms 0.00 655350.0 FORMAT "%8.1" /end CHARACTERISTIC
/begin CHARACTERISTIC DSM_DInDfp_AirCtl_GovNegDev_C "Verzögerung Ersatzreaktion für Fehlerpfad Dfp_AirCtl_GovNegDev" VALUE 0xCEC12 Kw_Wu16 655350.0 Time_ms 0.00 655350.0 FORMAT "%8.1" /end CHARACTERISTIC
/begin CHARACTERISTIC DSM_DInDfp_AirCtl_GovNegDev2_C "Verzögerung Ersatzreaktion für Fehlerpfad Dfp_AirCtl_GovNegDev2" VALUE 0xCEC14 Kw_Wu16 655350.0 Time_ms 0.00 655350.0 FORMAT "%8.1" /end CHARACTERISTIC
/begin CHARACTERISTIC DSM_DInDfp_AirCtl_GovPosDev_C "Verzögerung Ersatzreaktion für Fehlerpfad Dfp_AirCtl_GovPosDev" VALUE 0xCEC16 Kw_Wu16 655350.0 Time_ms 0.00 655350.0 FORMAT "%8.1" /end CHARACTERISTIC
/begin CHARACTERISTIC DSM_DInDfp_AirCtl_GovPosDev2_C "Verzögerung Ersatzreaktion für Fehlerpfad Dfp_AirCtl_GovPosDev2" VALUE 0xCEC18 Kw_Wu16 655350.0 Time_ms 0.00 655350.0 FORMAT "%8.1" /end CHARACTERISTIC
/begin CHARACTERISTIC DSM_DInDfp_AltCD_C "Verzögerung Ersatzreaktion für Fehlerpfad Dfp_AltCD" VALUE 0xCEC1A Kw_Wu16 655350.0 Time_ms 0.00 655350.0 FORMAT "%8.1" /end CHARACTERISTIC
/begin CHARACTERISTIC DSM_DInDfp_AltCD_Load_C "Verzögerung Ersatzreaktion für Fehlerpfad Dfp_AltCD_Load" VALUE 0xCEC1C Kw_Wu16 655350.0 Time_ms 0.00 655350.0 FORMAT "%8.1" /end CHARACTERISTIC
/begin CHARACTERISTIC DSM_DInDfp_BPACD_BPADia1_C "Verzögerung Ersatzreaktion für Fehlerpfad Dfp_BPACD_BPADia1" VALUE 0xCEC1E Kw_Wu16 655350.0 Time_ms 0.00 655350.0 FORMAT "%8.1" /end CHARACTERISTIC
/begin CHARACTERISTIC DSM_DInDfp_BPACD_BPADia2_C "Verzögerung Ersatzreaktion für Fehlerpfad Dfp_BPACD_BPADia2" VALUE 0xCEC20 Kw_Wu16 655350.0 Time_ms 0.00 655350.0 FORMAT "%8.1" /end CHARACTERISTIC
/begin CHARACTERISTIC DSM_DInDfp_BPACD_BPADia3_C "Verzögerung Ersatzreaktion für Fehlerpfad Dfp_BPACD_BPADia3" VALUE 0xCEC22 Kw_Wu16 655350.0 Time_ms 0.00 655350.0 FORMAT "%8.1" /end CHARACTERISTIC
/begin CHARACTERISTIC DSM_DInDfp_BPACD_BPADia4_C "Verzögerung Ersatzreaktion für Fehlerpfad Dfp_BPACD_BPADia4" VALUE 0xCEC24 Kw_Wu16 655350.0 Time_ms 0.00 655350.0 FORMAT "%8.1" /end CHARACTERISTIC
/begin CHARACTERISTIC DSM_DInDfp_BPACD_Max_C "Verzögerung Ersatzreaktion für Fehlerpfad Dfp_BPACD_Max" VALUE 0xCEC26 Kw_Wu16 655350.0 Time_ms 0.00 655350.0 FORMAT "%8.1" /end CHARACTERISTIC
/begin CHARACTERISTIC DSM_DInDfp_BPACD_Min_C "Verzögerung Ersatzreaktion für Fehlerpfad Dfp_BPACD_Min" VALUE 0xCEC28 Kw_Wu16 655350.0 Time_ms 0.00 655350.0 FORMAT "%8.1" /end CHARACTERISTIC
/begin CHARACTERISTIC DSM_DInDfp_BPACD_PwmIn_C "Verzögerung Ersatzreaktion für Fehlerpfad Dfp_BPACD_PwmIn" VALUE 0xCEC2A Kw_Wu16 655350.0 Time_ms 0.00 655350.0 FORMAT "%8.1" /end CHARACTERISTIC
/begin CHARACTERISTIC DSM_DInDfp_BPACD_PwmInDia1_C "Verzögerung Ersatzreaktion für Fehlerpfad Dfp_BPACD_PwmInDia1" VALUE 0xCEC2C Kw_Wu16 655350.0 Time_ms 0.00 655350.0 FORMAT "%8.1" /end CHARACTERISTIC
/begin CHARACTERISTIC DSM_DInDfp_BPACD_PwmInDia2_C "Verzögerung Ersatzreaktion für Fehlerpfad Dfp_BPACD_PwmInDia2" VALUE 0xCEC2E Kw_Wu16 655350.0 Time_ms 0.00 655350.0 FORMAT "%8.1" /end CHARACTERISTIC
/begin CHARACTERISTIC DSM_DInDfp_BPACD_PwmInDia3_C "Verzögerung Ersatzreaktion für Fehlerpfad Dfp_BPACD_PwmInDia3" VALUE 0xCEC30 Kw_Wu16 655350.0 Time_ms 0.00 655350.0 FORMAT "%8.1" /end CHARACTERISTIC
/begin CHARACTERISTIC DSM_DInDfp_BPACD_PwmInDia4_C "Verzögerung Ersatzreaktion für Fehlerpfad Dfp_BPACD_PwmInDia4" VALUE 0xCEC32 Kw_Wu16 655350.0 Time_ms 0.00 655350.0 FORMAT "%8.1" /end CHARACTERISTIC
/begin CHARACTERISTIC DSM_DInDfp_BPACD_SigNpl_C "Verzögerung Ersatzreaktion für Fehlerpfad Dfp_BPACD_SigNpl" VALUE 0xCEC34 Kw_Wu16 655350.0 Time_ms 0.00 655350.0 FORMAT "%8.1" /end CHARACTERISTIC
/begin CHARACTERISTIC DSM_DInDfp_BPSCD_C "Verzögerung Ersatzreaktion für Fehlerpfad Dfp_BPSCD" VALUE 0xCEC36 Kw_Wu16 655350.0 Time_ms 0.00 655350.0 FORMAT "%8.1" /end CHARACTERISTIC
/begin CHARACTERISTIC DSM_DInDfp_BattCD_C "Verzögerung Ersatzreaktion für Fehlerpfad Dfp_BattCD" VALUE 0xCEC38 Kw_Wu16 655350.0 Time_ms 0.00 655350.0 FORMAT "%8.1" /end CHARACTERISTIC
/begin CHARACTERISTIC DSM_DInDfp_BrkCD_C "Verzögerung Ersatzreaktion für Fehlerpfad Dfp_BrkCD" VALUE 0xCEC3A Kw_Wu16 655350.0 Time_ms 0.00 655350.0 FORMAT "%8.1" /end CHARACTERISTIC
/begin CHARACTERISTIC DSM_DInDfp_Bss_C "Verzögerung Ersatzreaktion für Fehlerpfad Dfp_Bss" VALUE 0xCEC3C Kw_Wu16 655350.0 Time_ms 0.00 655350.0 FORMAT "%8.1" /end CHARACTERISTIC
/begin CHARACTERISTIC DSM_DInDfp_CBACD_C "Verzögerung Ersatzreaktion für Fehlerpfad Dfp_CBACD" VALUE 0xCEC3E Kw_Wu16 655350.0 Time_ms 0.00 655350.0 FORMAT "%8.1" /end CHARACTERISTIC
/begin CHARACTERISTIC DSM_DInDfp_CTSCD_C "Verzögerung Ersatzreaktion für Fehlerpfad Dfp_CTSCD" VALUE 0xCEC40 Kw_Wu16 655350.0 Time_ms 0.00 655350.0 FORMAT "%8.1" /end CHARACTERISTIC
/begin CHARACTERISTIC DSM_DInDfp_Clg_DynTst_C "Verzögerung Ersatzreaktion für Fehlerpfad Dfp_Clg_DynTst" VALUE 0xCEC42 Kw_Wu16 655350.0 Time_ms 0.00 655350.0 FORMAT "%8.1" /end CHARACTERISTIC
/begin CHARACTERISTIC DSM_DInDfp_CmbChbMisfire1_C "Verzögerung Ersatzreaktion für Fehlerpfad Dfp_CmbChbMisfire1" VALUE 0xCEC44 Kw_Wu16 655350.0 Time_ms 0.00 655350.0 FORMAT "%8.1" /end CHARACTERISTIC
/begin CHARACTERISTIC DSM_DInDfp_CmbChbMisfire2_C "Verzögerung Ersatzreaktion für Fehlerpfad Dfp_CmbChbMisfire2" VALUE 0xCEC46 Kw_Wu16 655350.0 Time_ms 0.00 655350.0 FORMAT "%8.1" /end CHARACTERISTIC
/begin CHARACTERISTIC DSM_DInDfp_Layer_PMRUHVERL_C "Verzögerung Ersatzreaktion für Fehlerpfad Dfp_Layer_PMRUHVERL" VALUE 0xCEC48 Kw_Wu16 655350.0 Time_ms 0.00 655350.0 FORMAT "%8.1" /end CHARACTERISTIC
/begin CHARACTERISTIC DSM_DInDfp_CmbChbMisfire3_C "Verzögerung Ersatzreaktion für Fehlerpfad Dfp_CmbChbMisfire3" VALUE 0xCEC4A Kw_Wu16 655350.0 Time_ms 0.00 655350.0 FORMAT "%8.1" /end CHARACTERISTIC
/begin CHARACTERISTIC DSM_DInDfp_CmbChbMisfire4_C "Verzögerung Ersatzreaktion für Fehlerpfad Dfp_CmbChbMisfire4" VALUE 0xCEC4C Kw_Wu16 655350.0 Time_ms 0.00 655350.0 FORMAT "%8.1" /end CHARACTERISTIC
/begin CHARACTERISTIC DSM_DInDfp_CmbChbMisfire5_C "Verzögerung Ersatzreaktion für Fehlerpfad Dfp_CmbChbMisfire5" VALUE 0xCEC4E Kw_Wu16 655350.0 Time_ms 0.00 655350.0 FORMAT "%8.1" /end CHARACTERISTIC
/begin CHARACTERISTIC DSM_DInDfp_CmbChbMisfire6_C "Verzögerung Ersatzreaktion für Fehlerpfad Dfp_CmbChbMisfire6" VALUE 0xCEC50 Kw_Wu16 655350.0 Time_ms 0.00 655350.0 FORMAT "%8.1" /end CHARACTERISTIC
/begin CHARACTERISTIC DSM_DInDfp_Layer_TOENS_C "Verzögerung Ersatzreaktion für Fehlerpfad Dfp_Layer_TOENS" VALUE 0xCEC52 Kw_Wu16 655350.0 Time_ms 0.00 655350.0 FORMAT "%8.1" /end CHARACTERISTIC
/begin CHARACTERISTIC DSM_DInDfp_Layer_MANHYDR_C "Verzögerung Ersatzreaktion für Fehlerpfad Dfp_Layer_MANHYDR" VALUE 0xCEC54 Kw_Wu16 655350.0 Time_ms 0.00 655350.0 FORMAT "%8.1" /end CHARACTERISTIC
/begin CHARACTERISTIC DSM_DInDfp_Layer_MANLUFT_C "Verzögerung Ersatzreaktion für Fehlerpfad Dfp_Layer_MANLUFT" VALUE 0xCEC56 Kw_Wu16 655350.0 Time_ms 0.00 655350.0 FORMAT "%8.1" /end CHARACTERISTIC
/begin CHARACTERISTIC DSM_DInDfp_CmbChbMisfireMul_C "Verzögerung Ersatzreaktion für Fehlerpfad Dfp_CmbChbMisfireMul" VALUE 0xCEC58 Kw_Wu16 655350.0 Time_ms 0.00 655350.0 FORMAT "%8.1" /end CHARACTERISTIC
/begin CHARACTERISTIC DSM_DInDfp_CoVMDCSh_C "Verzögerung Ersatzreaktion für Fehlerpfad Dfp_CoVMDCSh" VALUE 0xCEC5A Kw_Wu16 655350.0 Time_ms 0.00 655350.0 FORMAT "%8.1" /end CHARACTERISTIC
/begin CHARACTERISTIC DSM_DInDfp_ConvCD_C "Verzögerung Ersatzreaktion für Fehlerpfad Dfp_ConvCD" VALUE 0xCEC5C Kw_Wu16 655350.0 Time_ms 0.00 655350.0 FORMAT "%8.1" /end CHARACTERISTIC
/begin CHARACTERISTIC DSM_DInDfp_CrCCDMFL_C "Verzögerung Ersatzreaktion für Fehlerpfad Dfp_CrCCDMFL" VALUE 0xCEC5E Kw_Wu16 655350.0 Time_ms 0.00 655350.0 FORMAT "%8.1" /end CHARACTERISTIC
/begin CHARACTERISTIC DSM_DInDfp_CrCtl_vCrCtl_C "Verzögerung Ersatzreaktion für Fehlerpfad Dfp_CrCtl_vCrCtl" VALUE 0xCEC60 Kw_Wu16 655350.0 Time_ms 0.00 655350.0 FORMAT "%8.1" /end CHARACTERISTIC
/begin CHARACTERISTIC DSM_DInDfp_DCC_PlausTrqDes_C "Verzögerung Ersatzreaktion für Fehlerpfad Dfp_DCC_PlausTrqDes" VALUE 0xCEC62 Kw_Wu16 655350.0 Time_ms 0.00 655350.0 FORMAT "%8.1" /end CHARACTERISTIC
/begin CHARACTERISTIC DSM_DInDfp_Dummy1_C "Verzögerung Ersatzreaktion für Fehlerpfad Dfp_Dummy1" VALUE 0xCEC64 Kw_Wu16 655350.0 Time_ms 0.00 655350.0 FORMAT "%8.1" /end CHARACTERISTIC
/begin CHARACTERISTIC DSM_DInDfp_EATSCD_C "Verzögerung Ersatzreaktion für Fehlerpfad Dfp_EATSCD" VALUE 0xCEC66 Kw_Wu16 655350.0 Time_ms 0.00 655350.0 FORMAT "%8.1" /end CHARACTERISTIC
/begin CHARACTERISTIC DSM_DInDfp_EBAFCD_C "Verzögerung Ersatzreaktion für Fehlerpfad Dfp_EBAFCD" VALUE 0xCEC68 Kw_Wu16 655350.0 Time_ms 0.00 655350.0 FORMAT "%8.1" /end CHARACTERISTIC
/begin CHARACTERISTIC DSM_DInDfp_EBFCD_C "Verzögerung Ersatzreaktion für Fehlerpfad Dfp_EBFCD" VALUE 0xCEC6A Kw_Wu16 655350.0 Time_ms 0.00 655350.0 FORMAT "%8.1" /end CHARACTERISTIC
/begin CHARACTERISTIC DSM_DInDfp_EBTSCD_C "Verzögerung Ersatzreaktion für Fehlerpfad Dfp_EBTSCD" VALUE 0xCEC6C Kw_Wu16 655350.0 Time_ms 0.00 655350.0 FORMAT "%8.1" /end CHARACTERISTIC
/begin CHARACTERISTIC DSM_DInDfp_EBTSCD_OvrTemp_C "Verzögerung Ersatzreaktion für Fehlerpfad Dfp_EBTSCD_OvrTemp" VALUE 0xCEC6E Kw_Wu16 655350.0 Time_ms 0.00 655350.0 FORMAT "%8.1" /end CHARACTERISTIC
/begin CHARACTERISTIC DSM_DInDfp_ECBCD_C "Verzögerung Ersatzreaktion für Fehlerpfad Dfp_ECBCD" VALUE 0xCEC70 Kw_Wu16 655350.0 Time_ms 0.00 655350.0 FORMAT "%8.1" /end CHARACTERISTIC
/begin CHARACTERISTIC DSM_DInDfp_EEPCDVarMng_C "Verzögerung Ersatzreaktion für Fehlerpfad Dfp_EEPCDVarMng" VALUE 0xCEC72 Kw_Wu16 655350.0 Time_ms 0.00 655350.0 FORMAT "%8.1" /end CHARACTERISTIC
/begin CHARACTERISTIC DSM_DInDfp_EGPpCD_C "Verzögerung Ersatzreaktion für Fehlerpfad Dfp_EGPpCD" VALUE 0xCEC74 Kw_Wu16 655350.0 Time_ms 0.00 655350.0 FORMAT "%8.1" /end CHARACTERISTIC
/begin CHARACTERISTIC DSM_DInDfp_EGPpCDTPreTrbn_C "Verzögerung Ersatzreaktion für Fehlerpfad Dfp_EgPpCDTPreTrbn" VALUE 0xCEC76 Kw_Wu16 655350.0 Time_ms 0.00 655350.0 FORMAT "%8.1" /end CHARACTERISTIC
/begin CHARACTERISTIC DSM_DInDfp_EGRCD_Max_C "Verzögerung Ersatzreaktion für Fehlerpfad Dfp_EGRCD_Max" VALUE 0xCEC78 Kw_Wu16 655350.0 Time_ms 0.00 655350.0 FORMAT "%8.1" /end CHARACTERISTIC
/begin CHARACTERISTIC DSM_DInDfp_EGRCD_Min_C "Verzögerung Ersatzreaktion für Fehlerpfad Dfp_EGRCD_Min" VALUE 0xCEC7A Kw_Wu16 655350.0 Time_ms 0.00 655350.0 FORMAT "%8.1" /end CHARACTERISTIC
/begin CHARACTERISTIC DSM_DInDfp_EGRCD_SigNpl_C "Verzögerung Ersatzreaktion für Fehlerpfad Dfp_EGRCD_SigNpl" VALUE 0xCEC7C Kw_Wu16 655350.0 Time_ms 0.00 655350.0 FORMAT "%8.1" /end CHARACTERISTIC
/begin CHARACTERISTIC DSM_DInDfp_EGTOilLvlCrit_C "Verzögerung Ersatzreaktion für Fehlerpfad Dfp_EGTOilLvlCrit" VALUE 0xCEC7E Kw_Wu16 655350.0 Time_ms 0.00 655350.0 FORMAT "%8.1" /end CHARACTERISTIC
/begin CHARACTERISTIC DSM_DInDfp_EGTOilVscCrit_C "Verzögerung Ersatzreaktion für Fehlerpfad Dfp_EGTOilVscCrit" VALUE 0xCEC80 Kw_Wu16 655350.0 Time_ms 0.00 655350.0 FORMAT "%8.1" /end CHARACTERISTIC
/begin CHARACTERISTIC DSM_DInDfp_EGTRgnOilDil_C "Verzögerung Ersatzreaktion für Fehlerpfad Dfp_EGTRgnOilDil" VALUE 0xCEC82 Kw_Wu16 655350.0 Time_ms 0.00 655350.0 FORMAT "%8.1" /end CHARACTERISTIC
/begin CHARACTERISTIC DSM_DInDfp_EGTTempGvnrInr_C "Verzögerung Ersatzreaktion für Fehlerpfad Dfp_EGTTempGvnrInr" VALUE 0xCEC84 Kw_Wu16 655350.0 Time_ms 0.00 655350.0 FORMAT "%8.1" /end CHARACTERISTIC
/begin CHARACTERISTIC DSM_DInDfp_EGTTempGvnrOutr_C "Verzögerung Ersatzreaktion für Fehlerpfad Dfp_EGTTempGvnrOutr" VALUE 0xCEC86 Kw_Wu16 655350.0 Time_ms 0.00 655350.0 FORMAT "%8.1" /end CHARACTERISTIC
/begin CHARACTERISTIC DSM_DInDfp_EMCCD1_C "Verzögerung Ersatzreaktion für Fehlerpfad Dfp_EMCCD1" VALUE 0xCEC88 Kw_Wu16 655350.0 Time_ms 0.00 655350.0 FORMAT "%8.1" /end CHARACTERISTIC
/begin CHARACTERISTIC DSM_DInDfp_EMCCD2_C "Verzögerung Ersatzreaktion für Fehlerpfad Dfp_EMCCD2" VALUE 0xCEC8A Kw_Wu16 655350.0 Time_ms 0.00 655350.0 FORMAT "%8.1" /end CHARACTERISTIC
/begin CHARACTERISTIC DSM_DInDfp_EMCCD_ADC1_C "Verzögerung Ersatzreaktion für Fehlerpfad Dfp_EMCCD_ADC1" VALUE 0xCEC8C Kw_Wu16 655350.0 Time_ms 0.00 655350.0 FORMAT "%8.1" /end CHARACTERISTIC
/begin CHARACTERISTIC DSM_DInDfp_EMCCD_ADC2_C "Verzögerung Ersatzreaktion für Fehlerpfad Dfp_EMCCD_ADC2" VALUE 0xCEC8E Kw_Wu16 655350.0 Time_ms 0.00 655350.0 FORMAT "%8.1" /end CHARACTERISTIC
/begin CHARACTERISTIC DSM_DInDfp_ETClbETFltInj1_C "Verzögerung Ersatzreaktion für Fehlerpfad Dfp_ETClbETFltInj1" VALUE 0xCEC90 Kw_Wu16 655350.0 Time_ms 0.00 655350.0 FORMAT "%8.1" /end CHARACTERISTIC
/begin CHARACTERISTIC DSM_DInDfp_ETClbETFltInj2_C "Verzögerung Ersatzreaktion für Fehlerpfad Dfp_ETClbETFltInj2" VALUE 0xCEC92 Kw_Wu16 655350.0 Time_ms 0.00 655350.0 FORMAT "%8.1" /end CHARACTERISTIC
/begin CHARACTERISTIC DSM_DInDfp_ETClbETFltInj3_C "Verzögerung Ersatzreaktion für Fehlerpfad Dfp_ETClbETFltInj3" VALUE 0xCEC94 Kw_Wu16 655350.0 Time_ms 0.00 655350.0 FORMAT "%8.1" /end CHARACTERISTIC
/begin CHARACTERISTIC DSM_DInDfp_ETClbETFltInj4_C "Verzögerung Ersatzreaktion für Fehlerpfad Dfp_ETClbETFltInj4" VALUE 0xCEC96 Kw_Wu16 655350.0 Time_ms 0.00 655350.0 FORMAT "%8.1" /end CHARACTERISTIC
/begin CHARACTERISTIC DSM_DInDfp_ETClbETFltInj5_C "Verzögerung Ersatzreaktion für Fehlerpfad Dfp_ETClbETFltInj5" VALUE 0xCEC98 Kw_Wu16 655350.0 Time_ms 0.00 655350.0 FORMAT "%8.1" /end CHARACTERISTIC
/begin CHARACTERISTIC DSM_DInDfp_ETClbETFltInj6_C "Verzögerung Ersatzreaktion für Fehlerpfad Dfp_ETClbETFltInj6" VALUE 0xCEC9A Kw_Wu16 655350.0 Time_ms 0.00 655350.0 FORMAT "%8.1" /end CHARACTERISTIC
/begin CHARACTERISTIC DSM_DInDfp_ETClbInj1_C "Verzögerung Ersatzreaktion für Fehlerpfad Dfp_ETClbInj1" VALUE 0xCEC9C Kw_Wu16 655350.0 Time_ms 0.00 655350.0 FORMAT "%8.1" /end CHARACTERISTIC
/begin CHARACTERISTIC DSM_DInDfp_ETClbInj2_C "Verzögerung Ersatzreaktion für Fehlerpfad Dfp_ETClbInj2" VALUE 0xCEC9E Kw_Wu16 655350.0 Time_ms 0.00 655350.0 FORMAT "%8.1" /end CHARACTERISTIC
/begin CHARACTERISTIC DSM_DInDfp_ETClbInj3_C "Verzögerung Ersatzreaktion für Fehlerpfad Dfp_ETClbInj3" VALUE 0xCECA0 Kw_Wu16 655350.0 Time_ms 0.00 655350.0 FORMAT "%8.1" /end CHARACTERISTIC
/begin CHARACTERISTIC DSM_DInDfp_ETClbInj4_C "Verzögerung Ersatzreaktion für Fehlerpfad Dfp_ETClbInj4" VALUE 0xCECA2 Kw_Wu16 655350.0 Time_ms 0.00 655350.0 FORMAT "%8.1" /end CHARACTERISTIC
/begin CHARACTERISTIC DSM_DInDfp_ETClbInj5_C "Verzögerung Ersatzreaktion für Fehlerpfad Dfp_ETClbInj5" VALUE 0xCECA4 Kw_Wu16 655350.0 Time_ms 0.00 655350.0 FORMAT "%8.1" /end CHARACTERISTIC
/begin CHARACTERISTIC DSM_DInDfp_ETClbInj6_C "Verzögerung Ersatzreaktion für Fehlerpfad Dfp_ETClbInj6" VALUE 0xCECA6 Kw_Wu16 655350.0 Time_ms 0.00 655350.0 FORMAT "%8.1" /end CHARACTERISTIC
/begin CHARACTERISTIC DSM_DInDfp_EngMCaS1_C "#SSD Verzögerung Ersatzreaktion für Fehlerpfad Dfp_EngMCaS1" VALUE 0xCECA8 Kw_Wu16 655350.0 Time_ms 0.00 655350.0 FORMAT "%8.1" /end CHARACTERISTIC
/begin CHARACTERISTIC DSM_DInDfp_EngMCrS1_C "#SSD Verzögerung Ersatzreaktion für Fehlerpfad Dfp_EngMCrS1" VALUE 0xCECAA Kw_Wu16 655350.0 Time_ms 0.00 655350.0 FORMAT "%8.1" /end CHARACTERISTIC
/begin CHARACTERISTIC DSM_DInDfp_EngMOfsCaSCrS_C "Verzögerung Ersatzreaktion für Fehlerpfad Dfp_EngMOfsCaSCrS" VALUE 0xCECAC Kw_Wu16 655350.0 Time_ms 0.00 655350.0 FORMAT "%8.1" /end CHARACTERISTIC
/begin CHARACTERISTIC DSM_DInDfp_EngPrtFWODet_C "Verzögerung Ersatzreaktion für Fehlerpfad Dfp_EngPrtFWODet" VALUE 0xCECAE Kw_Wu16 655350.0 Time_ms 0.00 655350.0 FORMAT "%8.1" /end CHARACTERISTIC
/begin CHARACTERISTIC DSM_DInDfp_FBCqDvt_C "Verzögerung Ersatzreaktion für Fehlerpfad Dfp_FBCqDvt" VALUE 0xCECB0 Kw_Wu16 655350.0 Time_ms 0.00 655350.0 FORMAT "%8.1" /end CHARACTERISTIC
/begin CHARACTERISTIC DSM_DInDfp_FMAErrMod_C "Verzögerung Ersatzreaktion für Fehlerpfad Dfp_FMAErrMod" VALUE 0xCECB2 Kw_Wu16 655350.0 Time_ms 0.00 655350.0 FORMAT "%8.1" /end CHARACTERISTIC
/begin CHARACTERISTIC DSM_DInDfp_FMTC_NonMonotonMap_C "Verzögerung Ersatzreaktion für Fehlerpfad Dfp_FMTC_NonMonotonMap" VALUE 0xCECB4 Kw_Wu16 655350.0 Time_ms 0.00 655350.0 FORMAT "%8.1" /end CHARACTERISTIC
/begin CHARACTERISTIC DSM_DInDfp_FTSCD_C "Verzögerung Ersatzreaktion für Fehlerpfad Dfp_FTSCD" VALUE 0xCECB6 Kw_Wu16 655350.0 Time_ms 0.00 655350.0 FORMAT "%8.1" /end CHARACTERISTIC
/begin CHARACTERISTIC DSM_DInDfp_FanCD_C "Verzögerung Ersatzreaktion für Fehlerpfad Dfp_FanCD" VALUE 0xCECB8 Kw_Wu16 655350.0 Time_ms 0.00 655350.0 FORMAT "%8.1" /end CHARACTERISTIC
/begin CHARACTERISTIC DSM_DInDfp_FanCD_FanCtlr1_C "Verzögerung Ersatzreaktion für Fehlerpfad Dfp_FanCD_FanCtlr1" VALUE 0xCECBA Kw_Wu16 655350.0 Time_ms 0.00 655350.0 FORMAT "%8.1" /end CHARACTERISTIC
/begin CHARACTERISTIC DSM_DInDfp_FanCD_FanCtlr2_C "Verzögerung Ersatzreaktion für Fehlerpfad Dfp_FanCD_FanCtlr2" VALUE 0xCECBC Kw_Wu16 655350.0 Time_ms 0.00 655350.0 FORMAT "%8.1" /end CHARACTERISTIC
/begin CHARACTERISTIC DSM_DInDfp_FanCD_FanCtlr3_C "Verzögerung Ersatzreaktion für Fehlerpfad Dfp_FanCD_FanCtlr3" VALUE 0xCECBE Kw_Wu16 655350.0 Time_ms 0.00 655350.0 FORMAT "%8.1" /end CHARACTERISTIC
/begin CHARACTERISTIC DSM_DInDfp_FlFCD_C "Verzögerung Ersatzreaktion für Fehlerpfad Dfp_FlFCD" VALUE 0xCECC0 Kw_Wu16 655350.0 Time_ms 0.00 655350.0 FORMAT "%8.1" /end CHARACTERISTIC
/begin CHARACTERISTIC DSM_DInDfp_FlMngSmkDefect_C "Verzögerung Ersatzreaktion für Fehlerpfad Dfp_FlMngSmkDefect" VALUE 0xCECC2 Kw_Wu16 655350.0 Time_ms 0.00 655350.0 FORMAT "%8.1" /end CHARACTERISTIC
/begin CHARACTERISTIC DSM_DInDfp_FrmMngANFRADMOMPT_C "Verzögerung Ersatzreaktion für Fehlerpfad Dfp_FrmMngANFRADMOMPT" VALUE 0xCECC4 Kw_Wu16 655350.0 Time_ms 0.00 655350.0 FORMAT "%8.1" /end CHARACTERISTIC
/begin CHARACTERISTIC DSM_DInDfp_FrmMngASC1_C "Verzögerung Ersatzreaktion für Fehlerpfad Dfp_FrmMngASC1" VALUE 0xCECC6 Kw_Wu16 655350.0 Time_ms 0.00 655350.0 FORMAT "%8.1" /end CHARACTERISTIC
/begin CHARACTERISTIC DSM_DInDfp_FrmMngASC2_C "Verzögerung Ersatzreaktion für Fehlerpfad Dfp_FrmMngASC2" VALUE 0xCECC8 Kw_Wu16 655350.0 Time_ms 0.00 655350.0 FORMAT "%8.1" /end CHARACTERISTIC
/begin CHARACTERISTIC DSM_DInDfp_FrmMngASC3_C "Verzögerung Ersatzreaktion für Fehlerpfad Dfp_FrmMngASC3" VALUE 0xCECCA Kw_Wu16 655350.0 Time_ms 0.00 655350.0 FORMAT "%8.1" /end CHARACTERISTIC
/begin CHARACTERISTIC DSM_DInDfp_FrmMngASC4_C "Verzögerung Ersatzreaktion für Fehlerpfad Dfp_FrmMngASC4" VALUE 0xCECCC Kw_Wu16 655350.0 Time_ms 0.00 655350.0 FORMAT "%8.1" /end CHARACTERISTIC
/begin CHARACTERISTIC DSM_DInDfp_FrmMngBOS_RESET_C "Verzögerung Ersatzreaktion für Fehlerpfad Dfp_FrmMngBOS_RESET" VALUE 0xCECCE Kw_Wu16 655350.0 Time_ms 0.00 655350.0 FORMAT "%8.1" /end CHARACTERISTIC
/begin CHARACTERISTIC DSM_DInDfp_FrmMngBOS_RESET2_C "Verzögerung Ersatzreaktion für Fehlerpfad Dfp_FrmMngBOS_RESET2" VALUE 0xCECD0 Kw_Wu16 655350.0 Time_ms 0.00 655350.0 FORMAT "%8.1" /end CHARACTERISTIC
/begin CHARACTERISTIC DSM_DInDfp_FrmMngDMANFAFS_C "Verzögerung Ersatzreaktion für Fehlerpfad Dfp_FrmMngDMANFAFS" VALUE 0xCECD2 Kw_Wu16 655350.0 Time_ms 0.00 655350.0 FORMAT "%8.1" /end CHARACTERISTIC
/begin CHARACTERISTIC DSM_DInDfp_FrmMngDRMANFSSG_C "Verzögerung Ersatzreaktion für Fehlerpfad Dfp_FrmMngDRMANFSSG" VALUE 0xCECD4 Kw_Wu16 655350.0 Time_ms 0.00 655350.0 FORMAT "%8.1" /end CHARACTERISTIC
/begin CHARACTERISTIC DSM_DInDfp_FrmMngEGS1_C "Verzögerung Ersatzreaktion für Fehlerpfad Dfp_FrmMngEGS1" VALUE 0xCECD6 Kw_Wu16 655350.0 Time_ms 0.00 655350.0 FORMAT "%8.1" /end CHARACTERISTIC
/begin CHARACTERISTIC DSM_DInDfp_FrmMngEGS2_C "Verzögerung Ersatzreaktion für Fehlerpfad Dfp_FrmMngEGS2" VALUE 0xCECD8 Kw_Wu16 655350.0 Time_ms 0.00 655350.0 FORMAT "%8.1" /end CHARACTERISTIC
/begin CHARACTERISTIC DSM_DInDfp_FrmMngGEARBX_DATA_C "Verzögerung Ersatzreaktion für Fehlerpfad Dfp_FrmMngGEARBX_DATA" VALUE 0xCECDA Kw_Wu16 655350.0 Time_ms 0.00 655350.0 FORMAT "%8.1" /end CHARACTERISTIC
/begin CHARACTERISTIC DSM_DInDfp_FrmMngGEARBX_DATA2_C "Verzögerung Ersatzreaktion für Fehlerpfad Dfp_FrmMngGEARBX_DATA2" VALUE 0xCECDC Kw_Wu16 655350.0 Time_ms 0.00 655350.0 FORMAT "%8.1" /end CHARACTERISTIC
/begin CHARACTERISTIC DSM_DInDfp_FrmMngHEAT_AC_C "Verzögerung Ersatzreaktion für Fehlerpfad Dfp_FrmMngHEAT_AC" VALUE 0xCECDE Kw_Wu16 655350.0 Time_ms 0.00 655350.0 FORMAT "%8.1" /end CHARACTERISTIC
/begin CHARACTERISTIC DSM_DInDfp_FrmMngINSTR2_C "Verzögerung Ersatzreaktion für Fehlerpfad Dfp_FrmMngINSTR2" VALUE 0xCECE0 Kw_Wu16 655350.0 Time_ms 0.00 655350.0 FORMAT "%8.1" /end CHARACTERISTIC
/begin CHARACTERISTIC DSM_DInDfp_FrmMngINSTR3_C "Verzögerung Ersatzreaktion für Fehlerpfad Dfp_FrmMngINSTR3" VALUE 0xCECE2 Kw_Wu16 655350.0 Time_ms 0.00 655350.0 FORMAT "%8.1" /end CHARACTERISTIC
/begin CHARACTERISTIC DSM_DInDfp_FrmMngLENKRADWINKEL_C "Verzögerung Ersatzreaktion für Fehlerpfad Dfp_FrmMngLENKRADWINKEL" VALUE 0xCECE4 Kw_Wu16 655350.0 Time_ms 0.00 655350.0 FORMAT "%8.1" /end CHARACTERISTIC
/begin CHARACTERISTIC DSM_DInDfp_FrmMngMILEAGE_RANGE_C "Verzögerung Ersatzreaktion für Fehlerpfad Dfp_FrmMngMILEAGE_RANGE" VALUE 0xCECE6 Kw_Wu16 655350.0 Time_ms 0.00 655350.0 FORMAT "%8.1" /end CHARACTERISTIC
/begin CHARACTERISTIC DSM_DInDfp_FrmMngOPCRCTLACC_C "Verzögerung Ersatzreaktion für Fehlerpfad Dfp_FrmMngOPCRCTLACC" VALUE 0xCECE8 Kw_Wu16 655350.0 Time_ms 0.00 655350.0 FORMAT "%8.1" /end CHARACTERISTIC
/begin CHARACTERISTIC DSM_DInDfp_FrmMngPRGG_CCTR_C "Verzögerung Ersatzreaktion für Fehlerpfad Dfp_FrmMngPRGG_CCTR" VALUE 0xCECEA Kw_Wu16 655350.0 Time_ms 0.00 655350.0 FORMAT "%8.1" /end CHARACTERISTIC
/begin CHARACTERISTIC DSM_DInDfp_FrmMngPWRMNG_LOADV_C "Verzögerung Ersatzreaktion für Fehlerpfad Dfp_FrmMngPWRMNG_LOADV" VALUE 0xCECEC Kw_Wu16 655350.0 Time_ms 0.00 655350.0 FORMAT "%8.1" /end CHARACTERISTIC
/begin CHARACTERISTIC DSM_DInDfp_FrmMngParkConsumer_C "#SSD Verzögerung Ersatzreaktion für Fehlerpfad Dfp_FrmMngParkConsumer_C" VALUE 0xCECEE Kw_Wu16 655350.0 Time_ms 0.00 655350.0 FORMAT "%8.1" /end CHARACTERISTIC
/begin CHARACTERISTIC DSM_DInDfp_FrmMngRQSTGEFAN_C "Verzögerung Ersatzreaktion für Fehlerpfad Dfp_FrmMngRQSTGEFAN_C" VALUE 0xCECF0 Kw_Wu16 655350.0 Time_ms 0.00 655350.0 FORMAT "%8.1" /end CHARACTERISTIC
/begin CHARACTERISTIC DSM_DInDfp_FrmMngSSGErr_C "Verzögerung Ersatzreaktion für Fehlerpfad Dfp_FrmMngSSGErr" VALUE 0xCECF2 Kw_Wu16 655350.0 Time_ms 0.00 655350.0 FORMAT "%8.1" /end CHARACTERISTIC
/begin CHARACTERISTIC DSM_DInDfp_FrmMngSSGShOff_C "Verzögerung Ersatzreaktion für Fehlerpfad Dfp_FrmMngSSGShOff" VALUE 0xCECF4 Kw_Wu16 655350.0 Time_ms 0.00 655350.0 FORMAT "%8.1" /end CHARACTERISTIC
/begin CHARACTERISTIC DSM_DInDfp_FrmMngSTAT_ANH_C "Verzögerung Ersatzreaktion für Fehlerpfad Dfp_FrmMngSTAT_ANH" VALUE 0xCECF6 Kw_Wu16 655350.0 Time_ms 0.00 655350.0 FORMAT "%8.1" /end CHARACTERISTIC
/begin CHARACTERISTIC DSM_DInDfp_FrmMngSTAT_ARS_C "Verzögerung Ersatzreaktion für Fehlerpfad Dfp_FrmMngSTAT_ARS" VALUE 0xCECF8 Kw_Wu16 655350.0 Time_ms 0.00 655350.0 FORMAT "%8.1" /end CHARACTERISTIC
/begin CHARACTERISTIC DSM_DInDfp_FrmMngSTAT_DSC_C "Verzögerung Ersatzreaktion für Fehlerpfad Dfp_FrmMngSTAT_DSC" VALUE 0xCECFA Kw_Wu16 655350.0 Time_ms 0.00 655350.0 FORMAT "%8.1" /end CHARACTERISTIC
/begin CHARACTERISTIC DSM_DInDfp_FrmMngSTAT_EKP_C "Verzögerung Ersatzreaktion für Fehlerpfad Dfp_FrmMngSTAT_EKP" VALUE 0xCECFC Kw_Wu16 655350.0 Time_ms 0.00 655350.0 FORMAT "%8.1" /end CHARACTERISTIC
/begin CHARACTERISTIC DSM_DInDfp_FrmMngSTAT_KOMBI_C "Verzögerung Ersatzreaktion für Fehlerpfad Dfp_FrmMngSTAT_KOMBI" VALUE 0xCECFE Kw_Wu16 655350.0 Time_ms 0.00 655350.0 FORMAT "%8.1" /end CHARACTERISTIC
/begin CHARACTERISTIC DSM_DInDfp_FrmMngSTAT_SITZ_C "Verzögerung Ersatzreaktion für Fehlerpfad Dfp_FrmMngSTAT_SITZ" VALUE 0xCED00 Kw_Wu16 655350.0 Time_ms 0.00 655350.0 FORMAT "%8.1" /end CHARACTERISTIC
/begin CHARACTERISTIC DSM_DInDfp_FrmMngStOBDGbxMilOf_C "Verzögerung Ersatzreaktion für Fehlerpfad Dfp_FrmMngStOBDGbxMilOf" VALUE 0xCED02 Kw_Wu16 655350.0 Time_ms 0.00 655350.0 FORMAT "%8.1" /end CHARACTERISTIC
/begin CHARACTERISTIC DSM_DInDfp_FrmMngStOBDGbxMilOn_C "Verzögerung Ersatzreaktion für Fehlerpfad Dfp_FrmMngStOBDGbxMilOn" VALUE 0xCED04 Kw_Wu16 655350.0 Time_ms 0.00 655350.0 FORMAT "%8.1" /end CHARACTERISTIC
/begin CHARACTERISTIC DSM_DInDfp_FrmMngTEMPRELTIME_C "Verzögerung Ersatzreaktion für Fehlerpfad Dfp_FrmMngTEMPRELTIME" VALUE 0xCED06 Kw_Wu16 655350.0 Time_ms 0.00 655350.0 FORMAT "%8.1" /end CHARACTERISTIC
/begin CHARACTERISTIC DSM_DInDfp_FrmMngTERMINAL_C "Verzögerung Ersatzreaktion für Fehlerpfad Dfp_FrmMngTERMINAL" VALUE 0xCED08 Kw_Wu16 655350.0 Time_ms 0.00 655350.0 FORMAT "%8.1" /end CHARACTERISTIC
/begin CHARACTERISTIC DSM_DInDfp_FrmMngTIME_DATE_C "Verzögerung Ersatzreaktion für Fehlerpfad Dfp_FrmMngTIME_DATE" VALUE 0xCED0A Kw_Wu16 655350.0 Time_ms 0.00 655350.0 FORMAT "%8.1" /end CHARACTERISTIC
/begin CHARACTERISTIC DSM_DInDfp_FrmMngTORQUE_DSC_C "Verzögerung Ersatzreaktion für Fehlerpfad Dfp_FrmMngTORQUE_DSC" VALUE 0xCED0C Kw_Wu16 655350.0 Time_ms 0.00 655350.0 FORMAT "%8.1" /end CHARACTERISTIC
/begin CHARACTERISTIC DSM_DInDfp_FrmMngTORQUE_GEARBX_C "Verzögerung Ersatzreaktion für Fehlerpfad Dfp_FrmMngTORQUE_GEARBX" VALUE 0xCED0E Kw_Wu16 655350.0 Time_ms 0.00 655350.0 FORMAT "%8.1" /end CHARACTERISTIC
/begin CHARACTERISTIC DSM_DInDfp_FrmMngTrq_ReqACC_C "Verzögerung Ersatzreaktion für Fehlerpfad Dfp_FrmMngTrq_ReqACC" VALUE 0xCED10 Kw_Wu16 655350.0 Time_ms 0.00 655350.0 FORMAT "%8.1" /end CHARACTERISTIC
/begin CHARACTERISTIC DSM_DInDfp_FrmMngVEH_MOD_C "Verzögerung Ersatzreaktion für Fehlerpfad Dfp_FrmMngVEH_MOD_C" VALUE 0xCED12 Kw_Wu16 655350.0 Time_ms 0.00 655350.0 FORMAT "%8.1" /end CHARACTERISTIC
/begin CHARACTERISTIC DSM_DInDfp_FrmMngVELOCITY_C "Verzögerung Ersatzreaktion für Fehlerpfad Dfp_FrmMngVELOCITY" VALUE 0xCED14 Kw_Wu16 655350.0 Time_ms 0.00 655350.0 FORMAT "%8.1" /end CHARACTERISTIC
/begin CHARACTERISTIC DSM_DInDfp_FrmMngWHEEL_SPEED_C "Verzögerung Ersatzreaktion für Fehlerpfad Dfp_FrmMngWHEEL_SPEED" VALUE 0xCED16 Kw_Wu16 655350.0 Time_ms 0.00 655350.0 FORMAT "%8.1" /end CHARACTERISTIC
/begin CHARACTERISTIC DSM_DInDfp_FrmMngstCurr_C "Inhibitlabel für Dfp_FrmMngstCurr" VALUE 0xCED18 Kw_Wu16 655350.0 Time_ms 0.00 655350.0 FORMAT "%8.1" /end CHARACTERISTIC
/begin CHARACTERISTIC DSM_DInDfp_FrmMngswtPSPOff_C "Inhibitlabel für Dfp_FrmMngswtPSPOff" VALUE 0xCED1A Kw_Wu16 655350.0 Time_ms 0.00 655350.0 FORMAT "%8.1" /end CHARACTERISTIC
/begin CHARACTERISTIC DSM_DInDfp_GearbxIncMax_C "Verzögerung Ersatzreaktion für Fehlerpfad Dfp_GearbxIncMax" VALUE 0xCED1C Kw_Wu16 655350.0 Time_ms 0.00 655350.0 FORMAT "%8.1" /end CHARACTERISTIC
/begin CHARACTERISTIC DSM_DInDfp_GlwCD_C "Verzögerung Ersatzreaktion für Fehlerpfad Dfp_GlwCD" VALUE 0xCED1E Kw_Wu16 655350.0 Time_ms 0.00 655350.0 FORMAT "%8.1" /end CHARACTERISTIC
/begin CHARACTERISTIC DSM_DInDfp_GlwCDGlwCirc1_C "Verzögerung Ersatzreaktion für Fehlerpfad Dfp_GlwCDGlwCirc1" VALUE 0xCED20 Kw_Wu16 655350.0 Time_ms 0.00 655350.0 FORMAT "%8.1" /end CHARACTERISTIC
/begin CHARACTERISTIC DSM_DInDfp_GlwCDGlwCirc2_C "Verzögerung Ersatzreaktion für Fehlerpfad Dfp_GlwCDGlwCirc2" VALUE 0xCED22 Kw_Wu16 655350.0 Time_ms 0.00 655350.0 FORMAT "%8.1" /end CHARACTERISTIC
/begin CHARACTERISTIC DSM_DInDfp_GlwCDGlwCirc3_C "Verzögerung Ersatzreaktion für Fehlerpfad Dfp_GlwCDGlwCirc3" VALUE 0xCED24 Kw_Wu16 655350.0 Time_ms 0.00 655350.0 FORMAT "%8.1" /end CHARACTERISTIC
/begin CHARACTERISTIC DSM_DInDfp_GlwCDGlwCirc4_C "Verzögerung Ersatzreaktion für Fehlerpfad Dfp_GlwCDGlwCirc4" VALUE 0xCED26 Kw_Wu16 655350.0 Time_ms 0.00 655350.0 FORMAT "%8.1" /end CHARACTERISTIC
/begin CHARACTERISTIC DSM_DInDfp_GlwCDGlwCirc5_C "Verzögerung Ersatzreaktion für Fehlerpfad Dfp_GlwCDGlwCirc5" VALUE 0xCED28 Kw_Wu16 655350.0 Time_ms 0.00 655350.0 FORMAT "%8.1" /end CHARACTERISTIC
/begin CHARACTERISTIC DSM_DInDfp_GlwCDGlwCirc6_C "Verzögerung Ersatzreaktion für Fehlerpfad Dfp_GlwCDGlwCirc6" VALUE 0xCED2A Kw_Wu16 655350.0 Time_ms 0.00 655350.0 FORMAT "%8.1" /end CHARACTERISTIC
/begin CHARACTERISTIC DSM_DInDfp_GlwCDGlwCirc7_C "Verzögerung Ersatzreaktion für Fehlerpfad Dfp_GlwCDGlwCirc7" VALUE 0xCED2C Kw_Wu16 655350.0 Time_ms 0.00 655350.0 FORMAT "%8.1" /end CHARACTERISTIC
/begin CHARACTERISTIC DSM_DInDfp_GlwCDGlwCirc8_C "Verzögerung Ersatzreaktion für Fehlerpfad Dfp_GlwCDGlwCirc8" VALUE 0xCED2E Kw_Wu16 655350.0 Time_ms 0.00 655350.0 FORMAT "%8.1" /end CHARACTERISTIC
/begin CHARACTERISTIC DSM_DInDfp_GlwCtl_C "Verzögerung Ersatzreaktion für Fehlerpfad Dfp_GlwCtl" VALUE 0xCED30 Kw_Wu16 655350.0 Time_ms 0.00 655350.0 FORMAT "%8.1" /end CHARACTERISTIC
/begin CHARACTERISTIC DSM_DInDfp_HWEMonCom_C "Verzögerung Ersatzreaktion für Fehlerpfad Dfp_HWEMonCom" VALUE 0xCED32 Kw_Wu16 655350.0 Time_ms 0.00 655350.0 FORMAT "%8.1" /end CHARACTERISTIC
/begin CHARACTERISTIC DSM_DInDfp_HWEMonEEPROM_C "Verzögerung Ersatzreaktion für Fehlerpfad Dfp_HWEMonEEPROM" VALUE 0xCED34 Kw_Wu16 655350.0 Time_ms 0.00 655350.0 FORMAT "%8.1" /end CHARACTERISTIC
/begin CHARACTERISTIC DSM_DInDfp_HWEMonRcyLocked_C "Verzögerung Ersatzreaktion für Fehlerpfad Dfp_HWEMonRcyLocked" VALUE 0xCED36 Kw_Wu16 655350.0 Time_ms 0.00 655350.0 FORMAT "%8.1" /end CHARACTERISTIC
/begin CHARACTERISTIC DSM_DInDfp_HWEMonRcySuppressed_C "Verzögerung Ersatzreaktion für Fehlerpfad Dfp_HWEMonRcySuppressed" VALUE 0xCED38 Kw_Wu16 655350.0 Time_ms 0.00 655350.0 FORMAT "%8.1" /end CHARACTERISTIC
/begin CHARACTERISTIC DSM_DInDfp_HWEMonRcyVisible_C "Verzögerung Ersatzreaktion für Fehlerpfad Dfp_HWEMonRcyVisible" VALUE 0xCED3A Kw_Wu16 655350.0 Time_ms 0.00 655350.0 FORMAT "%8.1" /end CHARACTERISTIC
/begin CHARACTERISTIC DSM_DInDfp_HWEMonUMaxSupply_C "Verzögerung Ersatzreaktion für Fehlerpfad Dfp_HWEMonUMaxSupply" VALUE 0xCED3C Kw_Wu16 655350.0 Time_ms 0.00 655350.0 FORMAT "%8.1" /end CHARACTERISTIC
/begin CHARACTERISTIC DSM_DInDfp_HWEMonUMinSupply_C "Verzögerung Ersatzreaktion für Fehlerpfad Dfp_HWEMonUMinSupply" VALUE 0xCED3E Kw_Wu16 655350.0 Time_ms 0.00 655350.0 FORMAT "%8.1" /end CHARACTERISTIC
/begin CHARACTERISTIC DSM_DInDfp_IATSCD_C "Verzögerung Ersatzreaktion für Fehlerpfad Dfp_IATSCD" VALUE 0xCED40 Kw_Wu16 655350.0 Time_ms 0.00 655350.0 FORMAT "%8.1" /end CHARACTERISTIC
/begin CHARACTERISTIC DSM_DInDfp_IATSCD_CATS_C "Verzögerung Ersatzreaktion für Fehlerpfad Dfp_IATSCD_CATS" VALUE 0xCED42 Kw_Wu16 655350.0 Time_ms 0.00 655350.0 FORMAT "%8.1" /end CHARACTERISTIC
/begin CHARACTERISTIC DSM_DInDfp_ImmCtlImmCD_C "Verzögerung Ersatzreaktion für Fehlerpfad Dfp_ImmCtlImmCD" VALUE 0xCED44 Kw_Wu16 655350.0 Time_ms 0.00 655350.0 FORMAT "%8.1" /end CHARACTERISTIC
/begin CHARACTERISTIC DSM_DInDfp_ImmCtlImmEep_C "Verzögerung Ersatzreaktion für Fehlerpfad Dfp_ImmCtlImmEep" VALUE 0xCED46 Kw_Wu16 655350.0 Time_ms 0.00 655350.0 FORMAT "%8.1" /end CHARACTERISTIC
/begin CHARACTERISTIC DSM_DInDfp_ImmCtlMpl_C "Verzögerung Ersatzreaktion für Fehlerpfad Dfp_ImmCtlMpl" VALUE 0xCED48 Kw_Wu16 655350.0 Time_ms 0.00 655350.0 FORMAT "%8.1" /end CHARACTERISTIC
/begin CHARACTERISTIC DSM_DInDfp_IndSys1_C "Verzögerung Ersatzreaktion für Fehlerpfad Dfp_IndSys1" VALUE 0xCED4A Kw_Wu16 655350.0 Time_ms 0.00 655350.0 FORMAT "%8.1" /end CHARACTERISTIC
/begin CHARACTERISTIC DSM_DInDfp_IndSys2_C "Verzögerung Ersatzreaktion für Fehlerpfad Dfp_IndSys2" VALUE 0xCED4C Kw_Wu16 655350.0 Time_ms 0.00 655350.0 FORMAT "%8.1" /end CHARACTERISTIC
/begin CHARACTERISTIC DSM_DInDfp_InjCrv_InjLim_C "Verzögerung Ersatzreaktion für Fehlerpfad Dfp_InjCrv_InjLim" VALUE 0xCED4E Kw_Wu16 655350.0 Time_ms 0.00 655350.0 FORMAT "%8.1" /end CHARACTERISTIC
/begin CHARACTERISTIC DSM_DInDfp_InjCtlAdjQnt_C "Verzögerung Ersatzreaktion für Fehlerpfad Dfp_InjCtlAdjQnt" VALUE 0xCED50 Kw_Wu16 655350.0 Time_ms 0.00 655350.0 FORMAT "%8.1" /end CHARACTERISTIC
/begin CHARACTERISTIC DSM_DInDfp_InjCtlDrift_C "Verzögerung Ersatzreaktion für Fehlerpfad Dfp_InjCtlDrift" VALUE 0xCED52 Kw_Wu16 655350.0 Time_ms 0.00 655350.0 FORMAT "%8.1" /end CHARACTERISTIC
/begin CHARACTERISTIC DSM_DInDfp_InjVlvBnk1A_C "#SSD Verzögerung Ersatzreaktion für Fehlerpfad Dfp_InjVlvBnk1A" VALUE 0xCED54 Kw_Wu16 655350.0 Time_ms 0.00 655350.0 FORMAT "%8.1" /end CHARACTERISTIC
/begin CHARACTERISTIC DSM_DInDfp_InjVlvBnk1B_C "#SSD Verzögerung Ersatzreaktion für Fehlerpfad Dfp_InjVlvBnk1B" VALUE 0xCED56 Kw_Wu16 655350.0 Time_ms 0.00 655350.0 FORMAT "%8.1" /end CHARACTERISTIC
/begin CHARACTERISTIC DSM_DInDfp_InjVlvBnk2A_C "#SSD Verzögerung Ersatzreaktion für Fehlerpfad Dfp_InjVlvBnk2A" VALUE 0xCED58 Kw_Wu16 655350.0 Time_ms 0.00 655350.0 FORMAT "%8.1" /end CHARACTERISTIC
/begin CHARACTERISTIC DSM_DInDfp_InjVlvBnk2B_C "#SSD Verzögerung Ersatzreaktion für Fehlerpfad Dfp_InjVlvBnk2B" VALUE 0xCED5A Kw_Wu16 655350.0 Time_ms 0.00 655350.0 FORMAT "%8.1" /end CHARACTERISTIC
/begin CHARACTERISTIC DSM_DInDfp_InjVlvChipA_C "#SSD Verzögerung Ersatzreaktion für Fehlerpfad Dfp_InjVlvChipA" VALUE 0xCED5C Kw_Wu16 655350.0 Time_ms 0.00 655350.0 FORMAT "%8.1" /end CHARACTERISTIC
/begin CHARACTERISTIC DSM_DInDfp_InjVlvChipB_C "#SSD Verzögerung Ersatzreaktion für Fehlerpfad Dfp_InjVlvChipB" VALUE 0xCED5E Kw_Wu16 655350.0 Time_ms 0.00 655350.0 FORMAT "%8.1" /end CHARACTERISTIC
/begin CHARACTERISTIC DSM_DInDfp_InjVlvCyl1A_C "#SSD Verzögerung Ersatzreaktion für Fehlerpfad Dfp_InjVlvCyl1A" VALUE 0xCED60 Kw_Wu16 655350.0 Time_ms 0.00 655350.0 FORMAT "%8.1" /end CHARACTERISTIC
/begin CHARACTERISTIC DSM_DInDfp_InjVlvCyl1B_C "#SSD Verzögerung Ersatzreaktion für Fehlerpfad Dfp_InjVlvCyl1B" VALUE 0xCED62 Kw_Wu16 655350.0 Time_ms 0.00 655350.0 FORMAT "%8.1" /end CHARACTERISTIC
/begin CHARACTERISTIC DSM_DInDfp_InjVlvCyl2A_C "#SSD Verzögerung Ersatzreaktion für Fehlerpfad Dfp_InjVlvCyl2A" VALUE 0xCED64 Kw_Wu16 655350.0 Time_ms 0.00 655350.0 FORMAT "%8.1" /end CHARACTERISTIC
/begin CHARACTERISTIC DSM_DInDfp_InjVlvCyl2B_C "#SSD Verzögerung Ersatzreaktion für Fehlerpfad Dfp_InjVlvCyl2B" VALUE 0xCED66 Kw_Wu16 655350.0 Time_ms 0.00 655350.0 FORMAT "%8.1" /end CHARACTERISTIC
/begin CHARACTERISTIC DSM_DInDfp_InjVlvCyl3A_C "#SSD Verzögerung Ersatzreaktion für Fehlerpfad Dfp_InjVlvCyl3A" VALUE 0xCED68 Kw_Wu16 655350.0 Time_ms 0.00 655350.0 FORMAT "%8.1" /end CHARACTERISTIC
/begin CHARACTERISTIC DSM_DInDfp_InjVlvCyl3B_C "#SSD Verzögerung Ersatzreaktion für Fehlerpfad Dfp_InjVlvCyl3B" VALUE 0xCED6A Kw_Wu16 655350.0 Time_ms 0.00 655350.0 FORMAT "%8.1" /end CHARACTERISTIC
/begin CHARACTERISTIC DSM_DInDfp_InjVlvCyl4A_C "#SSD Verzögerung Ersatzreaktion für Fehlerpfad Dfp_InjVlvCyl4A" VALUE 0xCED6C Kw_Wu16 655350.0 Time_ms 0.00 655350.0 FORMAT "%8.1" /end CHARACTERISTIC
/begin CHARACTERISTIC DSM_DInDfp_InjVlvCyl4B_C "#SSD Verzögerung Ersatzreaktion für Fehlerpfad Dfp_InjVlvCyl4B" VALUE 0xCED6E Kw_Wu16 655350.0 Time_ms 0.00 655350.0 FORMAT "%8.1" /end CHARACTERISTIC
/begin CHARACTERISTIC DSM_DInDfp_InjVlvCyl5A_C "#SSD Verzögerung Ersatzreaktion für Fehlerpfad Dfp_InjVlvCyl5A" VALUE 0xCED70 Kw_Wu16 655350.0 Time_ms 0.00 655350.0 FORMAT "%8.1" /end CHARACTERISTIC
/begin CHARACTERISTIC DSM_DInDfp_InjVlvCyl5B_C "#SSD Verzögerung Ersatzreaktion für Fehlerpfad Dfp_InjVlvCyl5B" VALUE 0xCED72 Kw_Wu16 655350.0 Time_ms 0.00 655350.0 FORMAT "%8.1" /end CHARACTERISTIC
/begin CHARACTERISTIC DSM_DInDfp_InjVlvCyl6A_C "#SSD Verzögerung Ersatzreaktion für Fehlerpfad Dfp_InjVlvCyl6A" VALUE 0xCED74 Kw_Wu16 655350.0 Time_ms 0.00 655350.0 FORMAT "%8.1" /end CHARACTERISTIC
/begin CHARACTERISTIC DSM_DInDfp_InjVlvCyl6B_C "#SSD Verzögerung Ersatzreaktion für Fehlerpfad Dfp_InjVlvCyl6B" VALUE 0xCED76 Kw_Wu16 655350.0 Time_ms 0.00 655350.0 FORMAT "%8.1" /end CHARACTERISTIC
/begin CHARACTERISTIC DSM_DInDfp_KeyCheck_C "Verzögerung Ersatzreaktion für Fehlerpfad Dfp_KeyCheck" VALUE 0xCED78 Kw_Wu16 655350.0 Time_ms 0.00 655350.0 FORMAT "%8.1" /end CHARACTERISTIC
/begin CHARACTERISTIC DSM_DInDfp_LIGovECUTransMode_C "Verzögerung Ersatzreaktion für Fehlerpfad Dfp_LIGovECUTransMode" VALUE 0xCED7A Kw_Wu16 655350.0 Time_ms 0.00 655350.0 FORMAT "%8.1" /end CHARACTERISTIC
/begin CHARACTERISTIC DSM_DInDfp_LPACD_Max_C "Verzögerung Ersatzreaktion für Fehlerpfad Dfp_LPACD_Max" VALUE 0xCED7C Kw_Wu16 655350.0 Time_ms 0.00 655350.0 FORMAT "%8.1" /end CHARACTERISTIC
/begin CHARACTERISTIC DSM_DInDfp_LPACD_Min_C "Verzögerung Ersatzreaktion für Fehlerpfad Dfp_LPACD_Min" VALUE 0xCED7E Kw_Wu16 655350.0 Time_ms 0.00 655350.0 FORMAT "%8.1" /end CHARACTERISTIC
/begin CHARACTERISTIC DSM_DInDfp_LPACD_SigNpl_C "Verzögerung Ersatzreaktion für Fehlerpfad Dfp_LPACD_SigNpl" VALUE 0xCED80 Kw_Wu16 655350.0 Time_ms 0.00 655350.0 FORMAT "%8.1" /end CHARACTERISTIC
/begin CHARACTERISTIC DSM_DInDfp_LSUCDCircNernst0_C "Verzögerung Ersatzreaktion für Fehlerpfad Dfp_LSUCDCircNernst0" VALUE 0xCED82 Kw_Wu16 655350.0 Time_ms 0.00 655350.0 FORMAT "%8.1" /end CHARACTERISTIC
/begin CHARACTERISTIC DSM_DInDfp_LSUCDCircPumpCur0_C "Verzögerung Ersatzreaktion für Fehlerpfad Dfp_LSUCDCircPumpCur0" VALUE 0xCED84 Kw_Wu16 655350.0 Time_ms 0.00 655350.0 FORMAT "%8.1" /end CHARACTERISTIC
/begin CHARACTERISTIC DSM_DInDfp_LSUCDCircVirtGnd0_C "Verzögerung Ersatzreaktion für Fehlerpfad Dfp_LSUCDCircVirtGnd0" VALUE 0xCED86 Kw_Wu16 655350.0 Time_ms 0.00 655350.0 FORMAT "%8.1" /end CHARACTERISTIC
/begin CHARACTERISTIC DSM_DInDfp_LSUCDHeater0_C "Verzögerung Ersatzreaktion für Fehlerpfad Dfp_LSUCDHeater0" VALUE 0xCED88 Kw_Wu16 655350.0 Time_ms 0.00 655350.0 FORMAT "%8.1" /end CHARACTERISTIC
/begin CHARACTERISTIC DSM_DInDfp_LSUCDHtCoup0_C "Verzögerung Ersatzreaktion für Fehlerpfad Dfp_LSUCDHtCoup0" VALUE 0xCED8A Kw_Wu16 655350.0 Time_ms 0.00 655350.0 FORMAT "%8.1" /end CHARACTERISTIC
/begin CHARACTERISTIC DSM_DInDfp_LSUCDO20_C "Verzögerung Ersatzreaktion für Fehlerpfad Dfp_LSUCDO20" VALUE 0xCED8C Kw_Wu16 655350.0 Time_ms 0.00 655350.0 FORMAT "%8.1" /end CHARACTERISTIC
/begin CHARACTERISTIC DSM_DInDfp_LSUCDO2Clb0_C "Verzögerung Ersatzreaktion für Fehlerpfad Dfp_LSUCDO2Clb0" VALUE 0xCED8E Kw_Wu16 655350.0 Time_ms 0.00 655350.0 FORMAT "%8.1" /end CHARACTERISTIC
/begin CHARACTERISTIC DSM_DInDfp_LSUCDRiClb0_C "Verzögerung Ersatzreaktion für Fehlerpfad Dfp_LSUCDRiClb0" VALUE 0xCED90 Kw_Wu16 655350.0 Time_ms 0.00 655350.0 FORMAT "%8.1" /end CHARACTERISTIC
/begin CHARACTERISTIC DSM_DInDfp_LSUCDSPI0_C "Verzögerung Ersatzreaktion für Fehlerpfad Dfp_LSUCDSPI0" VALUE 0xCED92 Kw_Wu16 655350.0 Time_ms 0.00 655350.0 FORMAT "%8.1" /end CHARACTERISTIC
/begin CHARACTERISTIC DSM_DInDfp_LSUCDSPIBattLow0_C "Verzögerung Ersatzreaktion für Fehlerpfad Dfp_LSUCDSPIBattLow0" VALUE 0xCED94 Kw_Wu16 655350.0 Time_ms 0.00 655350.0 FORMAT "%8.1" /end CHARACTERISTIC
/begin CHARACTERISTIC DSM_DInDfp_LSUCDWireIP0_C "Verzögerung Ersatzreaktion für Fehlerpfad Dfp_LSUCDWireIP0" VALUE 0xCED96 Kw_Wu16 655350.0 Time_ms 0.00 655350.0 FORMAT "%8.1" /end CHARACTERISTIC
/begin CHARACTERISTIC DSM_DInDfp_LSUCtlRiExc0_C "Verzögerung Ersatzreaktion für Fehlerpfad Dfp_LSUCtlRiExc0" VALUE 0xCED98 Kw_Wu16 655350.0 Time_ms 0.00 655350.0 FORMAT "%8.1" /end CHARACTERISTIC
/begin CHARACTERISTIC DSM_DInDfp_LSUMon1Sens_C "Verzögerung Ersatzreaktion für Fehlerpfad Dfp_LSUMon1Sens" VALUE 0xCED9A Kw_Wu16 655350.0 Time_ms 0.00 655350.0 FORMAT "%8.1" /end CHARACTERISTIC
/begin CHARACTERISTIC DSM_DInDfp_LSUMon2Sens_C "Verzögerung Ersatzreaktion für Fehlerpfad Dfp_LSUMon2Sens" VALUE 0xCED9C Kw_Wu16 655350.0 Time_ms 0.00 655350.0 FORMAT "%8.1" /end CHARACTERISTIC
/begin CHARACTERISTIC DSM_DInDfp_MIL_C "Verzögerung Ersatzreaktion für Fehlerpfad Dfp_MIL" VALUE 0xCED9E Kw_Wu16 655350.0 Time_ms 0.00 655350.0 FORMAT "%8.1" /end CHARACTERISTIC
/begin CHARACTERISTIC DSM_DInDfp_MRlyCD_C "Verzögerung Ersatzreaktion für Fehlerpfad Dfp_MRlyCD" VALUE 0xCEDA0 Kw_Wu16 655350.0 Time_ms 0.00 655350.0 FORMAT "%8.1" /end CHARACTERISTIC
/begin CHARACTERISTIC DSM_DInDfp_MSidCD_Comm_C "#SSD Verzögerung Ersatzreaktion für Fehlerpfad Dfp_MSidCD_Comm" VALUE 0xCEDA2 Kw_Wu16 655350.0 Time_ms 0.00 655350.0 FORMAT "%8.1" /end CHARACTERISTIC
/begin CHARACTERISTIC DSM_DInDfp_MSidCD_Pin_C "#SSD Verzögerung Ersatzreaktion für Fehlerpfad Dfp_MSidCD_Pin" VALUE 0xCEDA4 Kw_Wu16 655350.0 Time_ms 0.00 655350.0 FORMAT "%8.1" /end CHARACTERISTIC
/begin CHARACTERISTIC DSM_DInDfp_MSidCD_Sel_INI_C "#SSD Verzögerung Ersatzreaktion für Fehlerpfad Dfp_MSidCD_Sel_INI" VALUE 0xCEDA6 Kw_Wu16 655350.0 Time_ms 0.00 655350.0 FORMAT "%8.1" /end CHARACTERISTIC
/begin CHARACTERISTIC DSM_DInDfp_MSidCD_Select_C "#SSD Verzögerung Ersatzreaktion für Fehlerpfad Dfp_MSidCD_Select" VALUE 0xCEDA8 Kw_Wu16 655350.0 Time_ms 0.00 655350.0 FORMAT "%8.1" /end CHARACTERISTIC
/begin CHARACTERISTIC DSM_DInDfp_MeUnCDNoLoad_C "#SSD Verzögerung Ersatzreaktion für Fehlerpfad Dfp_MeUnCDNoLoad" VALUE 0xCEDAA Kw_Wu16 655350.0 Time_ms 0.00 655350.0 FORMAT "%8.1" /end CHARACTERISTIC
/begin CHARACTERISTIC DSM_DInDfp_MeUnCDSCBat_C "#SSD Verzögerung Ersatzreaktion für Fehlerpfad Dfp_MeUnCDSCBat" VALUE 0xCEDAC Kw_Wu16 655350.0 Time_ms 0.00 655350.0 FORMAT "%8.1" /end CHARACTERISTIC
/begin CHARACTERISTIC DSM_DInDfp_MeUnCDSCGnd_C "#SSD Verzögerung Ersatzreaktion für Fehlerpfad Dfp_MeUnCDSCGnd" VALUE 0xCEDAE Kw_Wu16 655350.0 Time_ms 0.00 655350.0 FORMAT "%8.1" /end CHARACTERISTIC
/begin CHARACTERISTIC DSM_DInDfp_MeUnCD_ADC_C "#SSD Verzögerung Ersatzreaktion für Fehlerpfad Dfp_MeUnCD_ADC" VALUE 0xCEDB0 Kw_Wu16 655350.0 Time_ms 0.00 655350.0 FORMAT "%8.1" /end CHARACTERISTIC
/begin CHARACTERISTIC DSM_DInDfp_MeUnCD_SigTst_C "#SSD Verzögerung Ersatzreaktion für Fehlerpfad Dfp_MeUnCD_SigTst" VALUE 0xCEDB2 Kw_Wu16 655350.0 Time_ms 0.00 655350.0 FORMAT "%8.1" /end CHARACTERISTIC
/begin CHARACTERISTIC DSM_DInDfp_Montr_C "Verzögerung Ersatzreaktion für Fehlerpfad Dfp_Montr" VALUE 0xCEDB4 Kw_Wu16 655350.0 Time_ms 0.00 655350.0 FORMAT "%8.1" /end CHARACTERISTIC
/begin CHARACTERISTIC DSM_DInDfp_NetMngDeviceA_C "Verzögerung Ersatzreaktion für Fehlerpfad Dfp_NetMngDeviceA" VALUE 0xCEDB6 Kw_Wu16 655350.0 Time_ms 0.00 655350.0 FORMAT "%8.1" /end CHARACTERISTIC
/begin CHARACTERISTIC DSM_DInDfp_NetMngDeviceB_C "Verzögerung Ersatzreaktion für Fehlerpfad Dfp_NetMngDeviceB" VALUE 0xCEDB8 Kw_Wu16 655350.0 Time_ms 0.00 655350.0 FORMAT "%8.1" /end CHARACTERISTIC
/begin CHARACTERISTIC DSM_DInDfp_NetMngDeviceC_C "Verzögerung Ersatzreaktion für Fehlerpfad Dfp_NetMngDeviceC" VALUE 0xCEDBA Kw_Wu16 655350.0 Time_ms 0.00 655350.0 FORMAT "%8.1" /end CHARACTERISTIC
/begin CHARACTERISTIC DSM_DInDfp_NetMngPtCan_C "Verzögerung Ersatzreaktion für Fehlerpfad Dfp_NetMngPtCan" VALUE 0xCEDBC Kw_Wu16 655350.0 Time_ms 0.00 655350.0 FORMAT "%8.1" /end CHARACTERISTIC
/begin CHARACTERISTIC DSM_DInDfp_OPSCD_Lamp_C "Verzögerung Ersatzreaktion für Fehlerpfad Dfp_OPSCD_Lamp" VALUE 0xCEDBE Kw_Wu16 655350.0 Time_ms 0.00 655350.0 FORMAT "%8.1" /end CHARACTERISTIC
/begin CHARACTERISTIC DSM_DInDfp_OPSCD_anain_C "Verzögerung Ersatzreaktion für Fehlerpfad Dfp_OPSCD_anain" VALUE 0xCEDC0 Kw_Wu16 655350.0 Time_ms 0.00 655350.0 FORMAT "%8.1" /end CHARACTERISTIC
/begin CHARACTERISTIC DSM_DInDfp_OTSCD_C "Verzögerung Ersatzreaktion für Fehlerpfad Dfp_OTSCD" VALUE 0xCEDC2 Kw_Wu16 655350.0 Time_ms 0.00 655350.0 FORMAT "%8.1" /end CHARACTERISTIC
/begin CHARACTERISTIC DSM_DInDfp_OvRMon_C "Verzögerung Ersatzreaktion für Fehlerpfad Dfp_OvRMon" VALUE 0xCEDC4 Kw_Wu16 655350.0 Time_ms 0.00 655350.0 FORMAT "%8.1" /end CHARACTERISTIC
/begin CHARACTERISTIC DSM_DInDfp_OvRMonSigA_C "Verzögerung Ersatzreaktion für Fehlerpfad Dfp_OvRMonSigA" VALUE 0xCEDC6 Kw_Wu16 655350.0 Time_ms 0.00 655350.0 FORMAT "%8.1" /end CHARACTERISTIC
/begin CHARACTERISTIC DSM_DInDfp_OxiCCDTPre_C "Verzögerung Ersatzreaktion für Fehlerpfad Dfp_OxiCCDTPre" VALUE 0xCEDC8 Kw_Wu16 655350.0 Time_ms 0.00 655350.0 FORMAT "%8.1" /end CHARACTERISTIC
/begin CHARACTERISTIC DSM_DInDfp_PCBS_C "Verzögerung Ersatzreaktion für Fehlerpfad Dfp_PCBS" VALUE 0xCEDCA Kw_Wu16 655350.0 Time_ms 0.00 655350.0 FORMAT "%8.1" /end CHARACTERISTIC
/begin CHARACTERISTIC DSM_DInDfp_PCR_GovDevNeg_C "Verzögerung Ersatzreaktion für Fehlerpfad Dfp_PCR_GovDevNeg" VALUE 0xCEDCC Kw_Wu16 655350.0 Time_ms 0.00 655350.0 FORMAT "%8.1" /end CHARACTERISTIC
/begin CHARACTERISTIC DSM_DInDfp_PCR_GovDevPos_C "Verzögerung Ersatzreaktion für Fehlerpfad Dfp_PCR_GovDevPos" VALUE 0xCEDCE Kw_Wu16 655350.0 Time_ms 0.00 655350.0 FORMAT "%8.1" /end CHARACTERISTIC
/begin CHARACTERISTIC DSM_DInDfp_PCR_LPGvnrDvtNeg_C "Verzögerung Ersatzreaktion für Fehlerpfad Dfp_PCR_LPGvnrDvtNeg" VALUE 0xCEDD0 Kw_Wu16 655350.0 Time_ms 0.00 655350.0 FORMAT "%8.1" /end CHARACTERISTIC
/begin CHARACTERISTIC DSM_DInDfp_PCR_LPGvnrDvtPos_C "Verzögerung Ersatzreaktion für Fehlerpfad Dfp_PCR_LPGvnrDvtPos" VALUE 0xCEDD2 Kw_Wu16 655350.0 Time_ms 0.00 655350.0 FORMAT "%8.1" /end CHARACTERISTIC
/begin CHARACTERISTIC DSM_DInDfp_PCVCDNoLoad_C "#SSD Verzögerung Ersatzreaktion für Fehlerpfad Dfp_PCVCDNoLoad" VALUE 0xCEDD4 Kw_Wu16 655350.0 Time_ms 0.00 655350.0 FORMAT "%8.1" /end CHARACTERISTIC
/begin CHARACTERISTIC DSM_DInDfp_PCVCDSCBat_C "#SSD Verzögerung Ersatzreaktion für Fehlerpfad Dfp_PCVCDSCBat" VALUE 0xCEDD6 Kw_Wu16 655350.0 Time_ms 0.00 655350.0 FORMAT "%8.1" /end CHARACTERISTIC
/begin CHARACTERISTIC DSM_DInDfp_PCVCDSCGnd_C "#SSD Verzögerung Ersatzreaktion für Fehlerpfad Dfp_PCVCDSCGnd" VALUE 0xCEDD8 Kw_Wu16 655350.0 Time_ms 0.00 655350.0 FORMAT "%8.1" /end CHARACTERISTIC
/begin CHARACTERISTIC DSM_DInDfp_PCVCD_ADC_C "#SSD Verzögerung Ersatzreaktion für Fehlerpfad Dfp_PCVCD_ADC" VALUE 0xCEDDA Kw_Wu16 655350.0 Time_ms 0.00 655350.0 FORMAT "%8.1" /end CHARACTERISTIC
/begin CHARACTERISTIC DSM_DInDfp_PCVCD_SigTst_C "#SSD Verzögerung Ersatzreaktion für Fehlerpfad Dfp_PCVCD_SigTst" VALUE 0xCEDDC Kw_Wu16 655350.0 Time_ms 0.00 655350.0 FORMAT "%8.1" /end CHARACTERISTIC
/begin CHARACTERISTIC DSM_DInDfp_PFltAPSPlaus_C "Verzögerung Ersatzreaktion für Fehlerpfad Dfp_PFltAPSPlaus" VALUE 0xCEDDE Kw_Wu16 655350.0 Time_ms 0.00 655350.0 FORMAT "%8.1" /end CHARACTERISTIC
/begin CHARACTERISTIC DSM_DInDfp_PFltAPSens_C "Verzögerung Ersatzreaktion für Fehlerpfad Dfp_PFltAPSens" VALUE 0xCEDE0 Kw_Wu16 655350.0 Time_ms 0.00 655350.0 FORMAT "%8.1" /end CHARACTERISTIC
/begin CHARACTERISTIC DSM_DInDfp_PFltBPSPlaus_C "Verzögerung Ersatzreaktion für Fehlerpfad Dfp_PFltBPSPlaus" VALUE 0xCEDE2 Kw_Wu16 655350.0 Time_ms 0.00 655350.0 FORMAT "%8.1" /end CHARACTERISTIC
/begin CHARACTERISTIC DSM_DInDfp_PFltCDPPre_C "Verzögerung Ersatzreaktion für Fehlerpfad Dfp_PFltCDPPre" VALUE 0xCEDE4 Kw_Wu16 655350.0 Time_ms 0.00 655350.0 FORMAT "%8.1" /end CHARACTERISTIC
/begin CHARACTERISTIC DSM_DInDfp_PFltCDTempPre_C "Verzögerung Ersatzreaktion für Fehlerpfad Dfp_PFltCDTempPre" VALUE 0xCEDE6 Kw_Wu16 655350.0 Time_ms 0.00 655350.0 FORMAT "%8.1" /end CHARACTERISTIC
/begin CHARACTERISTIC DSM_DInDfp_PFltChar_C "Verzögerung Ersatzreaktion für Fehlerpfad Dfp_PFltChar" VALUE 0xCEDE8 Kw_Wu16 655350.0 Time_ms 0.00 655350.0 FORMAT "%8.1" /end CHARACTERISTIC
/begin CHARACTERISTIC DSM_DInDfp_PFltEngPrt_C "Verzögerung Ersatzreaktion für Fehlerpfad Dfp_PFltEngPrt" VALUE 0xCEDEA Kw_Wu16 655350.0 Time_ms 0.00 655350.0 FORMAT "%8.1" /end CHARACTERISTIC
/begin CHARACTERISTIC DSM_DInDfp_PFltOvldInhRgn_C "Verzögerung Ersatzreaktion für Fehlerpfad Dfp_PFltOvldInhRgn" VALUE 0xCEDEC Kw_Wu16 655350.0 Time_ms 0.00 655350.0 FORMAT "%8.1" /end CHARACTERISTIC
/begin CHARACTERISTIC DSM_DInDfp_PFltOvldTrqLim_C "Verzögerung Ersatzreaktion für Fehlerpfad Dfp_PFltOvldTrqLim" VALUE 0xCEDEE Kw_Wu16 655350.0 Time_ms 0.00 655350.0 FORMAT "%8.1" /end CHARACTERISTIC
/begin CHARACTERISTIC DSM_DInDfp_PFltPresDynPlaus_C "Verzögerung Ersatzreaktion für Fehlerpfad Dfp_PFltPresDynPlaus" VALUE 0xCEDF0 Kw_Wu16 655350.0 Time_ms 0.00 655350.0 FORMAT "%8.1" /end CHARACTERISTIC
/begin CHARACTERISTIC DSM_DInDfp_PFltPresPlaus_C "Verzögerung Ersatzreaktion für Fehlerpfad Dfp_PFltPresPlaus" VALUE 0xCEDF2 Kw_Wu16 655350.0 Time_ms 0.00 655350.0 FORMAT "%8.1" /end CHARACTERISTIC
/begin CHARACTERISTIC DSM_DInDfp_PFltPresSens_C "Verzögerung Ersatzreaktion für Fehlerpfad Dfp_PFltPresSens" VALUE 0xCEDF4 Kw_Wu16 655350.0 Time_ms 0.00 655350.0 FORMAT "%8.1" /end CHARACTERISTIC
/begin CHARACTERISTIC DSM_DInDfp_PFltPresSensFrz_C "Verzögerung Ersatzreaktion für Fehlerpfad Dfp_PFltPresSensFrz" VALUE 0xCEDF6 Kw_Wu16 655350.0 Time_ms 0.00 655350.0 FORMAT "%8.1" /end CHARACTERISTIC
/begin CHARACTERISTIC DSM_DInDfp_PFltPresSensHsLn_C "Verzögerung Ersatzreaktion für Fehlerpfad Dfp_PFltPresSensHsLn" VALUE 0xCEDF8 Kw_Wu16 655350.0 Time_ms 0.00 655350.0 FORMAT "%8.1" /end CHARACTERISTIC
/begin CHARACTERISTIC DSM_DInDfp_PFltPresSensSot_C "Verzögerung Ersatzreaktion für Fehlerpfad Dfp_PFltPresSensSot" VALUE 0xCEDFA Kw_Wu16 655350.0 Time_ms 0.00 655350.0 FORMAT "%8.1" /end CHARACTERISTIC
/begin CHARACTERISTIC DSM_DInDfp_PFltRgnPerm_C "Verzögerung Ersatzreaktion für Fehlerpfad Dfp_PFltRgnPerm" VALUE 0xCEDFC Kw_Wu16 655350.0 Time_ms 0.00 655350.0 FORMAT "%8.1" /end CHARACTERISTIC
/begin CHARACTERISTIC DSM_DInDfp_PFltTempDwnStrm_C "Verzögerung Ersatzreaktion für Fehlerpfad Dfp_PFltTempDwnStrm" VALUE 0xCEDFE Kw_Wu16 655350.0 Time_ms 0.00 655350.0 FORMAT "%8.1" /end CHARACTERISTIC
/begin CHARACTERISTIC DSM_DInDfp_PFltTempSens_C "Verzögerung Ersatzreaktion für Fehlerpfad Dfp_PFltTempSens" VALUE 0xCEE00 Kw_Wu16 655350.0 Time_ms 0.00 655350.0 FORMAT "%8.1" /end CHARACTERISTIC
/begin CHARACTERISTIC DSM_DInDfp_PFltTempUpStrm_C "Verzögerung Ersatzreaktion für Fehlerpfad Dfp_PFltTempUpStrm" VALUE 0xCEE02 Kw_Wu16 655350.0 Time_ms 0.00 655350.0 FORMAT "%8.1" /end CHARACTERISTIC
/begin CHARACTERISTIC DSM_DInDfp_PFlt_tOxiPreMax_C "Verzögerung Ersatzreaktion für Fehlerpfad Dfp_PFlt_tOxiPreMax" VALUE 0xCEE04 Kw_Wu16 655350.0 Time_ms 0.00 655350.0 FORMAT "%8.1" /end CHARACTERISTIC
/begin CHARACTERISTIC DSM_DInDfp_PFlt_tOxiPreMxRgn_C "Verzögerung Ersatzreaktion für Fehlerpfad Dfp_PFlt_tOxiPreMxRgn" VALUE 0xCEE06 Kw_Wu16 655350.0 Time_ms 0.00 655350.0 FORMAT "%8.1" /end CHARACTERISTIC
/begin CHARACTERISTIC DSM_DInDfp_PFlt_tPreMax_C "Verzögerung Ersatzreaktion für Fehlerpfad Dfp_PFlt_tPreMax" VALUE 0xCEE08 Kw_Wu16 655350.0 Time_ms 0.00 655350.0 FORMAT "%8.1" /end CHARACTERISTIC
/begin CHARACTERISTIC DSM_DInDfp_PFlt_tPreMaxRgn_C "Verzögerung Ersatzreaktion für Fehlerpfad Dfp_PFlt_tPreMaxRgn" VALUE 0xCEE0A Kw_Wu16 655350.0 Time_ms 0.00 655350.0 FORMAT "%8.1" /end CHARACTERISTIC
/begin CHARACTERISTIC DSM_DInDfp_PFltmSotDiffMax_C "Verzögerung Ersatzreaktion für Fehlerpfad Dfp_PFltmSotDiffMax" VALUE 0xCEE0C Kw_Wu16 655350.0 Time_ms 0.00 655350.0 FORMAT "%8.1" /end CHARACTERISTIC
/begin CHARACTERISTIC DSM_DInDfp_PSPCD_Actr_C "Verzögerung Ersatzreaktion für Fehlerpfad Dfp_PSPCD_Actr" VALUE 0xCEE0E Kw_Wu16 655350.0 Time_ms 0.00 655350.0 FORMAT "%8.1" /end CHARACTERISTIC
/begin CHARACTERISTIC DSM_DInDfp_PresPlausDblDef_C "Verzögerung Ersatzreaktion für Fehlerpfad Dfp_PresPlausDblDef" VALUE 0xCEE10 Kw_Wu16 655350.0 Time_ms 0.00 655350.0 FORMAT "%8.1" /end CHARACTERISTIC
/begin CHARACTERISTIC DSM_DInDfp_QLTCD_C "Verzögerung Ersatzreaktion für Fehlerpfad Dfp_QLTCD" VALUE 0xCEE12 Kw_Wu16 655350.0 Time_ms 0.00 655350.0 FORMAT "%8.1" /end CHARACTERISTIC
/begin CHARACTERISTIC DSM_DInDfp_RailCD_C "#SSD Verzögerung Ersatzreaktion für Fehlerpfad Dfp_RailCD" VALUE 0xCEE14 Kw_Wu16 655350.0 Time_ms 0.00 655350.0 FORMAT "%8.1" /end CHARACTERISTIC
/begin CHARACTERISTIC DSM_DInDfp_RailCDOfsTst_C "Verzögerung Ersatzreaktion für Fehlerpfad Dfp_RailCDOfsTst" VALUE 0xCEE16 Kw_Wu16 655350.0 Time_ms 0.00 655350.0 FORMAT "%8.1" /end CHARACTERISTIC
/begin CHARACTERISTIC DSM_DInDfp_RailCD_PMonStrt_C "#SSD Verzögerung Ersatzreaktion für Fehlerpfad Dfp_RailCD_PMonStrt" VALUE 0xCEE18 Kw_Wu16 655350.0 Time_ms 0.00 655350.0 FORMAT "%8.1" /end CHARACTERISTIC
/begin CHARACTERISTIC DSM_DInDfp_RailCtlModeMeUnDiag_C "#SSD Verzögerung Ersatzreaktion für Fehlerpfad Dfp_RailCtlModeMeUnDiag" VALUE 0xCEE1A Kw_Wu16 655350.0 Time_ms 0.00 655350.0 FORMAT "%8.1" /end CHARACTERISTIC
/begin CHARACTERISTIC DSM_DInDfp_RailCtlModePCVDiag_C "#SSD Verzögerung Ersatzreaktion für Fehlerpfad Dfp_RailCtlModePCVDiag" VALUE 0xCEE1C Kw_Wu16 655350.0 Time_ms 0.00 655350.0 FORMAT "%8.1" /end CHARACTERISTIC
/begin CHARACTERISTIC DSM_DInDfp_RailMeUn0_C "#SSD Verzögerung Ersatzreaktion für Fehlerpfad Dfp_RailMeUn0" VALUE 0xCEE1E Kw_Wu16 655350.0 Time_ms 0.00 655350.0 FORMAT "%8.1" /end CHARACTERISTIC
/begin CHARACTERISTIC DSM_DInDfp_RailMeUn1_C "#SSD Verzögerung Ersatzreaktion für Fehlerpfad Dfp_RailMeUn1" VALUE 0xCEE20 Kw_Wu16 655350.0 Time_ms 0.00 655350.0 FORMAT "%8.1" /end CHARACTERISTIC
/begin CHARACTERISTIC DSM_DInDfp_RailMeUn2_C "#SSD Verzögerung Ersatzreaktion für Fehlerpfad Dfp_RailMeUn2" VALUE 0xCEE22 Kw_Wu16 655350.0 Time_ms 0.00 655350.0 FORMAT "%8.1" /end CHARACTERISTIC
/begin CHARACTERISTIC DSM_DInDfp_RailMeUn3_C "#SSD Verzögerung Ersatzreaktion für Fehlerpfad Dfp_RailMeUn3" VALUE 0xCEE24 Kw_Wu16 655350.0 Time_ms 0.00 655350.0 FORMAT "%8.1" /end CHARACTERISTIC
/begin CHARACTERISTIC DSM_DInDfp_RailMeUn4_C "#SSD Verzögerung Ersatzreaktion für Fehlerpfad Dfp_RailMeUn4" VALUE 0xCEE26 Kw_Wu16 655350.0 Time_ms 0.00 655350.0 FORMAT "%8.1" /end CHARACTERISTIC
/begin CHARACTERISTIC DSM_DInDfp_RailPCV0_C "#SSD Verzögerung Ersatzreaktion für Fehlerpfad Dfp_RailPCV0" VALUE 0xCEE28 Kw_Wu16 655350.0 Time_ms 0.00 655350.0 FORMAT "%8.1" /end CHARACTERISTIC
/begin CHARACTERISTIC DSM_DInDfp_RailPCV1_C "#SSD Verzögerung Ersatzreaktion für Fehlerpfad Dfp_RailPCV1" VALUE 0xCEE2A Kw_Wu16 655350.0 Time_ms 0.00 655350.0 FORMAT "%8.1" /end CHARACTERISTIC
/begin CHARACTERISTIC DSM_DInDfp_RailPCV2_C "#SSD Verzögerung Ersatzreaktion für Fehlerpfad Dfp_RailPCV2" VALUE 0xCEE2C Kw_Wu16 655350.0 Time_ms 0.00 655350.0 FORMAT "%8.1" /end CHARACTERISTIC
/begin CHARACTERISTIC DSM_DInDfp_RailPCV3_C "#SSD Verzögerung Ersatzreaktion für Fehlerpfad Dfp_RailPCV3" VALUE 0xCEE2E Kw_Wu16 655350.0 Time_ms 0.00 655350.0 FORMAT "%8.1" /end CHARACTERISTIC
/begin CHARACTERISTIC DSM_DInDfp_RailPCV4_C "#SSD Verzögerung Ersatzreaktion für Fehlerpfad Dfp_RailPCV4" VALUE 0xCEE30 Kw_Wu16 655350.0 Time_ms 0.00 655350.0 FORMAT "%8.1" /end CHARACTERISTIC
/begin CHARACTERISTIC DSM_DInDfp_RailPCV5_C "#SSD Verzögerung Ersatzreaktion für Fehlerpfad Dfp_RailPCV5" VALUE 0xCEE32 Kw_Wu16 655350.0 Time_ms 0.00 655350.0 FORMAT "%8.1" /end CHARACTERISTIC
/begin CHARACTERISTIC DSM_DInDfp_SOPTst_C "Verzögerung Ersatzreaktion für Fehlerpfad Dfp_SOPTst" VALUE 0xCEE34 Kw_Wu16 655350.0 Time_ms 0.00 655350.0 FORMAT "%8.1" /end CHARACTERISTIC
/begin CHARACTERISTIC DSM_DInDfp_SSpMon1_C "Verzögerung Ersatzreaktion für Fehlerpfad Dfp_SSpMon1" VALUE 0xCEE36 Kw_Wu16 655350.0 Time_ms 0.00 655350.0 FORMAT "%8.1" /end CHARACTERISTIC
/begin CHARACTERISTIC DSM_DInDfp_SSpMon2_C "Verzögerung Ersatzreaktion für Fehlerpfad Dfp_SSpMon2" VALUE 0xCEE38 Kw_Wu16 655350.0 Time_ms 0.00 655350.0 FORMAT "%8.1" /end CHARACTERISTIC
/begin CHARACTERISTIC DSM_DInDfp_SSpMon3_C "Verzögerung Ersatzreaktion für Fehlerpfad Dfp_SSpMon3" VALUE 0xCEE3A Kw_Wu16 655350.0 Time_ms 0.00 655350.0 FORMAT "%8.1" /end CHARACTERISTIC
/begin CHARACTERISTIC DSM_DInDfp_SWChk_CycSigChkDat_C "Verzögerung Ersatzreaktion für Fehlerpfad Dfp_SWChk_CycSigChkDat" VALUE 0xCEE3C Kw_Wu16 655350.0 Time_ms 0.00 655350.0 FORMAT "%8.1" /end CHARACTERISTIC
/begin CHARACTERISTIC DSM_DInDfp_SWChk_CycSigChkPrg_C "Verzögerung Ersatzreaktion für Fehlerpfad Dfp_SWChk_CycSigChkPrg" VALUE 0xCEE3E Kw_Wu16 655350.0 Time_ms 0.00 655350.0 FORMAT "%8.1" /end CHARACTERISTIC
/begin CHARACTERISTIC DSM_DInDfp_ShutCD_C "Verzögerung Ersatzreaktion für Fehlerpfad Dfp_ShutCD" VALUE 0xCEE40 Kw_Wu16 655350.0 Time_ms 0.00 655350.0 FORMAT "%8.1" /end CHARACTERISTIC
/begin CHARACTERISTIC DSM_DInDfp_StSysTrqShutOff_C "Verzögerung Ersatzreaktion für Fehlerpfad Dfp_StSysTrqShutOff" VALUE 0xCEE42 Kw_Wu16 655350.0 Time_ms 0.00 655350.0 FORMAT "%8.1" /end CHARACTERISTIC
/begin CHARACTERISTIC DSM_DInDfp_StrtCD_Actr_C "Verzögerung Ersatzreaktion für Fehlerpfad Dfp_StrtCD_Actr" VALUE 0xCEE44 Kw_Wu16 655350.0 Time_ms 0.00 655350.0 FORMAT "%8.1" /end CHARACTERISTIC
/begin CHARACTERISTIC DSM_DInDfp_SysLamp_C "Verzögerung Ersatzreaktion für Fehlerpfad Dfp_SysLamp" VALUE 0xCEE46 Kw_Wu16 655350.0 Time_ms 0.00 655350.0 FORMAT "%8.1" /end CHARACTERISTIC
/begin CHARACTERISTIC DSM_DInDfp_T15CD_C "Verzögerung Ersatzreaktion für Fehlerpfad Dfp_T15CD" VALUE 0xCEE48 Kw_Wu16 655350.0 Time_ms 0.00 655350.0 FORMAT "%8.1" /end CHARACTERISTIC
/begin CHARACTERISTIC DSM_DInDfp_TGearbx_C "Verzögerung Ersatzreaktion für Fehlerpfad Dfp_TGearbx" VALUE 0xCEE4A Kw_Wu16 655350.0 Time_ms 0.00 655350.0 FORMAT "%8.1" /end CHARACTERISTIC
/begin CHARACTERISTIC DSM_DInDfp_TPUMon_C "#SSD Verzögerung Ersatzreaktion für Fehlerpfad Dfp_TPUMon" VALUE 0xCEE4C Kw_Wu16 655350.0 Time_ms 0.00 655350.0 FORMAT "%8.1" /end CHARACTERISTIC
/begin CHARACTERISTIC DSM_DInDfp_TVACD_Max_C "Verzögerung Ersatzreaktion für Fehlerpfad Dfp_TVACD_Max" VALUE 0xCEE4E Kw_Wu16 655350.0 Time_ms 0.00 655350.0 FORMAT "%8.1" /end CHARACTERISTIC
/begin CHARACTERISTIC DSM_DInDfp_TVACD_Min_C "Verzögerung Ersatzreaktion für Fehlerpfad Dfp_TVACD_Min" VALUE 0xCEE50 Kw_Wu16 655350.0 Time_ms 0.00 655350.0 FORMAT "%8.1" /end CHARACTERISTIC
/begin CHARACTERISTIC DSM_DInDfp_TVACD_SigNpl_C "Verzögerung Ersatzreaktion für Fehlerpfad Dfp_TVACD_SigNpl" VALUE 0xCEE52 Kw_Wu16 655350.0 Time_ms 0.00 655350.0 FORMAT "%8.1" /end CHARACTERISTIC
/begin CHARACTERISTIC DSM_DInDfp_TVACD_TVADia1_C "Verzögerung Ersatzreaktion für Fehlerpfad Dfp_TVACD_TVADia1" VALUE 0xCEE54 Kw_Wu16 655350.0 Time_ms 0.00 655350.0 FORMAT "%8.1" /end CHARACTERISTIC
/begin CHARACTERISTIC DSM_DInDfp_TVACD_TVADia2_C "Verzögerung Ersatzreaktion für Fehlerpfad Dfp_TVACD_TVADia2" VALUE 0xCEE56 Kw_Wu16 655350.0 Time_ms 0.00 655350.0 FORMAT "%8.1" /end CHARACTERISTIC
/begin CHARACTERISTIC DSM_DInDfp_TVACD_TVADia3_C "Verzögerung Ersatzreaktion für Fehlerpfad Dfp_TVACD_TVADia3" VALUE 0xCEE58 Kw_Wu16 655350.0 Time_ms 0.00 655350.0 FORMAT "%8.1" /end CHARACTERISTIC
/begin CHARACTERISTIC DSM_DInDfp_TVACD_TVADia4_C "Verzögerung Ersatzreaktion für Fehlerpfad Dfp_TVACD_TVADia4" VALUE 0xCEE5A Kw_Wu16 655350.0 Time_ms 0.00 655350.0 FORMAT "%8.1" /end CHARACTERISTIC
/begin CHARACTERISTIC DSM_DInDfp_ThrVlvMon_C "Inhibit Handler Delay Time for path Dfp_ThrVlvMon" VALUE 0xCEE5C Kw_Wu16 655350.0 Time_ms 0.00 655350.0 FORMAT "%8.1" /end CHARACTERISTIC
/begin CHARACTERISTIC DSM_DInDfp_VSACD_DiaDet_C "Verzögerung Ersatzreaktion für Fehlerpfad Dfp_VSACD_DiaDet" VALUE 0xCEE5E Kw_Wu16 655350.0 Time_ms 0.00 655350.0 FORMAT "%8.1" /end CHARACTERISTIC
/begin CHARACTERISTIC DSM_DInDfp_VSACD_DioInDia1_C "Verzögerung Ersatzreaktion für Fehlerpfad Dfp_VSACD_DioInDia1" VALUE 0xCEE60 Kw_Wu16 655350.0 Time_ms 0.00 655350.0 FORMAT "%8.1" /end CHARACTERISTIC
/begin CHARACTERISTIC DSM_DInDfp_VSACD_DioInDia2_C "Verzögerung Ersatzreaktion für Fehlerpfad Dfp_VSACD_DioInDia2" VALUE 0xCEE62 Kw_Wu16 655350.0 Time_ms 0.00 655350.0 FORMAT "%8.1" /end CHARACTERISTIC
/begin CHARACTERISTIC DSM_DInDfp_VSACD_DioInDia3_C "Verzögerung Ersatzreaktion für Fehlerpfad Dfp_VSACD_DioInDia3" VALUE 0xCEE64 Kw_Wu16 655350.0 Time_ms 0.00 655350.0 FORMAT "%8.1" /end CHARACTERISTIC
/begin CHARACTERISTIC DSM_DInDfp_VSACD_DioInDia4_C "Verzögerung Ersatzreaktion für Fehlerpfad Dfp_VSACD_DioInDia4" VALUE 0xCEE66 Kw_Wu16 655350.0 Time_ms 0.00 655350.0 FORMAT "%8.1" /end CHARACTERISTIC
/begin CHARACTERISTIC DSM_DInDfp_VSACD_DioInMin_C "Verzögerung Ersatzreaktion für Fehlerpfad Dfp_VSACD_DioInMin" VALUE 0xCEE68 Kw_Wu16 655350.0 Time_ms 0.00 655350.0 FORMAT "%8.1" /end CHARACTERISTIC
/begin CHARACTERISTIC DSM_DInDfp_VSACD_Max_C "Verzögerung Ersatzreaktion für Fehlerpfad Dfp_VSACD_Max" VALUE 0xCEE6A Kw_Wu16 655350.0 Time_ms 0.00 655350.0 FORMAT "%8.1" /end CHARACTERISTIC
/begin CHARACTERISTIC DSM_DInDfp_VSACD_Min_C "Verzögerung Ersatzreaktion für Fehlerpfad Dfp_VSACD_Min" VALUE 0xCEE6C Kw_Wu16 655350.0 Time_ms 0.00 655350.0 FORMAT "%8.1" /end CHARACTERISTIC
/begin CHARACTERISTIC DSM_DInDfp_VSACD_SigNpl_C "Verzögerung Ersatzreaktion für Fehlerpfad Dfp_VSACD_SigNpl" VALUE 0xCEE6E Kw_Wu16 655350.0 Time_ms 0.00 655350.0 FORMAT "%8.1" /end CHARACTERISTIC
/begin CHARACTERISTIC DSM_DInDfp_VSACD_VSADia1_C "Verzögerung Ersatzreaktion für Fehlerpfad Dfp_VSACD_VSADia1" VALUE 0xCEE70 Kw_Wu16 655350.0 Time_ms 0.00 655350.0 FORMAT "%8.1" /end CHARACTERISTIC
/begin CHARACTERISTIC DSM_DInDfp_VSACD_VSADia2_C "Verzögerung Ersatzreaktion für Fehlerpfad Dfp_VSACD_VSADia2" VALUE 0xCEE72 Kw_Wu16 655350.0 Time_ms 0.00 655350.0 FORMAT "%8.1" /end CHARACTERISTIC
/begin CHARACTERISTIC DSM_DInDfp_VSACD_VSADia3_C "Verzögerung Ersatzreaktion für Fehlerpfad Dfp_VSACD_VSADia3" VALUE 0xCEE74 Kw_Wu16 655350.0 Time_ms 0.00 655350.0 FORMAT "%8.1" /end CHARACTERISTIC
/begin CHARACTERISTIC DSM_DInDfp_VSACD_VSADia4_C "Verzögerung Ersatzreaktion für Fehlerpfad Dfp_VSACD_VSADia4" VALUE 0xCEE76 Kw_Wu16 655350.0 Time_ms 0.00 655350.0 FORMAT "%8.1" /end CHARACTERISTIC
/begin CHARACTERISTIC DSM_DInDfp_VSSCD1_C "Verzögerung Ersatzreaktion für Fehlerpfad Dfp_VSSCD1" VALUE 0xCEE78 Kw_Wu16 655350.0 Time_ms 0.00 655350.0 FORMAT "%8.1" /end CHARACTERISTIC
/begin CHARACTERISTIC DSM_DInDfp_VSSCD2_C "Verzögerung Ersatzreaktion für Fehlerpfad Dfp_VSSCD2" VALUE 0xCEE7A Kw_Wu16 655350.0 Time_ms 0.00 655350.0 FORMAT "%8.1" /end CHARACTERISTIC
/begin CHARACTERISTIC DSM_DInDfp_WdCom_C "Verzögerung Ersatzreaktion für Fehlerpfad Dfp_WdCom" VALUE 0xCEE7C Kw_Wu16 655350.0 Time_ms 0.00 655350.0 FORMAT "%8.1" /end CHARACTERISTIC
/begin MEASUREMENT DSM_FCM_mp "Fehlerspeicher" UBYTE OneToOne 1 100 0.00 255.0 FORMAT "%5.1" ARRAY_SIZE 644 ECU_ADDRESS 0x8FE9AE /end MEASUREMENT
/begin MEASUREMENT Fid_ACCIRevErr_mp "Ist diese Fid verriegelt, so geht die ACC-Momentenschnittstelle in den Zustand ""irreversibler Fehler""" UBYTE OneToOne 1 100 0.00 255.0 FORMAT "%5.1" ECU_ADDRESS 0x8FEC32 /end MEASUREMENT
/begin MEASUREMENT Fid_AccPedBrkPres_mp "FID für defekten Bremsdruck" UBYTE OneToOne 1 100 0.00 255.0 FORMAT "%5.1" ECU_ADDRESS 0x8FEC33 /end MEASUREMENT
/begin MEASUREMENT Fid_AccPedVel_mp "Messpunkt fuer Fid_AccPedVel" UBYTE OneToOne 1 100 0.00 255.0 FORMAT "%5.1" ECU_ADDRESS 0x8FEC34 /end MEASUREMENT
/begin MEASUREMENT Fid_AccPed_Brk_mp "Verriegelung der Freigabe der Überprüfung auf Unplausibilität  bei defekter Bremse" UBYTE OneToOne 1 100 0.00 255.0 FORMAT "%5.1" ECU_ADDRESS 0x8FEC35 /end MEASUREMENT
/begin MEASUREMENT Fid_ACCRevErr_mp "Ist diese Fid verriegelt, so geht die ACC-Momentenschnittstelle in den Zustand ""reversibler Fehler""" UBYTE OneToOne 1 100 0.00 255.0 FORMAT "%5.1" ECU_ADDRESS 0x8FEC36 /end MEASUREMENT
/begin MEASUREMENT Fid_ACCtlDflt1_mp "Messpunkt fuer Funktions Identifier Fid_ACCtlDflt1" UBYTE OneToOne 1 100 0.00 255.0 FORMAT "%5.1" ECU_ADDRESS 0x8FEC37 /end MEASUREMENT
/begin MEASUREMENT Fid_ACCtlDflt2_mp "Messpunkt fuer Funktions Identifier Fid_ACCtlDflt2" UBYTE OneToOne 1 100 0.00 255.0 FORMAT "%5.1" ECU_ADDRESS 0x8FEC38 /end MEASUREMENT
/begin MEASUREMENT Fid_ACCtl_ACTrqErr_mp "Messpunkt fuer Funktions Identifier Fid_ACCtl_ACTrqErr" UBYTE OneToOne 1 100 0.00 255.0 FORMAT "%5.1" ECU_ADDRESS 0x8FEC39 /end MEASUREMENT
/begin MEASUREMENT Fid_ACCtl_CTSErr_mp "Messpunkt fuer Funktions Identifier Fid_ACCtl_CTSErr" UBYTE OneToOne 1 100 0.00 255.0 FORMAT "%5.1" ECU_ADDRESS 0x8FEC3A /end MEASUREMENT
/begin MEASUREMENT Fid_ACCtl_FanErr_mp "Messpunkt fuer Funktions Identifier Fid_ACCtl_FanErr" UBYTE OneToOne 1 100 0.00 255.0 FORMAT "%5.1" ECU_ADDRESS 0x8FEC3B /end MEASUREMENT
/begin MEASUREMENT Fid_ACCtl_mp "Funktionssperrung für Klimadruck" UBYTE OneToOne 1 100 0.00 255.0 FORMAT "%5.1" ECU_ADDRESS 0x8FEC3C /end MEASUREMENT
/begin MEASUREMENT Fid_ACCtl_TGearbxErr_mp "Messpunkt fuer Funktions Identifier Fid_ACCtl_TGearbxErr" UBYTE OneToOne 1 100 0.00 255.0 FORMAT "%5.1" ECU_ADDRESS 0x8FEC3D /end MEASUREMENT
/begin MEASUREMENT Fid_ACCtl_VSSErr_mp "Messpunkt fuer Funktions Identifier Fid_ACCtl_VSSErr" UBYTE OneToOne 1 100 0.00 255.0 FORMAT "%5.1" ECU_ADDRESS 0x8FEC3E /end MEASUREMENT
/begin MEASUREMENT Fid_ACC_AliveErr_mp "Ist diese Fid verriegelt, so geht die ACC-Momentenschnittstelle in Zustand ""irreversiler Fehler""" UBYTE OneToOne 1 100 0.00 255.0 FORMAT "%5.1" ECU_ADDRESS 0x8FEC3F /end MEASUREMENT
/begin MEASUREMENT Fid_ACC_CsErr_mp "Ist diese Fid verriegelt, so geht die ACC-Momentenschnittstelle in den Zustand ""irreversibler Fehler""" UBYTE OneToOne 1 100 0.00 255.0 FORMAT "%5.1" ECU_ADDRESS 0x8FEC40 /end MEASUREMENT
/begin MEASUREMENT Fid_ACC_TiOutErr_mp "Ist diese Fid verriegelt, so geht die ACC-Momentenschnittstelle in den Zustand ""reversibler Fehler""" UBYTE OneToOne 1 100 0.00 255.0 FORMAT "%5.1" ECU_ADDRESS 0x8FEC41 /end MEASUREMENT
/begin MEASUREMENT Fid_ACTrqC_mp "FID für Gültigkeitsprüfung des aktivierten Klimas für die Klimamomentenkorrektur" UBYTE OneToOne 1 100 0.00 255.0 FORMAT "%5.1" ECU_ADDRESS 0x8FEC42 /end MEASUREMENT
/begin MEASUREMENT Fid_AFSCD_AirPerTime_mp "FID für Berechnung der Luftmasse pro Zeit" UBYTE OneToOne 1 100 0.00 255.0 FORMAT "%5.1" ECU_ADDRESS 0x8FEC43 /end MEASUREMENT
/begin MEASUREMENT Fid_AFSCD_mp "FID für Luftmassberechnung" UBYTE OneToOne 1 100 0.00 255.0 FORMAT "%5.1" ECU_ADDRESS 0x8FEC44 /end MEASUREMENT
/begin MEASUREMENT Fid_AFSCD_PlOffsDrft_mp "FID für Funktion AFSCD_PlOffsDrft" UBYTE OneToOne 1 100 0.00 255.0 FORMAT "%5.1" ECU_ADDRESS 0x8FEC45 /end MEASUREMENT
/begin MEASUREMENT Fid_AFSCD_PlSetyDrft_mp "FID für Plausibilitätsprüfung für Empfindlichkeitsdrift des Sensorsignals" UBYTE OneToOne 1 100 0.00 255.0 FORMAT "%5.1" ECU_ADDRESS 0x8FEC46 /end MEASUREMENT
/begin MEASUREMENT Fid_AFSCD_SRCCorrAirm_mp "Fid zur Verriegelung des SRC des korrigierten Sensorsignals (HFM6)" UBYTE OneToOne 1 100 0.00 255.0 FORMAT "%5.1" ECU_ADDRESS 0x8FEC47 /end MEASUREMENT
/begin MEASUREMENT Fid_AFSCD_SRCDcyc_mp "Fid zur Verriegelung des SRC des Tastverhältnisses des Temperatursignals" UBYTE OneToOne 1 100 0.00 255.0 FORMAT "%5.1" ECU_ADDRESS 0x8FEC48 /end MEASUREMENT
/begin MEASUREMENT Fid_AFSCD_SRCRawAirm_mp "Fid zur Verriegelung des SRC des unkorrigierten Sensorsignals (HFM6)" UBYTE OneToOne 1 100 0.00 255.0 FORMAT "%5.1" ECU_ADDRESS 0x8FEC49 /end MEASUREMENT
/begin MEASUREMENT Fid_AFSCD_SRCRefSig_mp "Fid zur Verriegelung des SRC der Periodendauer des Referenz- bzw Temperatursignals" UBYTE OneToOne 1 100 0.00 255.0 FORMAT "%5.1" ECU_ADDRESS 0x8FEC4A /end MEASUREMENT
/begin MEASUREMENT Fid_AFS_CanMon_mp "Messpunkt fuer Funktions Identifier Fid_AFS_CanMon" UBYTE OneToOne 1 100 0.00 255.0 FORMAT "%5.1" ECU_ADDRESS 0x8FEC4B /end MEASUREMENT
/begin MEASUREMENT Fid_AFS_GenDisableCond_mp "Messpunkt fuer Funktions Identifier Fid_AFS_GenDisableCond" UBYTE OneToOne 1 100 0.00 255.0 FORMAT "%5.1" ECU_ADDRESS 0x8FEC4C /end MEASUREMENT
/begin MEASUREMENT Fid_AirCtlCorrAlt_mp "" UBYTE OneToOne 1 100 0.00 255.0 FORMAT "%5.1" ECU_ADDRESS 0x8FEC4D /end MEASUREMENT
/begin MEASUREMENT Fid_AirCtlDyn_mp "Fid für dynamische Begrenzung 2 - AirCtl" UBYTE OneToOne 1 100 0.00 255.0 FORMAT "%5.1" ECU_ADDRESS 0x8FEC4E /end MEASUREMENT
/begin MEASUREMENT Fid_AirCtlNeg2_mp "Messpunkt fuer Funktions Identifier Fid_AirCtlNeg2" UBYTE OneToOne 1 100 0.00 255.0 FORMAT "%5.1" ECU_ADDRESS 0x8FEC4F /end MEASUREMENT
/begin MEASUREMENT Fid_AirCtlNeg_mp "Messpunkt fuer Funktions Identifier Fid_AirCtlNeg" UBYTE OneToOne 1 100 0.00 255.0 FORMAT "%5.1" ECU_ADDRESS 0x8FEC50 /end MEASUREMENT
/begin MEASUREMENT Fid_AirCtlPFltEGRRed_mp "AirCtlPFltEGRRed fault identifier" UBYTE OneToOne 1 100 0.00 255.0 FORMAT "%5.1" ECU_ADDRESS 0x8FEC51 /end MEASUREMENT
/begin MEASUREMENT Fid_AirCtlPlateBreakAct_mp "" UBYTE OneToOne 1 100 0.00 255.0 FORMAT "%5.1" ECU_ADDRESS 0x8FEC52 /end MEASUREMENT
/begin MEASUREMENT Fid_AirCtlPlateBreak_mp "Fid for plate break monitoring" UBYTE OneToOne 1 100 0.00 255.0 FORMAT "%5.1" ECU_ADDRESS 0x8FEC53 /end MEASUREMENT
/begin MEASUREMENT Fid_AirCtlPos2_mp "Messpunkt fuer Funktions Identifier Fid_AirCtlPos2" UBYTE OneToOne 1 100 0.00 255.0 FORMAT "%5.1" ECU_ADDRESS 0x8FEC54 /end MEASUREMENT
/begin MEASUREMENT Fid_AirCtlPos_mp "Messpunkt fuer Funktions Identifier Fid_AirCtlPos" UBYTE OneToOne 1 100 0.00 255.0 FORMAT "%5.1" ECU_ADDRESS 0x8FEC55 /end MEASUREMENT
/begin MEASUREMENT Fid_AirCtl_Brk_mp "Fid zum Deaktvieren der Fehlerausblendung bei betätigter Bremse" UBYTE OneToOne 1 100 0.00 255.0 FORMAT "%5.1" ECU_ADDRESS 0x8FEC56 /end MEASUREMENT
/begin MEASUREMENT Fid_AirCtl_Gear_mp "Störung Identifikation für Airctl vom gearbxstatus" UBYTE OneToOne 1 100 0.00 255.0 FORMAT "%5.1" ECU_ADDRESS 0x8FEC57 /end MEASUREMENT
/begin MEASUREMENT Fid_AirCtl_mp "AirCtl Fehler-Identifier" UBYTE OneToOne 1 100 0.00 255.0 FORMAT "%5.1" ECU_ADDRESS 0x8FEC58 /end MEASUREMENT
/begin MEASUREMENT Fid_AirSysAirMassTst_mp "Function identifier zur Verriegelung des Luftmassensystemtests" UBYTE OneToOne 1 100 0.00 255.0 FORMAT "%5.1" ECU_ADDRESS 0x8FEC59 /end MEASUREMENT
/begin MEASUREMENT Fid_AOHt_AltErr_mp "Messpunkt fuer Funktions Identifier Fid_AOHt_AltErr" UBYTE OneToOne 1 100 0.00 255.0 FORMAT "%5.1" ECU_ADDRESS 0x8FEC5A /end MEASUREMENT
/begin MEASUREMENT Fid_AOHt_ShutOffErr_mp "Messpunkt fuer Funktions Identifier Fid_AOHt_ShutOffErr" UBYTE OneToOne 1 100 0.00 255.0 FORMAT "%5.1" ECU_ADDRESS 0x8FEC5B /end MEASUREMENT
/begin MEASUREMENT Fid_APP1_mp "Fid für Fehlerpfad APP1" UBYTE OneToOne 1 100 0.00 255.0 FORMAT "%5.1" ECU_ADDRESS 0x8FEC5C /end MEASUREMENT
/begin MEASUREMENT Fid_APP2_mp "Fid für Fehlerpfad APP2" UBYTE OneToOne 1 100 0.00 255.0 FORMAT "%5.1" ECU_ADDRESS 0x8FEC5D /end MEASUREMENT
/begin MEASUREMENT Fid_APPKickdown_mp "Messpunkt für Fid_APPKickdown" UBYTE OneToOne 1 100 0.00 255.0 FORMAT "%5.1" ECU_ADDRESS 0x8FEC5E /end MEASUREMENT
/begin MEASUREMENT Fid_APSCD_mp "Fid für APSCD Fehlerpfad" UBYTE OneToOne 1 100 0.00 255.0 FORMAT "%5.1" ECU_ADDRESS 0x8FEC5F /end MEASUREMENT
/begin MEASUREMENT Fid_ARSOff_mp "Fid for error reaction" UBYTE OneToOne 1 100 0.00 255.0 FORMAT "%5.1" ECU_ADDRESS 0x8FEC60 /end MEASUREMENT
/begin MEASUREMENT Fid_ASDdc_mp "FID zur Deaktivierung des ASDdc" UBYTE OneToOne 1 100 0.00 255.0 FORMAT "%5.1" ECU_ADDRESS 0x8FEC61 /end MEASUREMENT
/begin MEASUREMENT Fid_ASModSwtOffEng_mp "Messpunkt für function identifier Fid_ASModSwtOffEng" UBYTE OneToOne 1 100 0.00 255.0 FORMAT "%5.1" ECU_ADDRESS 0x8FEC62 /end MEASUREMENT
/begin MEASUREMENT Fid_ASModSwtOffIndVol_mp "Meßpunkt für function identifier Fid_ASModSwtOffIndVol" UBYTE OneToOne 1 100 0.00 255.0 FORMAT "%5.1" ECU_ADDRESS 0x8FEC63 /end MEASUREMENT
/begin MEASUREMENT Fid_BPSCDMon_mp "FID zur Sperrung des SRC-Checks bei einem Fehler in der verwendeten Sensorversorgung" UBYTE OneToOne 1 100 0.00 255.0 FORMAT "%5.1" ECU_ADDRESS 0x8FEC64 /end MEASUREMENT
/begin MEASUREMENT Fid_ClgDynTst_mp "Messpunkt fuer Funktions Identifier Fid_ClgDynTst" UBYTE OneToOne 1 100 0.00 255.0 FORMAT "%5.1" ECU_ADDRESS 0x8FEC65 /end MEASUREMENT
/begin MEASUREMENT Fid_CmbChb_mp "FID zur Aktivierung der Aussetzererkennung" UBYTE OneToOne 1 100 0.00 255.0 FORMAT "%5.1" ECU_ADDRESS 0x8FEC66 /end MEASUREMENT
/begin MEASUREMENT Fid_CoDT_GripDeb_mp "Fid für Kraftschlußentprellung" UBYTE OneToOne 1 100 0.00 255.0 FORMAT "%5.1" ECU_ADDRESS 0x8FEC67 /end MEASUREMENT
/begin MEASUREMENT Fid_CoEngIRevSys1_mp "Fid für irreversible Systemfehler 1" UBYTE OneToOne 1 100 0.00 255.0 FORMAT "%5.1" ECU_ADDRESS 0x8FEC68 /end MEASUREMENT
/begin MEASUREMENT Fid_CoEngIRevSys2_mp "Fid für irreversible Systemfehler 2" UBYTE OneToOne 1 100 0.00 255.0 FORMAT "%5.1" ECU_ADDRESS 0x8FEC69 /end MEASUREMENT
/begin MEASUREMENT Fid_CoEngIRevVeh_mp "Freigabe, sofern keine irreversiblen Fahrzeugfehler vorhanden" UBYTE OneToOne 1 100 0.00 255.0 FORMAT "%5.1" ECU_ADDRESS 0x8FEC6A /end MEASUREMENT
/begin MEASUREMENT Fid_CoEngPFltErr_mp "Messpunkt fuer Funktions Identifier Fid_CoEngPFltErr" UBYTE OneToOne 1 100 0.00 255.0 FORMAT "%5.1" ECU_ADDRESS 0x8FEC6B /end MEASUREMENT
/begin MEASUREMENT Fid_CoEngPFltOvldErr_mp "Messpunkt fuer Funktions Identifier Fid_CoEngPFltOvldErr" UBYTE OneToOne 1 100 0.00 255.0 FORMAT "%5.1" ECU_ADDRESS 0x8FEC6C /end MEASUREMENT
/begin MEASUREMENT Fid_CoEngRevSys1_mp "Fid für reversible Systemfehler 1" UBYTE OneToOne 1 100 0.00 255.0 FORMAT "%5.1" ECU_ADDRESS 0x8FEC6D /end MEASUREMENT
/begin MEASUREMENT Fid_CoEngRevSys2_mp "Fid für reversible Systemfehler 2" UBYTE OneToOne 1 100 0.00 255.0 FORMAT "%5.1" ECU_ADDRESS 0x8FEC6E /end MEASUREMENT
/begin MEASUREMENT Fid_CoEngRevVeh_mp "Freigabe, sofern keine reversiblen Fahrzeugfehler vorliegen" UBYTE OneToOne 1 100 0.00 255.0 FORMAT "%5.1" ECU_ADDRESS 0x8FEC6F /end MEASUREMENT
/begin MEASUREMENT Fid_CoEngShOffTst_mp "Fid für Deaktivierung belibiger Nachlauf-Prüfungen" UBYTE OneToOne 1 100 0.00 255.0 FORMAT "%5.1" ECU_ADDRESS 0x8FEC70 /end MEASUREMENT
/begin MEASUREMENT Fid_CoEngSoftShOffTV_mp "Messpunkt fuer Funktions Identifier Fid_CoEngSoftShOffTV" UBYTE OneToOne 1 100 0.00 255.0 FORMAT "%5.1" ECU_ADDRESS 0x8FEC71 /end MEASUREMENT
/begin MEASUREMENT Fid_CoEng_ActrPrt_mp "Fehler zur Vermeidung des Stellerschutzzustands COENG_ACTR_PRT" UBYTE OneToOne 1 100 0.00 255.0 FORMAT "%5.1" ECU_ADDRESS 0x8FEC72 /end MEASUREMENT
/begin MEASUREMENT Fid_CoEng_Nrml2Strt_mp "Fid für Übergang vom NORMAL zum START" UBYTE OneToOne 1 100 0.00 255.0 FORMAT "%5.1" ECU_ADDRESS 0x8FEC73 /end MEASUREMENT
/begin MEASUREMENT Fid_CoEng_PwrStgEnable_mp "Messpunkt fuer Funktions Identifier Fid_CoEng_PwrStgEnable" UBYTE OneToOne 1 100 0.00 255.0 FORMAT "%5.1" ECU_ADDRESS 0x8FEC74 /end MEASUREMENT
/begin MEASUREMENT Fid_CoEng_trqLimErr1_mp "Fid für die Aktivierung eines limitierten Moments bei fehlerhaften Raildruck" UBYTE OneToOne 1 100 0.00 255.0 FORMAT "%5.1" ECU_ADDRESS 0x8FEC75 /end MEASUREMENT
/begin MEASUREMENT Fid_CoEng_trqLimErr2_mp "Messpunkt fuer Funktions Identifier Fid_CoEng_trqLimErr2" UBYTE OneToOne 1 100 0.00 255.0 FORMAT "%5.1" ECU_ADDRESS 0x8FEC76 /end MEASUREMENT
/begin MEASUREMENT Fid_CoEng_trqLimErr3_mp "Messpunkt fuer Funktions Identifier Fid_CoEng_trqLimErr3" UBYTE OneToOne 1 100 0.00 255.0 FORMAT "%5.1" ECU_ADDRESS 0x8FEC77 /end MEASUREMENT
/begin MEASUREMENT Fid_CoEng_trqLimErr4_mp "Measurement point for Function Identifier Fid_CoEng_trqLimErr4" UBYTE OneToOne 1 100 0.00 255.0 FORMAT "%5.1" ECU_ADDRESS 0x8FEC78 /end MEASUREMENT
/begin MEASUREMENT Fid_CoEng_trqLimErr_mp "Fehler-begrenzender Moment" UBYTE OneToOne 1 100 0.00 255.0 FORMAT "%5.1" ECU_ADDRESS 0x8FEC79 /end MEASUREMENT
/begin MEASUREMENT Fid_CoVehtrqLimErr_mp "Fid zur Erkennung der Systemfehler, die auf dem Vortriebsmoment reagieren" UBYTE OneToOne 1 100 0.00 255.0 FORMAT "%5.1" ECU_ADDRESS 0x8FEC7A /end MEASUREMENT
/begin MEASUREMENT Fid_CoVM_StabDem_Err_mp "Messpunkt fuer Funktions Identifier Fid_CoVM_StabDem_Err" UBYTE OneToOne 1 100 0.00 255.0 FORMAT "%5.1" ECU_ADDRESS 0x8FEC7B /end MEASUREMENT
/begin MEASUREMENT Fid_CpBVlvOff_mp "Messpunkt fuer Funktions Identifier Fid_CpBVlvOff" UBYTE OneToOne 1 100 0.00 255.0 FORMAT "%5.1" ECU_ADDRESS 0x8FEC7C /end MEASUREMENT
/begin MEASUREMENT Fid_CrCtlShutOffIr_mp "die zu einer irreversiblen Fahrgeschwindigkeitsausschaltung führenden Fehlerpfade" UBYTE OneToOne 1 100 0.00 255.0 FORMAT "%5.1" ECU_ADDRESS 0x8FEC7D /end MEASUREMENT
/begin MEASUREMENT Fid_CrCtl_ASCTimeout_mp "Messpunkt fuer Funktions Identifier Fid_CrCtl_ASCTimeout" UBYTE OneToOne 1 100 0.00 255.0 FORMAT "%5.1" ECU_ADDRESS 0x8FEC7E /end MEASUREMENT
/begin MEASUREMENT Fid_CrCtl_CanDef_mp "Abschaltung CrCtl am Slave bei Fehler Privater CAN" UBYTE OneToOne 1 100 0.00 255.0 FORMAT "%5.1" ECU_ADDRESS 0x8FEC7F /end MEASUREMENT
/begin MEASUREMENT Fid_CrCtl_KombiTimeout_mp "lokale Größe" UBYTE OneToOne 1 100 0.00 255.0 FORMAT "%5.1" ECU_ADDRESS 0x8FEC80 /end MEASUREMENT
/begin MEASUREMENT Fid_CrCtl_vCrCtl_mp "Messpunkt fuer Funktions Identifier Fid_CrCtl_vCrCtl" UBYTE OneToOne 1 100 0.00 255.0 FORMAT "%5.1" ECU_ADDRESS 0x8FEC81 /end MEASUREMENT
/begin MEASUREMENT Fid_CTSCDFlTemp_mp "Messpunkt fuer Funktions Identifier Fid_CTSCDFlTemp" UBYTE OneToOne 1 100 0.00 255.0 FORMAT "%5.1" ECU_ADDRESS 0x8FEC82 /end MEASUREMENT
/begin MEASUREMENT Fid_CTSCD_Plaus_mp "Fid für OTS-CTS Plausibilitätsfehler im OTSCD Fehlerpfad" UBYTE OneToOne 1 100 0.00 255.0 FORMAT "%5.1" ECU_ADDRESS 0x8FEC83 /end MEASUREMENT
/begin MEASUREMENT Fid_DCCIRevErr_mp "Fid fuer irreversible Störung in DCC" UBYTE OneToOne 1 100 0.00 255.0 FORMAT "%5.1" ECU_ADDRESS 0x8FEC84 /end MEASUREMENT
/begin MEASUREMENT Fid_DCCRevErr_mp "Fid fuer reversible Störung in DCC" UBYTE OneToOne 1 100 0.00 255.0 FORMAT "%5.1" ECU_ADDRESS 0x8FEC85 /end MEASUREMENT
/begin MEASUREMENT Fid_DCC_AliveErr_mp "Fid fuer Alive counter Störung in DCC" UBYTE OneToOne 1 100 0.00 255.0 FORMAT "%5.1" ECU_ADDRESS 0x8FEC86 /end MEASUREMENT
/begin MEASUREMENT Fid_DCC_CsErr_mp "Fid fuer checksum Störung in DCC" UBYTE OneToOne 1 100 0.00 255.0 FORMAT "%5.1" ECU_ADDRESS 0x8FEC87 /end MEASUREMENT
/begin MEASUREMENT Fid_DCC_PlausErr_mp "Fid fuer plausibilitaet Störung in DCC" UBYTE OneToOne 1 100 0.00 255.0 FORMAT "%5.1" ECU_ADDRESS 0x8FEC88 /end MEASUREMENT
/begin MEASUREMENT Fid_DCC_TiOutErr_mp "Fid fuer timeout Störung in DCC" UBYTE OneToOne 1 100 0.00 255.0 FORMAT "%5.1" ECU_ADDRESS 0x8FEC89 /end MEASUREMENT
/begin MEASUREMENT Fid_DSM_Wuc_mp "Warm Up Cycle bei fehlerhafter Kühlmitteltemperatur deaktivieren" UBYTE OneToOne 1 100 0.00 255.0 FORMAT "%5.1" ECU_ADDRESS 0x8FEC8A /end MEASUREMENT
/begin MEASUREMENT Fid_EATSCDTSubs_mp "Messpunkt fuer Funktions Identifier Fid_EATSCDTSubs" UBYTE OneToOne 1 100 0.00 255.0 FORMAT "%5.1" ECU_ADDRESS 0x8FEC8B /end MEASUREMENT
/begin MEASUREMENT Fid_EBAFCD_mp "Messpunkt fuer Funktions Identifier Fid_EBAFCD" UBYTE OneToOne 1 100 0.00 255.0 FORMAT "%5.1" ECU_ADDRESS 0x8FEC8C /end MEASUREMENT
/begin MEASUREMENT Fid_EBFCD_mp "Messpunkt fuer Funktions Identifier Fid_EBFCD" UBYTE OneToOne 1 100 0.00 255.0 FORMAT "%5.1" ECU_ADDRESS 0x8FEC8D /end MEASUREMENT
/begin MEASUREMENT Fid_ECU_mp "Messpunkt fuer Funktions Identifier Fid_ECU" UBYTE OneToOne 1 100 0.00 255.0 FORMAT "%5.1" ECU_ADDRESS 0x8FEC8E /end MEASUREMENT
/begin MEASUREMENT Fid_EGRClg_mp "Meßpunkt für Function Identifier Fid_EGRClg" UBYTE OneToOne 1 100 0.00 255.0 FORMAT "%5.1" ECU_ADDRESS 0x8FEC8F /end MEASUREMENT
/begin MEASUREMENT Fid_EGSysCoLSU0_mp "Messpunkt für Function Identifier Fid_EGSysCoLSU0" UBYTE OneToOne 1 100 0.00 255.0 FORMAT "%5.1" ECU_ADDRESS 0x8FEC90 /end MEASUREMENT
/begin MEASUREMENT Fid_EGSysCoNSC_mp "Messpunkt für Function Identifier Fid_EGSysCoNSC" UBYTE OneToOne 1 100 0.00 255.0 FORMAT "%5.1" ECU_ADDRESS 0x8FEC91 /end MEASUREMENT
/begin MEASUREMENT Fid_EGSysCoOxi_mp "Messpunkt für Function Identifier Fid_EGSysCoOxi" UBYTE OneToOne 1 100 0.00 255.0 FORMAT "%5.1" ECU_ADDRESS 0x8FEC92 /end MEASUREMENT
/begin MEASUREMENT Fid_EGSysCoTrbn_mp "Messpunkt für Function Identifier Fid_EGSysCoTrbn" UBYTE OneToOne 1 100 0.00 255.0 FORMAT "%5.1" ECU_ADDRESS 0x8FEC93 /end MEASUREMENT
/begin MEASUREMENT Fid_EGSysCoTube0_mp "Messpunkt für Function Identifier Fid_EGSysCoTube0" UBYTE OneToOne 1 100 0.00 255.0 FORMAT "%5.1" ECU_ADDRESS 0x8FEC94 /end MEASUREMENT
/begin MEASUREMENT Fid_EGSysCoTube1_mp "Messpunkt für Function Identifier Fid_EGSysCoTube1" UBYTE OneToOne 1 100 0.00 255.0 FORMAT "%5.1" ECU_ADDRESS 0x8FEC95 /end MEASUREMENT
/begin MEASUREMENT Fid_EGSysHtgDel_mp "Messpunkt für Function Identifier Fid_EGSysHtgDel" UBYTE OneToOne 1 100 0.00 255.0 FORMAT "%5.1" ECU_ADDRESS 0x8FEC96 /end MEASUREMENT
/begin MEASUREMENT Fid_EGSysMaxTOxiPre_mp "Fid zum verriegeln der Schleppzeigerfunktionalität" UBYTE OneToOne 1 100 0.00 255.0 FORMAT "%5.1" ECU_ADDRESS 0x8FEC97 /end MEASUREMENT
/begin MEASUREMENT Fid_EGSysMaxTPreRgn_mp "Fid zum verriegeln der Schleppzeigerfunktionalität" UBYTE OneToOne 1 100 0.00 255.0 FORMAT "%5.1" ECU_ADDRESS 0x8FEC98 /end MEASUREMENT
/begin MEASUREMENT Fid_EGSysMaxTPre_mp "Fid zum verriegeln der Schleppzeigerfunktionalität" UBYTE OneToOne 1 100 0.00 255.0 FORMAT "%5.1" ECU_ADDRESS 0x8FEC99 /end MEASUREMENT
/begin MEASUREMENT Fid_EGSysMxTOxiPreRgn_mp "" UBYTE OneToOne 1 100 0.00 255.0 FORMAT "%5.1" ECU_ADDRESS 0x8FEC9A /end MEASUREMENT
/begin MEASUREMENT Fid_EGSysNSC_mp "Messpunkt für Function Identifier NSC" UBYTE OneToOne 1 100 0.00 255.0 FORMAT "%5.1" ECU_ADDRESS 0x8FEC9B /end MEASUREMENT
/begin MEASUREMENT Fid_EGSysOxiCat_mp "Messpunkt für Function Identifier OxiCat" UBYTE OneToOne 1 100 0.00 255.0 FORMAT "%5.1" ECU_ADDRESS 0x8FEC9C /end MEASUREMENT
/begin MEASUREMENT Fid_EGSysPresEnv_mp "Messpunkt für Function Identifier Fid_EGSysPresEnv" UBYTE OneToOne 1 100 0.00 255.0 FORMAT "%5.1" ECU_ADDRESS 0x8FEC9D /end MEASUREMENT
/begin MEASUREMENT Fid_EGSysStrt_mp "Messpunkt für Function Identifier Fid_EGSysStrt" UBYTE OneToOne 1 100 0.00 255.0 FORMAT "%5.1" ECU_ADDRESS 0x8FEC9E /end MEASUREMENT
/begin MEASUREMENT Fid_EGSysTemp_mp "Messpunkt für Function Identifier Fid_EGSysTemp" UBYTE OneToOne 1 100 0.00 255.0 FORMAT "%5.1" ECU_ADDRESS 0x8FEC9F /end MEASUREMENT
/begin MEASUREMENT Fid_EGSysTrbn_mp "Messpunkt für Function Identifier Fid_EGSysTrbn" UBYTE OneToOne 1 100 0.00 255.0 FORMAT "%5.1" ECU_ADDRESS 0x8FECA0 /end MEASUREMENT
/begin MEASUREMENT Fid_EGSysTube_mp "Messpunkt für Function Identifier Tube" UBYTE OneToOne 1 100 0.00 255.0 FORMAT "%5.1" ECU_ADDRESS 0x8FECA1 /end MEASUREMENT
/begin MEASUREMENT Fid_EGSys_AP_mp "Fehler des Atmosphärendruckfühlers" UBYTE OneToOne 1 100 0.00 255.0 FORMAT "%5.1" ECU_ADDRESS 0x8FECA2 /end MEASUREMENT
/begin MEASUREMENT Fid_EGTRgnLck_mp "Function indentifier zur Verriegelung einer Regeneration bei Überschreiten der kritischen Ölverdünnungszeit" UBYTE OneToOne 1 100 0.00 255.0 FORMAT "%5.1" ECU_ADDRESS 0x8FECA3 /end MEASUREMENT
/begin MEASUREMENT Fid_EGTTempGvnrAirCtl_mp "Fehler Erkennung für dauernde Regelabweichung des Luftmassenreglers" UBYTE OneToOne 1 100 0.00 255.0 FORMAT "%5.1" ECU_ADDRESS 0x8FECA4 /end MEASUREMENT
/begin MEASUREMENT Fid_EGTTempGvnrInr_mp "Function Identifier für Temperatur des inneren Regelkreises" UBYTE OneToOne 1 100 0.00 255.0 FORMAT "%5.1" ECU_ADDRESS 0x8FECA5 /end MEASUREMENT
/begin MEASUREMENT Fid_EGTTempGvnrOutr_mp "Function Identifier für Temperatur des äußeren Regelkreises" UBYTE OneToOne 1 100 0.00 255.0 FORMAT "%5.1" ECU_ADDRESS 0x8FECA6 /end MEASUREMENT
/begin MEASUREMENT Fid_EMCCD_ShutOff_mp "Messpunkt fuer Funktions Identifier Fid_EMCCD_ShutOff" UBYTE OneToOne 1 100 0.00 255.0 FORMAT "%5.1" ECU_ADDRESS 0x8FECA7 /end MEASUREMENT
/begin MEASUREMENT Fid_EngCTSCD_mp "Messpunkt fuer Funktions Identifier Fid_EngCTSCD" UBYTE OneToOne 1 100 0.00 255.0 FORMAT "%5.1" ECU_ADDRESS 0x8FECA8 /end MEASUREMENT
/begin MEASUREMENT Fid_EngMCaS1_mp "Fid Definition zur Vermeidung der Nockenwellendiagnose beim Versorgungsfehler" UBYTE OneToOne 1 100 0.00 255.0 FORMAT "%5.1" ECU_ADDRESS 0x8FECA9 /end MEASUREMENT
/begin MEASUREMENT Fid_EngMCaSBackUp_mp "Wechsel ins Notfahren erfolgt bei gültigem Nockenwellensignal" UBYTE OneToOne 1 100 0.00 255.0 FORMAT "%5.1" ECU_ADDRESS 0x8FECAA /end MEASUREMENT
/begin MEASUREMENT Fid_EngMCrS1_mp "Fid Definition zur Vermeidung der Kurbelwellendiagnose beim Versorgungsfehler" UBYTE OneToOne 1 100 0.00 255.0 FORMAT "%5.1" ECU_ADDRESS 0x8FECAB /end MEASUREMENT
/begin MEASUREMENT Fid_EngMCrSBackUp_mp "Wenn EngM_stBackUpVar_C=1,dann nur wenn der Dfp_EngMCrS1 einen Fehler meldet,wird (über diese Fid) in den BackUp mode gewechselt" UBYTE OneToOne 1 100 0.00 255.0 FORMAT "%5.1" ECU_ADDRESS 0x8FECAC /end MEASUREMENT
/begin MEASUREMENT Fid_EngMTEng_mp "Fid for EngM_EngMntCtl subsystem" UBYTE OneToOne 1 100 0.00 255.0 FORMAT "%5.1" ECU_ADDRESS 0x8FECAD /end MEASUREMENT
/begin MEASUREMENT Fid_EngMTrqFrcPDiff_mp "Messpunkt für Function Identifier" UBYTE OneToOne 1 100 0.00 255.0 FORMAT "%5.1" ECU_ADDRESS 0x8FECAE /end MEASUREMENT
/begin MEASUREMENT Fid_EngMVVeh_mp "Fid for EngM_EngMntCtl subsystem" UBYTE OneToOne 1 100 0.00 255.0 FORMAT "%5.1" ECU_ADDRESS 0x8FECAF /end MEASUREMENT
/begin MEASUREMENT Fid_EngM_ChkStrtSpd_mp "Fid für Anfang nur mit Kurbelwellen-System" UBYTE OneToOne 1 100 0.00 255.0 FORMAT "%5.1" ECU_ADDRESS 0x8FECB0 /end MEASUREMENT
/begin MEASUREMENT Fid_EngPrt_nLimErr_mp "Messpunkt für Funktions Identifier bei zusätzlicher Drezahlbegrenzung im Systemfehlerfall" UBYTE OneToOne 1 100 0.00 255.0 FORMAT "%5.1" ECU_ADDRESS 0x8FECB1 /end MEASUREMENT
/begin MEASUREMENT Fid_ETClbCorActv_mp "FID zur Deaktivierung der ETClb ET Korrektur" UBYTE OneToOne 1 100 0.00 255.0 FORMAT "%5.1" ECU_ADDRESS 0x8FECB2 /end MEASUREMENT
/begin MEASUREMENT Fid_FanCtl_mp "Fehler-Identifier für Wassertemperatur-Sensorfehler" UBYTE OneToOne 1 100 0.00 255.0 FORMAT "%5.1" ECU_ADDRESS 0x8FECB3 /end MEASUREMENT
/begin MEASUREMENT Fid_FanGbxOil_mp "fault identifier for Gear box oil temperature" UBYTE OneToOne 1 100 0.00 255.0 FORMAT "%5.1" ECU_ADDRESS 0x8FECB4 /end MEASUREMENT
/begin MEASUREMENT Fid_FBCMonI_mp "Messpunkt fuer Funktions Identifier Fid_FBCMonI" UBYTE OneToOne 1 100 0.00 255.0 FORMAT "%5.1" ECU_ADDRESS 0x8FECB5 /end MEASUREMENT
/begin MEASUREMENT Fid_FBC_mp "FID zur Aktivierung der Mengenausgleichsregelung" UBYTE OneToOne 1 100 0.00 255.0 FORMAT "%5.1" ECU_ADDRESS 0x8FECB6 /end MEASUREMENT
/begin MEASUREMENT Fid_FlMngFullLdRglOff_mp "Messpunkt fuer Funktions Identifier Fid_FlMngFullLdRglOff" UBYTE OneToOne 1 100 0.00 255.0 FORMAT "%5.1" ECU_ADDRESS 0x8FECB7 /end MEASUREMENT
/begin MEASUREMENT Fid_FlMngSmkDefect_mp "Messpunkt fuer Funktions Identifier Fid_FlMngSmkDefect" UBYTE OneToOne 1 100 0.00 255.0 FORMAT "%5.1" ECU_ADDRESS 0x8FECB8 /end MEASUREMENT
/begin MEASUREMENT Fid_FlMngTPFltErr_mp "Umschaltung auf Defektkennfeld" UBYTE OneToOne 1 100 0.00 255.0 FORMAT "%5.1" ECU_ADDRESS 0x8FECB9 /end MEASUREMENT
/begin MEASUREMENT Fid_FlSysCTSSens_mp "Fid zur Deaktivierung der Verwendung der Wassertemperatur als Kraftstoffsystemtemperatur" UBYTE OneToOne 1 100 0.00 255.0 FORMAT "%5.1" ECU_ADDRESS 0x8FECBA /end MEASUREMENT
/begin MEASUREMENT Fid_FlSysDens_mp "Verriegelung der Sensorerfassung für die Kraftstofftemperatur" UBYTE OneToOne 1 100 0.00 255.0 FORMAT "%5.1" ECU_ADDRESS 0x8FECBB /end MEASUREMENT
/begin MEASUREMENT Fid_FlSysFTSSens_mp "Fid zur Deaktivierung der Verwendung der Kraftstofftemperatur als Kraftstoffsystemtemperatur" UBYTE OneToOne 1 100 0.00 255.0 FORMAT "%5.1" ECU_ADDRESS 0x8FECBC /end MEASUREMENT
/begin MEASUREMENT Fid_FMASwtOff1_mp "Meßpunkt für FMA-Abschaltung bei leichten Systemfehlern (Abschaltmöglichkeit 1)" UBYTE OneToOne 1 100 0.00 255.0 FORMAT "%5.1" ECU_ADDRESS 0x8FECBD /end MEASUREMENT
/begin MEASUREMENT Fid_FMASwtOff2_mp "Fid um Abschaltbedingung 2 wegen Systemfehler zu realisieren" UBYTE OneToOne 1 100 0.00 255.0 FORMAT "%5.1" ECU_ADDRESS 0x8FECBE /end MEASUREMENT
/begin MEASUREMENT Fid_FMASwtOff3_mp "Meßpunkt für FMA-Abschaltung bei schweren Systemfehlern (Abschaltmöglichkeit 3)" UBYTE OneToOne 1 100 0.00 255.0 FORMAT "%5.1" ECU_ADDRESS 0x8FECBF /end MEASUREMENT
/begin MEASUREMENT Fid_FMTC_AirCorr_mp "Veriegelung der Eta-Korrektur für Luftmasse pro Zylinder" UBYTE OneToOne 1 100 0.00 255.0 FORMAT "%5.1" ECU_ADDRESS 0x8FECC0 /end MEASUREMENT
/begin MEASUREMENT Fid_FMTC_PCRCorr_mp "Messpunkt fuer Funktions Identifier Fid_FMTC_PCRCorr" UBYTE OneToOne 1 100 0.00 255.0 FORMAT "%5.1" ECU_ADDRESS 0x8FECC1 /end MEASUREMENT
/begin MEASUREMENT Fid_FMTC_SOECorr_mp "Veriegelung der Eta-Korrektur für den Spritzbeginn" UBYTE OneToOne 1 100 0.00 255.0 FORMAT "%5.1" ECU_ADDRESS 0x8FECC2 /end MEASUREMENT
/begin MEASUREMENT Fid_FrmMngAddLevl_mp "Messpunkt fuer Funktions Identifier Fid_FrmMngAddLevl" UBYTE OneToOne 1 100 0.00 255.0 FORMAT "%5.1" ECU_ADDRESS 0x8FECC3 /end MEASUREMENT
/begin MEASUREMENT Fid_FrmMngAOHt_mp "" UBYTE OneToOne 1 100 0.00 255.0 FORMAT "%5.1" ECU_ADDRESS 0x8FECC4 /end MEASUREMENT
/begin MEASUREMENT Fid_FrmMngAPP_mp "Messpunkt fuer Funktions Identifier Fid_FrmMngAPP" UBYTE OneToOne 1 100 0.00 255.0 FORMAT "%5.1" ECU_ADDRESS 0x8FECC5 /end MEASUREMENT
/begin MEASUREMENT Fid_FrmMngARS_mp "Messpunkt fuer Funktions Identifier Fid_FrmMngARS" UBYTE OneToOne 1 100 0.00 255.0 FORMAT "%5.1" ECU_ADDRESS 0x8FECC6 /end MEASUREMENT
/begin MEASUREMENT Fid_FrmMngBrkDef_mp "Messpunkt fuer Funktions Identifier Fid_FrmMngBrkDef" UBYTE OneToOne 1 100 0.00 255.0 FORMAT "%5.1" ECU_ADDRESS 0x8FECC7 /end MEASUREMENT
/begin MEASUREMENT Fid_FrmMngBrk_mp "Messpunkt fuer Funktions Identifier Fid_FrmMngBrk" UBYTE OneToOne 1 100 0.00 255.0 FORMAT "%5.1" ECU_ADDRESS 0x8FECC8 /end MEASUREMENT
/begin MEASUREMENT Fid_FrmMngCoEng_mp "Messpunkt fuer Funktions Identifier Fid_FrmMngCoEng" UBYTE OneToOne 1 100 0.00 255.0 FORMAT "%5.1" ECU_ADDRESS 0x8FECC9 /end MEASUREMENT
/begin MEASUREMENT Fid_FrmMngCoEng_St2_mp "Messpunkt fuer Funktions Identifier Fid_FrmMngCoEng_St2" UBYTE OneToOne 1 100 0.00 255.0 FORMAT "%5.1" ECU_ADDRESS 0x8FECCA /end MEASUREMENT
/begin MEASUREMENT Fid_FrmMngConvDef_mp "Messpunkt fuer Funktions Identifier Fid_FrmMngConvDef" UBYTE OneToOne 1 100 0.00 255.0 FORMAT "%5.1" ECU_ADDRESS 0x8FECCB /end MEASUREMENT
/begin MEASUREMENT Fid_FrmMngEngOvrSpd_mp "Messpunkt fuer Funktions Identifier Fid_FrmMngEngOvrSpd" UBYTE OneToOne 1 100 0.00 255.0 FORMAT "%5.1" ECU_ADDRESS 0x8FECCC /end MEASUREMENT
/begin MEASUREMENT Fid_FrmMngEngRpmTemp_mp "Messpunkt für Funktions Identifier Fid_FrmMngEngRpmTemp" UBYTE OneToOne 1 100 0.00 255.0 FORMAT "%5.1" ECU_ADDRESS 0x8FECCD /end MEASUREMENT
/begin MEASUREMENT Fid_FrmMngEngSpd_mp "Messpunkt fuer Funktions Identifier Fid_FrmMngEngSpd" UBYTE OneToOne 1 100 0.00 255.0 FORMAT "%5.1" ECU_ADDRESS 0x8FECCE /end MEASUREMENT
/begin MEASUREMENT Fid_FrmMngInjDU1_mp "Messpunkt fuer Funktions Identifier Fid_FrmMngInjDU1" UBYTE OneToOne 1 100 0.00 255.0 FORMAT "%5.1" ECU_ADDRESS 0x8FECCF /end MEASUREMENT
/begin MEASUREMENT Fid_FrmMngInjDU2_mp "Messpunkt fuer Funktions Identifier Fid_FrmMngInjDU2" UBYTE OneToOne 1 100 0.00 255.0 FORMAT "%5.1" ECU_ADDRESS 0x8FECD0 /end MEASUREMENT
/begin MEASUREMENT Fid_FrmMngInjVlv_mp "Messpunkt fuer Funktions Identifier Fid_FrmMngInjVlv" UBYTE OneToOne 1 100 0.00 255.0 FORMAT "%5.1" ECU_ADDRESS 0x8FECD1 /end MEASUREMENT
/begin MEASUREMENT Fid_FrmMngnSetpoint_mp "Messpunkt fuer Funktions Identifier Fid_FrmMngnSetpoint" UBYTE OneToOne 1 100 0.00 255.0 FORMAT "%5.1" ECU_ADDRESS 0x8FECD2 /end MEASUREMENT
/begin MEASUREMENT Fid_FrmMngOBDCtl_mp "Messpunkt fuer Funktions Identifier Fid_FrmMngOBDCtl" UBYTE OneToOne 1 100 0.00 255.0 FORMAT "%5.1" ECU_ADDRESS 0x8FECD3 /end MEASUREMENT
/begin MEASUREMENT Fid_FrmMngParkConsumer_mp "Messpunkt fuer Funktions Identifier Fid_FrmMngParkConsumer" UBYTE OneToOne 1 100 0.00 255.0 FORMAT "%5.1" ECU_ADDRESS 0x8FECD4 /end MEASUREMENT
/begin MEASUREMENT Fid_FrmMngPFltDef_mp "Messpunkt fuer Funktions Identifier Fid_FrmMngPFltDef" UBYTE OneToOne 1 100 0.00 255.0 FORMAT "%5.1" ECU_ADDRESS 0x8FECD5 /end MEASUREMENT
/begin MEASUREMENT Fid_FrmMngPla_DSC_mp "Fid für FrmMng-Plaus DSC" UBYTE OneToOne 1 100 0.00 255.0 FORMAT "%5.1" ECU_ADDRESS 0x8FECD6 /end MEASUREMENT
/begin MEASUREMENT Fid_FrmMngPla_EGS_mp "Fid für FrmMng-Plaus EGS" UBYTE OneToOne 1 100 0.00 255.0 FORMAT "%5.1" ECU_ADDRESS 0x8FECD7 /end MEASUREMENT
/begin MEASUREMENT Fid_FrmMngPowerTrainCAN_mp "Messpunkt fuer Funktions Identifier Fid_FrmMngPowerTrainCAN" UBYTE OneToOne 1 100 0.00 255.0 FORMAT "%5.1" ECU_ADDRESS 0x8FECD8 /end MEASUREMENT
/begin MEASUREMENT Fid_FrmMngpVal_mp "Messpunkt fuer Funktions Identifier Fid_FrmMngpVal" UBYTE OneToOne 1 100 0.00 255.0 FORMAT "%5.1" ECU_ADDRESS 0x8FECD9 /end MEASUREMENT
/begin MEASUREMENT Fid_FrmMngPwrMngLIGovSt_mp "Messpunkt fuer Funktions Identifier Fid_FrmMngPwrMngLIGovSt" UBYTE OneToOne 1 100 0.00 255.0 FORMAT "%5.1" ECU_ADDRESS 0x8FECDA /end MEASUREMENT
/begin MEASUREMENT Fid_FrmMngSIG_ARS_mp "Messpunkt fuer Funktions Identifier Fid_FrmMngSIG_ARS" UBYTE OneToOne 1 100 0.00 255.0 FORMAT "%5.1" ECU_ADDRESS 0x8FECDB /end MEASUREMENT
/begin MEASUREMENT Fid_FrmMngSIG_DSC_mp "Messpunkt fuer Funktions Identifier Fid_FrmMngSIG_DSC" UBYTE OneToOne 1 100 0.00 255.0 FORMAT "%5.1" ECU_ADDRESS 0x8FECDC /end MEASUREMENT
/begin MEASUREMENT Fid_FrmMngSig_EGS_mp "Messpunkt fuer Funktions Identifier Fid_FrmMngSIG_EGS" UBYTE OneToOne 1 100 0.00 255.0 FORMAT "%5.1" ECU_ADDRESS 0x8FECDD /end MEASUREMENT
/begin MEASUREMENT Fid_FrmMngtEng_mp "Messpunkt fuer Funktions Identifier Fid_FrmMngtEng" UBYTE OneToOne 1 100 0.00 255.0 FORMAT "%5.1" ECU_ADDRESS 0x8FECDE /end MEASUREMENT
/begin MEASUREMENT Fid_FrmMngTO_ARS_mp "Messpunkt fuer Funktions Identifier Fid_FrmMngTO_ARS" UBYTE OneToOne 1 100 0.00 255.0 FORMAT "%5.1" ECU_ADDRESS 0x8FECDF /end MEASUREMENT
/begin MEASUREMENT Fid_FrmMngTO_DSC_mp "Messpunkt fuer Funktions Identifier Fid_FrmMngTO_DSC" UBYTE OneToOne 1 100 0.00 255.0 FORMAT "%5.1" ECU_ADDRESS 0x8FECE0 /end MEASUREMENT
/begin MEASUREMENT Fid_FrmMngTo_EGS_mp "Messpunkt fuer Funktions Identifier Fid_FrmMngTO_EGS" UBYTE OneToOne 1 100 0.00 255.0 FORMAT "%5.1" ECU_ADDRESS 0x8FECE1 /end MEASUREMENT
/begin MEASUREMENT Fid_FrmMngTrqGearbx_mp "Messpunkt fuer Funktions Identifier Fid_FrmMngTrqGearbx" UBYTE OneToOne 1 100 0.00 255.0 FORMAT "%5.1" ECU_ADDRESS 0x8FECE2 /end MEASUREMENT
/begin MEASUREMENT Fid_FrmMngWaterVlv_mp "Fid for heating current defect" UBYTE OneToOne 1 100 0.00 255.0 FORMAT "%5.1" ECU_ADDRESS 0x8FECE3 /end MEASUREMENT
/begin MEASUREMENT Fid_FrmMng_stTrq_mp "Messpunkt fuer Funktions Identifier Fid_FrmMng_stTrq_mp" UBYTE OneToOne 1 100 0.00 255.0 FORMAT "%5.1" ECU_ADDRESS 0x8FECE4 /end MEASUREMENT
/begin MEASUREMENT Fid_FrmMng_ST_TORQ_mp "Messpunkt fuer Funktions Identifier Fid_FrmMng_ST_TORQ" UBYTE OneToOne 1 100 0.00 255.0 FORMAT "%5.1" ECU_ADDRESS 0x8FECE5 /end MEASUREMENT
/begin MEASUREMENT Fid_FTSCDErr_mp "Messpunkt fuer Funktions Identifier Fid_FTSCDErr" UBYTE OneToOne 1 100 0.00 255.0 FORMAT "%5.1" ECU_ADDRESS 0x8FECE6 /end MEASUREMENT
/begin MEASUREMENT Fid_FWOscDet_mp "Fid for Fly Wheel Oscillation detection" UBYTE OneToOne 1 100 0.00 255.0 FORMAT "%5.1" ECU_ADDRESS 0x8FECE7 /end MEASUREMENT
/begin MEASUREMENT Fid_GearbxDrvAwayInactv_mp "" UBYTE OneToOne 1 100 0.00 255.0 FORMAT "%5.1" ECU_ADDRESS 0x8FECE8 /end MEASUREMENT
/begin MEASUREMENT Fid_GearbxDrvAway_mp "Fid zur Aktivierung der Anfahrmomentbegrenzung" UBYTE OneToOne 1 100 0.00 255.0 FORMAT "%5.1" ECU_ADDRESS 0x8FECE9 /end MEASUREMENT
/begin MEASUREMENT Fid_GearbxNmin_mp "Fid zu Abschaltung erhöhter Leerlaufdrehzahl während Wandlerkupplung im modus geregelt" UBYTE OneToOne 1 100 0.00 255.0 FORMAT "%5.1" ECU_ADDRESS 0x8FECEA /end MEASUREMENT
/begin MEASUREMENT Fid_GearbxPtCANErr_mp "Messpunkt fuer Funktions Identifier Fid_GearbxPtCANErr" UBYTE OneToOne 1 100 0.00 255.0 FORMAT "%5.1" ECU_ADDRESS 0x8FECEB /end MEASUREMENT
/begin MEASUREMENT Fid_GearbxSlip_mp "Messpunkt fuer Funktions Identifier Fid_GearbxSlip" UBYTE OneToOne 1 100 0.00 255.0 FORMAT "%5.1" ECU_ADDRESS 0x8FECEC /end MEASUREMENT
/begin MEASUREMENT Fid_GearbxTrqLimErr_mp "Messpunkt fuer Funktions Identifier Fid_GearbxTrqLimErr" UBYTE OneToOne 1 100 0.00 255.0 FORMAT "%5.1" ECU_ADDRESS 0x8FECED /end MEASUREMENT
/begin MEASUREMENT Fid_Gearbx_GearDet_mp "Fid für Gangerkennung" UBYTE OneToOne 1 100 0.00 255.0 FORMAT "%5.1" ECU_ADDRESS 0x8FECEE /end MEASUREMENT
/begin MEASUREMENT Fid_Gearbx_TrqIntv_Err_mp "Messpunkt fuer Funktions Identifier Fid_Gearbx_TrqIntv_Err" UBYTE OneToOne 1 100 0.00 255.0 FORMAT "%5.1" ECU_ADDRESS 0x8FECEF /end MEASUREMENT
/begin MEASUREMENT Fid_GlwCtl1_mp "Verwendung der Ersatztemperatur anstelle der Motortemperatur zur Berechnung der Motortemperatur für das Glühen." UBYTE OneToOne 1 100 0.00 255.0 FORMAT "%5.1" ECU_ADDRESS 0x8FECF0 /end MEASUREMENT
/begin MEASUREMENT Fid_HDC_mp "Messpunkt fuer Funktions Identifier Fid_HDC" UBYTE OneToOne 1 100 0.00 255.0 FORMAT "%5.1" ECU_ADDRESS 0x8FECF1 /end MEASUREMENT
/begin MEASUREMENT Fid_IndSys1_mp "Messpunkt fuer Funktions Identifier Fid_IndSys1" UBYTE OneToOne 1 100 0.00 255.0 FORMAT "%5.1" ECU_ADDRESS 0x8FECF2 /end MEASUREMENT
/begin MEASUREMENT Fid_IndSys2_mp "Messpunkt fuer Funktions Identifier Fid_IndSys2" UBYTE OneToOne 1 100 0.00 255.0 FORMAT "%5.1" ECU_ADDRESS 0x8FECF3 /end MEASUREMENT
/begin MEASUREMENT Fid_InjCrvCoErr_mp "FID für ausgeschaltete Voreinspritzung" UBYTE OneToOne 1 100 0.00 255.0 FORMAT "%5.1" ECU_ADDRESS 0x8FECF4 /end MEASUREMENT
/begin MEASUREMENT Fid_InjCrvCylOffs_mp "Fid zur Anzeige von defektem Wassertemperatursensor" UBYTE OneToOne 1 100 0.00 255.0 FORMAT "%5.1" ECU_ADDRESS 0x8FECF5 /end MEASUREMENT
/begin MEASUREMENT Fid_InjCrv_PoIOvrQLim_mp "" UBYTE OneToOne 1 100 0.00 255.0 FORMAT "%5.1" ECU_ADDRESS 0x8FECF6 /end MEASUREMENT
/begin MEASUREMENT Fid_InjCtl_qLimErr_mp "Aktivierung der Mengenbegrenzung wegen Systemfehler" UBYTE OneToOne 1 100 0.00 255.0 FORMAT "%5.1" ECU_ADDRESS 0x8FECF7 /end MEASUREMENT
/begin MEASUREMENT Fid_InjVlvWvCorOff_mp "Fid der Druckwellenkorrektur" UBYTE OneToOne 1 100 0.00 255.0 FORMAT "%5.1" ECU_ADDRESS 0x8FECF8 /end MEASUREMENT
/begin MEASUREMENT Fid_Layer_FI_TANS_mp "Messpunkt fuer Funktions Identifier Fid_Layer_FI_TANS" UBYTE OneToOne 1 100 0.00 255.0 FORMAT "%5.1" ECU_ADDRESS 0x8FECF9 /end MEASUREMENT
/begin MEASUREMENT Fid_Layer_FI_TUMG_mp "Messpunkt fuer Funktions Identifier Fid_Layer_FI_TUMG" UBYTE OneToOne 1 100 0.00 255.0 FORMAT "%5.1" ECU_ADDRESS 0x8FECFA /end MEASUREMENT
/begin MEASUREMENT Fid_Layer_MANHYDR_mp "Messpunkt fuer Funktions Identifier Fid_Layer_MANHYDR" UBYTE OneToOne 1 100 0.00 255.0 FORMAT "%5.1" ECU_ADDRESS 0x8FECFB /end MEASUREMENT
/begin MEASUREMENT Fid_Layer_MANLUFT_mp "Messpunkt fuer Funktions Identifier Fid_Layer_MANLUFT" UBYTE OneToOne 1 100 0.00 255.0 FORMAT "%5.1" ECU_ADDRESS 0x8FECFC /end MEASUREMENT
/begin MEASUREMENT Fid_LIGovSetpDrvAway_mp "FID zur Deaktivierung der Anfahr Drehzahlbestimmung" UBYTE OneToOne 1 100 0.00 255.0 FORMAT "%5.1" ECU_ADDRESS 0x8FECFD /end MEASUREMENT
/begin MEASUREMENT Fid_LIGovSetpointDrvAwy_mp "Messpunkt fuer Funktions Identifier Fid_LIGovSetpointDrvAwy" UBYTE OneToOne 1 100 0.00 255.0 FORMAT "%5.1" ECU_ADDRESS 0x8FECFE /end MEASUREMENT
/begin MEASUREMENT Fid_LIGovUbr_mp "FID zur Deaktivierung der Funkionalität Unterbremsen" UBYTE OneToOne 1 100 0.00 255.0 FORMAT "%5.1" ECU_ADDRESS 0x8FECFF /end MEASUREMENT
/begin MEASUREMENT Fid_LSUCDactiv0_mp "Messpunkt fuer Funktions Identifier Fid_LSUCDactiv0" UBYTE OneToOne 1 100 0.00 255.0 FORMAT "%5.1" ECU_ADDRESS 0x8FED00 /end MEASUREMENT
/begin MEASUREMENT Fid_LSUCDlsu0_mp "Messpunkt fuer Funktions Identifier Fid_LSUCDlsu0" UBYTE OneToOne 1 100 0.00 255.0 FORMAT "%5.1" ECU_ADDRESS 0x8FED01 /end MEASUREMENT
/begin MEASUREMENT Fid_LSUCDMon0_mp "Messpunkt fuer Funktions Identifier Fid_LSUCDMon0" UBYTE OneToOne 1 100 0.00 255.0 FORMAT "%5.1" ECU_ADDRESS 0x8FED02 /end MEASUREMENT
/begin MEASUREMENT Fid_LSUCDO20_mp "Messpunkt fuer Funktions Identifier Fid_LSUCDO20" UBYTE OneToOne 1 100 0.00 255.0 FORMAT "%5.1" ECU_ADDRESS 0x8FED03 /end MEASUREMENT
/begin MEASUREMENT Fid_LSUCDRi0_mp "Messpunkt fuer Funktions Identifier Fid_LSUCDRi0" UBYTE OneToOne 1 100 0.00 255.0 FORMAT "%5.1" ECU_ADDRESS 0x8FED04 /end MEASUREMENT
/begin MEASUREMENT Fid_LSUClbSched_mp "Fid zur Unterdrückung der CJ125-Kalibrierung im Falle einer defekten Batterie" UBYTE OneToOne 1 100 0.00 255.0 FORMAT "%5.1" ECU_ADDRESS 0x8FED05 /end MEASUREMENT
/begin MEASUREMENT Fid_LSUCtl0_mp "Messpunkt fuer Funktions Identifier Fid_LSUCtl0" UBYTE OneToOne 1 100 0.00 255.0 FORMAT "%5.1" ECU_ADDRESS 0x8FED06 /end MEASUREMENT
/begin MEASUREMENT Fid_LSUMonAllChecks_mp "Messpunkt fuer Funktions Identifier Fid_LSUMonAllChecks" UBYTE OneToOne 1 100 0.00 255.0 FORMAT "%5.1" ECU_ADDRESS 0x8FED07 /end MEASUREMENT
/begin MEASUREMENT Fid_LSUMonPlausChk_mp "Messpunkt fuer Funktions Identifier Fid_LSUMonPlausChk" UBYTE OneToOne 1 100 0.00 255.0 FORMAT "%5.1" ECU_ADDRESS 0x8FED08 /end MEASUREMENT
/begin MEASUREMENT Fid_MeUnCDCalcI_mp "Fehleridentifier um den I-Anteil des Stromreglers für die Zumesseinheit einzufrieren" UBYTE OneToOne 1 100 0.00 255.0 FORMAT "%5.1" ECU_ADDRESS 0x8FED09 /end MEASUREMENT
/begin MEASUREMENT Fid_MSidCD_ECU_mp "Messpunkt fuer Funktions Identifier Fid_MSidCD_ECU" UBYTE OneToOne 1 100 0.00 255.0 FORMAT "%5.1" ECU_ADDRESS 0x8FED0A /end MEASUREMENT
/begin MEASUREMENT Fid_MSidCD_Pin_mp "Messpunkt fuer Funktions Identifier Fid_MSidCD_Pin" UBYTE OneToOne 1 100 0.00 255.0 FORMAT "%5.1" ECU_ADDRESS 0x8FED0B /end MEASUREMENT
/begin MEASUREMENT Fid_OTSCD_mp "Fid für SRC Max- und Min-Fehler des OTSCD Fehlerpfads" UBYTE OneToOne 1 100 0.00 255.0 FORMAT "%5.1" ECU_ADDRESS 0x8FED0C /end MEASUREMENT
/begin MEASUREMENT Fid_OxiCat_pPreCat_mp "Druckverlust über OxiKat" UBYTE OneToOne 1 100 0.00 255.0 FORMAT "%5.1" ECU_ADDRESS 0x8FED0D /end MEASUREMENT
/begin MEASUREMENT Fid_PCBSPFltDef_mp "Messpunkt fuer Funktions Identifier Fid_PCBSPFltDef" UBYTE OneToOne 1 100 0.00 255.0 FORMAT "%5.1" ECU_ADDRESS 0x8FED0E /end MEASUREMENT
/begin MEASUREMENT Fid_PCRBalGvnr_mp "Messpunkt fuer Funktions Identifier Fid_PCRBalGvnr" UBYTE OneToOne 1 100 0.00 255.0 FORMAT "%5.1" ECU_ADDRESS 0x8FED0F /end MEASUREMENT
/begin MEASUREMENT Fid_PCRExtnLimActr_mp "Function identifier shut-off correction of the actuator limitation because of increasing backpressure upstream from  part. filte" UBYTE OneToOne 1 100 0.00 255.0 FORMAT "%5.1" ECU_ADDRESS 0x8FED10 /end MEASUREMENT
/begin MEASUREMENT Fid_PCRGvnrDvtNeg_mp "Messpunkt fuer Funktions Identifier Fid_PCRGvnrDvtNeg" UBYTE OneToOne 1 100 0.00 255.0 FORMAT "%5.1" ECU_ADDRESS 0x8FED11 /end MEASUREMENT
/begin MEASUREMENT Fid_PCRGvnrDvtPos_mp "Messpunkt fuer Funktions Identifier Fid_PCRGvnrDvtPos" UBYTE OneToOne 1 100 0.00 255.0 FORMAT "%5.1" ECU_ADDRESS 0x8FED12 /end MEASUREMENT
/begin MEASUREMENT Fid_PCRLPGvnrDvtNeg_mp "Fid fuer neg. Regelabweichung PCR-LP" UBYTE OneToOne 1 100 0.00 255.0 FORMAT "%5.1" ECU_ADDRESS 0x8FED13 /end MEASUREMENT
/begin MEASUREMENT Fid_PCRLPGvnrDvtPos_mp "FID fürpos. Regelabweichung PCR-LP" UBYTE OneToOne 1 100 0.00 255.0 FORMAT "%5.1" ECU_ADDRESS 0x8FED14 /end MEASUREMENT
/begin MEASUREMENT Fid_PCRSurgeGvnr_mp "" UBYTE OneToOne 1 100 0.00 255.0 FORMAT "%5.1" ECU_ADDRESS 0x8FED15 /end MEASUREMENT
/begin MEASUREMENT Fid_PCRSurgeLIGov_mp "Fault path identifier for Anti-Surge LIGov" UBYTE OneToOne 1 100 0.00 255.0 FORMAT "%5.1" ECU_ADDRESS 0x8FED16 /end MEASUREMENT
/begin MEASUREMENT Fid_PCR_LPMS_mp "FID für Ladedruckregelung-Niederdruckstufe LP 8 Zyl." UBYTE OneToOne 1 100 0.00 255.0 FORMAT "%5.1" ECU_ADDRESS 0x8FED17 /end MEASUREMENT
/begin MEASUREMENT Fid_PCR_LP_mp "FID für Ladedruckregelung-Niederdruckstufe (LP)" UBYTE OneToOne 1 100 0.00 255.0 FORMAT "%5.1" ECU_ADDRESS 0x8FED18 /end MEASUREMENT
/begin MEASUREMENT Fid_PCR_mp "Systemfehler in PCR" UBYTE OneToOne 1 100 0.00 255.0 FORMAT "%5.1" ECU_ADDRESS 0x8FED19 /end MEASUREMENT
/begin MEASUREMENT Fid_PCR_MS_mp "Messpunkt fuer Funktions Identifier Fid_PCR_MS" UBYTE OneToOne 1 100 0.00 255.0 FORMAT "%5.1" ECU_ADDRESS 0x8FED1A /end MEASUREMENT
/begin MEASUREMENT Fid_PCR_SurgeDet_mp "Meßpunkt für Fid" UBYTE OneToOne 1 100 0.00 255.0 FORMAT "%5.1" ECU_ADDRESS 0x8FED1B /end MEASUREMENT
/begin MEASUREMENT Fid_PCVCDCalcI_mp "Fehleridentifier um den I-Anteil des Stromreglers für das Druckregelventil einzufrieren" UBYTE OneToOne 1 100 0.00 255.0 FORMAT "%5.1" ECU_ADDRESS 0x8FED1C /end MEASUREMENT
/begin MEASUREMENT Fid_PFltAshCorRgn_mp "function identifier zur Freigabe der Regenerationsanforderung" UBYTE OneToOne 1 100 0.00 255.0 FORMAT "%5.1" ECU_ADDRESS 0x8FED1D /end MEASUREMENT
/begin MEASUREMENT Fid_PFltAshCor_mp "Messpunkt fuer Funktions Identifier Fid_PFltAshCor" UBYTE OneToOne 1 100 0.00 255.0 FORMAT "%5.1" ECU_ADDRESS 0x8FED1E /end MEASUREMENT
/begin MEASUREMENT Fid_PFltBrk_mp "Function Identifier für Bremssignal" UBYTE OneToOne 1 100 0.00 255.0 FORMAT "%5.1" ECU_ADDRESS 0x8FED1F /end MEASUREMENT
/begin MEASUREMENT Fid_PFltChar_mp "Fid für Verhinderung Resflow-SRC" UBYTE OneToOne 1 100 0.00 255.0 FORMAT "%5.1" ECU_ADDRESS 0x8FED20 /end MEASUREMENT
/begin MEASUREMENT Fid_PFltChngPar_mp "Messpunkt fuer Funktions Identifier Fid_PFltChngPar" UBYTE OneToOne 1 100 0.00 255.0 FORMAT "%5.1" ECU_ADDRESS 0x8FED21 /end MEASUREMENT
/begin MEASUREMENT Fid_PFltClth_mp "Function Identifier für Kupplungssignal" UBYTE OneToOne 1 100 0.00 255.0 FORMAT "%5.1" ECU_ADDRESS 0x8FED22 /end MEASUREMENT
/begin MEASUREMENT Fid_PFltDiagRls1_mp "Messpunkt fuer Funktions Identifier Fid_PFltDiagRls" UBYTE OneToOne 1 100 0.00 255.0 FORMAT "%5.1" ECU_ADDRESS 0x8FED23 /end MEASUREMENT
/begin MEASUREMENT Fid_PFltDiagRls2_mp "Messpunkt fuer Funktions Identifier Fid_PFltDiagRls" UBYTE OneToOne 1 100 0.00 255.0 FORMAT "%5.1" ECU_ADDRESS 0x8FED24 /end MEASUREMENT
/begin MEASUREMENT Fid_PFltDynChk_mp "Messpunkt fuer Funktions Identifier Fid_PFltDynChk" UBYTE OneToOne 1 100 0.00 255.0 FORMAT "%5.1" ECU_ADDRESS 0x8FED25 /end MEASUREMENT
/begin MEASUREMENT Fid_PFltEngPrtRgnMon_mp "Messpunkt fuer Funktions Identifier Fid_PFltEngPrtRgnMon" UBYTE OneToOne 1 100 0.00 255.0 FORMAT "%5.1" ECU_ADDRESS 0x8FED26 /end MEASUREMENT
/begin MEASUREMENT Fid_PFltGearDet_mp "Function Identifier für Gangsignal" UBYTE OneToOne 1 100 0.00 255.0 FORMAT "%5.1" ECU_ADDRESS 0x8FED27 /end MEASUREMENT
/begin MEASUREMENT Fid_PFltHsLnChk_mp "Messpunkt fuer Funktions Identifier Fid_PFltHsLnChk" UBYTE OneToOne 1 100 0.00 255.0 FORMAT "%5.1" ECU_ADDRESS 0x8FED28 /end MEASUREMENT
/begin MEASUREMENT Fid_PFltLckRgnErr_mp "Messpunkt fuer Funktions Identifier Fid_PFltLckRgnErr" UBYTE OneToOne 1 100 0.00 255.0 FORMAT "%5.1" ECU_ADDRESS 0x8FED29 /end MEASUREMENT
/begin MEASUREMENT Fid_PFltLckRgnFuel_mp "Fid für PFlt-Kraftstoff-Verriegelungsregeneration" UBYTE OneToOne 1 100 0.00 255.0 FORMAT "%5.1" ECU_ADDRESS 0x8FED2A /end MEASUREMENT
/begin MEASUREMENT Fid_PFltNumPFltErrLck_mp "Messpunkt fuer Funktions Identifier Fid_PFltNumPFltErrLck" UBYTE OneToOne 1 100 0.00 255.0 FORMAT "%5.1" ECU_ADDRESS 0x8FED2B /end MEASUREMENT
/begin MEASUREMENT Fid_PFltNumPFltErr_mp "Messpunkt fuer Funktions Identifier Fid_PFltNumPFltErr" UBYTE OneToOne 1 100 0.00 255.0 FORMAT "%5.1" ECU_ADDRESS 0x8FED2C /end MEASUREMENT
/begin MEASUREMENT Fid_PFltPlausPres_mp "Messpunkt fuer Funktions Identifier Fid_PFltPlausPres" UBYTE OneToOne 1 100 0.00 255.0 FORMAT "%5.1" ECU_ADDRESS 0x8FED2D /end MEASUREMENT
/begin MEASUREMENT Fid_PFltPlausTemp_mp "Messpunkt fuer Funktions Identifier Fid_PFltPlausTemp" UBYTE OneToOne 1 100 0.00 255.0 FORMAT "%5.1" ECU_ADDRESS 0x8FED2E /end MEASUREMENT
/begin MEASUREMENT Fid_PFltPPreErr_mp " Function identifier Fid_PFltPPreErr_mp" UBYTE OneToOne 1 100 0.00 255.0 FORMAT "%5.1" ECU_ADDRESS 0x8FED2F /end MEASUREMENT
/begin MEASUREMENT Fid_PFltPresPlausProj_mp "Messpunkt fuer Funktions Identifier Fid_PFltPresPlausProj" UBYTE OneToOne 1 100 0.00 255.0 FORMAT "%5.1" ECU_ADDRESS 0x8FED30 /end MEASUREMENT
/begin MEASUREMENT Fid_PFltPresSensFrz_mp "Messpunkt fuer Funktions Identifier Fid_PFltPresSensFrz" UBYTE OneToOne 1 100 0.00 255.0 FORMAT "%5.1" ECU_ADDRESS 0x8FED31 /end MEASUREMENT
/begin MEASUREMENT Fid_PFltPresSensHsLn_mp "Fid für Verhinderung der Schlauchleitungsüberwachung der Drucksensoren" UBYTE OneToOne 1 100 0.00 255.0 FORMAT "%5.1" ECU_ADDRESS 0x8FED32 /end MEASUREMENT
/begin MEASUREMENT Fid_PFltSimOn_mp "wenn aktiv wird von Beladungsmessung auf Simulation umgesch." UBYTE OneToOne 1 100 0.00 255.0 FORMAT "%5.1" ECU_ADDRESS 0x8FED33 /end MEASUREMENT
/begin MEASUREMENT Fid_PFltSpdVeh_mp "Function Identifier für Fahrzeugsgeschwindigkeit" UBYTE OneToOne 1 100 0.00 255.0 FORMAT "%5.1" ECU_ADDRESS 0x8FED34 /end MEASUREMENT
/begin MEASUREMENT Fid_PFltSRCPres_mp "Messpunkt fuer Funktions Identifier Fid_PFltSRCPres" UBYTE OneToOne 1 100 0.00 255.0 FORMAT "%5.1" ECU_ADDRESS 0x8FED35 /end MEASUREMENT
/begin MEASUREMENT Fid_PFltSRCTemp_mp "Fid für Verhinderung Temperatursensor-SRC" UBYTE OneToOne 1 100 0.00 255.0 FORMAT "%5.1" ECU_ADDRESS 0x8FED36 /end MEASUREMENT
/begin MEASUREMENT Fid_PFltSuc_mp "Messpunkt fuer Funktions Identifier Fid_PFltSuc" UBYTE OneToOne 1 100 0.00 255.0 FORMAT "%5.1" ECU_ADDRESS 0x8FED37 /end MEASUREMENT
/begin MEASUREMENT Fid_PFltTempAir_mp "Function Identifier für Ansaugsluft-temperatur" UBYTE OneToOne 1 100 0.00 255.0 FORMAT "%5.1" ECU_ADDRESS 0x8FED38 /end MEASUREMENT
/begin MEASUREMENT Fid_PFltTempClnt_mp "Function identifier für Kühlflüssigkeitstemperatur" UBYTE OneToOne 1 100 0.00 255.0 FORMAT "%5.1" ECU_ADDRESS 0x8FED39 /end MEASUREMENT
/begin MEASUREMENT Fid_PFltTempOxiPre_mp "Messpunkt fuer Funktions Identifier Fid_PFltTempOxiPre" UBYTE OneToOne 1 100 0.00 255.0 FORMAT "%5.1" ECU_ADDRESS 0x8FED3A /end MEASUREMENT
/begin MEASUREMENT Fid_PFltTempPre_mp "Messpunkt fuer Funktions Identifier Fid_PFltTempPre" UBYTE OneToOne 1 100 0.00 255.0 FORMAT "%5.1" ECU_ADDRESS 0x8FED3B /end MEASUREMENT
/begin MEASUREMENT Fid_PFltTempSensFrz_mp "Messpunkt fuer Funktions Identifier Fid_PFltTempSensFrz" UBYTE OneToOne 1 100 0.00 255.0 FORMAT "%5.1" ECU_ADDRESS 0x8FED3C /end MEASUREMENT
/begin MEASUREMENT Fid_PFltTOxiPreDiff_mp "Zur Sperre der Fehlererkennung bzw. Heilung" UBYTE OneToOne 1 100 0.00 255.0 FORMAT "%5.1" ECU_ADDRESS 0x8FED3D /end MEASUREMENT
/begin MEASUREMENT Fid_PFltTPreDiff_mp "Zur Sperre der Fehlererkennung bzw. Heilung" UBYTE OneToOne 1 100 0.00 255.0 FORMAT "%5.1" ECU_ADDRESS 0x8FED3E /end MEASUREMENT
/begin MEASUREMENT Fid_PFltVltgBatt_mp "Function Identifier für Akkumulatorspannung" UBYTE OneToOne 1 100 0.00 255.0 FORMAT "%5.1" ECU_ADDRESS 0x8FED3F /end MEASUREMENT
/begin MEASUREMENT Fid_RailCDRPSErrChk_mp "Fid zur Reaktion auf Fehler des Kraftstoffdrucksensors: Dfp_RailCD_mp wird nicht weiter gestestet." UBYTE OneToOne 1 100 0.00 255.0 FORMAT "%5.1" ECU_ADDRESS 0x8FED40 /end MEASUREMENT
/begin MEASUREMENT Fid_RailCDSubstVal_mp "Fid zur Reaktion auf Fehler des Kraftstoffdrucksensors" UBYTE OneToOne 1 100 0.00 255.0 FORMAT "%5.1" ECU_ADDRESS 0x8FED41 /end MEASUREMENT
/begin MEASUREMENT Fid_RailCD_PMonStrt_mp "Messpunkt fuer Funktions Identifier Fid_RailCD_PMonStrt" UBYTE OneToOne 1 100 0.00 255.0 FORMAT "%5.1" ECU_ADDRESS 0x8FED42 /end MEASUREMENT
/begin MEASUREMENT Fid_RailCtlMode_mp "Fehlerverriegelung allgemein für die Druckregelung" UBYTE OneToOne 1 100 0.00 255.0 FORMAT "%5.1" ECU_ADDRESS 0x8FED43 /end MEASUREMENT
/begin MEASUREMENT Fid_RailMeUn0Blk_mp "Fehleridentifier zur Verriegelung der Überwachung auf positive Regelabweichung" UBYTE OneToOne 1 100 0.00 255.0 FORMAT "%5.1" ECU_ADDRESS 0x8FED44 /end MEASUREMENT
/begin MEASUREMENT Fid_RailMeUn0Rls_mp "Fehleridentifier zur Freigabe der Überwachung auf positive Regelabweichung" UBYTE OneToOne 1 100 0.00 255.0 FORMAT "%5.1" ECU_ADDRESS 0x8FED45 /end MEASUREMENT
/begin MEASUREMENT Fid_RailMeUn1Blk_mp "Fehleridentifier zur Verriegelung der Überwachung auf positive Regelabweichung und Sollwert des Volumenstroms d. Zumesseinheit" UBYTE OneToOne 1 100 0.00 255.0 FORMAT "%5.1" ECU_ADDRESS 0x8FED46 /end MEASUREMENT
/begin MEASUREMENT Fid_RailMeUn1Rls_mp "Fehleridentifier zur Freigabe der Überwachung auf positive Regelabweichung und Sollwert des Volumenstroms d. Zumesseinheit" UBYTE OneToOne 1 100 0.00 255.0 FORMAT "%5.1" ECU_ADDRESS 0x8FED47 /end MEASUREMENT
/begin MEASUREMENT Fid_RailMeUn2Blk_mp "Fehleridentifier zur Verriegelung der Überwachung auf negative Regelabweichung bei Nullförderung" UBYTE OneToOne 1 100 0.00 255.0 FORMAT "%5.1" ECU_ADDRESS 0x8FED48 /end MEASUREMENT
/begin MEASUREMENT Fid_RailMeUn2Rls_mp "Fehleridentifier zur Freigabe der Überwachung auf negative Regelabweichung bei Nullförderung" UBYTE OneToOne 1 100 0.00 255.0 FORMAT "%5.1" ECU_ADDRESS 0x8FED49 /end MEASUREMENT
/begin MEASUREMENT Fid_RailMeUn3Blk_mp "Fehleridentifier zur Verriegelung der Überwachung auf minimalen Raildruck" UBYTE OneToOne 1 100 0.00 255.0 FORMAT "%5.1" ECU_ADDRESS 0x8FED4A /end MEASUREMENT
/begin MEASUREMENT Fid_RailMeUn3Rls_mp "Fehleridentifier zur Freigabe der Überwachung auf minimalen Raildruck" UBYTE OneToOne 1 100 0.00 255.0 FORMAT "%5.1" ECU_ADDRESS 0x8FED4B /end MEASUREMENT
/begin MEASUREMENT Fid_RailMeUn4Blk_mp "Fehleridentifier zur Verriegelung der Überwachung auf maximalen Raildruck" UBYTE OneToOne 1 100 0.00 255.0 FORMAT "%5.1" ECU_ADDRESS 0x8FED4C /end MEASUREMENT
/begin MEASUREMENT Fid_RailMeUn4Rls_mp "Fehleridentifier zur Freigabe der Überwachung auf maximalen Raildruck" UBYTE OneToOne 1 100 0.00 255.0 FORMAT "%5.1" ECU_ADDRESS 0x8FED4D /end MEASUREMENT
/begin MEASUREMENT Fid_RailMeUnCtlMode_mp "Fehlerverriegelung für die Druckregelung über Zumesseinheit" UBYTE OneToOne 1 100 0.00 255.0 FORMAT "%5.1" ECU_ADDRESS 0x8FED4E /end MEASUREMENT
/begin MEASUREMENT Fid_RailPCV0Blk_mp "Fehleridentifier zur Verriegelung der Überwachung auf positive Regelabweichung" UBYTE OneToOne 1 100 0.00 255.0 FORMAT "%5.1" ECU_ADDRESS 0x8FED4F /end MEASUREMENT
/begin MEASUREMENT Fid_RailPCV0Rls_mp "Fehleridentifier zur Freigabe der Überwachung auf positive Regelabweichung" UBYTE OneToOne 1 100 0.00 255.0 FORMAT "%5.1" ECU_ADDRESS 0x8FED50 /end MEASUREMENT
/begin MEASUREMENT Fid_RailPCV1Blk_mp "Fehleridentifier zur Verriegelung der Überwachung auf positive Regelabweichung kombiniert mit Stellgröße des Druckregelventils" UBYTE OneToOne 1 100 0.00 255.0 FORMAT "%5.1" ECU_ADDRESS 0x8FED51 /end MEASUREMENT
/begin MEASUREMENT Fid_RailPCV1Rls_mp "Fehleridentifier zur Freigabe der Überwachung auf positive Regelabweichung kombiniert mit Stellgröße des Druckregelventils" UBYTE OneToOne 1 100 0.00 255.0 FORMAT "%5.1" ECU_ADDRESS 0x8FED52 /end MEASUREMENT
/begin MEASUREMENT Fid_RailPCV2Blk_mp "Fehleridentifier zur Verriegelung der Überwachung auf negative Regelabweichung kombiniert mit Stellgröße des Druckregelventils" UBYTE OneToOne 1 100 0.00 255.0 FORMAT "%5.1" ECU_ADDRESS 0x8FED53 /end MEASUREMENT
/begin MEASUREMENT Fid_RailPCV2Rls_mp "Fehleridentifier zur Freigabe der Überwachung auf negative Regelabweichung kombiniert mit Stellgröße des Druckregelventils" UBYTE OneToOne 1 100 0.00 255.0 FORMAT "%5.1" ECU_ADDRESS 0x8FED54 /end MEASUREMENT
/begin MEASUREMENT Fid_RailPCV3Blk_mp "Fehleridentifier zur Verriegelung der Überwachung auf minimalen Raildruck" UBYTE OneToOne 1 100 0.00 255.0 FORMAT "%5.1" ECU_ADDRESS 0x8FED55 /end MEASUREMENT
/begin MEASUREMENT Fid_RailPCV3Rls_mp "Fehleridentifier zur Freigabe der Überwachung auf minimalen Raildruck" UBYTE OneToOne 1 100 0.00 255.0 FORMAT "%5.1" ECU_ADDRESS 0x8FED56 /end MEASUREMENT
/begin MEASUREMENT Fid_RailPCV4Blk_mp "Fehleridentifier zur Verriegelung der Überwachung auf maximalen Raildruck" UBYTE OneToOne 1 100 0.00 255.0 FORMAT "%5.1" ECU_ADDRESS 0x8FED57 /end MEASUREMENT
/begin MEASUREMENT Fid_RailPCV4Rls_mp "Fehleridentifier zur Freigabe der Überwachung auf maximalen Raildruck" UBYTE OneToOne 1 100 0.00 255.0 FORMAT "%5.1" ECU_ADDRESS 0x8FED58 /end MEASUREMENT
/begin MEASUREMENT Fid_RailPCV5Blk_mp "Fehleridentifier zur Verriegelung der Plausibilisierung des Raildruck mit dem Strom durch das Druckregelventil" UBYTE OneToOne 1 100 0.00 255.0 FORMAT "%5.1" ECU_ADDRESS 0x8FED59 /end MEASUREMENT
/begin MEASUREMENT Fid_RailPCV5Rls_mp "Fehleridentifier zur Freigabe der Plausibilisierung des Raildruck mit dem Strom durch das Druckregelventil" UBYTE OneToOne 1 100 0.00 255.0 FORMAT "%5.1" ECU_ADDRESS 0x8FED5A /end MEASUREMENT
/begin MEASUREMENT Fid_RailPCVCtlMode_mp "Fehlerverriegelung für die Druckregelung über Druckregelventil" UBYTE OneToOne 1 100 0.00 255.0 FORMAT "%5.1" ECU_ADDRESS 0x8FED5B /end MEASUREMENT
/begin MEASUREMENT Fid_RailSetPointLim_mp "Fid zur Verriegelung der ""normalen"" Begrenzung des Raildruck-Sollwertes" UBYTE OneToOne 1 100 0.00 255.0 FORMAT "%5.1" ECU_ADDRESS 0x8FED5C /end MEASUREMENT
/begin MEASUREMENT Fid_RailSetPointRed_mp "Fehlerverriegelung zur Freigabe der Solldruckabsenkung im Systemfehlerfall" UBYTE OneToOne 1 100 0.00 255.0 FORMAT "%5.1" ECU_ADDRESS 0x8FED5D /end MEASUREMENT
/begin MEASUREMENT Fid_ShuttrCTS_mp "Messpunkt fuer Funktions Identifier Fid_ShuttrCTS" UBYTE OneToOne 1 100 0.00 255.0 FORMAT "%5.1" ECU_ADDRESS 0x8FED5E /end MEASUREMENT
/begin MEASUREMENT Fid_ShuttrEGS_mp "Messpunkt fuer Funktions Identifier Fid_ShuttrEGS" UBYTE OneToOne 1 100 0.00 255.0 FORMAT "%5.1" ECU_ADDRESS 0x8FED5F /end MEASUREMENT
/begin MEASUREMENT Fid_SignalsTstNLim_mp "Drehzahlbegrenzung beim Testerzugrift im Fall einen Defekt in Nockenwelle oder Kurbelwelle" UBYTE OneToOne 1 100 0.00 255.0 FORMAT "%5.1" ECU_ADDRESS 0x8FED60 /end MEASUREMENT
/begin MEASUREMENT Fid_StSysImmo_mp "FID WFS sperrt Starter" UBYTE OneToOne 1 100 0.00 255.0 FORMAT "%5.1" ECU_ADDRESS 0x8FED61 /end MEASUREMENT
/begin MEASUREMENT Fid_StSysStrtTipGbxDat_mp "fid Getriebedaten für Automatik Start" UBYTE OneToOne 1 100 0.00 255.0 FORMAT "%5.1" ECU_ADDRESS 0x8FED62 /end MEASUREMENT
/begin MEASUREMENT Fid_T15CDCanError_mp "Function Identifier für Ersatzwert bei CAN- Fehler" UBYTE OneToOne 1 100 0.00 255.0 FORMAT "%5.1" ECU_ADDRESS 0x8FED63 /end MEASUREMENT
/begin MEASUREMENT Fid_T50CDSig_mp "Messpunkt fuer Funktions Identifier Fid_T50CDSig" UBYTE OneToOne 1 100 0.00 255.0 FORMAT "%5.1" ECU_ADDRESS 0x8FED64 /end MEASUREMENT
/begin MEASUREMENT Fid_ThrVlvMon_mp "Messpunkt fuer Funktions Identifier Fid_ThrVlvMon" UBYTE OneToOne 1 100 0.00 255.0 FORMAT "%5.1" ECU_ADDRESS 0x8FED65 /end MEASUREMENT
/begin MEASUREMENT Fid_UsrDa_FDCOff_mp "Messpunkt fuer Funktions Identifier Fid_UsrDa_FDCOff" UBYTE OneToOne 1 100 0.00 255.0 FORMAT "%5.1" ECU_ADDRESS 0x8FED66 /end MEASUREMENT
/begin MEASUREMENT Fid_VehDaDist_mp "Status Funktionsidentifier Fid_VehDaDist zur Verriegelung Kilometerzähler VehDa_lSum" UBYTE OneToOne 1 100 0.00 255.0 FORMAT "%5.1" ECU_ADDRESS 0x8FED67 /end MEASUREMENT
/begin MEASUREMENT Fid_VSACDDioInDia_mp "" UBYTE OneToOne 1 100 0.00 255.0 FORMAT "%5.1" ECU_ADDRESS 0x8FED68 /end MEASUREMENT
/begin MEASUREMENT Fid_ZFCClbActv_mp "FID für Ersatzreaktion für die Nullmengenkalibrierung" UBYTE OneToOne 1 100 0.00 255.0 FORMAT "%5.1" ECU_ADDRESS 0x8FED69 /end MEASUREMENT
/begin MEASUREMENT Fid_ZFCCldCmbCham_mp "Function Identifier für die Erkennung ausgekühlter Brennraum der Nullmengenkalibrierung" UBYTE OneToOne 1 100 0.00 255.0 FORMAT "%5.1" ECU_ADDRESS 0x8FED6A /end MEASUREMENT
/begin FUNCTION dsm_auto_inhdel ""
 /begin DEF_CHARACTERISTIC DSM_DInDfp_Layer_TANS_C DSM_DInDfp_ACCDCmpr_C DSM_DInDfp_ACCDPres_C DSM_DInDfp_ACCDPres1_C DSM_DInDfp_ACCDPresAna_C DSM_DInDfp_ACCDSwtin_C DSM_DInDfp_ACC_PlausTrqDes_C DSM_DInDfp_ACC_trqInr_C DSM_DInDfp_ACTrq_C DSM_DInDfp_ADCMon_C DSM_DInDfp_AFSCDIdlAdjVal_C DSM_DInDfp_AFSCDLdAdjVal_C DSM_DInDfp_AFSCD_AirTempDcyc_C DSM_DInDfp_AFSCD_PlOffsDrft_C DSM_DInDfp_AFSCD_PlSetyDrft_C DSM_DInDfp_AFSCD_SRCAirTemp_C DSM_DInDfp_AFSCD_SRCBatt_C DSM_DInDfp_AFSCD_SRCCorrAirm_C DSM_DInDfp_AFSCD_SRCRawAirm_C DSM_DInDfp_Layer_TUMG_C DSM_DInDfp_AFSCD_SRCRefSigPer_C DSM_DInDfp_AOHtCD_C DSM_DInDfp_Layer_GEN_C DSM_DInDfp_Layer_BSD_C DSM_DInDfp_AOHtCD_AOHtDia1_C DSM_DInDfp_AOHtCD_AOHtDia2_C DSM_DInDfp_AOHtCD_AOHtDia3_C DSM_DInDfp_APP1_C DSM_DInDfp_APP2_C DSM_DInDfp_APPCDCmpd_C DSM_DInDfp_APPSync_C DSM_DInDfp_APSCD_C DSM_DInDfp_ARS_C DSM_DInDfp_AccPedPlausBrk_C DSM_DInDfp_Layer_QLT_C DSM_DInDfp_AirCtlGvnrDvtRgnMax_C DSM_DInDfp_Layer_IBS1_C DSM_DInDfp_Layer_IBS2_C DSM_DInDfp_Layer_IBS3_C DSM_DInDfp_Layer_PMBN_C DSM_DInDfp_Layer_PMBATT_C DSM_DInDfp_AirCtlGvnrDvtRgnMin_C DSM_DInDfp_AirCtlGvnrDvtRgnMn2_C DSM_DInDfp_AirCtlGvnrDvtRgnMx2_C DSM_DInDfp_AirCtlPlateBreak_C DSM_DInDfp_AirCtlRmpTO_C DSM_DInDfp_AirCtl_GovNegDev_C DSM_DInDfp_AirCtl_GovNegDev2_C DSM_DInDfp_AirCtl_GovPosDev_C DSM_DInDfp_AirCtl_GovPosDev2_C DSM_DInDfp_AltCD_C DSM_DInDfp_AltCD_Load_C DSM_DInDfp_BPACD_BPADia1_C DSM_DInDfp_BPACD_BPADia2_C DSM_DInDfp_BPACD_BPADia3_C DSM_DInDfp_BPACD_BPADia4_C DSM_DInDfp_BPACD_Max_C DSM_DInDfp_BPACD_Min_C DSM_DInDfp_BPACD_PwmIn_C DSM_DInDfp_BPACD_PwmInDia1_C DSM_DInDfp_BPACD_PwmInDia2_C DSM_DInDfp_BPACD_PwmInDia3_C DSM_DInDfp_BPACD_PwmInDia4_C DSM_DInDfp_BPACD_SigNpl_C DSM_DInDfp_BPSCD_C DSM_DInDfp_BattCD_C DSM_DInDfp_BrkCD_C DSM_DInDfp_Bss_C DSM_DInDfp_CBACD_C DSM_DInDfp_CTSCD_C DSM_DInDfp_Clg_DynTst_C DSM_DInDfp_CmbChbMisfire1_C DSM_DInDfp_CmbChbMisfire2_C DSM_DInDfp_Layer_PMRUHVERL_C DSM_DInDfp_CmbChbMisfire3_C DSM_DInDfp_CmbChbMisfire4_C DSM_DInDfp_CmbChbMisfire5_C DSM_DInDfp_CmbChbMisfire6_C DSM_DInDfp_Layer_TOENS_C DSM_DInDfp_Layer_MANHYDR_C DSM_DInDfp_Layer_MANLUFT_C DSM_DInDfp_CmbChbMisfireMul_C DSM_DInDfp_CoVMDCSh_C DSM_DInDfp_ConvCD_C DSM_DInDfp_CrCCDMFL_C DSM_DInDfp_CrCtl_vCrCtl_C DSM_DInDfp_DCC_PlausTrqDes_C DSM_DInDfp_Dummy1_C DSM_DInDfp_EATSCD_C DSM_DInDfp_EBAFCD_C DSM_DInDfp_EBFCD_C DSM_DInDfp_EBTSCD_C DSM_DInDfp_EBTSCD_OvrTemp_C DSM_DInDfp_ECBCD_C DSM_DInDfp_EEPCDVarMng_C DSM_DInDfp_EGPpCD_C DSM_DInDfp_EGPpCDTPreTrbn_C DSM_DInDfp_EGRCD_Max_C DSM_DInDfp_EGRCD_Min_C DSM_DInDfp_EGRCD_SigNpl_C DSM_DInDfp_EGTOilLvlCrit_C DSM_DInDfp_EGTOilVscCrit_C DSM_DInDfp_EGTRgnOilDil_C DSM_DInDfp_EGTTempGvnrInr_C DSM_DInDfp_EGTTempGvnrOutr_C DSM_DInDfp_EMCCD1_C DSM_DInDfp_EMCCD2_C DSM_DInDfp_EMCCD_ADC1_C DSM_DInDfp_EMCCD_ADC2_C DSM_DInDfp_ETClbETFltInj1_C DSM_DInDfp_ETClbETFltInj2_C DSM_DInDfp_ETClbETFltInj3_C DSM_DInDfp_ETClbETFltInj4_C DSM_DInDfp_ETClbETFltInj5_C DSM_DInDfp_ETClbETFltInj6_C DSM_DInDfp_ETClbInj1_C DSM_DInDfp_ETClbInj2_C DSM_DInDfp_ETClbInj3_C DSM_DInDfp_ETClbInj4_C DSM_DInDfp_ETClbInj5_C DSM_DInDfp_ETClbInj6_C DSM_DInDfp_EngMCaS1_C DSM_DInDfp_EngMCrS1_C DSM_DInDfp_EngMOfsCaSCrS_C DSM_DInDfp_EngPrtFWODet_C DSM_DInDfp_FBCqDvt_C DSM_DInDfp_FMAErrMod_C DSM_DInDfp_FMTC_NonMonotonMap_C DSM_DInDfp_FTSCD_C DSM_DInDfp_FanCD_C DSM_DInDfp_FanCD_FanCtlr1_C DSM_DInDfp_FanCD_FanCtlr2_C DSM_DInDfp_FanCD_FanCtlr3_C DSM_DInDfp_FlFCD_C DSM_DInDfp_FlMngSmkDefect_C DSM_DInDfp_FrmMngANFRADMOMPT_C DSM_DInDfp_FrmMngASC1_C DSM_DInDfp_FrmMngASC2_C DSM_DInDfp_FrmMngASC3_C DSM_DInDfp_FrmMngASC4_C DSM_DInDfp_FrmMngBOS_RESET_C DSM_DInDfp_FrmMngBOS_RESET2_C DSM_DInDfp_FrmMngDMANFAFS_C DSM_DInDfp_FrmMngDRMANFSSG_C DSM_DInDfp_FrmMngEGS1_C DSM_DInDfp_FrmMngEGS2_C DSM_DInDfp_FrmMngGEARBX_DATA_C DSM_DInDfp_FrmMngGEARBX_DATA2_C DSM_DInDfp_FrmMngHEAT_AC_C DSM_DInDfp_FrmMngINSTR2_C DSM_DInDfp_FrmMngINSTR3_C DSM_DInDfp_FrmMngLENKRADWINKEL_C DSM_DInDfp_FrmMngMILEAGE_RANGE_C DSM_DInDfp_FrmMngOPCRCTLACC_C DSM_DInDfp_FrmMngPRGG_CCTR_C DSM_DInDfp_FrmMngPWRMNG_LOADV_C DSM_DInDfp_FrmMngParkConsumer_C DSM_DInDfp_FrmMngRQSTGEFAN_C DSM_DInDfp_FrmMngSSGErr_C DSM_DInDfp_FrmMngSSGShOff_C DSM_DInDfp_FrmMngSTAT_ANH_C DSM_DInDfp_FrmMngSTAT_ARS_C DSM_DInDfp_FrmMngSTAT_DSC_C DSM_DInDfp_FrmMngSTAT_EKP_C DSM_DInDfp_FrmMngSTAT_KOMBI_C DSM_DInDfp_FrmMngSTAT_SITZ_C DSM_DInDfp_FrmMngStOBDGbxMilOf_C DSM_DInDfp_FrmMngStOBDGbxMilOn_C DSM_DInDfp_FrmMngTEMPRELTIME_C DSM_DInDfp_FrmMngTERMINAL_C DSM_DInDfp_FrmMngTIME_DATE_C DSM_DInDfp_FrmMngTORQUE_DSC_C DSM_DInDfp_FrmMngTORQUE_GEARBX_C DSM_DInDfp_FrmMngTrq_ReqACC_C DSM_DInDfp_FrmMngVEH_MOD_C DSM_DInDfp_FrmMngVELOCITY_C DSM_DInDfp_FrmMngWHEEL_SPEED_C DSM_DInDfp_FrmMngstCurr_C DSM_DInDfp_FrmMngswtPSPOff_C DSM_DInDfp_GearbxIncMax_C DSM_DInDfp_GlwCD_C DSM_DInDfp_GlwCDGlwCirc1_C DSM_DInDfp_GlwCDGlwCirc2_C DSM_DInDfp_GlwCDGlwCirc3_C DSM_DInDfp_GlwCDGlwCirc4_C DSM_DInDfp_GlwCDGlwCirc5_C DSM_DInDfp_GlwCDGlwCirc6_C DSM_DInDfp_GlwCDGlwCirc7_C DSM_DInDfp_GlwCDGlwCirc8_C DSM_DInDfp_GlwCtl_C DSM_DInDfp_HWEMonCom_C DSM_DInDfp_HWEMonEEPROM_C DSM_DInDfp_HWEMonRcyLocked_C DSM_DInDfp_HWEMonRcySuppressed_C DSM_DInDfp_HWEMonRcyVisible_C DSM_DInDfp_HWEMonUMaxSupply_C DSM_DInDfp_HWEMonUMinSupply_C DSM_DInDfp_IATSCD_C DSM_DInDfp_IATSCD_CATS_C DSM_DInDfp_ImmCtlImmCD_C DSM_DInDfp_ImmCtlImmEep_C DSM_DInDfp_ImmCtlMpl_C DSM_DInDfp_IndSys1_C DSM_DInDfp_IndSys2_C DSM_DInDfp_InjCrv_InjLim_C DSM_DInDfp_InjCtlAdjQnt_C DSM_DInDfp_InjCtlDrift_C DSM_DInDfp_InjVlvBnk1A_C DSM_DInDfp_InjVlvBnk1B_C DSM_DInDfp_InjVlvBnk2A_C DSM_DInDfp_InjVlvBnk2B_C DSM_DInDfp_InjVlvChipA_C DSM_DInDfp_InjVlvChipB_C DSM_DInDfp_InjVlvCyl1A_C DSM_DInDfp_InjVlvCyl1B_C DSM_DInDfp_InjVlvCyl2A_C DSM_DInDfp_InjVlvCyl2B_C DSM_DInDfp_InjVlvCyl3A_C DSM_DInDfp_InjVlvCyl3B_C DSM_DInDfp_InjVlvCyl4A_C DSM_DInDfp_InjVlvCyl4B_C DSM_DInDfp_InjVlvCyl5A_C DSM_DInDfp_InjVlvCyl5B_C DSM_DInDfp_InjVlvCyl6A_C DSM_DInDfp_InjVlvCyl6B_C DSM_DInDfp_KeyCheck_C DSM_DInDfp_LIGovECUTransMode_C DSM_DInDfp_LPACD_Max_C DSM_DInDfp_LPACD_Min_C DSM_DInDfp_LPACD_SigNpl_C DSM_DInDfp_LSUCDCircNernst0_C DSM_DInDfp_LSUCDCircPumpCur0_C DSM_DInDfp_LSUCDCircVirtGnd0_C DSM_DInDfp_LSUCDHeater0_C DSM_DInDfp_LSUCDHtCoup0_C DSM_DInDfp_LSUCDO20_C DSM_DInDfp_LSUCDO2Clb0_C DSM_DInDfp_LSUCDRiClb0_C DSM_DInDfp_LSUCDSPI0_C DSM_DInDfp_LSUCDSPIBattLow0_C DSM_DInDfp_LSUCDWireIP0_C DSM_DInDfp_LSUCtlRiExc0_C DSM_DInDfp_LSUMon1Sens_C DSM_DInDfp_LSUMon2Sens_C DSM_DInDfp_MIL_C DSM_DInDfp_MRlyCD_C DSM_DInDfp_MSidCD_Comm_C DSM_DInDfp_MSidCD_Pin_C DSM_DInDfp_MSidCD_Sel_INI_C DSM_DInDfp_MSidCD_Select_C DSM_DInDfp_MeUnCDNoLoad_C DSM_DInDfp_MeUnCDSCBat_C DSM_DInDfp_MeUnCDSCGnd_C DSM_DInDfp_MeUnCD_ADC_C DSM_DInDfp_MeUnCD_SigTst_C DSM_DInDfp_Montr_C DSM_DInDfp_NetMngDeviceA_C DSM_DInDfp_NetMngDeviceB_C DSM_DInDfp_NetMngDeviceC_C DSM_DInDfp_NetMngPtCan_C DSM_DInDfp_OPSCD_Lamp_C DSM_DInDfp_OPSCD_anain_C DSM_DInDfp_OTSCD_C DSM_DInDfp_OvRMon_C DSM_DInDfp_OvRMonSigA_C DSM_DInDfp_OxiCCDTPre_C DSM_DInDfp_PCBS_C DSM_DInDfp_PCR_GovDevNeg_C DSM_DInDfp_PCR_GovDevPos_C DSM_DInDfp_PCR_LPGvnrDvtNeg_C DSM_DInDfp_PCR_LPGvnrDvtPos_C DSM_DInDfp_PCVCDNoLoad_C DSM_DInDfp_PCVCDSCBat_C DSM_DInDfp_PCVCDSCGnd_C DSM_DInDfp_PCVCD_ADC_C DSM_DInDfp_PCVCD_SigTst_C DSM_DInDfp_PFltAPSPlaus_C DSM_DInDfp_PFltAPSens_C DSM_DInDfp_PFltBPSPlaus_C DSM_DInDfp_PFltCDPPre_C DSM_DInDfp_PFltCDTempPre_C DSM_DInDfp_PFltChar_C DSM_DInDfp_PFltEngPrt_C DSM_DInDfp_PFltOvldInhRgn_C DSM_DInDfp_PFltOvldTrqLim_C DSM_DInDfp_PFltPresDynPlaus_C DSM_DInDfp_PFltPresPlaus_C DSM_DInDfp_PFltPresSens_C DSM_DInDfp_PFltPresSensFrz_C DSM_DInDfp_PFltPresSensHsLn_C DSM_DInDfp_PFltPresSensSot_C DSM_DInDfp_PFltRgnPerm_C DSM_DInDfp_PFltTempDwnStrm_C DSM_DInDfp_PFltTempSens_C DSM_DInDfp_PFltTempUpStrm_C DSM_DInDfp_PFlt_tOxiPreMax_C DSM_DInDfp_PFlt_tOxiPreMxRgn_C DSM_DInDfp_PFlt_tPreMax_C DSM_DInDfp_PFlt_tPreMaxRgn_C DSM_DInDfp_PFltmSotDiffMax_C DSM_DInDfp_PSPCD_Actr_C DSM_DInDfp_PresPlausDblDef_C DSM_DInDfp_QLTCD_C DSM_DInDfp_RailCD_C DSM_DInDfp_RailCDOfsTst_C DSM_DInDfp_RailCD_PMonStrt_C DSM_DInDfp_RailCtlModeMeUnDiag_C DSM_DInDfp_RailCtlModePCVDiag_C DSM_DInDfp_RailMeUn0_C DSM_DInDfp_RailMeUn1_C DSM_DInDfp_RailMeUn2_C DSM_DInDfp_RailMeUn3_C DSM_DInDfp_RailMeUn4_C DSM_DInDfp_RailPCV0_C DSM_DInDfp_RailPCV1_C DSM_DInDfp_RailPCV2_C DSM_DInDfp_RailPCV3_C DSM_DInDfp_RailPCV4_C DSM_DInDfp_RailPCV5_C DSM_DInDfp_SOPTst_C DSM_DInDfp_SSpMon1_C DSM_DInDfp_SSpMon2_C DSM_DInDfp_SSpMon3_C DSM_DInDfp_SWChk_CycSigChkDat_C DSM_DInDfp_SWChk_CycSigChkPrg_C DSM_DInDfp_ShutCD_C DSM_DInDfp_StSysTrqShutOff_C DSM_DInDfp_StrtCD_Actr_C DSM_DInDfp_SysLamp_C DSM_DInDfp_T15CD_C DSM_DInDfp_TGearbx_C DSM_DInDfp_TPUMon_C DSM_DInDfp_TVACD_Max_C DSM_DInDfp_TVACD_Min_C DSM_DInDfp_TVACD_SigNpl_C DSM_DInDfp_TVACD_TVADia1_C DSM_DInDfp_TVACD_TVADia2_C DSM_DInDfp_TVACD_TVADia3_C DSM_DInDfp_TVACD_TVADia4_C DSM_DInDfp_ThrVlvMon_C DSM_DInDfp_VSACD_DiaDet_C DSM_DInDfp_VSACD_DioInDia1_C DSM_DInDfp_VSACD_DioInDia2_C DSM_DInDfp_VSACD_DioInDia3_C DSM_DInDfp_VSACD_DioInDia4_C DSM_DInDfp_VSACD_DioInMin_C DSM_DInDfp_VSACD_Max_C DSM_DInDfp_VSACD_Min_C DSM_DInDfp_VSACD_SigNpl_C DSM_DInDfp_VSACD_VSADia1_C DSM_DInDfp_VSACD_VSADia2_C DSM_DInDfp_VSACD_VSADia3_C DSM_DInDfp_VSACD_VSADia4_C DSM_DInDfp_VSSCD1_C DSM_DInDfp_VSSCD2_C DSM_DInDfp_WdCom_C /end DEF_CHARACTERISTIC
/end FUNCTION
/begin FUNCTION dsm_auto_oldas ""
 /begin OUT_MEASUREMENT DSM_FCM_mp Fid_ACCIRevErr_mp Fid_AccPedBrkPres_mp Fid_AccPedVel_mp Fid_AccPed_Brk_mp Fid_ACCRevErr_mp Fid_ACCtlDflt1_mp Fid_ACCtlDflt2_mp Fid_ACCtl_ACTrqErr_mp Fid_ACCtl_CTSErr_mp Fid_ACCtl_FanErr_mp Fid_ACCtl_mp Fid_ACCtl_TGearbxErr_mp Fid_ACCtl_VSSErr_mp Fid_ACC_AliveErr_mp Fid_ACC_CsErr_mp Fid_ACC_TiOutErr_mp Fid_ACTrqC_mp Fid_AFSCD_AirPerTime_mp Fid_AFSCD_mp Fid_AFSCD_PlOffsDrft_mp Fid_AFSCD_PlSetyDrft_mp Fid_AFSCD_SRCCorrAirm_mp Fid_AFSCD_SRCDcyc_mp Fid_AFSCD_SRCRawAirm_mp Fid_AFSCD_SRCRefSig_mp Fid_AFS_CanMon_mp Fid_AFS_GenDisableCond_mp Fid_AirCtlCorrAlt_mp Fid_AirCtlDyn_mp Fid_AirCtlNeg2_mp Fid_AirCtlNeg_mp Fid_AirCtlPFltEGRRed_mp Fid_AirCtlPlateBreakAct_mp Fid_AirCtlPlateBreak_mp Fid_AirCtlPos2_mp Fid_AirCtlPos_mp Fid_AirCtl_Brk_mp Fid_AirCtl_Gear_mp Fid_AirCtl_mp Fid_AirSysAirMassTst_mp Fid_AOHt_AltErr_mp Fid_AOHt_ShutOffErr_mp Fid_APP1_mp Fid_APP2_mp Fid_APPKickdown_mp Fid_APSCD_mp Fid_ARSOff_mp Fid_ASDdc_mp Fid_ASModSwtOffEng_mp Fid_ASModSwtOffIndVol_mp Fid_BPSCDMon_mp Fid_ClgDynTst_mp Fid_CmbChb_mp Fid_CoDT_GripDeb_mp Fid_CoEngIRevSys1_mp Fid_CoEngIRevSys2_mp Fid_CoEngIRevVeh_mp Fid_CoEngPFltErr_mp Fid_CoEngPFltOvldErr_mp Fid_CoEngRevSys1_mp Fid_CoEngRevSys2_mp Fid_CoEngRevVeh_mp Fid_CoEngShOffTst_mp Fid_CoEngSoftShOffTV_mp Fid_CoEng_ActrPrt_mp Fid_CoEng_Nrml2Strt_mp Fid_CoEng_PwrStgEnable_mp Fid_CoEng_trqLimErr1_mp Fid_CoEng_trqLimErr2_mp Fid_CoEng_trqLimErr3_mp Fid_CoEng_trqLimErr4_mp Fid_CoEng_trqLimErr_mp Fid_CoVehtrqLimErr_mp Fid_CoVM_StabDem_Err_mp Fid_CpBVlvOff_mp Fid_CrCtlShutOffIr_mp Fid_CrCtl_ASCTimeout_mp Fid_CrCtl_CanDef_mp Fid_CrCtl_KombiTimeout_mp Fid_CrCtl_vCrCtl_mp Fid_CTSCDFlTemp_mp Fid_CTSCD_Plaus_mp Fid_DCCIRevErr_mp Fid_DCCRevErr_mp Fid_DCC_AliveErr_mp Fid_DCC_CsErr_mp Fid_DCC_PlausErr_mp Fid_DCC_TiOutErr_mp Fid_DSM_Wuc_mp Fid_EATSCDTSubs_mp Fid_EBAFCD_mp Fid_EBFCD_mp Fid_ECU_mp Fid_EGRClg_mp Fid_EGSysCoLSU0_mp Fid_EGSysCoNSC_mp Fid_EGSysCoOxi_mp Fid_EGSysCoTrbn_mp Fid_EGSysCoTube0_mp Fid_EGSysCoTube1_mp Fid_EGSysHtgDel_mp Fid_EGSysMaxTOxiPre_mp Fid_EGSysMaxTPreRgn_mp Fid_EGSysMaxTPre_mp Fid_EGSysMxTOxiPreRgn_mp Fid_EGSysNSC_mp Fid_EGSysOxiCat_mp Fid_EGSysPresEnv_mp Fid_EGSysStrt_mp Fid_EGSysTemp_mp Fid_EGSysTrbn_mp Fid_EGSysTube_mp Fid_EGSys_AP_mp Fid_EGTRgnLck_mp Fid_EGTTempGvnrAirCtl_mp Fid_EGTTempGvnrInr_mp Fid_EGTTempGvnrOutr_mp Fid_EMCCD_ShutOff_mp Fid_EngCTSCD_mp Fid_EngMCaS1_mp Fid_EngMCaSBackUp_mp Fid_EngMCrS1_mp Fid_EngMCrSBackUp_mp Fid_EngMTEng_mp Fid_EngMTrqFrcPDiff_mp Fid_EngMVVeh_mp Fid_EngM_ChkStrtSpd_mp Fid_EngPrt_nLimErr_mp Fid_ETClbCorActv_mp Fid_FanCtl_mp Fid_FanGbxOil_mp Fid_FBCMonI_mp Fid_FBC_mp Fid_FlMngFullLdRglOff_mp Fid_FlMngSmkDefect_mp Fid_FlMngTPFltErr_mp Fid_FlSysCTSSens_mp Fid_FlSysDens_mp Fid_FlSysFTSSens_mp Fid_FMASwtOff1_mp Fid_FMASwtOff2_mp Fid_FMASwtOff3_mp Fid_FMTC_AirCorr_mp Fid_FMTC_PCRCorr_mp Fid_FMTC_SOECorr_mp Fid_FrmMngAddLevl_mp Fid_FrmMngAOHt_mp Fid_FrmMngAPP_mp Fid_FrmMngARS_mp Fid_FrmMngBrkDef_mp Fid_FrmMngBrk_mp Fid_FrmMngCoEng_mp Fid_FrmMngCoEng_St2_mp Fid_FrmMngConvDef_mp Fid_FrmMngEngOvrSpd_mp Fid_FrmMngEngRpmTemp_mp Fid_FrmMngEngSpd_mp Fid_FrmMngInjDU1_mp Fid_FrmMngInjDU2_mp Fid_FrmMngInjVlv_mp Fid_FrmMngnSetpoint_mp Fid_FrmMngOBDCtl_mp Fid_FrmMngParkConsumer_mp Fid_FrmMngPFltDef_mp Fid_FrmMngPla_DSC_mp Fid_FrmMngPla_EGS_mp Fid_FrmMngPowerTrainCAN_mp Fid_FrmMngpVal_mp Fid_FrmMngPwrMngLIGovSt_mp Fid_FrmMngSIG_ARS_mp Fid_FrmMngSIG_DSC_mp Fid_FrmMngSig_EGS_mp Fid_FrmMngtEng_mp Fid_FrmMngTO_ARS_mp Fid_FrmMngTO_DSC_mp Fid_FrmMngTo_EGS_mp Fid_FrmMngTrqGearbx_mp Fid_FrmMngWaterVlv_mp Fid_FrmMng_stTrq_mp Fid_FrmMng_ST_TORQ_mp Fid_FTSCDErr_mp Fid_FWOscDet_mp Fid_GearbxDrvAwayInactv_mp Fid_GearbxDrvAway_mp Fid_GearbxNmin_mp Fid_GearbxPtCANErr_mp Fid_GearbxSlip_mp Fid_GearbxTrqLimErr_mp Fid_Gearbx_GearDet_mp Fid_Gearbx_TrqIntv_Err_mp Fid_GlwCtl1_mp Fid_HDC_mp Fid_IndSys1_mp Fid_IndSys2_mp Fid_InjCrvCoErr_mp Fid_InjCrvCylOffs_mp Fid_InjCrv_PoIOvrQLim_mp Fid_InjCtl_qLimErr_mp Fid_InjVlvWvCorOff_mp Fid_Layer_FI_TANS_mp Fid_Layer_FI_TUMG_mp Fid_Layer_MANHYDR_mp Fid_Layer_MANLUFT_mp Fid_LIGovSetpDrvAway_mp Fid_LIGovSetpointDrvAwy_mp Fid_LIGovUbr_mp Fid_LSUCDactiv0_mp Fid_LSUCDlsu0_mp Fid_LSUCDMon0_mp Fid_LSUCDO20_mp Fid_LSUCDRi0_mp Fid_LSUClbSched_mp Fid_LSUCtl0_mp Fid_LSUMonAllChecks_mp Fid_LSUMonPlausChk_mp Fid_MeUnCDCalcI_mp Fid_MSidCD_ECU_mp Fid_MSidCD_Pin_mp Fid_OTSCD_mp Fid_OxiCat_pPreCat_mp Fid_PCBSPFltDef_mp Fid_PCRBalGvnr_mp Fid_PCRExtnLimActr_mp Fid_PCRGvnrDvtNeg_mp Fid_PCRGvnrDvtPos_mp Fid_PCRLPGvnrDvtNeg_mp Fid_PCRLPGvnrDvtPos_mp Fid_PCRSurgeGvnr_mp Fid_PCRSurgeLIGov_mp Fid_PCR_LPMS_mp Fid_PCR_LP_mp Fid_PCR_mp Fid_PCR_MS_mp Fid_PCR_SurgeDet_mp Fid_PCVCDCalcI_mp Fid_PFltAshCorRgn_mp Fid_PFltAshCor_mp Fid_PFltBrk_mp Fid_PFltChar_mp Fid_PFltChngPar_mp Fid_PFltClth_mp Fid_PFltDiagRls1_mp Fid_PFltDiagRls2_mp Fid_PFltDynChk_mp Fid_PFltEngPrtRgnMon_mp Fid_PFltGearDet_mp Fid_PFltHsLnChk_mp Fid_PFltLckRgnErr_mp Fid_PFltLckRgnFuel_mp Fid_PFltNumPFltErrLck_mp Fid_PFltNumPFltErr_mp Fid_PFltPlausPres_mp Fid_PFltPlausTemp_mp Fid_PFltPPreErr_mp Fid_PFltPresPlausProj_mp Fid_PFltPresSensFrz_mp Fid_PFltPresSensHsLn_mp Fid_PFltSimOn_mp Fid_PFltSpdVeh_mp Fid_PFltSRCPres_mp Fid_PFltSRCTemp_mp Fid_PFltSuc_mp Fid_PFltTempAir_mp Fid_PFltTempClnt_mp Fid_PFltTempOxiPre_mp Fid_PFltTempPre_mp Fid_PFltTempSensFrz_mp Fid_PFltTOxiPreDiff_mp Fid_PFltTPreDiff_mp Fid_PFltVltgBatt_mp Fid_RailCDRPSErrChk_mp Fid_RailCDSubstVal_mp Fid_RailCD_PMonStrt_mp Fid_RailCtlMode_mp Fid_RailMeUn0Blk_mp Fid_RailMeUn0Rls_mp Fid_RailMeUn1Blk_mp Fid_RailMeUn1Rls_mp Fid_RailMeUn2Blk_mp Fid_RailMeUn2Rls_mp Fid_RailMeUn3Blk_mp Fid_RailMeUn3Rls_mp Fid_RailMeUn4Blk_mp Fid_RailMeUn4Rls_mp Fid_RailMeUnCtlMode_mp Fid_RailPCV0Blk_mp Fid_RailPCV0Rls_mp Fid_RailPCV1Blk_mp Fid_RailPCV1Rls_mp Fid_RailPCV2Blk_mp Fid_RailPCV2Rls_mp Fid_RailPCV3Blk_mp Fid_RailPCV3Rls_mp Fid_RailPCV4Blk_mp Fid_RailPCV4Rls_mp Fid_RailPCV5Blk_mp Fid_RailPCV5Rls_mp Fid_RailPCVCtlMode_mp Fid_RailSetPointLim_mp Fid_RailSetPointRed_mp Fid_ShuttrCTS_mp Fid_ShuttrEGS_mp Fid_SignalsTstNLim_mp Fid_StSysImmo_mp Fid_StSysStrtTipGbxDat_mp Fid_T15CDCanError_mp Fid_T50CDSig_mp Fid_ThrVlvMon_mp Fid_UsrDa_FDCOff_mp Fid_VehDaDist_mp Fid_VSACDDioInDia_mp Fid_ZFCClbActv_mp Fid_ZFCCldCmbCham_mp /end OUT_MEASUREMENT
/end FUNCTION
/begin COMPU_METHOD OneToOne "eins zu eins (physikalischer Wert ist gleich dem internen Wert)" RAT_FUNC "%6.2" "-" COEFFS 0 1 0 0 0 1 /end COMPU_METHOD
/begin COMPU_METHOD Time_ms "Zeit in ms für Fehlerentprellung (DSM) und SW-Timer" RAT_FUNC "%6.1" "ms" COEFFS 0 0.1 0 0 0 1 /end COMPU_METHOD
/begin RECORD_LAYOUT Kw_Wu16 FNC_VALUES 1 UWORD COLUMN_DIR DIRECT /end RECORD_LAYOUT
/end MODULE
/end PROJECT
