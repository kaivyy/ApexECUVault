ASAP2_VERSION 1 41
/begin PROJECT MSD70 "Spray Guided DI-System with Piezo Injectors for 6-Cylinder"
/begin HEADER "_default_HeaderComment" PROJECT_NO _0B /end HEADER
/begin MODULE _default_ModuleName "_default_ModuleLongIdentifier"
/begin MOD_COMMON "_default_ModCommonComment" DEPOSIT ABSOLUTE BYTE_ORDER MSB_LAST ALIGNMENT_BYTE 1 ALIGNMENT_WORD 2 ALIGNMENT_LONG 2 ALIGNMENT_FLOAT32_IEEE 2 ALIGNMENT_FLOAT64_IEEE 4 /end MOD_COMMON
/begin CHARACTERISTIC fmy_id_imob_1.dtc "DTC table declaration for the diagnosis instance XX" MAP 0xa1004314 _REC_MAP_20_u2_u2_u2 65535. _CNV_A_R_LINEAR_____0_CM 0. 65535. DISPLAY_IDENTIFIER ID_ERR_DTC_IMOB_1 FORMAT "%5.0"
 /begin AXIS_DESCR COM_AXIS errm_online_dummy _CNV_S_2_ERRM_DTC_R_483_CM 1 0. 1. AXIS_PTS_REF ldp_nr_1_id_err_dtc /end AXIS_DESCR
 /begin AXIS_DESCR COM_AXIS errm_online_dummy _CNV_S_6_ERRM_DTC_R_484_CM 6 0. 5. AXIS_PTS_REF ldp_nr_2_id_err_dtc /end AXIS_DESCR
/end CHARACTERISTIC
/begin CHARACTERISTIC fmy_id_imob_2.dtc "DTC table declaration for the diagnosis instance XX" MAP 0xa1004328 _REC_MAP_20_u2_u2_u2 65535. _CNV_A_R_LINEAR_____0_CM 0. 65535. DISPLAY_IDENTIFIER ID_ERR_DTC_IMOB_2 FORMAT "%5.0"
 /begin AXIS_DESCR COM_AXIS errm_online_dummy _CNV_S_2_ERRM_DTC_R_483_CM 1 0. 1. AXIS_PTS_REF ldp_nr_1_id_err_dtc /end AXIS_DESCR
 /begin AXIS_DESCR COM_AXIS errm_online_dummy _CNV_S_6_ERRM_DTC_R_484_CM 6 0. 5. AXIS_PTS_REF ldp_nr_2_id_err_dtc /end AXIS_DESCR
/end CHARACTERISTIC
/begin CHARACTERISTIC fmy_id_imob_3.dtc "DTC table declaration for the diagnosis instance XX" MAP 0xa100433c _REC_MAP_20_u2_u2_u2 65535. _CNV_A_R_LINEAR_____0_CM 0. 65535. DISPLAY_IDENTIFIER ID_ERR_DTC_IMOB_3 FORMAT "%5.0"
 /begin AXIS_DESCR COM_AXIS errm_online_dummy _CNV_S_2_ERRM_DTC_R_483_CM 1 0. 1. AXIS_PTS_REF ldp_nr_1_id_err_dtc /end AXIS_DESCR
 /begin AXIS_DESCR COM_AXIS errm_online_dummy _CNV_S_6_ERRM_DTC_R_484_CM 6 0. 5. AXIS_PTS_REF ldp_nr_2_id_err_dtc /end AXIS_DESCR
/end CHARACTERISTIC
/begin CHARACTERISTIC fmy_id_tco_el.dtc "DTC table declaration for the diagnosis instance XX" MAP 0xa1004cc4 _REC_MAP_20_u2_u2_u2 65535. _CNV_A_R_LINEAR_____0_CM 0. 65535. DISPLAY_IDENTIFIER ID_ERR_DTC_TCO_EL FORMAT "%5.0"
 /begin AXIS_DESCR COM_AXIS errm_online_dummy _CNV_S_2_ERRM_DTC_R_483_CM 1 0. 1. AXIS_PTS_REF ldp_nr_1_id_err_dtc /end AXIS_DESCR
 /begin AXIS_DESCR COM_AXIS errm_online_dummy _CNV_S_6_ERRM_DTC_R_484_CM 6 0. 5. AXIS_PTS_REF ldp_nr_2_id_err_dtc /end AXIS_DESCR
/end CHARACTERISTIC
/begin CHARACTERISTIC fmy_id_tco_grd.dtc "DTC table declaration for the diagnosis instance XX" MAP 0xa1004cd8 _REC_MAP_20_u2_u2_u2 65535. _CNV_A_R_LINEAR_____0_CM 0. 65535. DISPLAY_IDENTIFIER ID_ERR_DTC_TCO_GRD FORMAT "%5.0"
 /begin AXIS_DESCR COM_AXIS errm_online_dummy _CNV_S_2_ERRM_DTC_R_483_CM 1 0. 1. AXIS_PTS_REF ldp_nr_1_id_err_dtc /end AXIS_DESCR
 /begin AXIS_DESCR COM_AXIS errm_online_dummy _CNV_S_6_ERRM_DTC_R_484_CM 6 0. 5. AXIS_PTS_REF ldp_nr_2_id_err_dtc /end AXIS_DESCR
/end CHARACTERISTIC
/begin CHARACTERISTIC fmy_id_tco_stuck.dtc "DTC table declaration for the diagnosis instance XX" MAP 0xa1004d00 _REC_MAP_20_u2_u2_u2 65535. _CNV_A_R_LINEAR_____0_CM 0. 65535. DISPLAY_IDENTIFIER ID_ERR_DTC_TCO_STUCK FORMAT "%5.0"
 /begin AXIS_DESCR COM_AXIS errm_online_dummy _CNV_S_2_ERRM_DTC_R_483_CM 1 0. 1. AXIS_PTS_REF ldp_nr_1_id_err_dtc /end AXIS_DESCR
 /begin AXIS_DESCR COM_AXIS errm_online_dummy _CNV_S_6_ERRM_DTC_R_484_CM 6 0. 5. AXIS_PTS_REF ldp_nr_2_id_err_dtc /end AXIS_DESCR
/end CHARACTERISTIC
/begin CHARACTERISTIC fmy_id_tco_plaus.dtc "DTC table declaration for the diagnosis instance XX" MAP 0xa1004cec _REC_MAP_20_u2_u2_u2 65535. _CNV_A_R_LINEAR_____0_CM 0. 65535. DISPLAY_IDENTIFIER ID_ERR_DTC_TCO_PLAUS FORMAT "%5.0"
 /begin AXIS_DESCR COM_AXIS errm_online_dummy _CNV_S_2_ERRM_DTC_R_483_CM 1 0. 1. AXIS_PTS_REF ldp_nr_1_id_err_dtc /end AXIS_DESCR
 /begin AXIS_DESCR COM_AXIS errm_online_dummy _CNV_S_6_ERRM_DTC_R_484_CM 6 0. 5. AXIS_PTS_REF ldp_nr_2_id_err_dtc /end AXIS_DESCR
/end CHARACTERISTIC
/begin CHARACTERISTIC fmy_id_tco_2_el.dtc "DTC table declaration for the diagnosis instance XX" MAP 0xa1004c88 _REC_MAP_20_u2_u2_u2 65535. _CNV_A_R_LINEAR_____0_CM 0. 65535. DISPLAY_IDENTIFIER ID_ERR_DTC_TCO_2_EL FORMAT "%5.0"
 /begin AXIS_DESCR COM_AXIS errm_online_dummy _CNV_S_2_ERRM_DTC_R_483_CM 1 0. 1. AXIS_PTS_REF ldp_nr_1_id_err_dtc /end AXIS_DESCR
 /begin AXIS_DESCR COM_AXIS errm_online_dummy _CNV_S_6_ERRM_DTC_R_484_CM 6 0. 5. AXIS_PTS_REF ldp_nr_2_id_err_dtc /end AXIS_DESCR
/end CHARACTERISTIC
/begin CHARACTERISTIC fmy_id_tco_2_grd.dtc "DTC table declaration for the diagnosis instance XX" MAP 0xa1004c9c _REC_MAP_20_u2_u2_u2 65535. _CNV_A_R_LINEAR_____0_CM 0. 65535. DISPLAY_IDENTIFIER ID_ERR_DTC_TCO_2_GRD FORMAT "%5.0"
 /begin AXIS_DESCR COM_AXIS errm_online_dummy _CNV_S_2_ERRM_DTC_R_483_CM 1 0. 1. AXIS_PTS_REF ldp_nr_1_id_err_dtc /end AXIS_DESCR
 /begin AXIS_DESCR COM_AXIS errm_online_dummy _CNV_S_6_ERRM_DTC_R_484_CM 6 0. 5. AXIS_PTS_REF ldp_nr_2_id_err_dtc /end AXIS_DESCR
/end CHARACTERISTIC
/begin CHARACTERISTIC fmy_id_tco_2_plaus.dtc "DTC table declaration for the diagnosis instance XX" MAP 0xa1004cb0 _REC_MAP_20_u2_u2_u2 65535. _CNV_A_R_LINEAR_____0_CM 0. 65535. DISPLAY_IDENTIFIER ID_ERR_DTC_TCO_2_PLAUS FORMAT "%5.0"
 /begin AXIS_DESCR COM_AXIS errm_online_dummy _CNV_S_2_ERRM_DTC_R_483_CM 1 0. 1. AXIS_PTS_REF ldp_nr_1_id_err_dtc /end AXIS_DESCR
 /begin AXIS_DESCR COM_AXIS errm_online_dummy _CNV_S_6_ERRM_DTC_R_484_CM 6 0. 5. AXIS_PTS_REF ldp_nr_2_id_err_dtc /end AXIS_DESCR
/end CHARACTERISTIC
/begin CHARACTERISTIC fmy_id_ect_el.dtc "DTC table declaration for the diagnosis instance XX" MAP 0xa1003f7c _REC_MAP_20_u2_u2_u2 65535. _CNV_A_R_LINEAR_____0_CM 0. 65535. DISPLAY_IDENTIFIER ID_ERR_DTC_ECT_EL FORMAT "%5.0"
 /begin AXIS_DESCR COM_AXIS errm_online_dummy _CNV_S_2_ERRM_DTC_R_483_CM 1 0. 1. AXIS_PTS_REF ldp_nr_1_id_err_dtc /end AXIS_DESCR
 /begin AXIS_DESCR COM_AXIS errm_online_dummy _CNV_S_6_ERRM_DTC_R_484_CM 6 0. 5. AXIS_PTS_REF ldp_nr_2_id_err_dtc /end AXIS_DESCR
/end CHARACTERISTIC
/begin CHARACTERISTIC fmy_id_ecf_el_1.dtc "DTC table declaration for the diagnosis instance XX" MAP 0xa1003f2c _REC_MAP_20_u2_u2_u2 65535. _CNV_A_R_LINEAR_____0_CM 0. 65535. DISPLAY_IDENTIFIER ID_ERR_DTC_ECF_EL_1 FORMAT "%5.0"
 /begin AXIS_DESCR COM_AXIS errm_online_dummy _CNV_S_2_ERRM_DTC_R_483_CM 1 0. 1. AXIS_PTS_REF ldp_nr_1_id_err_dtc /end AXIS_DESCR
 /begin AXIS_DESCR COM_AXIS errm_online_dummy _CNV_S_6_ERRM_DTC_R_484_CM 6 0. 5. AXIS_PTS_REF ldp_nr_2_id_err_dtc /end AXIS_DESCR
/end CHARACTERISTIC
/begin CHARACTERISTIC fmy_id_ecfpwm_fb_1.dtc "DTC table declaration for the diagnosis instance XX" MAP 0xa1003f40 _REC_MAP_20_u2_u2_u2 65535. _CNV_A_R_LINEAR_____0_CM 0. 65535. DISPLAY_IDENTIFIER ID_ERR_DTC_ECFPWM_FB_1 FORMAT "%5.0"
 /begin AXIS_DESCR COM_AXIS errm_online_dummy _CNV_S_2_ERRM_DTC_R_483_CM 1 0. 1. AXIS_PTS_REF ldp_nr_1_id_err_dtc /end AXIS_DESCR
 /begin AXIS_DESCR COM_AXIS errm_online_dummy _CNV_S_6_ERRM_DTC_R_484_CM 6 0. 5. AXIS_PTS_REF ldp_nr_2_id_err_dtc /end AXIS_DESCR
/end CHARACTERISTIC
/begin CHARACTERISTIC fmy_id_th.dtc "DTC table declaration for the diagnosis instance XX" MAP 0xa1004d50 _REC_MAP_20_u2_u2_u2 65535. _CNV_A_R_LINEAR_____0_CM 0. 65535. DISPLAY_IDENTIFIER ID_ERR_DTC_TH FORMAT "%5.0"
 /begin AXIS_DESCR COM_AXIS errm_online_dummy _CNV_S_2_ERRM_DTC_R_483_CM 1 0. 1. AXIS_PTS_REF ldp_nr_1_id_err_dtc /end AXIS_DESCR
 /begin AXIS_DESCR COM_AXIS errm_online_dummy _CNV_S_6_ERRM_DTC_R_484_CM 6 0. 5. AXIS_PTS_REF ldp_nr_2_id_err_dtc /end AXIS_DESCR
/end CHARACTERISTIC
/begin CHARACTERISTIC fmy_id_ftl_min.dtc "DTC table declaration for the diagnosis instance XX" MAP 0xa10040d0 _REC_MAP_20_u2_u2_u2 65535. _CNV_A_R_LINEAR_____0_CM 0. 65535. DISPLAY_IDENTIFIER ID_ERR_DTC_FTL_MIN FORMAT "%5.0"
 /begin AXIS_DESCR COM_AXIS errm_online_dummy _CNV_S_2_ERRM_DTC_R_483_CM 1 0. 1. AXIS_PTS_REF ldp_nr_1_id_err_dtc /end AXIS_DESCR
 /begin AXIS_DESCR COM_AXIS errm_online_dummy _CNV_S_6_ERRM_DTC_R_484_CM 6 0. 5. AXIS_PTS_REF ldp_nr_2_id_err_dtc /end AXIS_DESCR
/end CHARACTERISTIC
/begin CHARACTERISTIC fmy_id_tia_el.dtc "DTC table declaration for the diagnosis instance XX" MAP 0xa1004d64 _REC_MAP_20_u2_u2_u2 65535. _CNV_A_R_LINEAR_____0_CM 0. 65535. DISPLAY_IDENTIFIER ID_ERR_DTC_TIA_EL FORMAT "%5.0"
 /begin AXIS_DESCR COM_AXIS errm_online_dummy _CNV_S_2_ERRM_DTC_R_483_CM 1 0. 1. AXIS_PTS_REF ldp_nr_1_id_err_dtc /end AXIS_DESCR
 /begin AXIS_DESCR COM_AXIS errm_online_dummy _CNV_S_6_ERRM_DTC_R_484_CM 6 0. 5. AXIS_PTS_REF ldp_nr_2_id_err_dtc /end AXIS_DESCR
/end CHARACTERISTIC
/begin CHARACTERISTIC fmy_id_amp.dtc "DTC table declaration for the diagnosis instance XX" MAP 0xa100398c _REC_MAP_20_u2_u2_u2 65535. _CNV_A_R_LINEAR_____0_CM 0. 65535. DISPLAY_IDENTIFIER ID_ERR_DTC_AMP FORMAT "%5.0"
 /begin AXIS_DESCR COM_AXIS errm_online_dummy _CNV_S_2_ERRM_DTC_R_483_CM 1 0. 1. AXIS_PTS_REF ldp_nr_1_id_err_dtc /end AXIS_DESCR
 /begin AXIS_DESCR COM_AXIS errm_online_dummy _CNV_S_6_ERRM_DTC_R_484_CM 6 0. 5. AXIS_PTS_REF ldp_nr_2_id_err_dtc /end AXIS_DESCR
/end CHARACTERISTIC
/begin CHARACTERISTIC fmy_id_amp_plaus.dtc "DTC table declaration for the diagnosis instance XX" MAP 0xa10039a0 _REC_MAP_20_u2_u2_u2 65535. _CNV_A_R_LINEAR_____0_CM 0. 65535. DISPLAY_IDENTIFIER ID_ERR_DTC_AMP_PLAUS FORMAT "%5.0"
 /begin AXIS_DESCR COM_AXIS errm_online_dummy _CNV_S_2_ERRM_DTC_R_483_CM 1 0. 1. AXIS_PTS_REF ldp_nr_1_id_err_dtc /end AXIS_DESCR
 /begin AXIS_DESCR COM_AXIS errm_online_dummy _CNV_S_6_ERRM_DTC_R_484_CM 6 0. 5. AXIS_PTS_REF ldp_nr_2_id_err_dtc /end AXIS_DESCR
/end CHARACTERISTIC
/begin CHARACTERISTIC fmy_id_maf.dtc "DTC table declaration for the diagnosis instance XX" MAP 0xa10044f4 _REC_MAP_20_u2_u2_u2 65535. _CNV_A_R_LINEAR_____0_CM 0. 65535. DISPLAY_IDENTIFIER ID_ERR_DTC_MAF FORMAT "%5.0"
 /begin AXIS_DESCR COM_AXIS errm_online_dummy _CNV_S_2_ERRM_DTC_R_483_CM 1 0. 1. AXIS_PTS_REF ldp_nr_1_id_err_dtc /end AXIS_DESCR
 /begin AXIS_DESCR COM_AXIS errm_online_dummy _CNV_S_6_ERRM_DTC_R_484_CM 6 0. 5. AXIS_PTS_REF ldp_nr_2_id_err_dtc /end AXIS_DESCR
/end CHARACTERISTIC
/begin CHARACTERISTIC fmy_id_iv_0.dtc "DTC table declaration for the diagnosis instance XX" MAP 0xa1004364 _REC_MAP_20_u2_u2_u2 65535. _CNV_A_R_LINEAR_____0_CM 0. 65535. DISPLAY_IDENTIFIER ID_ERR_DTC_IV_0 FORMAT "%5.0"
 /begin AXIS_DESCR COM_AXIS errm_online_dummy _CNV_S_2_ERRM_DTC_R_483_CM 1 0. 1. AXIS_PTS_REF ldp_nr_1_id_err_dtc /end AXIS_DESCR
 /begin AXIS_DESCR COM_AXIS errm_online_dummy _CNV_S_6_ERRM_DTC_R_484_CM 6 0. 5. AXIS_PTS_REF ldp_nr_2_id_err_dtc /end AXIS_DESCR
/end CHARACTERISTIC
/begin CHARACTERISTIC fmy_id_iv_1.dtc "DTC table declaration for the diagnosis instance XX" MAP 0xa1004378 _REC_MAP_20_u2_u2_u2 65535. _CNV_A_R_LINEAR_____0_CM 0. 65535. DISPLAY_IDENTIFIER ID_ERR_DTC_IV_1 FORMAT "%5.0"
 /begin AXIS_DESCR COM_AXIS errm_online_dummy _CNV_S_2_ERRM_DTC_R_483_CM 1 0. 1. AXIS_PTS_REF ldp_nr_1_id_err_dtc /end AXIS_DESCR
 /begin AXIS_DESCR COM_AXIS errm_online_dummy _CNV_S_6_ERRM_DTC_R_484_CM 6 0. 5. AXIS_PTS_REF ldp_nr_2_id_err_dtc /end AXIS_DESCR
/end CHARACTERISTIC
/begin CHARACTERISTIC fmy_id_iv_2.dtc "DTC table declaration for the diagnosis instance XX" MAP 0xa100438c _REC_MAP_20_u2_u2_u2 65535. _CNV_A_R_LINEAR_____0_CM 0. 65535. DISPLAY_IDENTIFIER ID_ERR_DTC_IV_2 FORMAT "%5.0"
 /begin AXIS_DESCR COM_AXIS errm_online_dummy _CNV_S_2_ERRM_DTC_R_483_CM 1 0. 1. AXIS_PTS_REF ldp_nr_1_id_err_dtc /end AXIS_DESCR
 /begin AXIS_DESCR COM_AXIS errm_online_dummy _CNV_S_6_ERRM_DTC_R_484_CM 6 0. 5. AXIS_PTS_REF ldp_nr_2_id_err_dtc /end AXIS_DESCR
/end CHARACTERISTIC
/begin CHARACTERISTIC fmy_id_iv_3.dtc "DTC table declaration for the diagnosis instance XX" MAP 0xa10043a0 _REC_MAP_20_u2_u2_u2 65535. _CNV_A_R_LINEAR_____0_CM 0. 65535. DISPLAY_IDENTIFIER ID_ERR_DTC_IV_3 FORMAT "%5.0"
 /begin AXIS_DESCR COM_AXIS errm_online_dummy _CNV_S_2_ERRM_DTC_R_483_CM 1 0. 1. AXIS_PTS_REF ldp_nr_1_id_err_dtc /end AXIS_DESCR
 /begin AXIS_DESCR COM_AXIS errm_online_dummy _CNV_S_6_ERRM_DTC_R_484_CM 6 0. 5. AXIS_PTS_REF ldp_nr_2_id_err_dtc /end AXIS_DESCR
/end CHARACTERISTIC
/begin CHARACTERISTIC fmy_id_iv_4.dtc "DTC table declaration for the diagnosis instance XX" MAP 0xa10043b4 _REC_MAP_20_u2_u2_u2 65535. _CNV_A_R_LINEAR_____0_CM 0. 65535. DISPLAY_IDENTIFIER ID_ERR_DTC_IV_4 FORMAT "%5.0"
 /begin AXIS_DESCR COM_AXIS errm_online_dummy _CNV_S_2_ERRM_DTC_R_483_CM 1 0. 1. AXIS_PTS_REF ldp_nr_1_id_err_dtc /end AXIS_DESCR
 /begin AXIS_DESCR COM_AXIS errm_online_dummy _CNV_S_6_ERRM_DTC_R_484_CM 6 0. 5. AXIS_PTS_REF ldp_nr_2_id_err_dtc /end AXIS_DESCR
/end CHARACTERISTIC
/begin CHARACTERISTIC fmy_id_iv_5.dtc "DTC table declaration for the diagnosis instance XX" MAP 0xa10043c8 _REC_MAP_20_u2_u2_u2 65535. _CNV_A_R_LINEAR_____0_CM 0. 65535. DISPLAY_IDENTIFIER ID_ERR_DTC_IV_5 FORMAT "%5.0"
 /begin AXIS_DESCR COM_AXIS errm_online_dummy _CNV_S_2_ERRM_DTC_R_483_CM 1 0. 1. AXIS_PTS_REF ldp_nr_1_id_err_dtc /end AXIS_DESCR
 /begin AXIS_DESCR COM_AXIS errm_online_dummy _CNV_S_6_ERRM_DTC_R_484_CM 6 0. 5. AXIS_PTS_REF ldp_nr_2_id_err_dtc /end AXIS_DESCR
/end CHARACTERISTIC
/begin CHARACTERISTIC fmy_id_rly_efp.dtc "DTC table declaration for the diagnosis instance XX" MAP 0xa10049e0 _REC_MAP_20_u2_u2_u2 65535. _CNV_A_R_LINEAR_____0_CM 0. 65535. DISPLAY_IDENTIFIER ID_ERR_DTC_RLY_EFP FORMAT "%5.0"
 /begin AXIS_DESCR COM_AXIS errm_online_dummy _CNV_S_2_ERRM_DTC_R_483_CM 1 0. 1. AXIS_PTS_REF ldp_nr_1_id_err_dtc /end AXIS_DESCR
 /begin AXIS_DESCR COM_AXIS errm_online_dummy _CNV_S_6_ERRM_DTC_R_484_CM 6 0. 5. AXIS_PTS_REF ldp_nr_2_id_err_dtc /end AXIS_DESCR
/end CHARACTERISTIC
/begin CHARACTERISTIC fmy_id_el_cps.dtc "DTC table declaration for the diagnosis instance XX" MAP 0xa1004030 _REC_MAP_20_u2_u2_u2 65535. _CNV_A_R_LINEAR_____0_CM 0. 65535. DISPLAY_IDENTIFIER ID_ERR_DTC_EL_CPS FORMAT "%5.0"
 /begin AXIS_DESCR COM_AXIS errm_online_dummy _CNV_S_2_ERRM_DTC_R_483_CM 1 0. 1. AXIS_PTS_REF ldp_nr_1_id_err_dtc /end AXIS_DESCR
 /begin AXIS_DESCR COM_AXIS errm_online_dummy _CNV_S_6_ERRM_DTC_R_484_CM 6 0. 5. AXIS_PTS_REF ldp_nr_2_id_err_dtc /end AXIS_DESCR
/end CHARACTERISTIC
/begin CHARACTERISTIC fmy_id_slv_ivvt_in.dtc "DTC table declaration for the diagnosis instance XX" MAP 0xa1004b48 _REC_MAP_20_u2_u2_u2 65535. _CNV_A_R_LINEAR_____0_CM 0. 65535. DISPLAY_IDENTIFIER ID_ERR_DTC_SLV_IVVT_IN FORMAT "%5.0"
 /begin AXIS_DESCR COM_AXIS errm_online_dummy _CNV_S_2_ERRM_DTC_R_483_CM 1 0. 1. AXIS_PTS_REF ldp_nr_1_id_err_dtc /end AXIS_DESCR
 /begin AXIS_DESCR COM_AXIS errm_online_dummy _CNV_S_6_ERRM_DTC_R_484_CM 6 0. 5. AXIS_PTS_REF ldp_nr_2_id_err_dtc /end AXIS_DESCR
/end CHARACTERISTIC
/begin CHARACTERISTIC fmy_id_slv_ivvt_ex.dtc "DTC table declaration for the diagnosis instance XX" MAP 0xa1004b34 _REC_MAP_20_u2_u2_u2 65535. _CNV_A_R_LINEAR_____0_CM 0. 65535. DISPLAY_IDENTIFIER ID_ERR_DTC_SLV_IVVT_EX FORMAT "%5.0"
 /begin AXIS_DESCR COM_AXIS errm_online_dummy _CNV_S_2_ERRM_DTC_R_483_CM 1 0. 1. AXIS_PTS_REF ldp_nr_1_id_err_dtc /end AXIS_DESCR
 /begin AXIS_DESCR COM_AXIS errm_online_dummy _CNV_S_6_ERRM_DTC_R_484_CM 6 0. 5. AXIS_PTS_REF ldp_nr_2_id_err_dtc /end AXIS_DESCR
/end CHARACTERISTIC
/begin CHARACTERISTIC fmy_id_ecu_cks.dtc "DTC table declaration for the diagnosis instance XX" MAP 0xa1003f90 _REC_MAP_20_u2_u2_u2 65535. _CNV_A_R_LINEAR_____0_CM 0. 65535. DISPLAY_IDENTIFIER ID_ERR_DTC_ECU_CKS FORMAT "%5.0"
 /begin AXIS_DESCR COM_AXIS errm_online_dummy _CNV_S_2_ERRM_DTC_R_483_CM 1 0. 1. AXIS_PTS_REF ldp_nr_1_id_err_dtc /end AXIS_DESCR
 /begin AXIS_DESCR COM_AXIS errm_online_dummy _CNV_S_6_ERRM_DTC_R_484_CM 6 0. 5. AXIS_PTS_REF ldp_nr_2_id_err_dtc /end AXIS_DESCR
/end CHARACTERISTIC
/begin CHARACTERISTIC fmy_id_tout_etcu_1.dtc "DTC table declaration for the diagnosis instance XX" MAP 0xa1004e04 _REC_MAP_20_u2_u2_u2 65535. _CNV_A_R_LINEAR_____0_CM 0. 65535. DISPLAY_IDENTIFIER ID_ERR_DTC_TOUT_ETCU_1 FORMAT "%5.0"
 /begin AXIS_DESCR COM_AXIS errm_online_dummy _CNV_S_2_ERRM_DTC_R_483_CM 1 0. 1. AXIS_PTS_REF ldp_nr_1_id_err_dtc /end AXIS_DESCR
 /begin AXIS_DESCR COM_AXIS errm_online_dummy _CNV_S_6_ERRM_DTC_R_484_CM 6 0. 5. AXIS_PTS_REF ldp_nr_2_id_err_dtc /end AXIS_DESCR
/end CHARACTERISTIC
/begin CHARACTERISTIC fmy_id_tout_etcu_2.dtc "DTC table declaration for the diagnosis instance XX" MAP 0xa1004e18 _REC_MAP_20_u2_u2_u2 65535. _CNV_A_R_LINEAR_____0_CM 0. 65535. DISPLAY_IDENTIFIER ID_ERR_DTC_TOUT_ETCU_2 FORMAT "%5.0"
 /begin AXIS_DESCR COM_AXIS errm_online_dummy _CNV_S_2_ERRM_DTC_R_483_CM 1 0. 1. AXIS_PTS_REF ldp_nr_1_id_err_dtc /end AXIS_DESCR
 /begin AXIS_DESCR COM_AXIS errm_online_dummy _CNV_S_6_ERRM_DTC_R_484_CM 6 0. 5. AXIS_PTS_REF ldp_nr_2_id_err_dtc /end AXIS_DESCR
/end CHARACTERISTIC
/begin CHARACTERISTIC fmy_id_tout_icl_2.dtc "DTC table declaration for the diagnosis instance XX" MAP 0xa1004e2c _REC_MAP_20_u2_u2_u2 65535. _CNV_A_R_LINEAR_____0_CM 0. 65535. DISPLAY_IDENTIFIER ID_ERR_DTC_TOUT_ICL_2 FORMAT "%5.0"
 /begin AXIS_DESCR COM_AXIS errm_online_dummy _CNV_S_2_ERRM_DTC_R_483_CM 1 0. 1. AXIS_PTS_REF ldp_nr_1_id_err_dtc /end AXIS_DESCR
 /begin AXIS_DESCR COM_AXIS errm_online_dummy _CNV_S_6_ERRM_DTC_R_484_CM 6 0. 5. AXIS_PTS_REF ldp_nr_2_id_err_dtc /end AXIS_DESCR
/end CHARACTERISTIC
/begin CHARACTERISTIC fmy_id_tout_icl_3.dtc "DTC table declaration for the diagnosis instance XX" MAP 0xa1004e40 _REC_MAP_20_u2_u2_u2 65535. _CNV_A_R_LINEAR_____0_CM 0. 65535. DISPLAY_IDENTIFIER ID_ERR_DTC_TOUT_ICL_3 FORMAT "%5.0"
 /begin AXIS_DESCR COM_AXIS errm_online_dummy _CNV_S_2_ERRM_DTC_R_483_CM 1 0. 1. AXIS_PTS_REF ldp_nr_1_id_err_dtc /end AXIS_DESCR
 /begin AXIS_DESCR COM_AXIS errm_online_dummy _CNV_S_6_ERRM_DTC_R_484_CM 6 0. 5. AXIS_PTS_REF ldp_nr_2_id_err_dtc /end AXIS_DESCR
/end CHARACTERISTIC
/begin CHARACTERISTIC fmy_id_tout_asr_1.dtc "DTC table declaration for the diagnosis instance XX" MAP 0xa1004db4 _REC_MAP_20_u2_u2_u2 65535. _CNV_A_R_LINEAR_____0_CM 0. 65535. DISPLAY_IDENTIFIER ID_ERR_DTC_TOUT_ASR_1 FORMAT "%5.0"
 /begin AXIS_DESCR COM_AXIS errm_online_dummy _CNV_S_2_ERRM_DTC_R_483_CM 1 0. 1. AXIS_PTS_REF ldp_nr_1_id_err_dtc /end AXIS_DESCR
 /begin AXIS_DESCR COM_AXIS errm_online_dummy _CNV_S_6_ERRM_DTC_R_484_CM 6 0. 5. AXIS_PTS_REF ldp_nr_2_id_err_dtc /end AXIS_DESCR
/end CHARACTERISTIC
/begin CHARACTERISTIC fmy_id_tout_asr_3.dtc "DTC table declaration for the diagnosis instance XX" MAP 0xa1004dc8 _REC_MAP_20_u2_u2_u2 65535. _CNV_A_R_LINEAR_____0_CM 0. 65535. DISPLAY_IDENTIFIER ID_ERR_DTC_TOUT_ASR_3 FORMAT "%5.0"
 /begin AXIS_DESCR COM_AXIS errm_online_dummy _CNV_S_2_ERRM_DTC_R_483_CM 1 0. 1. AXIS_PTS_REF ldp_nr_1_id_err_dtc /end AXIS_DESCR
 /begin AXIS_DESCR COM_AXIS errm_online_dummy _CNV_S_6_ERRM_DTC_R_484_CM 6 0. 5. AXIS_PTS_REF ldp_nr_2_id_err_dtc /end AXIS_DESCR
/end CHARACTERISTIC
/begin CHARACTERISTIC fmy_id_tout_asr_4.dtc "DTC table declaration for the diagnosis instance XX" MAP 0xa1004ddc _REC_MAP_20_u2_u2_u2 65535. _CNV_A_R_LINEAR_____0_CM 0. 65535. DISPLAY_IDENTIFIER ID_ERR_DTC_TOUT_ASR_4 FORMAT "%5.0"
 /begin AXIS_DESCR COM_AXIS errm_online_dummy _CNV_S_2_ERRM_DTC_R_483_CM 1 0. 1. AXIS_PTS_REF ldp_nr_1_id_err_dtc /end AXIS_DESCR
 /begin AXIS_DESCR COM_AXIS errm_online_dummy _CNV_S_6_ERRM_DTC_R_484_CM 6 0. 5. AXIS_PTS_REF ldp_nr_2_id_err_dtc /end AXIS_DESCR
/end CHARACTERISTIC
/begin CHARACTERISTIC fmy_id_tout_pste_1.dtc "DTC table declaration for the diagnosis instance XX" MAP 0xa1004e7c _REC_MAP_20_u2_u2_u2 65535. _CNV_A_R_LINEAR_____0_CM 0. 65535. DISPLAY_IDENTIFIER ID_ERR_DTC_TOUT_PSTE_1 FORMAT "%5.0"
 /begin AXIS_DESCR COM_AXIS errm_online_dummy _CNV_S_2_ERRM_DTC_R_483_CM 1 0. 1. AXIS_PTS_REF ldp_nr_1_id_err_dtc /end AXIS_DESCR
 /begin AXIS_DESCR COM_AXIS errm_online_dummy _CNV_S_6_ERRM_DTC_R_484_CM 6 0. 5. AXIS_PTS_REF ldp_nr_2_id_err_dtc /end AXIS_DESCR
/end CHARACTERISTIC
/begin CHARACTERISTIC fmy_id_tout_amt_1.dtc "DTC table declaration for the diagnosis instance XX" MAP 0xa1004da0 _REC_MAP_20_u2_u2_u2 65535. _CNV_A_R_LINEAR_____0_CM 0. 65535. DISPLAY_IDENTIFIER ID_ERR_DTC_TOUT_AMT_1 FORMAT "%5.0"
 /begin AXIS_DESCR COM_AXIS errm_online_dummy _CNV_S_2_ERRM_DTC_R_483_CM 1 0. 1. AXIS_PTS_REF ldp_nr_1_id_err_dtc /end AXIS_DESCR
 /begin AXIS_DESCR COM_AXIS errm_online_dummy _CNV_S_6_ERRM_DTC_R_484_CM 6 0. 5. AXIS_PTS_REF ldp_nr_2_id_err_dtc /end AXIS_DESCR
/end CHARACTERISTIC
/begin CHARACTERISTIC fmy_id_vs.dtc "DTC table declaration for the diagnosis instance XX" MAP 0xa10050d4 _REC_MAP_20_u2_u2_u2 65535. _CNV_A_R_LINEAR_____0_CM 0. 65535. DISPLAY_IDENTIFIER ID_ERR_DTC_VS FORMAT "%5.0"
 /begin AXIS_DESCR COM_AXIS errm_online_dummy _CNV_S_2_ERRM_DTC_R_483_CM 1 0. 1. AXIS_PTS_REF ldp_nr_1_id_err_dtc /end AXIS_DESCR
 /begin AXIS_DESCR COM_AXIS errm_online_dummy _CNV_S_6_ERRM_DTC_R_484_CM 6 0. 5. AXIS_PTS_REF ldp_nr_2_id_err_dtc /end AXIS_DESCR
/end CHARACTERISTIC
/begin CHARACTERISTIC fmy_id_knks_1.dtc "DTC table declaration for the diagnosis instance XX" MAP 0xa10043dc _REC_MAP_20_u2_u2_u2 65535. _CNV_A_R_LINEAR_____0_CM 0. 65535. DISPLAY_IDENTIFIER ID_ERR_DTC_KNKS_1 FORMAT "%5.0"
 /begin AXIS_DESCR COM_AXIS errm_online_dummy _CNV_S_2_ERRM_DTC_R_483_CM 1 0. 1. AXIS_PTS_REF ldp_nr_1_id_err_dtc /end AXIS_DESCR
 /begin AXIS_DESCR COM_AXIS errm_online_dummy _CNV_S_6_ERRM_DTC_R_484_CM 6 0. 5. AXIS_PTS_REF ldp_nr_2_id_err_dtc /end AXIS_DESCR
/end CHARACTERISTIC
/begin CHARACTERISTIC fmy_id_knks_2.dtc "DTC table declaration for the diagnosis instance XX" MAP 0xa10043f0 _REC_MAP_20_u2_u2_u2 65535. _CNV_A_R_LINEAR_____0_CM 0. 65535. DISPLAY_IDENTIFIER ID_ERR_DTC_KNKS_2 FORMAT "%5.0"
 /begin AXIS_DESCR COM_AXIS errm_online_dummy _CNV_S_2_ERRM_DTC_R_483_CM 1 0. 1. AXIS_PTS_REF ldp_nr_1_id_err_dtc /end AXIS_DESCR
 /begin AXIS_DESCR COM_AXIS errm_online_dummy _CNV_S_6_ERRM_DTC_R_484_CM 6 0. 5. AXIS_PTS_REF ldp_nr_2_id_err_dtc /end AXIS_DESCR
/end CHARACTERISTIC
/begin CHARACTERISTIC fmy_id_igc_scp_0.dtc "DTC table declaration for the diagnosis instance XX" MAP 0xa1004274 _REC_MAP_20_u2_u2_u2 65535. _CNV_A_R_LINEAR_____0_CM 0. 65535. DISPLAY_IDENTIFIER ID_ERR_DTC_IGC_SCP_0 FORMAT "%5.0"
 /begin AXIS_DESCR COM_AXIS errm_online_dummy _CNV_S_2_ERRM_DTC_R_483_CM 1 0. 1. AXIS_PTS_REF ldp_nr_1_id_err_dtc /end AXIS_DESCR
 /begin AXIS_DESCR COM_AXIS errm_online_dummy _CNV_S_6_ERRM_DTC_R_484_CM 6 0. 5. AXIS_PTS_REF ldp_nr_2_id_err_dtc /end AXIS_DESCR
/end CHARACTERISTIC
/begin CHARACTERISTIC fmy_id_igc_scp_1.dtc "DTC table declaration for the diagnosis instance XX" MAP 0xa1004288 _REC_MAP_20_u2_u2_u2 65535. _CNV_A_R_LINEAR_____0_CM 0. 65535. DISPLAY_IDENTIFIER ID_ERR_DTC_IGC_SCP_1 FORMAT "%5.0"
 /begin AXIS_DESCR COM_AXIS errm_online_dummy _CNV_S_2_ERRM_DTC_R_483_CM 1 0. 1. AXIS_PTS_REF ldp_nr_1_id_err_dtc /end AXIS_DESCR
 /begin AXIS_DESCR COM_AXIS errm_online_dummy _CNV_S_6_ERRM_DTC_R_484_CM 6 0. 5. AXIS_PTS_REF ldp_nr_2_id_err_dtc /end AXIS_DESCR
/end CHARACTERISTIC
/begin CHARACTERISTIC fmy_id_igc_scp_2.dtc "DTC table declaration for the diagnosis instance XX" MAP 0xa100429c _REC_MAP_20_u2_u2_u2 65535. _CNV_A_R_LINEAR_____0_CM 0. 65535. DISPLAY_IDENTIFIER ID_ERR_DTC_IGC_SCP_2 FORMAT "%5.0"
 /begin AXIS_DESCR COM_AXIS errm_online_dummy _CNV_S_2_ERRM_DTC_R_483_CM 1 0. 1. AXIS_PTS_REF ldp_nr_1_id_err_dtc /end AXIS_DESCR
 /begin AXIS_DESCR COM_AXIS errm_online_dummy _CNV_S_6_ERRM_DTC_R_484_CM 6 0. 5. AXIS_PTS_REF ldp_nr_2_id_err_dtc /end AXIS_DESCR
/end CHARACTERISTIC
/begin CHARACTERISTIC fmy_id_igc_scp_3.dtc "DTC table declaration for the diagnosis instance XX" MAP 0xa10042b0 _REC_MAP_20_u2_u2_u2 65535. _CNV_A_R_LINEAR_____0_CM 0. 65535. DISPLAY_IDENTIFIER ID_ERR_DTC_IGC_SCP_3 FORMAT "%5.0"
 /begin AXIS_DESCR COM_AXIS errm_online_dummy _CNV_S_2_ERRM_DTC_R_483_CM 1 0. 1. AXIS_PTS_REF ldp_nr_1_id_err_dtc /end AXIS_DESCR
 /begin AXIS_DESCR COM_AXIS errm_online_dummy _CNV_S_6_ERRM_DTC_R_484_CM 6 0. 5. AXIS_PTS_REF ldp_nr_2_id_err_dtc /end AXIS_DESCR
/end CHARACTERISTIC
/begin CHARACTERISTIC fmy_id_igc_scp_4.dtc "DTC table declaration for the diagnosis instance XX" MAP 0xa10042c4 _REC_MAP_20_u2_u2_u2 65535. _CNV_A_R_LINEAR_____0_CM 0. 65535. DISPLAY_IDENTIFIER ID_ERR_DTC_IGC_SCP_4 FORMAT "%5.0"
 /begin AXIS_DESCR COM_AXIS errm_online_dummy _CNV_S_2_ERRM_DTC_R_483_CM 1 0. 1. AXIS_PTS_REF ldp_nr_1_id_err_dtc /end AXIS_DESCR
 /begin AXIS_DESCR COM_AXIS errm_online_dummy _CNV_S_6_ERRM_DTC_R_484_CM 6 0. 5. AXIS_PTS_REF ldp_nr_2_id_err_dtc /end AXIS_DESCR
/end CHARACTERISTIC
/begin CHARACTERISTIC fmy_id_igc_scp_5.dtc "DTC table declaration for the diagnosis instance XX" MAP 0xa10042d8 _REC_MAP_20_u2_u2_u2 65535. _CNV_A_R_LINEAR_____0_CM 0. 65535. DISPLAY_IDENTIFIER ID_ERR_DTC_IGC_SCP_5 FORMAT "%5.0"
 /begin AXIS_DESCR COM_AXIS errm_online_dummy _CNV_S_2_ERRM_DTC_R_483_CM 1 0. 1. AXIS_PTS_REF ldp_nr_1_id_err_dtc /end AXIS_DESCR
 /begin AXIS_DESCR COM_AXIS errm_online_dummy _CNV_S_6_ERRM_DTC_R_484_CM 6 0. 5. AXIS_PTS_REF ldp_nr_2_id_err_dtc /end AXIS_DESCR
/end CHARACTERISTIC
/begin CHARACTERISTIC fmy_id_igc_scg_0.dtc "DTC table declaration for the diagnosis instance XX" MAP 0xa10041fc _REC_MAP_20_u2_u2_u2 65535. _CNV_A_R_LINEAR_____0_CM 0. 65535. DISPLAY_IDENTIFIER ID_ERR_DTC_IGC_SCG_0 FORMAT "%5.0"
 /begin AXIS_DESCR COM_AXIS errm_online_dummy _CNV_S_2_ERRM_DTC_R_483_CM 1 0. 1. AXIS_PTS_REF ldp_nr_1_id_err_dtc /end AXIS_DESCR
 /begin AXIS_DESCR COM_AXIS errm_online_dummy _CNV_S_6_ERRM_DTC_R_484_CM 6 0. 5. AXIS_PTS_REF ldp_nr_2_id_err_dtc /end AXIS_DESCR
/end CHARACTERISTIC
/begin CHARACTERISTIC fmy_id_igc_scg_1.dtc "DTC table declaration for the diagnosis instance XX" MAP 0xa1004210 _REC_MAP_20_u2_u2_u2 65535. _CNV_A_R_LINEAR_____0_CM 0. 65535. DISPLAY_IDENTIFIER ID_ERR_DTC_IGC_SCG_1 FORMAT "%5.0"
 /begin AXIS_DESCR COM_AXIS errm_online_dummy _CNV_S_2_ERRM_DTC_R_483_CM 1 0. 1. AXIS_PTS_REF ldp_nr_1_id_err_dtc /end AXIS_DESCR
 /begin AXIS_DESCR COM_AXIS errm_online_dummy _CNV_S_6_ERRM_DTC_R_484_CM 6 0. 5. AXIS_PTS_REF ldp_nr_2_id_err_dtc /end AXIS_DESCR
/end CHARACTERISTIC
/begin CHARACTERISTIC fmy_id_igc_scg_2.dtc "DTC table declaration for the diagnosis instance XX" MAP 0xa1004224 _REC_MAP_20_u2_u2_u2 65535. _CNV_A_R_LINEAR_____0_CM 0. 65535. DISPLAY_IDENTIFIER ID_ERR_DTC_IGC_SCG_2 FORMAT "%5.0"
 /begin AXIS_DESCR COM_AXIS errm_online_dummy _CNV_S_2_ERRM_DTC_R_483_CM 1 0. 1. AXIS_PTS_REF ldp_nr_1_id_err_dtc /end AXIS_DESCR
 /begin AXIS_DESCR COM_AXIS errm_online_dummy _CNV_S_6_ERRM_DTC_R_484_CM 6 0. 5. AXIS_PTS_REF ldp_nr_2_id_err_dtc /end AXIS_DESCR
/end CHARACTERISTIC
/begin CHARACTERISTIC fmy_id_igc_scg_3.dtc "DTC table declaration for the diagnosis instance XX" MAP 0xa1004238 _REC_MAP_20_u2_u2_u2 65535. _CNV_A_R_LINEAR_____0_CM 0. 65535. DISPLAY_IDENTIFIER ID_ERR_DTC_IGC_SCG_3 FORMAT "%5.0"
 /begin AXIS_DESCR COM_AXIS errm_online_dummy _CNV_S_2_ERRM_DTC_R_483_CM 1 0. 1. AXIS_PTS_REF ldp_nr_1_id_err_dtc /end AXIS_DESCR
 /begin AXIS_DESCR COM_AXIS errm_online_dummy _CNV_S_6_ERRM_DTC_R_484_CM 6 0. 5. AXIS_PTS_REF ldp_nr_2_id_err_dtc /end AXIS_DESCR
/end CHARACTERISTIC
/begin CHARACTERISTIC fmy_id_igc_scg_4.dtc "DTC table declaration for the diagnosis instance XX" MAP 0xa100424c _REC_MAP_20_u2_u2_u2 65535. _CNV_A_R_LINEAR_____0_CM 0. 65535. DISPLAY_IDENTIFIER ID_ERR_DTC_IGC_SCG_4 FORMAT "%5.0"
 /begin AXIS_DESCR COM_AXIS errm_online_dummy _CNV_S_2_ERRM_DTC_R_483_CM 1 0. 1. AXIS_PTS_REF ldp_nr_1_id_err_dtc /end AXIS_DESCR
 /begin AXIS_DESCR COM_AXIS errm_online_dummy _CNV_S_6_ERRM_DTC_R_484_CM 6 0. 5. AXIS_PTS_REF ldp_nr_2_id_err_dtc /end AXIS_DESCR
/end CHARACTERISTIC
/begin CHARACTERISTIC fmy_id_igc_scg_5.dtc "DTC table declaration for the diagnosis instance XX" MAP 0xa1004260 _REC_MAP_20_u2_u2_u2 65535. _CNV_A_R_LINEAR_____0_CM 0. 65535. DISPLAY_IDENTIFIER ID_ERR_DTC_IGC_SCG_5 FORMAT "%5.0"
 /begin AXIS_DESCR COM_AXIS errm_online_dummy _CNV_S_2_ERRM_DTC_R_483_CM 1 0. 1. AXIS_PTS_REF ldp_nr_1_id_err_dtc /end AXIS_DESCR
 /begin AXIS_DESCR COM_AXIS errm_online_dummy _CNV_S_6_ERRM_DTC_R_484_CM 6 0. 5. AXIS_PTS_REF ldp_nr_2_id_err_dtc /end AXIS_DESCR
/end CHARACTERISTIC
/begin CHARACTERISTIC fmy_id_igc_ol_0.dtc "DTC table declaration for the diagnosis instance XX" MAP 0xa1004184 _REC_MAP_20_u2_u2_u2 65535. _CNV_A_R_LINEAR_____0_CM 0. 65535. DISPLAY_IDENTIFIER ID_ERR_DTC_IGC_OL_0 FORMAT "%5.0"
 /begin AXIS_DESCR COM_AXIS errm_online_dummy _CNV_S_2_ERRM_DTC_R_483_CM 1 0. 1. AXIS_PTS_REF ldp_nr_1_id_err_dtc /end AXIS_DESCR
 /begin AXIS_DESCR COM_AXIS errm_online_dummy _CNV_S_6_ERRM_DTC_R_484_CM 6 0. 5. AXIS_PTS_REF ldp_nr_2_id_err_dtc /end AXIS_DESCR
/end CHARACTERISTIC
/begin CHARACTERISTIC fmy_id_igc_ol_1.dtc "DTC table declaration for the diagnosis instance XX" MAP 0xa1004198 _REC_MAP_20_u2_u2_u2 65535. _CNV_A_R_LINEAR_____0_CM 0. 65535. DISPLAY_IDENTIFIER ID_ERR_DTC_IGC_OL_1 FORMAT "%5.0"
 /begin AXIS_DESCR COM_AXIS errm_online_dummy _CNV_S_2_ERRM_DTC_R_483_CM 1 0. 1. AXIS_PTS_REF ldp_nr_1_id_err_dtc /end AXIS_DESCR
 /begin AXIS_DESCR COM_AXIS errm_online_dummy _CNV_S_6_ERRM_DTC_R_484_CM 6 0. 5. AXIS_PTS_REF ldp_nr_2_id_err_dtc /end AXIS_DESCR
/end CHARACTERISTIC
/begin CHARACTERISTIC fmy_id_igc_ol_2.dtc "DTC table declaration for the diagnosis instance XX" MAP 0xa10041ac _REC_MAP_20_u2_u2_u2 65535. _CNV_A_R_LINEAR_____0_CM 0. 65535. DISPLAY_IDENTIFIER ID_ERR_DTC_IGC_OL_2 FORMAT "%5.0"
 /begin AXIS_DESCR COM_AXIS errm_online_dummy _CNV_S_2_ERRM_DTC_R_483_CM 1 0. 1. AXIS_PTS_REF ldp_nr_1_id_err_dtc /end AXIS_DESCR
 /begin AXIS_DESCR COM_AXIS errm_online_dummy _CNV_S_6_ERRM_DTC_R_484_CM 6 0. 5. AXIS_PTS_REF ldp_nr_2_id_err_dtc /end AXIS_DESCR
/end CHARACTERISTIC
/begin CHARACTERISTIC fmy_id_igc_ol_3.dtc "DTC table declaration for the diagnosis instance XX" MAP 0xa10041c0 _REC_MAP_20_u2_u2_u2 65535. _CNV_A_R_LINEAR_____0_CM 0. 65535. DISPLAY_IDENTIFIER ID_ERR_DTC_IGC_OL_3 FORMAT "%5.0"
 /begin AXIS_DESCR COM_AXIS errm_online_dummy _CNV_S_2_ERRM_DTC_R_483_CM 1 0. 1. AXIS_PTS_REF ldp_nr_1_id_err_dtc /end AXIS_DESCR
 /begin AXIS_DESCR COM_AXIS errm_online_dummy _CNV_S_6_ERRM_DTC_R_484_CM 6 0. 5. AXIS_PTS_REF ldp_nr_2_id_err_dtc /end AXIS_DESCR
/end CHARACTERISTIC
/begin CHARACTERISTIC fmy_id_igc_ol_4.dtc "DTC table declaration for the diagnosis instance XX" MAP 0xa10041d4 _REC_MAP_20_u2_u2_u2 65535. _CNV_A_R_LINEAR_____0_CM 0. 65535. DISPLAY_IDENTIFIER ID_ERR_DTC_IGC_OL_4 FORMAT "%5.0"
 /begin AXIS_DESCR COM_AXIS errm_online_dummy _CNV_S_2_ERRM_DTC_R_483_CM 1 0. 1. AXIS_PTS_REF ldp_nr_1_id_err_dtc /end AXIS_DESCR
 /begin AXIS_DESCR COM_AXIS errm_online_dummy _CNV_S_6_ERRM_DTC_R_484_CM 6 0. 5. AXIS_PTS_REF ldp_nr_2_id_err_dtc /end AXIS_DESCR
/end CHARACTERISTIC
/begin CHARACTERISTIC fmy_id_igc_ol_5.dtc "DTC table declaration for the diagnosis instance XX" MAP 0xa10041e8 _REC_MAP_20_u2_u2_u2 65535. _CNV_A_R_LINEAR_____0_CM 0. 65535. DISPLAY_IDENTIFIER ID_ERR_DTC_IGC_OL_5 FORMAT "%5.0"
 /begin AXIS_DESCR COM_AXIS errm_online_dummy _CNV_S_2_ERRM_DTC_R_483_CM 1 0. 1. AXIS_PTS_REF ldp_nr_1_id_err_dtc /end AXIS_DESCR
 /begin AXIS_DESCR COM_AXIS errm_online_dummy _CNV_S_6_ERRM_DTC_R_484_CM 6 0. 5. AXIS_PTS_REF ldp_nr_2_id_err_dtc /end AXIS_DESCR
/end CHARACTERISTIC
/begin CHARACTERISTIC fmy_id_tps_1.dtc "DTC table declaration for the diagnosis instance XX" MAP 0xa1004e90 _REC_MAP_20_u2_u2_u2 65535. _CNV_A_R_LINEAR_____0_CM 0. 65535. DISPLAY_IDENTIFIER ID_ERR_DTC_TPS_1 FORMAT "%5.0"
 /begin AXIS_DESCR COM_AXIS errm_online_dummy _CNV_S_2_ERRM_DTC_R_483_CM 1 0. 1. AXIS_PTS_REF ldp_nr_1_id_err_dtc /end AXIS_DESCR
 /begin AXIS_DESCR COM_AXIS errm_online_dummy _CNV_S_6_ERRM_DTC_R_484_CM 6 0. 5. AXIS_PTS_REF ldp_nr_2_id_err_dtc /end AXIS_DESCR
/end CHARACTERISTIC
/begin CHARACTERISTIC fmy_id_tps_2.dtc "DTC table declaration for the diagnosis instance XX" MAP 0xa1004ea4 _REC_MAP_20_u2_u2_u2 65535. _CNV_A_R_LINEAR_____0_CM 0. 65535. DISPLAY_IDENTIFIER ID_ERR_DTC_TPS_2 FORMAT "%5.0"
 /begin AXIS_DESCR COM_AXIS errm_online_dummy _CNV_S_2_ERRM_DTC_R_483_CM 1 0. 1. AXIS_PTS_REF ldp_nr_1_id_err_dtc /end AXIS_DESCR
 /begin AXIS_DESCR COM_AXIS errm_online_dummy _CNV_S_6_ERRM_DTC_R_484_CM 6 0. 5. AXIS_PTS_REF ldp_nr_2_id_err_dtc /end AXIS_DESCR
/end CHARACTERISTIC
/begin CHARACTERISTIC fmy_id_tps_maf_1.dtc "DTC table declaration for the diagnosis instance XX" MAP 0xa1004ee0 _REC_MAP_20_u2_u2_u2 65535. _CNV_A_R_LINEAR_____0_CM 0. 65535. DISPLAY_IDENTIFIER ID_ERR_DTC_TPS_MAF_1 FORMAT "%5.0"
 /begin AXIS_DESCR COM_AXIS errm_online_dummy _CNV_S_2_ERRM_DTC_R_483_CM 1 0. 1. AXIS_PTS_REF ldp_nr_1_id_err_dtc /end AXIS_DESCR
 /begin AXIS_DESCR COM_AXIS errm_online_dummy _CNV_S_6_ERRM_DTC_R_484_CM 6 0. 5. AXIS_PTS_REF ldp_nr_2_id_err_dtc /end AXIS_DESCR
/end CHARACTERISTIC
/begin CHARACTERISTIC fmy_id_tps_maf_2.dtc "DTC table declaration for the diagnosis instance XX" MAP 0xa1004ef4 _REC_MAP_20_u2_u2_u2 65535. _CNV_A_R_LINEAR_____0_CM 0. 65535. DISPLAY_IDENTIFIER ID_ERR_DTC_TPS_MAF_2 FORMAT "%5.0"
 /begin AXIS_DESCR COM_AXIS errm_online_dummy _CNV_S_2_ERRM_DTC_R_483_CM 1 0. 1. AXIS_PTS_REF ldp_nr_1_id_err_dtc /end AXIS_DESCR
 /begin AXIS_DESCR COM_AXIS errm_online_dummy _CNV_S_6_ERRM_DTC_R_484_CM 6 0. 5. AXIS_PTS_REF ldp_nr_2_id_err_dtc /end AXIS_DESCR
/end CHARACTERISTIC
/begin CHARACTERISTIC fmy_id_tps_ratio.dtc "DTC table declaration for the diagnosis instance XX" MAP 0xa1004f08 _REC_MAP_20_u2_u2_u2 65535. _CNV_A_R_LINEAR_____0_CM 0. 65535. DISPLAY_IDENTIFIER ID_ERR_DTC_TPS_RATIO FORMAT "%5.0"
 /begin AXIS_DESCR COM_AXIS errm_online_dummy _CNV_S_2_ERRM_DTC_R_483_CM 1 0. 1. AXIS_PTS_REF ldp_nr_1_id_err_dtc /end AXIS_DESCR
 /begin AXIS_DESCR COM_AXIS errm_online_dummy _CNV_S_6_ERRM_DTC_R_484_CM 6 0. 5. AXIS_PTS_REF ldp_nr_2_id_err_dtc /end AXIS_DESCR
/end CHARACTERISTIC
/begin CHARACTERISTIC fmy_id_v_ref_1.dtc "DTC table declaration for the diagnosis instance XX" MAP 0xa1004fd0 _REC_MAP_20_u2_u2_u2 65535. _CNV_A_R_LINEAR_____0_CM 0. 65535. DISPLAY_IDENTIFIER ID_ERR_DTC_V_REF_1 FORMAT "%5.0"
 /begin AXIS_DESCR COM_AXIS errm_online_dummy _CNV_S_2_ERRM_DTC_R_483_CM 1 0. 1. AXIS_PTS_REF ldp_nr_1_id_err_dtc /end AXIS_DESCR
 /begin AXIS_DESCR COM_AXIS errm_online_dummy _CNV_S_6_ERRM_DTC_R_484_CM 6 0. 5. AXIS_PTS_REF ldp_nr_2_id_err_dtc /end AXIS_DESCR
/end CHARACTERISTIC
/begin CHARACTERISTIC fmy_id_v_ref_2.dtc "DTC table declaration for the diagnosis instance XX" MAP 0xa1004fe4 _REC_MAP_20_u2_u2_u2 65535. _CNV_A_R_LINEAR_____0_CM 0. 65535. DISPLAY_IDENTIFIER ID_ERR_DTC_V_REF_2 FORMAT "%5.0"
 /begin AXIS_DESCR COM_AXIS errm_online_dummy _CNV_S_2_ERRM_DTC_R_483_CM 1 0. 1. AXIS_PTS_REF ldp_nr_1_id_err_dtc /end AXIS_DESCR
 /begin AXIS_DESCR COM_AXIS errm_online_dummy _CNV_S_6_ERRM_DTC_R_484_CM 6 0. 5. AXIS_PTS_REF ldp_nr_2_id_err_dtc /end AXIS_DESCR
/end CHARACTERISTIC
/begin CHARACTERISTIC fmy_id_pvs_1.dtc "DTC table declaration for the diagnosis instance XX" MAP 0xa10048c8 _REC_MAP_20_u2_u2_u2 65535. _CNV_A_R_LINEAR_____0_CM 0. 65535. DISPLAY_IDENTIFIER ID_ERR_DTC_PVS_1 FORMAT "%5.0"
 /begin AXIS_DESCR COM_AXIS errm_online_dummy _CNV_S_2_ERRM_DTC_R_483_CM 1 0. 1. AXIS_PTS_REF ldp_nr_1_id_err_dtc /end AXIS_DESCR
 /begin AXIS_DESCR COM_AXIS errm_online_dummy _CNV_S_6_ERRM_DTC_R_484_CM 6 0. 5. AXIS_PTS_REF ldp_nr_2_id_err_dtc /end AXIS_DESCR
/end CHARACTERISTIC
/begin CHARACTERISTIC fmy_id_pvs_2.dtc "DTC table declaration for the diagnosis instance XX" MAP 0xa10048dc _REC_MAP_20_u2_u2_u2 65535. _CNV_A_R_LINEAR_____0_CM 0. 65535. DISPLAY_IDENTIFIER ID_ERR_DTC_PVS_2 FORMAT "%5.0"
 /begin AXIS_DESCR COM_AXIS errm_online_dummy _CNV_S_2_ERRM_DTC_R_483_CM 1 0. 1. AXIS_PTS_REF ldp_nr_1_id_err_dtc /end AXIS_DESCR
 /begin AXIS_DESCR COM_AXIS errm_online_dummy _CNV_S_6_ERRM_DTC_R_484_CM 6 0. 5. AXIS_PTS_REF ldp_nr_2_id_err_dtc /end AXIS_DESCR
/end CHARACTERISTIC
/begin CHARACTERISTIC fmy_id_pvs_ratio.dtc "DTC table declaration for the diagnosis instance XX" MAP 0xa100492c _REC_MAP_20_u2_u2_u2 65535. _CNV_A_R_LINEAR_____0_CM 0. 65535. DISPLAY_IDENTIFIER ID_ERR_DTC_PVS_RATIO FORMAT "%5.0"
 /begin AXIS_DESCR COM_AXIS errm_online_dummy _CNV_S_2_ERRM_DTC_R_483_CM 1 0. 1. AXIS_PTS_REF ldp_nr_1_id_err_dtc /end AXIS_DESCR
 /begin AXIS_DESCR COM_AXIS errm_online_dummy _CNV_S_6_ERRM_DTC_R_484_CM 6 0. 5. AXIS_PTS_REF ldp_nr_2_id_err_dtc /end AXIS_DESCR
/end CHARACTERISTIC
/begin CHARACTERISTIC fmy_id_pvs_double.dtc "DTC table declaration for the diagnosis instance XX" MAP 0xa1004904 _REC_MAP_20_u2_u2_u2 65535. _CNV_A_R_LINEAR_____0_CM 0. 65535. DISPLAY_IDENTIFIER ID_ERR_DTC_PVS_DOUBLE FORMAT "%5.0"
 /begin AXIS_DESCR COM_AXIS errm_online_dummy _CNV_S_2_ERRM_DTC_R_483_CM 1 0. 1. AXIS_PTS_REF ldp_nr_1_id_err_dtc /end AXIS_DESCR
 /begin AXIS_DESCR COM_AXIS errm_online_dummy _CNV_S_6_ERRM_DTC_R_484_CM 6 0. 5. AXIS_PTS_REF ldp_nr_2_id_err_dtc /end AXIS_DESCR
/end CHARACTERISTIC
/begin CHARACTERISTIC fmy_id_pvs_bls_not_plaus.dtc "DTC table declaration for the diagnosis instance XX" MAP 0xa10048f0 _REC_MAP_20_u2_u2_u2 65535. _CNV_A_R_LINEAR_____0_CM 0. 65535. DISPLAY_IDENTIFIER ID_ERR_DTC_PVS_BLS_NOT_PLAUS FORMAT "%5.0"
 /begin AXIS_DESCR COM_AXIS errm_online_dummy _CNV_S_2_ERRM_DTC_R_483_CM 1 0. 1. AXIS_PTS_REF ldp_nr_1_id_err_dtc /end AXIS_DESCR
 /begin AXIS_DESCR COM_AXIS errm_online_dummy _CNV_S_6_ERRM_DTC_R_484_CM 6 0. 5. AXIS_PTS_REF ldp_nr_2_id_err_dtc /end AXIS_DESCR
/end CHARACTERISTIC
/begin CHARACTERISTIC fmy_id_mtc_dr.dtc "DTC table declaration for the diagnosis instance XX" MAP 0xa1004698 _REC_MAP_20_u2_u2_u2 65535. _CNV_A_R_LINEAR_____0_CM 0. 65535. DISPLAY_IDENTIFIER ID_ERR_DTC_MTC_DR FORMAT "%5.0"
 /begin AXIS_DESCR COM_AXIS errm_online_dummy _CNV_S_2_ERRM_DTC_R_483_CM 1 0. 1. AXIS_PTS_REF ldp_nr_1_id_err_dtc /end AXIS_DESCR
 /begin AXIS_DESCR COM_AXIS errm_online_dummy _CNV_S_6_ERRM_DTC_R_484_CM 6 0. 5. AXIS_PTS_REF ldp_nr_2_id_err_dtc /end AXIS_DESCR
/end CHARACTERISTIC
/begin CHARACTERISTIC fmy_id_mtc_ctl_1.dtc "DTC table declaration for the diagnosis instance XX" MAP 0xa100465c _REC_MAP_20_u2_u2_u2 65535. _CNV_A_R_LINEAR_____0_CM 0. 65535. DISPLAY_IDENTIFIER ID_ERR_DTC_MTC_CTL_1 FORMAT "%5.0"
 /begin AXIS_DESCR COM_AXIS errm_online_dummy _CNV_S_2_ERRM_DTC_R_483_CM 1 0. 1. AXIS_PTS_REF ldp_nr_1_id_err_dtc /end AXIS_DESCR
 /begin AXIS_DESCR COM_AXIS errm_online_dummy _CNV_S_6_ERRM_DTC_R_484_CM 6 0. 5. AXIS_PTS_REF ldp_nr_2_id_err_dtc /end AXIS_DESCR
/end CHARACTERISTIC
/begin CHARACTERISTIC fmy_id_mtc_ctl_2.dtc "DTC table declaration for the diagnosis instance XX" MAP 0xa1004670 _REC_MAP_20_u2_u2_u2 65535. _CNV_A_R_LINEAR_____0_CM 0. 65535. DISPLAY_IDENTIFIER ID_ERR_DTC_MTC_CTL_2 FORMAT "%5.0"
 /begin AXIS_DESCR COM_AXIS errm_online_dummy _CNV_S_2_ERRM_DTC_R_483_CM 1 0. 1. AXIS_PTS_REF ldp_nr_1_id_err_dtc /end AXIS_DESCR
 /begin AXIS_DESCR COM_AXIS errm_online_dummy _CNV_S_6_ERRM_DTC_R_484_CM 6 0. 5. AXIS_PTS_REF ldp_nr_2_id_err_dtc /end AXIS_DESCR
/end CHARACTERISTIC
/begin CHARACTERISTIC fmy_id_mtc_ctl_3.dtc "DTC table declaration for the diagnosis instance XX" MAP 0xa1004684 _REC_MAP_20_u2_u2_u2 65535. _CNV_A_R_LINEAR_____0_CM 0. 65535. DISPLAY_IDENTIFIER ID_ERR_DTC_MTC_CTL_3 FORMAT "%5.0"
 /begin AXIS_DESCR COM_AXIS errm_online_dummy _CNV_S_2_ERRM_DTC_R_483_CM 1 0. 1. AXIS_PTS_REF ldp_nr_1_id_err_dtc /end AXIS_DESCR
 /begin AXIS_DESCR COM_AXIS errm_online_dummy _CNV_S_6_ERRM_DTC_R_484_CM 6 0. 5. AXIS_PTS_REF ldp_nr_2_id_err_dtc /end AXIS_DESCR
/end CHARACTERISTIC
/begin CHARACTERISTIC fmy_id_tps_ad.dtc "DTC table declaration for the diagnosis instance XX" MAP 0xa1004eb8 _REC_MAP_20_u2_u2_u2 65535. _CNV_A_R_LINEAR_____0_CM 0. 65535. DISPLAY_IDENTIFIER ID_ERR_DTC_TPS_AD FORMAT "%5.0"
 /begin AXIS_DESCR COM_AXIS errm_online_dummy _CNV_S_2_ERRM_DTC_R_483_CM 1 0. 1. AXIS_PTS_REF ldp_nr_1_id_err_dtc /end AXIS_DESCR
 /begin AXIS_DESCR COM_AXIS errm_online_dummy _CNV_S_6_ERRM_DTC_R_484_CM 6 0. 5. AXIS_PTS_REF ldp_nr_2_id_err_dtc /end AXIS_DESCR
/end CHARACTERISTIC
/begin CHARACTERISTIC fmy_id_tps_ad_bol.dtc "DTC table declaration for the diagnosis instance XX" MAP 0xa1004ecc _REC_MAP_20_u2_u2_u2 65535. _CNV_A_R_LINEAR_____0_CM 0. 65535. DISPLAY_IDENTIFIER ID_ERR_DTC_TPS_AD_BOL FORMAT "%5.0"
 /begin AXIS_DESCR COM_AXIS errm_online_dummy _CNV_S_2_ERRM_DTC_R_483_CM 1 0. 1. AXIS_PTS_REF ldp_nr_1_id_err_dtc /end AXIS_DESCR
 /begin AXIS_DESCR COM_AXIS errm_online_dummy _CNV_S_6_ERRM_DTC_R_484_CM 6 0. 5. AXIS_PTS_REF ldp_nr_2_id_err_dtc /end AXIS_DESCR
/end CHARACTERISTIC
/begin CHARACTERISTIC fmy_id_tps_st_chk_1.dtc "DTC table declaration for the diagnosis instance XX" MAP 0xa1004f1c _REC_MAP_20_u2_u2_u2 65535. _CNV_A_R_LINEAR_____0_CM 0. 65535. DISPLAY_IDENTIFIER ID_ERR_DTC_TPS_ST_CHK_1 FORMAT "%5.0"
 /begin AXIS_DESCR COM_AXIS errm_online_dummy _CNV_S_2_ERRM_DTC_R_483_CM 1 0. 1. AXIS_PTS_REF ldp_nr_1_id_err_dtc /end AXIS_DESCR
 /begin AXIS_DESCR COM_AXIS errm_online_dummy _CNV_S_6_ERRM_DTC_R_484_CM 6 0. 5. AXIS_PTS_REF ldp_nr_2_id_err_dtc /end AXIS_DESCR
/end CHARACTERISTIC
/begin CHARACTERISTIC fmy_id_tps_st_chk_2.dtc "DTC table declaration for the diagnosis instance XX" MAP 0xa1004f30 _REC_MAP_20_u2_u2_u2 65535. _CNV_A_R_LINEAR_____0_CM 0. 65535. DISPLAY_IDENTIFIER ID_ERR_DTC_TPS_ST_CHK_2 FORMAT "%5.0"
 /begin AXIS_DESCR COM_AXIS errm_online_dummy _CNV_S_2_ERRM_DTC_R_483_CM 1 0. 1. AXIS_PTS_REF ldp_nr_1_id_err_dtc /end AXIS_DESCR
 /begin AXIS_DESCR COM_AXIS errm_online_dummy _CNV_S_6_ERRM_DTC_R_484_CM 6 0. 5. AXIS_PTS_REF ldp_nr_2_id_err_dtc /end AXIS_DESCR
/end CHARACTERISTIC
/begin CHARACTERISTIC fmy_id_gen.dtc "DTC table declaration for the diagnosis instance XX" MAP 0xa1004134 _REC_MAP_20_u2_u2_u2 65535. _CNV_A_R_LINEAR_____0_CM 0. 65535. DISPLAY_IDENTIFIER ID_ERR_DTC_GEN FORMAT "%5.0"
 /begin AXIS_DESCR COM_AXIS errm_online_dummy _CNV_S_2_ERRM_DTC_R_483_CM 1 0. 1. AXIS_PTS_REF ldp_nr_1_id_err_dtc /end AXIS_DESCR
 /begin AXIS_DESCR COM_AXIS errm_online_dummy _CNV_S_6_ERRM_DTC_R_484_CM 6 0. 5. AXIS_PTS_REF ldp_nr_2_id_err_dtc /end AXIS_DESCR
/end CHARACTERISTIC
/begin CHARACTERISTIC fmy_id_gen_diag.dtc "DTC table declaration for the diagnosis instance XX" MAP 0xa1004148 _REC_MAP_20_u2_u2_u2 65535. _CNV_A_R_LINEAR_____0_CM 0. 65535. DISPLAY_IDENTIFIER ID_ERR_DTC_GEN_DIAG FORMAT "%5.0"
 /begin AXIS_DESCR COM_AXIS errm_online_dummy _CNV_S_2_ERRM_DTC_R_483_CM 1 0. 1. AXIS_PTS_REF ldp_nr_1_id_err_dtc /end AXIS_DESCR
 /begin AXIS_DESCR COM_AXIS errm_online_dummy _CNV_S_6_ERRM_DTC_R_484_CM 6 0. 5. AXIS_PTS_REF ldp_nr_2_id_err_dtc /end AXIS_DESCR
/end CHARACTERISTIC
/begin CHARACTERISTIC fmy_id_alter_bn.dtc "DTC table declaration for the diagnosis instance XX" MAP 0xa100393c _REC_MAP_20_u2_u2_u2 65535. _CNV_A_R_LINEAR_____0_CM 0. 65535. DISPLAY_IDENTIFIER ID_ERR_DTC_ALTER_BN FORMAT "%5.0"
 /begin AXIS_DESCR COM_AXIS errm_online_dummy _CNV_S_2_ERRM_DTC_R_483_CM 1 0. 1. AXIS_PTS_REF ldp_nr_1_id_err_dtc /end AXIS_DESCR
 /begin AXIS_DESCR COM_AXIS errm_online_dummy _CNV_S_6_ERRM_DTC_R_484_CM 6 0. 5. AXIS_PTS_REF ldp_nr_2_id_err_dtc /end AXIS_DESCR
/end CHARACTERISTIC
/begin CHARACTERISTIC fmy_id_alter_bn_bat.dtc "DTC table declaration for the diagnosis instance XX" MAP 0xa1003950 _REC_MAP_20_u2_u2_u2 65535. _CNV_A_R_LINEAR_____0_CM 0. 65535. DISPLAY_IDENTIFIER ID_ERR_DTC_ALTER_BN_BAT FORMAT "%5.0"
 /begin AXIS_DESCR COM_AXIS errm_online_dummy _CNV_S_2_ERRM_DTC_R_483_CM 1 0. 1. AXIS_PTS_REF ldp_nr_1_id_err_dtc /end AXIS_DESCR
 /begin AXIS_DESCR COM_AXIS errm_online_dummy _CNV_S_6_ERRM_DTC_R_484_CM 6 0. 5. AXIS_PTS_REF ldp_nr_2_id_err_dtc /end AXIS_DESCR
/end CHARACTERISTIC
/begin CHARACTERISTIC fmy_id_vim_1_el.dtc "DTC table declaration for the diagnosis instance XX" MAP 0xa1005048 _REC_MAP_20_u2_u2_u2 65535. _CNV_A_R_LINEAR_____0_CM 0. 65535. DISPLAY_IDENTIFIER ID_ERR_DTC_VIM_1_EL FORMAT "%5.0"
 /begin AXIS_DESCR COM_AXIS errm_online_dummy _CNV_S_2_ERRM_DTC_R_483_CM 1 0. 1. AXIS_PTS_REF ldp_nr_1_id_err_dtc /end AXIS_DESCR
 /begin AXIS_DESCR COM_AXIS errm_online_dummy _CNV_S_6_ERRM_DTC_R_484_CM 6 0. 5. AXIS_PTS_REF ldp_nr_2_id_err_dtc /end AXIS_DESCR
/end CHARACTERISTIC
/begin CHARACTERISTIC fmy_id_vim_2_el.dtc "DTC table declaration for the diagnosis instance XX" MAP 0xa100505c _REC_MAP_20_u2_u2_u2 65535. _CNV_A_R_LINEAR_____0_CM 0. 65535. DISPLAY_IDENTIFIER ID_ERR_DTC_VIM_2_EL FORMAT "%5.0"
 /begin AXIS_DESCR COM_AXIS errm_online_dummy _CNV_S_2_ERRM_DTC_R_483_CM 1 0. 1. AXIS_PTS_REF ldp_nr_1_id_err_dtc /end AXIS_DESCR
 /begin AXIS_DESCR COM_AXIS errm_online_dummy _CNV_S_6_ERRM_DTC_R_484_CM 6 0. 5. AXIS_PTS_REF ldp_nr_2_id_err_dtc /end AXIS_DESCR
/end CHARACTERISTIC
/begin CHARACTERISTIC fmy_id_vimpwm_1_fb.dtc "DTC table declaration for the diagnosis instance XX" MAP 0xa1005084 _REC_MAP_20_u2_u2_u2 65535. _CNV_A_R_LINEAR_____0_CM 0. 65535. DISPLAY_IDENTIFIER ID_ERR_DTC_VIMPWM_1_FB FORMAT "%5.0"
 /begin AXIS_DESCR COM_AXIS errm_online_dummy _CNV_S_2_ERRM_DTC_R_483_CM 1 0. 1. AXIS_PTS_REF ldp_nr_1_id_err_dtc /end AXIS_DESCR
 /begin AXIS_DESCR COM_AXIS errm_online_dummy _CNV_S_6_ERRM_DTC_R_484_CM 6 0. 5. AXIS_PTS_REF ldp_nr_2_id_err_dtc /end AXIS_DESCR
/end CHARACTERISTIC
/begin CHARACTERISTIC fmy_id_vimpwm_2_fb.dtc "DTC table declaration for the diagnosis instance XX" MAP 0xa1005098 _REC_MAP_20_u2_u2_u2 65535. _CNV_A_R_LINEAR_____0_CM 0. 65535. DISPLAY_IDENTIFIER ID_ERR_DTC_VIMPWM_2_FB FORMAT "%5.0"
 /begin AXIS_DESCR COM_AXIS errm_online_dummy _CNV_S_2_ERRM_DTC_R_483_CM 1 0. 1. AXIS_PTS_REF ldp_nr_1_id_err_dtc /end AXIS_DESCR
 /begin AXIS_DESCR COM_AXIS errm_online_dummy _CNV_S_6_ERRM_DTC_R_484_CM 6 0. 5. AXIS_PTS_REF ldp_nr_2_id_err_dtc /end AXIS_DESCR
/end CHARACTERISTIC
/begin CHARACTERISTIC fmy_id_t_es.dtc "DTC table declaration for the diagnosis instance XX" MAP 0xa1004c38 _REC_MAP_20_u2_u2_u2 65535. _CNV_A_R_LINEAR_____0_CM 0. 65535. DISPLAY_IDENTIFIER ID_ERR_DTC_T_ES FORMAT "%5.0"
 /begin AXIS_DESCR COM_AXIS errm_online_dummy _CNV_S_2_ERRM_DTC_R_483_CM 1 0. 1. AXIS_PTS_REF ldp_nr_1_id_err_dtc /end AXIS_DESCR
 /begin AXIS_DESCR COM_AXIS errm_online_dummy _CNV_S_6_ERRM_DTC_R_484_CM 6 0. 5. AXIS_PTS_REF ldp_nr_2_id_err_dtc /end AXIS_DESCR
/end CHARACTERISTIC
/begin CHARACTERISTIC fmy_id_map_dip_plaus.dtc "DTC table declaration for the diagnosis instance XX" MAP 0xa1004508 _REC_MAP_20_u2_u2_u2 65535. _CNV_A_R_LINEAR_____0_CM 0. 65535. DISPLAY_IDENTIFIER ID_ERR_DTC_MAP_DIP_PLAUS FORMAT "%5.0"
 /begin AXIS_DESCR COM_AXIS errm_online_dummy _CNV_S_2_ERRM_DTC_R_483_CM 1 0. 1. AXIS_PTS_REF ldp_nr_1_id_err_dtc /end AXIS_DESCR
 /begin AXIS_DESCR COM_AXIS errm_online_dummy _CNV_S_6_ERRM_DTC_R_484_CM 6 0. 5. AXIS_PTS_REF ldp_nr_2_id_err_dtc /end AXIS_DESCR
/end CHARACTERISTIC
/begin CHARACTERISTIC fmy_id_toil_level.dtc "DTC table declaration for the diagnosis instance XX" MAP 0xa1004d8c _REC_MAP_20_u2_u2_u2 65535. _CNV_A_R_LINEAR_____0_CM 0. 65535. DISPLAY_IDENTIFIER ID_ERR_DTC_TOIL_LEVEL FORMAT "%5.0"
 /begin AXIS_DESCR COM_AXIS errm_online_dummy _CNV_S_2_ERRM_DTC_R_483_CM 1 0. 1. AXIS_PTS_REF ldp_nr_1_id_err_dtc /end AXIS_DESCR
 /begin AXIS_DESCR COM_AXIS errm_online_dummy _CNV_S_6_ERRM_DTC_R_484_CM 6 0. 5. AXIS_PTS_REF ldp_nr_2_id_err_dtc /end AXIS_DESCR
/end CHARACTERISTIC
/begin CHARACTERISTIC fmy_id_vim_plaus.dtc "DTC table declaration for the diagnosis instance XX" MAP 0xa1005070 _REC_MAP_20_u2_u2_u2 65535. _CNV_A_R_LINEAR_____0_CM 0. 65535. DISPLAY_IDENTIFIER ID_ERR_DTC_VIM_PLAUS FORMAT "%5.0"
 /begin AXIS_DESCR COM_AXIS errm_online_dummy _CNV_S_2_ERRM_DTC_R_483_CM 1 0. 1. AXIS_PTS_REF ldp_nr_1_id_err_dtc /end AXIS_DESCR
 /begin AXIS_DESCR COM_AXIS errm_online_dummy _CNV_S_6_ERRM_DTC_R_484_CM 6 0. 5. AXIS_PTS_REF ldp_nr_2_id_err_dtc /end AXIS_DESCR
/end CHARACTERISTIC
/begin CHARACTERISTIC fmy_id_alter_bn_rgn.dtc "DTC table declaration for the diagnosis instance XX" MAP 0xa1003964 _REC_MAP_20_u2_u2_u2 65535. _CNV_A_R_LINEAR_____0_CM 0. 65535. DISPLAY_IDENTIFIER ID_ERR_DTC_ALTER_BN_RGN FORMAT "%5.0"
 /begin AXIS_DESCR COM_AXIS errm_online_dummy _CNV_S_2_ERRM_DTC_R_483_CM 1 0. 1. AXIS_PTS_REF ldp_nr_1_id_err_dtc /end AXIS_DESCR
 /begin AXIS_DESCR COM_AXIS errm_online_dummy _CNV_S_6_ERRM_DTC_R_484_CM 6 0. 5. AXIS_PTS_REF ldp_nr_2_id_err_dtc /end AXIS_DESCR
/end CHARACTERISTIC
/begin CHARACTERISTIC fmy_id_per_cam_in_1.dtc "DTC table declaration for the diagnosis instance XX" MAP 0xa10047ec _REC_MAP_20_u2_u2_u2 65535. _CNV_A_R_LINEAR_____0_CM 0. 65535. DISPLAY_IDENTIFIER ID_ERR_DTC_PER_CAM_IN_1 FORMAT "%5.0"
 /begin AXIS_DESCR COM_AXIS errm_online_dummy _CNV_S_2_ERRM_DTC_R_483_CM 1 0. 1. AXIS_PTS_REF ldp_nr_1_id_err_dtc /end AXIS_DESCR
 /begin AXIS_DESCR COM_AXIS errm_online_dummy _CNV_S_6_ERRM_DTC_R_484_CM 6 0. 5. AXIS_PTS_REF ldp_nr_2_id_err_dtc /end AXIS_DESCR
/end CHARACTERISTIC
/begin CHARACTERISTIC fmy_id_per_cam_ex_1.dtc "DTC table declaration for the diagnosis instance XX" MAP 0xa10047d8 _REC_MAP_20_u2_u2_u2 65535. _CNV_A_R_LINEAR_____0_CM 0. 65535. DISPLAY_IDENTIFIER ID_ERR_DTC_PER_CAM_EX_1 FORMAT "%5.0"
 /begin AXIS_DESCR COM_AXIS errm_online_dummy _CNV_S_2_ERRM_DTC_R_483_CM 1 0. 1. AXIS_PTS_REF ldp_nr_1_id_err_dtc /end AXIS_DESCR
 /begin AXIS_DESCR COM_AXIS errm_online_dummy _CNV_S_6_ERRM_DTC_R_484_CM 6 0. 5. AXIS_PTS_REF ldp_nr_2_id_err_dtc /end AXIS_DESCR
/end CHARACTERISTIC
/begin CHARACTERISTIC fmy_id_syn_cam_in_1.dtc "DTC table declaration for the diagnosis instance XX" MAP 0xa1004bfc _REC_MAP_20_u2_u2_u2 65535. _CNV_A_R_LINEAR_____0_CM 0. 65535. DISPLAY_IDENTIFIER ID_ERR_DTC_SYN_CAM_IN_1 FORMAT "%5.0"
 /begin AXIS_DESCR COM_AXIS errm_online_dummy _CNV_S_2_ERRM_DTC_R_483_CM 1 0. 1. AXIS_PTS_REF ldp_nr_1_id_err_dtc /end AXIS_DESCR
 /begin AXIS_DESCR COM_AXIS errm_online_dummy _CNV_S_6_ERRM_DTC_R_484_CM 6 0. 5. AXIS_PTS_REF ldp_nr_2_id_err_dtc /end AXIS_DESCR
/end CHARACTERISTIC
/begin CHARACTERISTIC fmy_id_syn_cam_ex_1.dtc "DTC table declaration for the diagnosis instance XX" MAP 0xa1004be8 _REC_MAP_20_u2_u2_u2 65535. _CNV_A_R_LINEAR_____0_CM 0. 65535. DISPLAY_IDENTIFIER ID_ERR_DTC_SYN_CAM_EX_1 FORMAT "%5.0"
 /begin AXIS_DESCR COM_AXIS errm_online_dummy _CNV_S_2_ERRM_DTC_R_483_CM 1 0. 1. AXIS_PTS_REF ldp_nr_1_id_err_dtc /end AXIS_DESCR
 /begin AXIS_DESCR COM_AXIS errm_online_dummy _CNV_S_6_ERRM_DTC_R_484_CM 6 0. 5. AXIS_PTS_REF ldp_nr_2_id_err_dtc /end AXIS_DESCR
/end CHARACTERISTIC
/begin CHARACTERISTIC fmy_id_ref_crk_cam_in_1.dtc "DTC table declaration for the diagnosis instance XX" MAP 0xa100497c _REC_MAP_20_u2_u2_u2 65535. _CNV_A_R_LINEAR_____0_CM 0. 65535. DISPLAY_IDENTIFIER ID_ERR_DTC_REF_CRK_CAM_IN_1 FORMAT "%5.0"
 /begin AXIS_DESCR COM_AXIS errm_online_dummy _CNV_S_2_ERRM_DTC_R_483_CM 1 0. 1. AXIS_PTS_REF ldp_nr_1_id_err_dtc /end AXIS_DESCR
 /begin AXIS_DESCR COM_AXIS errm_online_dummy _CNV_S_6_ERRM_DTC_R_484_CM 6 0. 5. AXIS_PTS_REF ldp_nr_2_id_err_dtc /end AXIS_DESCR
/end CHARACTERISTIC
/begin CHARACTERISTIC fmy_id_ref_crk_cam_ex_1.dtc "DTC table declaration for the diagnosis instance XX" MAP 0xa1004968 _REC_MAP_20_u2_u2_u2 65535. _CNV_A_R_LINEAR_____0_CM 0. 65535. DISPLAY_IDENTIFIER ID_ERR_DTC_REF_CRK_CAM_EX_1 FORMAT "%5.0"
 /begin AXIS_DESCR COM_AXIS errm_online_dummy _CNV_S_2_ERRM_DTC_R_483_CM 1 0. 1. AXIS_PTS_REF ldp_nr_1_id_err_dtc /end AXIS_DESCR
 /begin AXIS_DESCR COM_AXIS errm_online_dummy _CNV_S_6_ERRM_DTC_R_484_CM 6 0. 5. AXIS_PTS_REF ldp_nr_2_id_err_dtc /end AXIS_DESCR
/end CHARACTERISTIC
/begin CHARACTERISTIC fmy_id_crk_tooth.dtc "DTC table declaration for the diagnosis instance XX" MAP 0xa1003d74 _REC_MAP_20_u2_u2_u2 65535. _CNV_A_R_LINEAR_____0_CM 0. 65535. DISPLAY_IDENTIFIER ID_ERR_DTC_CRK_TOOTH FORMAT "%5.0"
 /begin AXIS_DESCR COM_AXIS errm_online_dummy _CNV_S_2_ERRM_DTC_R_483_CM 1 0. 1. AXIS_PTS_REF ldp_nr_1_id_err_dtc /end AXIS_DESCR
 /begin AXIS_DESCR COM_AXIS errm_online_dummy _CNV_S_6_ERRM_DTC_R_484_CM 6 0. 5. AXIS_PTS_REF ldp_nr_2_id_err_dtc /end AXIS_DESCR
/end CHARACTERISTIC
/begin CHARACTERISTIC fmy_id_crk_tooth_per.dtc "DTC table declaration for the diagnosis instance XX" MAP 0xa1003d88 _REC_MAP_20_u2_u2_u2 65535. _CNV_A_R_LINEAR_____0_CM 0. 65535. DISPLAY_IDENTIFIER ID_ERR_DTC_CRK_TOOTH_PER FORMAT "%5.0"
 /begin AXIS_DESCR COM_AXIS errm_online_dummy _CNV_S_2_ERRM_DTC_R_483_CM 1 0. 1. AXIS_PTS_REF ldp_nr_1_id_err_dtc /end AXIS_DESCR
 /begin AXIS_DESCR COM_AXIS errm_online_dummy _CNV_S_6_ERRM_DTC_R_484_CM 6 0. 5. AXIS_PTS_REF ldp_nr_2_id_err_dtc /end AXIS_DESCR
/end CHARACTERISTIC
/begin CHARACTERISTIC fmy_id_crk_syn.dtc "DTC table declaration for the diagnosis instance XX" MAP 0xa1003d60 _REC_MAP_20_u2_u2_u2 65535. _CNV_A_R_LINEAR_____0_CM 0. 65535. DISPLAY_IDENTIFIER ID_ERR_DTC_CRK_SYN FORMAT "%5.0"
 /begin AXIS_DESCR COM_AXIS errm_online_dummy _CNV_S_2_ERRM_DTC_R_483_CM 1 0. 1. AXIS_PTS_REF ldp_nr_1_id_err_dtc /end AXIS_DESCR
 /begin AXIS_DESCR COM_AXIS errm_online_dummy _CNV_S_6_ERRM_DTC_R_484_CM 6 0. 5. AXIS_PTS_REF ldp_nr_2_id_err_dtc /end AXIS_DESCR
/end CHARACTERISTIC
/begin CHARACTERISTIC fmy_id_crk_plaus.dtc "DTC table declaration for the diagnosis instance XX" MAP 0xa1003d4c _REC_MAP_20_u2_u2_u2 65535. _CNV_A_R_LINEAR_____0_CM 0. 65535. DISPLAY_IDENTIFIER ID_ERR_DTC_CRK_PLAUS FORMAT "%5.0"
 /begin AXIS_DESCR COM_AXIS errm_online_dummy _CNV_S_2_ERRM_DTC_R_483_CM 1 0. 1. AXIS_PTS_REF ldp_nr_1_id_err_dtc /end AXIS_DESCR
 /begin AXIS_DESCR COM_AXIS errm_online_dummy _CNV_S_6_ERRM_DTC_R_484_CM 6 0. 5. AXIS_PTS_REF ldp_nr_2_id_err_dtc /end AXIS_DESCR
/end CHARACTERISTIC
/begin CHARACTERISTIC fmy_id_plaus_cam_in_1.dtc "DTC table declaration for the diagnosis instance XX" MAP 0xa1004814 _REC_MAP_20_u2_u2_u2 65535. _CNV_A_R_LINEAR_____0_CM 0. 65535. DISPLAY_IDENTIFIER ID_ERR_DTC_PLAUS_CAM_IN_1 FORMAT "%5.0"
 /begin AXIS_DESCR COM_AXIS errm_online_dummy _CNV_S_2_ERRM_DTC_R_483_CM 1 0. 1. AXIS_PTS_REF ldp_nr_1_id_err_dtc /end AXIS_DESCR
 /begin AXIS_DESCR COM_AXIS errm_online_dummy _CNV_S_6_ERRM_DTC_R_484_CM 6 0. 5. AXIS_PTS_REF ldp_nr_2_id_err_dtc /end AXIS_DESCR
/end CHARACTERISTIC
/begin CHARACTERISTIC fmy_id_plaus_cam_ex_1.dtc "DTC table declaration for the diagnosis instance XX" MAP 0xa1004800 _REC_MAP_20_u2_u2_u2 65535. _CNV_A_R_LINEAR_____0_CM 0. 65535. DISPLAY_IDENTIFIER ID_ERR_DTC_PLAUS_CAM_EX_1 FORMAT "%5.0"
 /begin AXIS_DESCR COM_AXIS errm_online_dummy _CNV_S_2_ERRM_DTC_R_483_CM 1 0. 1. AXIS_PTS_REF ldp_nr_1_id_err_dtc /end AXIS_DESCR
 /begin AXIS_DESCR COM_AXIS errm_online_dummy _CNV_S_6_ERRM_DTC_R_484_CM 6 0. 5. AXIS_PTS_REF ldp_nr_2_id_err_dtc /end AXIS_DESCR
/end CHARACTERISTIC
/begin CHARACTERISTIC fmy_id_syn_crk_cam_in_1.dtc "DTC table declaration for the diagnosis instance XX" MAP 0xa1004c24 _REC_MAP_20_u2_u2_u2 65535. _CNV_A_R_LINEAR_____0_CM 0. 65535. DISPLAY_IDENTIFIER ID_ERR_DTC_SYN_CRK_CAM_IN_1 FORMAT "%5.0"
 /begin AXIS_DESCR COM_AXIS errm_online_dummy _CNV_S_2_ERRM_DTC_R_483_CM 1 0. 1. AXIS_PTS_REF ldp_nr_1_id_err_dtc /end AXIS_DESCR
 /begin AXIS_DESCR COM_AXIS errm_online_dummy _CNV_S_6_ERRM_DTC_R_484_CM 6 0. 5. AXIS_PTS_REF ldp_nr_2_id_err_dtc /end AXIS_DESCR
/end CHARACTERISTIC
/begin CHARACTERISTIC fmy_id_syn_crk_cam_ex_1.dtc "DTC table declaration for the diagnosis instance XX" MAP 0xa1004c10 _REC_MAP_20_u2_u2_u2 65535. _CNV_A_R_LINEAR_____0_CM 0. 65535. DISPLAY_IDENTIFIER ID_ERR_DTC_SYN_CRK_CAM_EX_1 FORMAT "%5.0"
 /begin AXIS_DESCR COM_AXIS errm_online_dummy _CNV_S_2_ERRM_DTC_R_483_CM 1 0. 1. AXIS_PTS_REF ldp_nr_1_id_err_dtc /end AXIS_DESCR
 /begin AXIS_DESCR COM_AXIS errm_online_dummy _CNV_S_6_ERRM_DTC_R_484_CM 6 0. 5. AXIS_PTS_REF ldp_nr_2_id_err_dtc /end AXIS_DESCR
/end CHARACTERISTIC
/begin CHARACTERISTIC fmy_id_can_boff_B.dtc "DTC table declaration for the diagnosis instance XX" MAP 0xa1003c48 _REC_MAP_20_u2_u2_u2 65535. _CNV_A_R_LINEAR_____0_CM 0. 65535. DISPLAY_IDENTIFIER ID_ERR_DTC_CAN_BOFF_B FORMAT "%5.0"
 /begin AXIS_DESCR COM_AXIS errm_online_dummy _CNV_S_2_ERRM_DTC_R_483_CM 1 0. 1. AXIS_PTS_REF ldp_nr_1_id_err_dtc /end AXIS_DESCR
 /begin AXIS_DESCR COM_AXIS errm_online_dummy _CNV_S_6_ERRM_DTC_R_484_CM 6 0. 5. AXIS_PTS_REF ldp_nr_2_id_err_dtc /end AXIS_DESCR
/end CHARACTERISTIC
/begin CHARACTERISTIC fmy_id_can_boff_C.dtc "DTC table declaration for the diagnosis instance XX" MAP 0xa1003c5c _REC_MAP_20_u2_u2_u2 65535. _CNV_A_R_LINEAR_____0_CM 0. 65535. DISPLAY_IDENTIFIER ID_ERR_DTC_CAN_BOFF_C FORMAT "%5.0"
 /begin AXIS_DESCR COM_AXIS errm_online_dummy _CNV_S_2_ERRM_DTC_R_483_CM 1 0. 1. AXIS_PTS_REF ldp_nr_1_id_err_dtc /end AXIS_DESCR
 /begin AXIS_DESCR COM_AXIS errm_online_dummy _CNV_S_6_ERRM_DTC_R_484_CM 6 0. 5. AXIS_PTS_REF ldp_nr_2_id_err_dtc /end AXIS_DESCR
/end CHARACTERISTIC
/begin CHARACTERISTIC fmy_id_rly_main.dtc "DTC table declaration for the diagnosis instance XX" MAP 0xa10049f4 _REC_MAP_20_u2_u2_u2 65535. _CNV_A_R_LINEAR_____0_CM 0. 65535. DISPLAY_IDENTIFIER ID_ERR_DTC_RLY_MAIN FORMAT "%5.0"
 /begin AXIS_DESCR COM_AXIS errm_online_dummy _CNV_S_2_ERRM_DTC_R_483_CM 1 0. 1. AXIS_PTS_REF ldp_nr_1_id_err_dtc /end AXIS_DESCR
 /begin AXIS_DESCR COM_AXIS errm_online_dummy _CNV_S_6_ERRM_DTC_R_484_CM 6 0. 5. AXIS_PTS_REF ldp_nr_2_id_err_dtc /end AXIS_DESCR
/end CHARACTERISTIC
/begin CHARACTERISTIC fmy_id_rly_main_dly.dtc "DTC table declaration for the diagnosis instance XX" MAP 0xa1004a08 _REC_MAP_20_u2_u2_u2 65535. _CNV_A_R_LINEAR_____0_CM 0. 65535. DISPLAY_IDENTIFIER ID_ERR_DTC_RLY_MAIN_DLY FORMAT "%5.0"
 /begin AXIS_DESCR COM_AXIS errm_online_dummy _CNV_S_2_ERRM_DTC_R_483_CM 1 0. 1. AXIS_PTS_REF ldp_nr_1_id_err_dtc /end AXIS_DESCR
 /begin AXIS_DESCR COM_AXIS errm_online_dummy _CNV_S_6_ERRM_DTC_R_484_CM 6 0. 5. AXIS_PTS_REF ldp_nr_2_id_err_dtc /end AXIS_DESCR
/end CHARACTERISTIC
/begin CHARACTERISTIC fmy_id_rly_accout.dtc "DTC table declaration for the diagnosis instance XX" MAP 0xa10049b8 _REC_MAP_20_u2_u2_u2 65535. _CNV_A_R_LINEAR_____0_CM 0. 65535. DISPLAY_IDENTIFIER ID_ERR_DTC_RLY_ACCOUT FORMAT "%5.0"
 /begin AXIS_DESCR COM_AXIS errm_online_dummy _CNV_S_2_ERRM_DTC_R_483_CM 1 0. 1. AXIS_PTS_REF ldp_nr_1_id_err_dtc /end AXIS_DESCR
 /begin AXIS_DESCR COM_AXIS errm_online_dummy _CNV_S_6_ERRM_DTC_R_484_CM 6 0. 5. AXIS_PTS_REF ldp_nr_2_id_err_dtc /end AXIS_DESCR
/end CHARACTERISTIC
/begin CHARACTERISTIC fmy_id_isc.dtc "DTC table declaration for the diagnosis instance XX" MAP 0xa1004350 _REC_MAP_20_u2_u2_u2 65535. _CNV_A_R_LINEAR_____0_CM 0. 65535. DISPLAY_IDENTIFIER ID_ERR_DTC_ISC FORMAT "%5.0"
 /begin AXIS_DESCR COM_AXIS errm_online_dummy _CNV_S_2_ERRM_DTC_R_483_CM 1 0. 1. AXIS_PTS_REF ldp_nr_1_id_err_dtc /end AXIS_DESCR
 /begin AXIS_DESCR COM_AXIS errm_online_dummy _CNV_S_6_ERRM_DTC_R_484_CM 6 0. 5. AXIS_PTS_REF ldp_nr_2_id_err_dtc /end AXIS_DESCR
/end CHARACTERISTIC
/begin CHARACTERISTIC fmy_id_im_bls_plaus.dtc "DTC table declaration for the diagnosis instance XX" MAP 0xa10042ec _REC_MAP_20_u2_u2_u2 65535. _CNV_A_R_LINEAR_____0_CM 0. 65535. DISPLAY_IDENTIFIER ID_ERR_DTC_IM_BLS_PLAUS FORMAT "%5.0"
 /begin AXIS_DESCR COM_AXIS errm_online_dummy _CNV_S_2_ERRM_DTC_R_483_CM 1 0. 1. AXIS_PTS_REF ldp_nr_1_id_err_dtc /end AXIS_DESCR
 /begin AXIS_DESCR COM_AXIS errm_online_dummy _CNV_S_6_ERRM_DTC_R_484_CM 6 0. 5. AXIS_PTS_REF ldp_nr_2_id_err_dtc /end AXIS_DESCR
/end CHARACTERISTIC
/begin CHARACTERISTIC fmy_id_im_bts_plaus.dtc "DTC table declaration for the diagnosis instance XX" MAP 0xa1004300 _REC_MAP_20_u2_u2_u2 65535. _CNV_A_R_LINEAR_____0_CM 0. 65535. DISPLAY_IDENTIFIER ID_ERR_DTC_IM_BTS_PLAUS FORMAT "%5.0"
 /begin AXIS_DESCR COM_AXIS errm_online_dummy _CNV_S_2_ERRM_DTC_R_483_CM 1 0. 1. AXIS_PTS_REF ldp_nr_1_id_err_dtc /end AXIS_DESCR
 /begin AXIS_DESCR COM_AXIS errm_online_dummy _CNV_S_6_ERRM_DTC_R_484_CM 6 0. 5. AXIS_PTS_REF ldp_nr_2_id_err_dtc /end AXIS_DESCR
/end CHARACTERISTIC
/begin CHARACTERISTIC fmy_id_msw_tog.dtc "DTC table declaration for the diagnosis instance XX" MAP 0xa1004648 _REC_MAP_20_u2_u2_u2 65535. _CNV_A_R_LINEAR_____0_CM 0. 65535. DISPLAY_IDENTIFIER ID_ERR_DTC_MSW_TOG FORMAT "%5.0"
 /begin AXIS_DESCR COM_AXIS errm_online_dummy _CNV_S_2_ERRM_DTC_R_483_CM 1 0. 1. AXIS_PTS_REF ldp_nr_1_id_err_dtc /end AXIS_DESCR
 /begin AXIS_DESCR COM_AXIS errm_online_dummy _CNV_S_6_ERRM_DTC_R_484_CM 6 0. 5. AXIS_PTS_REF ldp_nr_2_id_err_dtc /end AXIS_DESCR
/end CHARACTERISTIC
/begin CHARACTERISTIC fmy_id_msw_2.dtc "DTC table declaration for the diagnosis instance XX" MAP 0xa1004620 _REC_MAP_20_u2_u2_u2 65535. _CNV_A_R_LINEAR_____0_CM 0. 65535. DISPLAY_IDENTIFIER ID_ERR_DTC_MSW_2 FORMAT "%5.0"
 /begin AXIS_DESCR COM_AXIS errm_online_dummy _CNV_S_2_ERRM_DTC_R_483_CM 1 0. 1. AXIS_PTS_REF ldp_nr_1_id_err_dtc /end AXIS_DESCR
 /begin AXIS_DESCR COM_AXIS errm_online_dummy _CNV_S_6_ERRM_DTC_R_484_CM 6 0. 5. AXIS_PTS_REF ldp_nr_2_id_err_dtc /end AXIS_DESCR
/end CHARACTERISTIC
/begin CHARACTERISTIC fmy_id_msw_3.dtc "DTC table declaration for the diagnosis instance XX" MAP 0xa1004634 _REC_MAP_20_u2_u2_u2 65535. _CNV_A_R_LINEAR_____0_CM 0. 65535. DISPLAY_IDENTIFIER ID_ERR_DTC_MSW_3 FORMAT "%5.0"
 /begin AXIS_DESCR COM_AXIS errm_online_dummy _CNV_S_2_ERRM_DTC_R_483_CM 1 0. 1. AXIS_PTS_REF ldp_nr_1_id_err_dtc /end AXIS_DESCR
 /begin AXIS_DESCR COM_AXIS errm_online_dummy _CNV_S_6_ERRM_DTC_R_484_CM 6 0. 5. AXIS_PTS_REF ldp_nr_2_id_err_dtc /end AXIS_DESCR
/end CHARACTERISTIC
/begin CHARACTERISTIC fmy_id_mis_0.dtc "DTC table declaration for the diagnosis instance XX" MAP 0xa1004580 _REC_MAP_20_u2_u2_u2 65535. _CNV_A_R_LINEAR_____0_CM 0. 65535. DISPLAY_IDENTIFIER ID_ERR_DTC_MIS_0 FORMAT "%5.0"
 /begin AXIS_DESCR COM_AXIS errm_online_dummy _CNV_S_2_ERRM_DTC_R_483_CM 1 0. 1. AXIS_PTS_REF ldp_nr_1_id_err_dtc /end AXIS_DESCR
 /begin AXIS_DESCR COM_AXIS errm_online_dummy _CNV_S_6_ERRM_DTC_R_484_CM 6 0. 5. AXIS_PTS_REF ldp_nr_2_id_err_dtc /end AXIS_DESCR
/end CHARACTERISTIC
/begin CHARACTERISTIC fmy_id_mis_1.dtc "DTC table declaration for the diagnosis instance XX" MAP 0xa1004594 _REC_MAP_20_u2_u2_u2 65535. _CNV_A_R_LINEAR_____0_CM 0. 65535. DISPLAY_IDENTIFIER ID_ERR_DTC_MIS_1 FORMAT "%5.0"
 /begin AXIS_DESCR COM_AXIS errm_online_dummy _CNV_S_2_ERRM_DTC_R_483_CM 1 0. 1. AXIS_PTS_REF ldp_nr_1_id_err_dtc /end AXIS_DESCR
 /begin AXIS_DESCR COM_AXIS errm_online_dummy _CNV_S_6_ERRM_DTC_R_484_CM 6 0. 5. AXIS_PTS_REF ldp_nr_2_id_err_dtc /end AXIS_DESCR
/end CHARACTERISTIC
/begin CHARACTERISTIC fmy_id_mis_2.dtc "DTC table declaration for the diagnosis instance XX" MAP 0xa10045a8 _REC_MAP_20_u2_u2_u2 65535. _CNV_A_R_LINEAR_____0_CM 0. 65535. DISPLAY_IDENTIFIER ID_ERR_DTC_MIS_2 FORMAT "%5.0"
 /begin AXIS_DESCR COM_AXIS errm_online_dummy _CNV_S_2_ERRM_DTC_R_483_CM 1 0. 1. AXIS_PTS_REF ldp_nr_1_id_err_dtc /end AXIS_DESCR
 /begin AXIS_DESCR COM_AXIS errm_online_dummy _CNV_S_6_ERRM_DTC_R_484_CM 6 0. 5. AXIS_PTS_REF ldp_nr_2_id_err_dtc /end AXIS_DESCR
/end CHARACTERISTIC
/begin CHARACTERISTIC fmy_id_mis_3.dtc "DTC table declaration for the diagnosis instance XX" MAP 0xa10045bc _REC_MAP_20_u2_u2_u2 65535. _CNV_A_R_LINEAR_____0_CM 0. 65535. DISPLAY_IDENTIFIER ID_ERR_DTC_MIS_3 FORMAT "%5.0"
 /begin AXIS_DESCR COM_AXIS errm_online_dummy _CNV_S_2_ERRM_DTC_R_483_CM 1 0. 1. AXIS_PTS_REF ldp_nr_1_id_err_dtc /end AXIS_DESCR
 /begin AXIS_DESCR COM_AXIS errm_online_dummy _CNV_S_6_ERRM_DTC_R_484_CM 6 0. 5. AXIS_PTS_REF ldp_nr_2_id_err_dtc /end AXIS_DESCR
/end CHARACTERISTIC
/begin CHARACTERISTIC fmy_id_mis_4.dtc "DTC table declaration for the diagnosis instance XX" MAP 0xa10045d0 _REC_MAP_20_u2_u2_u2 65535. _CNV_A_R_LINEAR_____0_CM 0. 65535. DISPLAY_IDENTIFIER ID_ERR_DTC_MIS_4 FORMAT "%5.0"
 /begin AXIS_DESCR COM_AXIS errm_online_dummy _CNV_S_2_ERRM_DTC_R_483_CM 1 0. 1. AXIS_PTS_REF ldp_nr_1_id_err_dtc /end AXIS_DESCR
 /begin AXIS_DESCR COM_AXIS errm_online_dummy _CNV_S_6_ERRM_DTC_R_484_CM 6 0. 5. AXIS_PTS_REF ldp_nr_2_id_err_dtc /end AXIS_DESCR
/end CHARACTERISTIC
/begin CHARACTERISTIC fmy_id_mis_5.dtc "DTC table declaration for the diagnosis instance XX" MAP 0xa10045e4 _REC_MAP_20_u2_u2_u2 65535. _CNV_A_R_LINEAR_____0_CM 0. 65535. DISPLAY_IDENTIFIER ID_ERR_DTC_MIS_5 FORMAT "%5.0"
 /begin AXIS_DESCR COM_AXIS errm_online_dummy _CNV_S_2_ERRM_DTC_R_483_CM 1 0. 1. AXIS_PTS_REF ldp_nr_1_id_err_dtc /end AXIS_DESCR
 /begin AXIS_DESCR COM_AXIS errm_online_dummy _CNV_S_6_ERRM_DTC_R_484_CM 6 0. 5. AXIS_PTS_REF ldp_nr_2_id_err_dtc /end AXIS_DESCR
/end CHARACTERISTIC
/begin CHARACTERISTIC fmy_id_mis_mpl.dtc "DTC table declaration for the diagnosis instance XX" MAP 0xa100460c _REC_MAP_20_u2_u2_u2 65535. _CNV_A_R_LINEAR_____0_CM 0. 65535. DISPLAY_IDENTIFIER ID_ERR_DTC_MIS_MPL FORMAT "%5.0"
 /begin AXIS_DESCR COM_AXIS errm_online_dummy _CNV_S_2_ERRM_DTC_R_483_CM 1 0. 1. AXIS_PTS_REF ldp_nr_1_id_err_dtc /end AXIS_DESCR
 /begin AXIS_DESCR COM_AXIS errm_online_dummy _CNV_S_6_ERRM_DTC_R_484_CM 6 0. 5. AXIS_PTS_REF ldp_nr_2_id_err_dtc /end AXIS_DESCR
/end CHARACTERISTIC
/begin CHARACTERISTIC fmy_id_mis_ftl_l.dtc "DTC table declaration for the diagnosis instance XX" MAP 0xa10045f8 _REC_MAP_20_u2_u2_u2 65535. _CNV_A_R_LINEAR_____0_CM 0. 65535. DISPLAY_IDENTIFIER ID_ERR_DTC_MIS_FTL_L FORMAT "%5.0"
 /begin AXIS_DESCR COM_AXIS errm_online_dummy _CNV_S_2_ERRM_DTC_R_483_CM 1 0. 1. AXIS_PTS_REF ldp_nr_1_id_err_dtc /end AXIS_DESCR
 /begin AXIS_DESCR COM_AXIS errm_online_dummy _CNV_S_6_ERRM_DTC_R_484_CM 6 0. 5. AXIS_PTS_REF ldp_nr_2_id_err_dtc /end AXIS_DESCR
/end CHARACTERISTIC
/begin CHARACTERISTIC fmy_id_fsd_1.dtc "DTC table declaration for the diagnosis instance XX" MAP 0xa1004094 _REC_MAP_20_u2_u2_u2 65535. _CNV_A_R_LINEAR_____0_CM 0. 65535. DISPLAY_IDENTIFIER ID_ERR_DTC_FSD_1 FORMAT "%5.0"
 /begin AXIS_DESCR COM_AXIS errm_online_dummy _CNV_S_2_ERRM_DTC_R_483_CM 1 0. 1. AXIS_PTS_REF ldp_nr_1_id_err_dtc /end AXIS_DESCR
 /begin AXIS_DESCR COM_AXIS errm_online_dummy _CNV_S_6_ERRM_DTC_R_484_CM 6 0. 5. AXIS_PTS_REF ldp_nr_2_id_err_dtc /end AXIS_DESCR
/end CHARACTERISTIC
/begin CHARACTERISTIC fmy_id_fsd_2.dtc "DTC table declaration for the diagnosis instance XX" MAP 0xa10040a8 _REC_MAP_20_u2_u2_u2 65535. _CNV_A_R_LINEAR_____0_CM 0. 65535. DISPLAY_IDENTIFIER ID_ERR_DTC_FSD_2 FORMAT "%5.0"
 /begin AXIS_DESCR COM_AXIS errm_online_dummy _CNV_S_2_ERRM_DTC_R_483_CM 1 0. 1. AXIS_PTS_REF ldp_nr_1_id_err_dtc /end AXIS_DESCR
 /begin AXIS_DESCR COM_AXIS errm_online_dummy _CNV_S_6_ERRM_DTC_R_484_CM 6 0. 5. AXIS_PTS_REF ldp_nr_2_id_err_dtc /end AXIS_DESCR
/end CHARACTERISTIC
/begin CHARACTERISTIC fmy_id_ef.dtc "DTC table declaration for the diagnosis instance XX" MAP 0xa1003fcc _REC_MAP_20_u2_u2_u2 65535. _CNV_A_R_LINEAR_____0_CM 0. 65535. DISPLAY_IDENTIFIER ID_ERR_DTC_EF FORMAT "%5.0"
 /begin AXIS_DESCR COM_AXIS errm_online_dummy _CNV_S_2_ERRM_DTC_R_483_CM 1 0. 1. AXIS_PTS_REF ldp_nr_1_id_err_dtc /end AXIS_DESCR
 /begin AXIS_DESCR COM_AXIS errm_online_dummy _CNV_S_6_ERRM_DTC_R_484_CM 6 0. 5. AXIS_PTS_REF ldp_nr_2_id_err_dtc /end AXIS_DESCR
/end CHARACTERISTIC
/begin CHARACTERISTIC fmy_id_tecu.dtc "DTC table declaration for the diagnosis instance XX" MAP 0xa1004d14 _REC_MAP_20_u2_u2_u2 65535. _CNV_A_R_LINEAR_____0_CM 0. 65535. DISPLAY_IDENTIFIER ID_ERR_DTC_TECU FORMAT "%5.0"
 /begin AXIS_DESCR COM_AXIS errm_online_dummy _CNV_S_2_ERRM_DTC_R_483_CM 1 0. 1. AXIS_PTS_REF ldp_nr_1_id_err_dtc /end AXIS_DESCR
 /begin AXIS_DESCR COM_AXIS errm_online_dummy _CNV_S_6_ERRM_DTC_R_484_CM 6 0. 5. AXIS_PTS_REF ldp_nr_2_id_err_dtc /end AXIS_DESCR
/end CHARACTERISTIC
/begin CHARACTERISTIC fmy_id_ebox_cfa.dtc "DTC table declaration for the diagnosis instance XX" MAP 0xa1003f18 _REC_MAP_20_u2_u2_u2 65535. _CNV_A_R_LINEAR_____0_CM 0. 65535. DISPLAY_IDENTIFIER ID_ERR_DTC_EBOX_CFA FORMAT "%5.0"
 /begin AXIS_DESCR COM_AXIS errm_online_dummy _CNV_S_2_ERRM_DTC_R_483_CM 1 0. 1. AXIS_PTS_REF ldp_nr_1_id_err_dtc /end AXIS_DESCR
 /begin AXIS_DESCR COM_AXIS errm_online_dummy _CNV_S_6_ERRM_DTC_R_484_CM 6 0. 5. AXIS_PTS_REF ldp_nr_2_id_err_dtc /end AXIS_DESCR
/end CHARACTERISTIC
/begin CHARACTERISTIC fmy_id_ecu_ram.dtc "DTC table declaration for the diagnosis instance XX" MAP 0xa1003fb8 _REC_MAP_20_u2_u2_u2 65535. _CNV_A_R_LINEAR_____0_CM 0. 65535. DISPLAY_IDENTIFIER ID_ERR_DTC_ECU_RAM FORMAT "%5.0"
 /begin AXIS_DESCR COM_AXIS errm_online_dummy _CNV_S_2_ERRM_DTC_R_483_CM 1 0. 1. AXIS_PTS_REF ldp_nr_1_id_err_dtc /end AXIS_DESCR
 /begin AXIS_DESCR COM_AXIS errm_online_dummy _CNV_S_6_ERRM_DTC_R_484_CM 6 0. 5. AXIS_PTS_REF ldp_nr_2_id_err_dtc /end AXIS_DESCR
/end CHARACTERISTIC
/begin CHARACTERISTIC fmy_id_tqi_lim.dtc "DTC table declaration for the diagnosis instance XX" MAP 0xa1004fa8 _REC_MAP_20_u2_u2_u2 65535. _CNV_A_R_LINEAR_____0_CM 0. 65535. DISPLAY_IDENTIFIER ID_ERR_DTC_TQI_LIM FORMAT "%5.0"
 /begin AXIS_DESCR COM_AXIS errm_online_dummy _CNV_S_2_ERRM_DTC_R_483_CM 1 0. 1. AXIS_PTS_REF ldp_nr_1_id_err_dtc /end AXIS_DESCR
 /begin AXIS_DESCR COM_AXIS errm_online_dummy _CNV_S_6_ERRM_DTC_R_484_CM 6 0. 5. AXIS_PTS_REF ldp_nr_2_id_err_dtc /end AXIS_DESCR
/end CHARACTERISTIC
/begin CHARACTERISTIC fmy_id_obd2_lsh_down_1.dtc "DTC table declaration for the diagnosis instance XX" MAP 0xa10046fc _REC_MAP_20_u2_u2_u2 65535. _CNV_A_R_LINEAR_____0_CM 0. 65535. DISPLAY_IDENTIFIER ID_ERR_DTC_OBD2_LSH_DOWN_1 FORMAT "%5.0"
 /begin AXIS_DESCR COM_AXIS errm_online_dummy _CNV_S_2_ERRM_DTC_R_483_CM 1 0. 1. AXIS_PTS_REF ldp_nr_1_id_err_dtc /end AXIS_DESCR
 /begin AXIS_DESCR COM_AXIS errm_online_dummy _CNV_S_6_ERRM_DTC_R_484_CM 6 0. 5. AXIS_PTS_REF ldp_nr_2_id_err_dtc /end AXIS_DESCR
/end CHARACTERISTIC
/begin CHARACTERISTIC fmy_id_obd2_lsh_down_2.dtc "DTC table declaration for the diagnosis instance XX" MAP 0xa1004710 _REC_MAP_20_u2_u2_u2 65535. _CNV_A_R_LINEAR_____0_CM 0. 65535. DISPLAY_IDENTIFIER ID_ERR_DTC_OBD2_LSH_DOWN_2 FORMAT "%5.0"
 /begin AXIS_DESCR COM_AXIS errm_online_dummy _CNV_S_2_ERRM_DTC_R_483_CM 1 0. 1. AXIS_PTS_REF ldp_nr_1_id_err_dtc /end AXIS_DESCR
 /begin AXIS_DESCR COM_AXIS errm_online_dummy _CNV_S_6_ERRM_DTC_R_484_CM 6 0. 5. AXIS_PTS_REF ldp_nr_2_id_err_dtc /end AXIS_DESCR
/end CHARACTERISTIC
/begin CHARACTERISTIC fmy_id_dmtls.dtc "DTC table declaration for the diagnosis instance XX" MAP 0xa1003ec8 _REC_MAP_20_u2_u2_u2 65535. _CNV_A_R_LINEAR_____0_CM 0. 65535. DISPLAY_IDENTIFIER ID_ERR_DTC_DMTLS FORMAT "%5.0"
 /begin AXIS_DESCR COM_AXIS errm_online_dummy _CNV_S_2_ERRM_DTC_R_483_CM 1 0. 1. AXIS_PTS_REF ldp_nr_1_id_err_dtc /end AXIS_DESCR
 /begin AXIS_DESCR COM_AXIS errm_online_dummy _CNV_S_6_ERRM_DTC_R_484_CM 6 0. 5. AXIS_PTS_REF ldp_nr_2_id_err_dtc /end AXIS_DESCR
/end CHARACTERISTIC
/begin CHARACTERISTIC fmy_id_dmtl_pump.dtc "DTC table declaration for the diagnosis instance XX" MAP 0xa1003e8c _REC_MAP_20_u2_u2_u2 65535. _CNV_A_R_LINEAR_____0_CM 0. 65535. DISPLAY_IDENTIFIER ID_ERR_DTC_DMTL_PUMP FORMAT "%5.0"
 /begin AXIS_DESCR COM_AXIS errm_online_dummy _CNV_S_2_ERRM_DTC_R_483_CM 1 0. 1. AXIS_PTS_REF ldp_nr_1_id_err_dtc /end AXIS_DESCR
 /begin AXIS_DESCR COM_AXIS errm_online_dummy _CNV_S_6_ERRM_DTC_R_484_CM 6 0. 5. AXIS_PTS_REF ldp_nr_2_id_err_dtc /end AXIS_DESCR
/end CHARACTERISTIC
/begin CHARACTERISTIC fmy_id_dmtlm.dtc "DTC table declaration for the diagnosis instance XX" MAP 0xa1003eb4 _REC_MAP_20_u2_u2_u2 65535. _CNV_A_R_LINEAR_____0_CM 0. 65535. DISPLAY_IDENTIFIER ID_ERR_DTC_DMTLM FORMAT "%5.0"
 /begin AXIS_DESCR COM_AXIS errm_online_dummy _CNV_S_2_ERRM_DTC_R_483_CM 1 0. 1. AXIS_PTS_REF ldp_nr_1_id_err_dtc /end AXIS_DESCR
 /begin AXIS_DESCR COM_AXIS errm_online_dummy _CNV_S_6_ERRM_DTC_R_484_CM 6 0. 5. AXIS_PTS_REF ldp_nr_2_id_err_dtc /end AXIS_DESCR
/end CHARACTERISTIC
/begin CHARACTERISTIC fmy_id_rough_leak.dtc "DTC table declaration for the diagnosis instance XX" MAP 0xa1004a44 _REC_MAP_20_u2_u2_u2 65535. _CNV_A_R_LINEAR_____0_CM 0. 65535. DISPLAY_IDENTIFIER ID_ERR_DTC_ROUGH_LEAK FORMAT "%5.0"
 /begin AXIS_DESCR COM_AXIS errm_online_dummy _CNV_S_2_ERRM_DTC_R_483_CM 1 0. 1. AXIS_PTS_REF ldp_nr_1_id_err_dtc /end AXIS_DESCR
 /begin AXIS_DESCR COM_AXIS errm_online_dummy _CNV_S_6_ERRM_DTC_R_484_CM 6 0. 5. AXIS_PTS_REF ldp_nr_2_id_err_dtc /end AXIS_DESCR
/end CHARACTERISTIC
/begin CHARACTERISTIC fmy_id_small_leak.dtc "DTC table declaration for the diagnosis instance XX" MAP 0xa1004b5c _REC_MAP_20_u2_u2_u2 65535. _CNV_A_R_LINEAR_____0_CM 0. 65535. DISPLAY_IDENTIFIER ID_ERR_DTC_SMALL_LEAK FORMAT "%5.0"
 /begin AXIS_DESCR COM_AXIS errm_online_dummy _CNV_S_2_ERRM_DTC_R_483_CM 1 0. 1. AXIS_PTS_REF ldp_nr_1_id_err_dtc /end AXIS_DESCR
 /begin AXIS_DESCR COM_AXIS errm_online_dummy _CNV_S_6_ERRM_DTC_R_484_CM 6 0. 5. AXIS_PTS_REF ldp_nr_2_id_err_dtc /end AXIS_DESCR
/end CHARACTERISTIC
/begin CHARACTERISTIC fmy_id_chk_fuc.dtc "DTC table declaration for the diagnosis instance XX" MAP 0xa1003ce8 _REC_MAP_20_u2_u2_u2 65535. _CNV_A_R_LINEAR_____0_CM 0. 65535. DISPLAY_IDENTIFIER ID_ERR_DTC_CHK_FUC FORMAT "%5.0"
 /begin AXIS_DESCR COM_AXIS errm_online_dummy _CNV_S_2_ERRM_DTC_R_483_CM 1 0. 1. AXIS_PTS_REF ldp_nr_1_id_err_dtc /end AXIS_DESCR
 /begin AXIS_DESCR COM_AXIS errm_online_dummy _CNV_S_6_ERRM_DTC_R_484_CM 6 0. 5. AXIS_PTS_REF ldp_nr_2_id_err_dtc /end AXIS_DESCR
/end CHARACTERISTIC
/begin CHARACTERISTIC fmy_id_sof.dtc "DTC table declaration for the diagnosis instance XX" MAP 0xa1004b70 _REC_MAP_20_u2_u2_u2 65535. _CNV_A_R_LINEAR_____0_CM 0. 65535. DISPLAY_IDENTIFIER ID_ERR_DTC_SOF FORMAT "%5.0"
 /begin AXIS_DESCR COM_AXIS errm_online_dummy _CNV_S_2_ERRM_DTC_R_483_CM 1 0. 1. AXIS_PTS_REF ldp_nr_1_id_err_dtc /end AXIS_DESCR
 /begin AXIS_DESCR COM_AXIS errm_online_dummy _CNV_S_6_ERRM_DTC_R_484_CM 6 0. 5. AXIS_PTS_REF ldp_nr_2_id_err_dtc /end AXIS_DESCR
/end CHARACTERISTIC
/begin CHARACTERISTIC fmy_id_sof_req.dtc "DTC table declaration for the diagnosis instance XX" MAP 0xa1004b84 _REC_MAP_20_u2_u2_u2 65535. _CNV_A_R_LINEAR_____0_CM 0. 65535. DISPLAY_IDENTIFIER ID_ERR_DTC_SOF_REQ FORMAT "%5.0"
 /begin AXIS_DESCR COM_AXIS errm_online_dummy _CNV_S_2_ERRM_DTC_R_483_CM 1 0. 1. AXIS_PTS_REF ldp_nr_1_id_err_dtc /end AXIS_DESCR
 /begin AXIS_DESCR COM_AXIS errm_online_dummy _CNV_S_6_ERRM_DTC_R_484_CM 6 0. 5. AXIS_PTS_REF ldp_nr_2_id_err_dtc /end AXIS_DESCR
/end CHARACTERISTIC
/begin CHARACTERISTIC fmy_id_rly_crcv_heat.dtc "DTC table declaration for the diagnosis instance XX" MAP 0xa10049cc _REC_MAP_20_u2_u2_u2 65535. _CNV_A_R_LINEAR_____0_CM 0. 65535. DISPLAY_IDENTIFIER ID_ERR_DTC_RLY_CRCV_HEAT FORMAT "%5.0"
 /begin AXIS_DESCR COM_AXIS errm_online_dummy _CNV_S_2_ERRM_DTC_R_483_CM 1 0. 1. AXIS_PTS_REF ldp_nr_1_id_err_dtc /end AXIS_DESCR
 /begin AXIS_DESCR COM_AXIS errm_online_dummy _CNV_S_6_ERRM_DTC_R_484_CM 6 0. 5. AXIS_PTS_REF ldp_nr_2_id_err_dtc /end AXIS_DESCR
/end CHARACTERISTIC
/begin CHARACTERISTIC fmy_id_rly_st.dtc "DTC table declaration for the diagnosis instance XX" MAP 0xa1004a1c _REC_MAP_20_u2_u2_u2 65535. _CNV_A_R_LINEAR_____0_CM 0. 65535. DISPLAY_IDENTIFIER ID_ERR_DTC_RLY_ST FORMAT "%5.0"
 /begin AXIS_DESCR COM_AXIS errm_online_dummy _CNV_S_2_ERRM_DTC_R_483_CM 1 0. 1. AXIS_PTS_REF ldp_nr_1_id_err_dtc /end AXIS_DESCR
 /begin AXIS_DESCR COM_AXIS errm_online_dummy _CNV_S_6_ERRM_DTC_R_484_CM 6 0. 5. AXIS_PTS_REF ldp_nr_2_id_err_dtc /end AXIS_DESCR
/end CHARACTERISTIC
/begin CHARACTERISTIC fmy_id_bsd.dtc "DTC table declaration for the diagnosis instance XX" MAP 0xa1003c34 _REC_MAP_20_u2_u2_u2 65535. _CNV_A_R_LINEAR_____0_CM 0. 65535. DISPLAY_IDENTIFIER ID_ERR_DTC_BSD FORMAT "%5.0"
 /begin AXIS_DESCR COM_AXIS errm_online_dummy _CNV_S_2_ERRM_DTC_R_483_CM 1 0. 1. AXIS_PTS_REF ldp_nr_1_id_err_dtc /end AXIS_DESCR
 /begin AXIS_DESCR COM_AXIS errm_online_dummy _CNV_S_6_ERRM_DTC_R_484_CM 6 0. 5. AXIS_PTS_REF ldp_nr_2_id_err_dtc /end AXIS_DESCR
/end CHARACTERISTIC
/begin CHARACTERISTIC fmy_id_poil_swi.dtc "DTC table declaration for the diagnosis instance XX" MAP 0xa100483c _REC_MAP_20_u2_u2_u2 65535. _CNV_A_R_LINEAR_____0_CM 0. 65535. DISPLAY_IDENTIFIER ID_ERR_DTC_POIL_SWI FORMAT "%5.0"
 /begin AXIS_DESCR COM_AXIS errm_online_dummy _CNV_S_2_ERRM_DTC_R_483_CM 1 0. 1. AXIS_PTS_REF ldp_nr_1_id_err_dtc /end AXIS_DESCR
 /begin AXIS_DESCR COM_AXIS errm_online_dummy _CNV_S_6_ERRM_DTC_R_484_CM 6 0. 5. AXIS_PTS_REF ldp_nr_2_id_err_dtc /end AXIS_DESCR
/end CHARACTERISTIC
/begin CHARACTERISTIC fmy_id_tout_efp_can.dtc "DTC table declaration for the diagnosis instance XX" MAP 0xa1004df0 _REC_MAP_20_u2_u2_u2 65535. _CNV_A_R_LINEAR_____0_CM 0. 65535. DISPLAY_IDENTIFIER ID_ERR_DTC_TOUT_EFP_CAN FORMAT "%5.0"
 /begin AXIS_DESCR COM_AXIS errm_online_dummy _CNV_S_2_ERRM_DTC_R_483_CM 1 0. 1. AXIS_PTS_REF ldp_nr_1_id_err_dtc /end AXIS_DESCR
 /begin AXIS_DESCR COM_AXIS errm_online_dummy _CNV_S_6_ERRM_DTC_R_484_CM 6 0. 5. AXIS_PTS_REF ldp_nr_2_id_err_dtc /end AXIS_DESCR
/end CHARACTERISTIC
/begin CHARACTERISTIC fmy_id_diagcps.dtc "DTC table declaration for the diagnosis instance XX" MAP 0xa1003e78 _REC_MAP_20_u2_u2_u2 65535. _CNV_A_R_LINEAR_____0_CM 0. 65535. DISPLAY_IDENTIFIER ID_ERR_DTC_DIAGCPS FORMAT "%5.0"
 /begin AXIS_DESCR COM_AXIS errm_online_dummy _CNV_S_2_ERRM_DTC_R_483_CM 1 0. 1. AXIS_PTS_REF ldp_nr_1_id_err_dtc /end AXIS_DESCR
 /begin AXIS_DESCR COM_AXIS errm_online_dummy _CNV_S_6_ERRM_DTC_R_484_CM 6 0. 5. AXIS_PTS_REF ldp_nr_2_id_err_dtc /end AXIS_DESCR
/end CHARACTERISTIC
/begin CHARACTERISTIC fmy_id_dcc.dtc "DTC table declaration for the diagnosis instance XX" MAP 0xa1003e3c _REC_MAP_20_u2_u2_u2 65535. _CNV_A_R_LINEAR_____0_CM 0. 65535. DISPLAY_IDENTIFIER ID_ERR_DTC_DCC FORMAT "%5.0"
 /begin AXIS_DESCR COM_AXIS errm_online_dummy _CNV_S_2_ERRM_DTC_R_483_CM 1 0. 1. AXIS_PTS_REF ldp_nr_1_id_err_dtc /end AXIS_DESCR
 /begin AXIS_DESCR COM_AXIS errm_online_dummy _CNV_S_6_ERRM_DTC_R_484_CM 6 0. 5. AXIS_PTS_REF ldp_nr_2_id_err_dtc /end AXIS_DESCR
/end CHARACTERISTIC
/begin CHARACTERISTIC fmy_id_ldm.dtc "DTC table declaration for the diagnosis instance XX" MAP 0xa1004418 _REC_MAP_20_u2_u2_u2 65535. _CNV_A_R_LINEAR_____0_CM 0. 65535. DISPLAY_IDENTIFIER ID_ERR_DTC_LDM FORMAT "%5.0"
 /begin AXIS_DESCR COM_AXIS errm_online_dummy _CNV_S_2_ERRM_DTC_R_483_CM 1 0. 1. AXIS_PTS_REF ldp_nr_1_id_err_dtc /end AXIS_DESCR
 /begin AXIS_DESCR COM_AXIS errm_online_dummy _CNV_S_6_ERRM_DTC_R_484_CM 6 0. 5. AXIS_PTS_REF ldp_nr_2_id_err_dtc /end AXIS_DESCR
/end CHARACTERISTIC
/begin CHARACTERISTIC fmy_id_dmtlh.dtc "DTC table declaration for the diagnosis instance XX" MAP 0xa1003ea0 _REC_MAP_20_u2_u2_u2 65535. _CNV_A_R_LINEAR_____0_CM 0. 65535. DISPLAY_IDENTIFIER ID_ERR_DTC_DMTLH FORMAT "%5.0"
 /begin AXIS_DESCR COM_AXIS errm_online_dummy _CNV_S_2_ERRM_DTC_R_483_CM 1 0. 1. AXIS_PTS_REF ldp_nr_1_id_err_dtc /end AXIS_DESCR
 /begin AXIS_DESCR COM_AXIS errm_online_dummy _CNV_S_6_ERRM_DTC_R_484_CM 6 0. 5. AXIS_PTS_REF ldp_nr_2_id_err_dtc /end AXIS_DESCR
/end CHARACTERISTIC
/begin CHARACTERISTIC fmy_id_cs.dtc "DTC table declaration for the diagnosis instance XX" MAP 0xa1003db0 _REC_MAP_20_u2_u2_u2 65535. _CNV_A_R_LINEAR_____0_CM 0. 65535. DISPLAY_IDENTIFIER ID_ERR_DTC_CS FORMAT "%5.0"
 /begin AXIS_DESCR COM_AXIS errm_online_dummy _CNV_S_2_ERRM_DTC_R_483_CM 1 0. 1. AXIS_PTS_REF ldp_nr_1_id_err_dtc /end AXIS_DESCR
 /begin AXIS_DESCR COM_AXIS errm_online_dummy _CNV_S_6_ERRM_DTC_R_484_CM 6 0. 5. AXIS_PTS_REF ldp_nr_2_id_err_dtc /end AXIS_DESCR
/end CHARACTERISTIC
/begin CHARACTERISTIC fmy_id_spi_mps.dtc "DTC table declaration for the diagnosis instance XX" MAP 0xa1004bac _REC_MAP_20_u2_u2_u2 65535. _CNV_A_R_LINEAR_____0_CM 0. 65535. DISPLAY_IDENTIFIER ID_ERR_DTC_SPI_MPS FORMAT "%5.0"
 /begin AXIS_DESCR COM_AXIS errm_online_dummy _CNV_S_2_ERRM_DTC_R_483_CM 1 0. 1. AXIS_PTS_REF ldp_nr_1_id_err_dtc /end AXIS_DESCR
 /begin AXIS_DESCR COM_AXIS errm_online_dummy _CNV_S_6_ERRM_DTC_R_484_CM 6 0. 5. AXIS_PTS_REF ldp_nr_2_id_err_dtc /end AXIS_DESCR
/end CHARACTERISTIC
/begin CHARACTERISTIC fmy_id_spi_knk.dtc "DTC table declaration for the diagnosis instance XX" MAP 0xa1004b98 _REC_MAP_20_u2_u2_u2 65535. _CNV_A_R_LINEAR_____0_CM 0. 65535. DISPLAY_IDENTIFIER ID_ERR_DTC_SPI_KNK FORMAT "%5.0"
 /begin AXIS_DESCR COM_AXIS errm_online_dummy _CNV_S_2_ERRM_DTC_R_483_CM 1 0. 1. AXIS_PTS_REF ldp_nr_1_id_err_dtc /end AXIS_DESCR
 /begin AXIS_DESCR COM_AXIS errm_online_dummy _CNV_S_6_ERRM_DTC_R_484_CM 6 0. 5. AXIS_PTS_REF ldp_nr_2_id_err_dtc /end AXIS_DESCR
/end CHARACTERISTIC
/begin CHARACTERISTIC fmy_id_bn_tq_dcc.dtc "DTC table declaration for the diagnosis instance XX" MAP 0xa1003ba8 _REC_MAP_20_u2_u2_u2 65535. _CNV_A_R_LINEAR_____0_CM 0. 65535. DISPLAY_IDENTIFIER ID_ERR_DTC_BN_TQ_DCC FORMAT "%5.0"
 /begin AXIS_DESCR COM_AXIS errm_online_dummy _CNV_S_2_ERRM_DTC_R_483_CM 1 0. 1. AXIS_PTS_REF ldp_nr_1_id_err_dtc /end AXIS_DESCR
 /begin AXIS_DESCR COM_AXIS errm_online_dummy _CNV_S_6_ERRM_DTC_R_484_CM 6 0. 5. AXIS_PTS_REF ldp_nr_2_id_err_dtc /end AXIS_DESCR
/end CHARACTERISTIC
/begin CHARACTERISTIC fmy_id_bn_tq_pste_2.dtc "DTC table declaration for the diagnosis instance XX" MAP 0xa1003bd0 _REC_MAP_20_u2_u2_u2 65535. _CNV_A_R_LINEAR_____0_CM 0. 65535. DISPLAY_IDENTIFIER ID_ERR_DTC_BN_TQ_PSTE_2 FORMAT "%5.0"
 /begin AXIS_DESCR COM_AXIS errm_online_dummy _CNV_S_2_ERRM_DTC_R_483_CM 1 0. 1. AXIS_PTS_REF ldp_nr_1_id_err_dtc /end AXIS_DESCR
 /begin AXIS_DESCR COM_AXIS errm_online_dummy _CNV_S_6_ERRM_DTC_R_484_CM 6 0. 5. AXIS_PTS_REF ldp_nr_2_id_err_dtc /end AXIS_DESCR
/end CHARACTERISTIC
/begin CHARACTERISTIC fmy_id_bn_ars.dtc "DTC table declaration for the diagnosis instance XX" MAP 0xa1003a18 _REC_MAP_20_u2_u2_u2 65535. _CNV_A_R_LINEAR_____0_CM 0. 65535. DISPLAY_IDENTIFIER ID_ERR_DTC_BN_ARS FORMAT "%5.0"
 /begin AXIS_DESCR COM_AXIS errm_online_dummy _CNV_S_2_ERRM_DTC_R_483_CM 1 0. 1. AXIS_PTS_REF ldp_nr_1_id_err_dtc /end AXIS_DESCR
 /begin AXIS_DESCR COM_AXIS errm_online_dummy _CNV_S_6_ERRM_DTC_R_484_CM 6 0. 5. AXIS_PTS_REF ldp_nr_2_id_err_dtc /end AXIS_DESCR
/end CHARACTERISTIC
/begin CHARACTERISTIC fmy_id_bn_cas.dtc "DTC table declaration for the diagnosis instance XX" MAP 0xa1003a2c _REC_MAP_20_u2_u2_u2 65535. _CNV_A_R_LINEAR_____0_CM 0. 65535. DISPLAY_IDENTIFIER ID_ERR_DTC_BN_CAS FORMAT "%5.0"
 /begin AXIS_DESCR COM_AXIS errm_online_dummy _CNV_S_2_ERRM_DTC_R_483_CM 1 0. 1. AXIS_PTS_REF ldp_nr_1_id_err_dtc /end AXIS_DESCR
 /begin AXIS_DESCR COM_AXIS errm_online_dummy _CNV_S_6_ERRM_DTC_R_484_CM 6 0. 5. AXIS_PTS_REF ldp_nr_2_id_err_dtc /end AXIS_DESCR
/end CHARACTERISTIC
/begin CHARACTERISTIC fmy_id_bn_tq_tcs.dtc "DTC table declaration for the diagnosis instance XX" MAP 0xa1003be4 _REC_MAP_20_u2_u2_u2 65535. _CNV_A_R_LINEAR_____0_CM 0. 65535. DISPLAY_IDENTIFIER ID_ERR_DTC_BN_TQ_TCS FORMAT "%5.0"
 /begin AXIS_DESCR COM_AXIS errm_online_dummy _CNV_S_2_ERRM_DTC_R_483_CM 1 0. 1. AXIS_PTS_REF ldp_nr_1_id_err_dtc /end AXIS_DESCR
 /begin AXIS_DESCR COM_AXIS errm_online_dummy _CNV_S_6_ERRM_DTC_R_484_CM 6 0. 5. AXIS_PTS_REF ldp_nr_2_id_err_dtc /end AXIS_DESCR
/end CHARACTERISTIC
/begin CHARACTERISTIC fmy_id_bn_vs_tcs.dtc "DTC table declaration for the diagnosis instance XX" MAP 0xa1003c20 _REC_MAP_20_u2_u2_u2 65535. _CNV_A_R_LINEAR_____0_CM 0. 65535. DISPLAY_IDENTIFIER ID_ERR_DTC_BN_VS_TCS FORMAT "%5.0"
 /begin AXIS_DESCR COM_AXIS errm_online_dummy _CNV_S_2_ERRM_DTC_R_483_CM 1 0. 1. AXIS_PTS_REF ldp_nr_1_id_err_dtc /end AXIS_DESCR
 /begin AXIS_DESCR COM_AXIS errm_online_dummy _CNV_S_6_ERRM_DTC_R_484_CM 6 0. 5. AXIS_PTS_REF ldp_nr_2_id_err_dtc /end AXIS_DESCR
/end CHARACTERISTIC
/begin CHARACTERISTIC fmy_id_bn_tcs.dtc "DTC table declaration for the diagnosis instance XX" MAP 0xa1003b80 _REC_MAP_20_u2_u2_u2 65535. _CNV_A_R_LINEAR_____0_CM 0. 65535. DISPLAY_IDENTIFIER ID_ERR_DTC_BN_TCS FORMAT "%5.0"
 /begin AXIS_DESCR COM_AXIS errm_online_dummy _CNV_S_2_ERRM_DTC_R_483_CM 1 0. 1. AXIS_PTS_REF ldp_nr_1_id_err_dtc /end AXIS_DESCR
 /begin AXIS_DESCR COM_AXIS errm_online_dummy _CNV_S_6_ERRM_DTC_R_484_CM 6 0. 5. AXIS_PTS_REF ldp_nr_2_id_err_dtc /end AXIS_DESCR
/end CHARACTERISTIC
/begin CHARACTERISTIC fmy_id_bn_tq_etcu.dtc "DTC table declaration for the diagnosis instance XX" MAP 0xa1003bbc _REC_MAP_20_u2_u2_u2 65535. _CNV_A_R_LINEAR_____0_CM 0. 65535. DISPLAY_IDENTIFIER ID_ERR_DTC_BN_TQ_ETCU FORMAT "%5.0"
 /begin AXIS_DESCR COM_AXIS errm_online_dummy _CNV_S_2_ERRM_DTC_R_483_CM 1 0. 1. AXIS_PTS_REF ldp_nr_1_id_err_dtc /end AXIS_DESCR
 /begin AXIS_DESCR COM_AXIS errm_online_dummy _CNV_S_6_ERRM_DTC_R_484_CM 6 0. 5. AXIS_PTS_REF ldp_nr_2_id_err_dtc /end AXIS_DESCR
/end CHARACTERISTIC
/begin CHARACTERISTIC fmy_id_bn_etcu.dtc "DTC table declaration for the diagnosis instance XX" MAP 0xa1003a68 _REC_MAP_20_u2_u2_u2 65535. _CNV_A_R_LINEAR_____0_CM 0. 65535. DISPLAY_IDENTIFIER ID_ERR_DTC_BN_ETCU FORMAT "%5.0"
 /begin AXIS_DESCR COM_AXIS errm_online_dummy _CNV_S_2_ERRM_DTC_R_483_CM 1 0. 1. AXIS_PTS_REF ldp_nr_1_id_err_dtc /end AXIS_DESCR
 /begin AXIS_DESCR COM_AXIS errm_online_dummy _CNV_S_6_ERRM_DTC_R_484_CM 6 0. 5. AXIS_PTS_REF ldp_nr_2_id_err_dtc /end AXIS_DESCR
/end CHARACTERISTIC
/begin CHARACTERISTIC fmy_id_bn_etcu_2.dtc "DTC table declaration for the diagnosis instance XX" MAP 0xa1003a7c _REC_MAP_20_u2_u2_u2 65535. _CNV_A_R_LINEAR_____0_CM 0. 65535. DISPLAY_IDENTIFIER ID_ERR_DTC_BN_ETCU_2 FORMAT "%5.0"
 /begin AXIS_DESCR COM_AXIS errm_online_dummy _CNV_S_2_ERRM_DTC_R_483_CM 1 0. 1. AXIS_PTS_REF ldp_nr_1_id_err_dtc /end AXIS_DESCR
 /begin AXIS_DESCR COM_AXIS errm_online_dummy _CNV_S_6_ERRM_DTC_R_484_CM 6 0. 5. AXIS_PTS_REF ldp_nr_2_id_err_dtc /end AXIS_DESCR
/end CHARACTERISTIC
/begin CHARACTERISTIC fmy_id_bn_etcu_disp.dtc "DTC table declaration for the diagnosis instance XX" MAP 0xa1003a90 _REC_MAP_20_u2_u2_u2 65535. _CNV_A_R_LINEAR_____0_CM 0. 65535. DISPLAY_IDENTIFIER ID_ERR_DTC_BN_ETCU_DISP FORMAT "%5.0"
 /begin AXIS_DESCR COM_AXIS errm_online_dummy _CNV_S_2_ERRM_DTC_R_483_CM 1 0. 1. AXIS_PTS_REF ldp_nr_1_id_err_dtc /end AXIS_DESCR
 /begin AXIS_DESCR COM_AXIS errm_online_dummy _CNV_S_6_ERRM_DTC_R_484_CM 6 0. 5. AXIS_PTS_REF ldp_nr_2_id_err_dtc /end AXIS_DESCR
/end CHARACTERISTIC
/begin CHARACTERISTIC fmy_id_bn_tq_amt.dtc "DTC table declaration for the diagnosis instance XX" MAP 0xa1003b94 _REC_MAP_20_u2_u2_u2 65535. _CNV_A_R_LINEAR_____0_CM 0. 65535. DISPLAY_IDENTIFIER ID_ERR_DTC_BN_TQ_AMT FORMAT "%5.0"
 /begin AXIS_DESCR COM_AXIS errm_online_dummy _CNV_S_2_ERRM_DTC_R_483_CM 1 0. 1. AXIS_PTS_REF ldp_nr_1_id_err_dtc /end AXIS_DESCR
 /begin AXIS_DESCR COM_AXIS errm_online_dummy _CNV_S_6_ERRM_DTC_R_484_CM 6 0. 5. AXIS_PTS_REF ldp_nr_2_id_err_dtc /end AXIS_DESCR
/end CHARACTERISTIC
/begin CHARACTERISTIC fmy_id_bn_acc.dtc "DTC table declaration for the diagnosis instance XX" MAP 0xa10039f0 _REC_MAP_20_u2_u2_u2 65535. _CNV_A_R_LINEAR_____0_CM 0. 65535. DISPLAY_IDENTIFIER ID_ERR_DTC_BN_ACC FORMAT "%5.0"
 /begin AXIS_DESCR COM_AXIS errm_online_dummy _CNV_S_2_ERRM_DTC_R_483_CM 1 0. 1. AXIS_PTS_REF ldp_nr_1_id_err_dtc /end AXIS_DESCR
 /begin AXIS_DESCR COM_AXIS errm_online_dummy _CNV_S_6_ERRM_DTC_R_484_CM 6 0. 5. AXIS_PTS_REF ldp_nr_2_id_err_dtc /end AXIS_DESCR
/end CHARACTERISTIC
/begin CHARACTERISTIC fmy_id_bn_t_icl.dtc "DTC table declaration for the diagnosis instance XX" MAP 0xa1003b6c _REC_MAP_20_u2_u2_u2 65535. _CNV_A_R_LINEAR_____0_CM 0. 65535. DISPLAY_IDENTIFIER ID_ERR_DTC_BN_T_ICL FORMAT "%5.0"
 /begin AXIS_DESCR COM_AXIS errm_online_dummy _CNV_S_2_ERRM_DTC_R_483_CM 1 0. 1. AXIS_PTS_REF ldp_nr_1_id_err_dtc /end AXIS_DESCR
 /begin AXIS_DESCR COM_AXIS errm_online_dummy _CNV_S_6_ERRM_DTC_R_484_CM 6 0. 5. AXIS_PTS_REF ldp_nr_2_id_err_dtc /end AXIS_DESCR
/end CHARACTERISTIC
/begin CHARACTERISTIC fmy_id_bn_veh_mod.dtc "DTC table declaration for the diagnosis instance XX" MAP 0xa1003c0c _REC_MAP_20_u2_u2_u2 65535. _CNV_A_R_LINEAR_____0_CM 0. 65535. DISPLAY_IDENTIFIER ID_ERR_DTC_BN_VEH_MOD FORMAT "%5.0"
 /begin AXIS_DESCR COM_AXIS errm_online_dummy _CNV_S_2_ERRM_DTC_R_483_CM 1 0. 1. AXIS_PTS_REF ldp_nr_1_id_err_dtc /end AXIS_DESCR
 /begin AXIS_DESCR COM_AXIS errm_online_dummy _CNV_S_6_ERRM_DTC_R_484_CM 6 0. 5. AXIS_PTS_REF ldp_nr_2_id_err_dtc /end AXIS_DESCR
/end CHARACTERISTIC
/begin CHARACTERISTIC fmy_id_bn_km_icl.dtc "DTC table declaration for the diagnosis instance XX" MAP 0xa1003ae0 _REC_MAP_20_u2_u2_u2 65535. _CNV_A_R_LINEAR_____0_CM 0. 65535. DISPLAY_IDENTIFIER ID_ERR_DTC_BN_KM_ICL FORMAT "%5.0"
 /begin AXIS_DESCR COM_AXIS errm_online_dummy _CNV_S_2_ERRM_DTC_R_483_CM 1 0. 1. AXIS_PTS_REF ldp_nr_1_id_err_dtc /end AXIS_DESCR
 /begin AXIS_DESCR COM_AXIS errm_online_dummy _CNV_S_6_ERRM_DTC_R_484_CM 6 0. 5. AXIS_PTS_REF ldp_nr_2_id_err_dtc /end AXIS_DESCR
/end CHARACTERISTIC
/begin CHARACTERISTIC fmy_id_bn_icl.dtc "DTC table declaration for the diagnosis instance XX" MAP 0xa1003acc _REC_MAP_20_u2_u2_u2 65535. _CNV_A_R_LINEAR_____0_CM 0. 65535. DISPLAY_IDENTIFIER ID_ERR_DTC_BN_ICL FORMAT "%5.0"
 /begin AXIS_DESCR COM_AXIS errm_online_dummy _CNV_S_2_ERRM_DTC_R_483_CM 1 0. 1. AXIS_PTS_REF ldp_nr_1_id_err_dtc /end AXIS_DESCR
 /begin AXIS_DESCR COM_AXIS errm_online_dummy _CNV_S_6_ERRM_DTC_R_484_CM 6 0. 5. AXIS_PTS_REF ldp_nr_2_id_err_dtc /end AXIS_DESCR
/end CHARACTERISTIC
/begin CHARACTERISTIC fmy_id_bn_pow_vb.dtc "DTC table declaration for the diagnosis instance XX" MAP 0xa1003b44 _REC_MAP_20_u2_u2_u2 65535. _CNV_A_R_LINEAR_____0_CM 0. 65535. DISPLAY_IDENTIFIER ID_ERR_DTC_BN_POW_VB FORMAT "%5.0"
 /begin AXIS_DESCR COM_AXIS errm_online_dummy _CNV_S_2_ERRM_DTC_R_483_CM 1 0. 1. AXIS_PTS_REF ldp_nr_1_id_err_dtc /end AXIS_DESCR
 /begin AXIS_DESCR COM_AXIS errm_online_dummy _CNV_S_6_ERRM_DTC_R_484_CM 6 0. 5. AXIS_PTS_REF ldp_nr_2_id_err_dtc /end AXIS_DESCR
/end CHARACTERISTIC
/begin CHARACTERISTIC fmy_id_bn_pow_gen.dtc "DTC table declaration for the diagnosis instance XX" MAP 0xa1003b30 _REC_MAP_20_u2_u2_u2 65535. _CNV_A_R_LINEAR_____0_CM 0. 65535. DISPLAY_IDENTIFIER ID_ERR_DTC_BN_POW_GEN FORMAT "%5.0"
 /begin AXIS_DESCR COM_AXIS errm_online_dummy _CNV_S_2_ERRM_DTC_R_483_CM 1 0. 1. AXIS_PTS_REF ldp_nr_1_id_err_dtc /end AXIS_DESCR
 /begin AXIS_DESCR COM_AXIS errm_online_dummy _CNV_S_6_ERRM_DTC_R_484_CM 6 0. 5. AXIS_PTS_REF ldp_nr_2_id_err_dtc /end AXIS_DESCR
/end CHARACTERISTIC
/begin CHARACTERISTIC fmy_id_bn_msw.dtc "DTC table declaration for the diagnosis instance XX" MAP 0xa1003b1c _REC_MAP_20_u2_u2_u2 65535. _CNV_A_R_LINEAR_____0_CM 0. 65535. DISPLAY_IDENTIFIER ID_ERR_DTC_BN_MSW FORMAT "%5.0"
 /begin AXIS_DESCR COM_AXIS errm_online_dummy _CNV_S_2_ERRM_DTC_R_483_CM 1 0. 1. AXIS_PTS_REF ldp_nr_1_id_err_dtc /end AXIS_DESCR
 /begin AXIS_DESCR COM_AXIS errm_online_dummy _CNV_S_6_ERRM_DTC_R_484_CM 6 0. 5. AXIS_PTS_REF ldp_nr_2_id_err_dtc /end AXIS_DESCR
/end CHARACTERISTIC
/begin CHARACTERISTIC fmy_id_bn_ang_pste.dtc "DTC table declaration for the diagnosis instance XX" MAP 0xa1003a04 _REC_MAP_20_u2_u2_u2 65535. _CNV_A_R_LINEAR_____0_CM 0. 65535. DISPLAY_IDENTIFIER ID_ERR_DTC_BN_ANG_PSTE FORMAT "%5.0"
 /begin AXIS_DESCR COM_AXIS errm_online_dummy _CNV_S_2_ERRM_DTC_R_483_CM 1 0. 1. AXIS_PTS_REF ldp_nr_1_id_err_dtc /end AXIS_DESCR
 /begin AXIS_DESCR COM_AXIS errm_online_dummy _CNV_S_6_ERRM_DTC_R_484_CM 6 0. 5. AXIS_PTS_REF ldp_nr_2_id_err_dtc /end AXIS_DESCR
/end CHARACTERISTIC
/begin CHARACTERISTIC fmy_id_bn_gear_rev.dtc "DTC table declaration for the diagnosis instance XX" MAP 0xa1003aa4 _REC_MAP_20_u2_u2_u2 65535. _CNV_A_R_LINEAR_____0_CM 0. 65535. DISPLAY_IDENTIFIER ID_ERR_DTC_BN_GEAR_REV FORMAT "%5.0"
 /begin AXIS_DESCR COM_AXIS errm_online_dummy _CNV_S_2_ERRM_DTC_R_483_CM 1 0. 1. AXIS_PTS_REF ldp_nr_1_id_err_dtc /end AXIS_DESCR
 /begin AXIS_DESCR COM_AXIS errm_online_dummy _CNV_S_6_ERRM_DTC_R_484_CM 6 0. 5. AXIS_PTS_REF ldp_nr_2_id_err_dtc /end AXIS_DESCR
/end CHARACTERISTIC
/begin CHARACTERISTIC fmy_id_bn_ltg_hdlp_l.dtc "DTC table declaration for the diagnosis instance XX" MAP 0xa1003b08 _REC_MAP_20_u2_u2_u2 65535. _CNV_A_R_LINEAR_____0_CM 0. 65535. DISPLAY_IDENTIFIER ID_ERR_DTC_BN_LTG_HDLP_L FORMAT "%5.0"
 /begin AXIS_DESCR COM_AXIS errm_online_dummy _CNV_S_2_ERRM_DTC_R_483_CM 1 0. 1. AXIS_PTS_REF ldp_nr_1_id_err_dtc /end AXIS_DESCR
 /begin AXIS_DESCR COM_AXIS errm_online_dummy _CNV_S_6_ERRM_DTC_R_484_CM 6 0. 5. AXIS_PTS_REF ldp_nr_2_id_err_dtc /end AXIS_DESCR
/end CHARACTERISTIC
/begin CHARACTERISTIC fmy_id_bn_ldm.dtc "DTC table declaration for the diagnosis instance XX" MAP 0xa1003af4 _REC_MAP_20_u2_u2_u2 65535. _CNV_A_R_LINEAR_____0_CM 0. 65535. DISPLAY_IDENTIFIER ID_ERR_DTC_BN_LDM FORMAT "%5.0"
 /begin AXIS_DESCR COM_AXIS errm_online_dummy _CNV_S_2_ERRM_DTC_R_483_CM 1 0. 1. AXIS_PTS_REF ldp_nr_1_id_err_dtc /end AXIS_DESCR
 /begin AXIS_DESCR COM_AXIS errm_online_dummy _CNV_S_6_ERRM_DTC_R_484_CM 6 0. 5. AXIS_PTS_REF ldp_nr_2_id_err_dtc /end AXIS_DESCR
/end CHARACTERISTIC
/begin CHARACTERISTIC fmy_id_bn_trl.dtc "DTC table declaration for the diagnosis instance XX" MAP 0xa1003bf8 _REC_MAP_20_u2_u2_u2 65535. _CNV_A_R_LINEAR_____0_CM 0. 65535. DISPLAY_IDENTIFIER ID_ERR_DTC_BN_TRL FORMAT "%5.0"
 /begin AXIS_DESCR COM_AXIS errm_online_dummy _CNV_S_2_ERRM_DTC_R_483_CM 1 0. 1. AXIS_PTS_REF ldp_nr_1_id_err_dtc /end AXIS_DESCR
 /begin AXIS_DESCR COM_AXIS errm_online_dummy _CNV_S_6_ERRM_DTC_R_484_CM 6 0. 5. AXIS_PTS_REF ldp_nr_2_id_err_dtc /end AXIS_DESCR
/end CHARACTERISTIC
/begin CHARACTERISTIC fmy_id_bn_hiv.dtc "DTC table declaration for the diagnosis instance XX" MAP 0xa1003ab8 _REC_MAP_20_u2_u2_u2 65535. _CNV_A_R_LINEAR_____0_CM 0. 65535. DISPLAY_IDENTIFIER ID_ERR_DTC_BN_HIV FORMAT "%5.0"
 /begin AXIS_DESCR COM_AXIS errm_online_dummy _CNV_S_2_ERRM_DTC_R_483_CM 1 0. 1. AXIS_PTS_REF ldp_nr_1_id_err_dtc /end AXIS_DESCR
 /begin AXIS_DESCR COM_AXIS errm_online_dummy _CNV_S_6_ERRM_DTC_R_484_CM 6 0. 5. AXIS_PTS_REF ldp_nr_2_id_err_dtc /end AXIS_DESCR
/end CHARACTERISTIC
/begin CHARACTERISTIC fmy_id_bn_t_clk.dtc "DTC table declaration for the diagnosis instance XX" MAP 0xa1003b58 _REC_MAP_20_u2_u2_u2 65535. _CNV_A_R_LINEAR_____0_CM 0. 65535. DISPLAY_IDENTIFIER ID_ERR_DTC_BN_T_CLK FORMAT "%5.0"
 /begin AXIS_DESCR COM_AXIS errm_online_dummy _CNV_S_2_ERRM_DTC_R_483_CM 1 0. 1. AXIS_PTS_REF ldp_nr_1_id_err_dtc /end AXIS_DESCR
 /begin AXIS_DESCR COM_AXIS errm_online_dummy _CNV_S_6_ERRM_DTC_R_484_CM 6 0. 5. AXIS_PTS_REF ldp_nr_2_id_err_dtc /end AXIS_DESCR
/end CHARACTERISTIC
/begin CHARACTERISTIC fmy_id_bn_efp_crash.dtc "DTC table declaration for the diagnosis instance XX" MAP 0xa1003a54 _REC_MAP_20_u2_u2_u2 65535. _CNV_A_R_LINEAR_____0_CM 0. 65535. DISPLAY_IDENTIFIER ID_ERR_DTC_BN_EFP_CRASH FORMAT "%5.0"
 /begin AXIS_DESCR COM_AXIS errm_online_dummy _CNV_S_2_ERRM_DTC_R_483_CM 1 0. 1. AXIS_PTS_REF ldp_nr_1_id_err_dtc /end AXIS_DESCR
 /begin AXIS_DESCR COM_AXIS errm_online_dummy _CNV_S_6_ERRM_DTC_R_484_CM 6 0. 5. AXIS_PTS_REF ldp_nr_2_id_err_dtc /end AXIS_DESCR
/end CHARACTERISTIC
/begin CHARACTERISTIC fmy_id_bn_efp.dtc "DTC table declaration for the diagnosis instance XX" MAP 0xa1003a40 _REC_MAP_20_u2_u2_u2 65535. _CNV_A_R_LINEAR_____0_CM 0. 65535. DISPLAY_IDENTIFIER ID_ERR_DTC_BN_EFP FORMAT "%5.0"
 /begin AXIS_DESCR COM_AXIS errm_online_dummy _CNV_S_2_ERRM_DTC_R_483_CM 1 0. 1. AXIS_PTS_REF ldp_nr_1_id_err_dtc /end AXIS_DESCR
 /begin AXIS_DESCR COM_AXIS errm_online_dummy _CNV_S_6_ERRM_DTC_R_484_CM 6 0. 5. AXIS_PTS_REF ldp_nr_2_id_err_dtc /end AXIS_DESCR
/end CHARACTERISTIC
/begin CHARACTERISTIC fmy_id_load_tps_plaus.dtc "DTC table declaration for the diagnosis instance XX" MAP 0xa100442c _REC_MAP_20_u2_u2_u2 65535. _CNV_A_R_LINEAR_____0_CM 0. 65535. DISPLAY_IDENTIFIER ID_ERR_DTC_LOAD_TPS_PLAUS FORMAT "%5.0"
 /begin AXIS_DESCR COM_AXIS errm_online_dummy _CNV_S_2_ERRM_DTC_R_483_CM 1 0. 1. AXIS_PTS_REF ldp_nr_1_id_err_dtc /end AXIS_DESCR
 /begin AXIS_DESCR COM_AXIS errm_online_dummy _CNV_S_6_ERRM_DTC_R_484_CM 6 0. 5. AXIS_PTS_REF ldp_nr_2_id_err_dtc /end AXIS_DESCR
/end CHARACTERISTIC
/begin CHARACTERISTIC fmy_id_egy_min.dtc "DTC table declaration for the diagnosis instance XX" MAP 0xa100401c _REC_MAP_20_u2_u2_u2 65535. _CNV_A_R_LINEAR_____0_CM 0. 65535. DISPLAY_IDENTIFIER ID_ERR_DTC_EGY_MIN FORMAT "%5.0"
 /begin AXIS_DESCR COM_AXIS errm_online_dummy _CNV_S_2_ERRM_DTC_R_483_CM 1 0. 1. AXIS_PTS_REF ldp_nr_1_id_err_dtc /end AXIS_DESCR
 /begin AXIS_DESCR COM_AXIS errm_online_dummy _CNV_S_6_ERRM_DTC_R_484_CM 6 0. 5. AXIS_PTS_REF ldp_nr_2_id_err_dtc /end AXIS_DESCR
/end CHARACTERISTIC
/begin CHARACTERISTIC fmy_id_efp_crash.dtc "DTC table declaration for the diagnosis instance XX" MAP 0xa1003ff4 _REC_MAP_20_u2_u2_u2 65535. _CNV_A_R_LINEAR_____0_CM 0. 65535. DISPLAY_IDENTIFIER ID_ERR_DTC_EFP_CRASH FORMAT "%5.0"
 /begin AXIS_DESCR COM_AXIS errm_online_dummy _CNV_S_2_ERRM_DTC_R_483_CM 1 0. 1. AXIS_PTS_REF ldp_nr_1_id_err_dtc /end AXIS_DESCR
 /begin AXIS_DESCR COM_AXIS errm_online_dummy _CNV_S_6_ERRM_DTC_R_484_CM 6 0. 5. AXIS_PTS_REF ldp_nr_2_id_err_dtc /end AXIS_DESCR
/end CHARACTERISTIC
/begin CHARACTERISTIC fmy_id_efp.dtc "DTC table declaration for the diagnosis instance XX" MAP 0xa1003fe0 _REC_MAP_20_u2_u2_u2 65535. _CNV_A_R_LINEAR_____0_CM 0. 65535. DISPLAY_IDENTIFIER ID_ERR_DTC_EFP FORMAT "%5.0"
 /begin AXIS_DESCR COM_AXIS errm_online_dummy _CNV_S_2_ERRM_DTC_R_483_CM 1 0. 1. AXIS_PTS_REF ldp_nr_1_id_err_dtc /end AXIS_DESCR
 /begin AXIS_DESCR COM_AXIS errm_online_dummy _CNV_S_6_ERRM_DTC_R_484_CM 6 0. 5. AXIS_PTS_REF ldp_nr_2_id_err_dtc /end AXIS_DESCR
/end CHARACTERISTIC
/begin CHARACTERISTIC fmy_id_locan_boff.dtc "DTC table declaration for the diagnosis instance XX" MAP 0xa1004440 _REC_MAP_20_u2_u2_u2 65535. _CNV_A_R_LINEAR_____0_CM 0. 65535. DISPLAY_IDENTIFIER ID_ERR_DTC_LOCAN_BOFF FORMAT "%5.0"
 /begin AXIS_DESCR COM_AXIS errm_online_dummy _CNV_S_2_ERRM_DTC_R_483_CM 1 0. 1. AXIS_PTS_REF ldp_nr_1_id_err_dtc /end AXIS_DESCR
 /begin AXIS_DESCR COM_AXIS errm_online_dummy _CNV_S_6_ERRM_DTC_R_484_CM 6 0. 5. AXIS_PTS_REF ldp_nr_2_id_err_dtc /end AXIS_DESCR
/end CHARACTERISTIC
/begin CHARACTERISTIC fmy_id_cwp_plaus.dtc "DTC table declaration for the diagnosis instance XX" MAP 0xa1003e14 _REC_MAP_20_u2_u2_u2 65535. _CNV_A_R_LINEAR_____0_CM 0. 65535. DISPLAY_IDENTIFIER ID_ERR_DTC_CWP_PLAUS FORMAT "%5.0"
 /begin AXIS_DESCR COM_AXIS errm_online_dummy _CNV_S_2_ERRM_DTC_R_483_CM 1 0. 1. AXIS_PTS_REF ldp_nr_1_id_err_dtc /end AXIS_DESCR
 /begin AXIS_DESCR COM_AXIS errm_online_dummy _CNV_S_6_ERRM_DTC_R_484_CM 6 0. 5. AXIS_PTS_REF ldp_nr_2_id_err_dtc /end AXIS_DESCR
/end CHARACTERISTIC
/begin CHARACTERISTIC fmy_id_cwp_int_off.dtc "DTC table declaration for the diagnosis instance XX" MAP 0xa1003e00 _REC_MAP_20_u2_u2_u2 65535. _CNV_A_R_LINEAR_____0_CM 0. 65535. DISPLAY_IDENTIFIER ID_ERR_DTC_CWP_INT_OFF FORMAT "%5.0"
 /begin AXIS_DESCR COM_AXIS errm_online_dummy _CNV_S_2_ERRM_DTC_R_483_CM 1 0. 1. AXIS_PTS_REF ldp_nr_1_id_err_dtc /end AXIS_DESCR
 /begin AXIS_DESCR COM_AXIS errm_online_dummy _CNV_S_6_ERRM_DTC_R_484_CM 6 0. 5. AXIS_PTS_REF ldp_nr_2_id_err_dtc /end AXIS_DESCR
/end CHARACTERISTIC
/begin CHARACTERISTIC fmy_id_cwp_pwr.dtc "DTC table declaration for the diagnosis instance XX" MAP 0xa1003e28 _REC_MAP_20_u2_u2_u2 65535. _CNV_A_R_LINEAR_____0_CM 0. 65535. DISPLAY_IDENTIFIER ID_ERR_DTC_CWP_PWR FORMAT "%5.0"
 /begin AXIS_DESCR COM_AXIS errm_online_dummy _CNV_S_2_ERRM_DTC_R_483_CM 1 0. 1. AXIS_PTS_REF ldp_nr_1_id_err_dtc /end AXIS_DESCR
 /begin AXIS_DESCR COM_AXIS errm_online_dummy _CNV_S_6_ERRM_DTC_R_484_CM 6 0. 5. AXIS_PTS_REF ldp_nr_2_id_err_dtc /end AXIS_DESCR
/end CHARACTERISTIC
/begin CHARACTERISTIC fmy_id_cwp_com_plaus.dtc "DTC table declaration for the diagnosis instance XX" MAP 0xa1003dec _REC_MAP_20_u2_u2_u2 65535. _CNV_A_R_LINEAR_____0_CM 0. 65535. DISPLAY_IDENTIFIER ID_ERR_DTC_CWP_COM_PLAUS FORMAT "%5.0"
 /begin AXIS_DESCR COM_AXIS errm_online_dummy _CNV_S_2_ERRM_DTC_R_483_CM 1 0. 1. AXIS_PTS_REF ldp_nr_1_id_err_dtc /end AXIS_DESCR
 /begin AXIS_DESCR COM_AXIS errm_online_dummy _CNV_S_6_ERRM_DTC_R_484_CM 6 0. 5. AXIS_PTS_REF ldp_nr_2_id_err_dtc /end AXIS_DESCR
/end CHARACTERISTIC
/begin CHARACTERISTIC fmy_id_qoil_sens.dtc "DTC table declaration for the diagnosis instance XX" MAP 0xa1004954 _REC_MAP_20_u2_u2_u2 65535. _CNV_A_R_LINEAR_____0_CM 0. 65535. DISPLAY_IDENTIFIER ID_ERR_DTC_QOIL_SENS FORMAT "%5.0"
 /begin AXIS_DESCR COM_AXIS errm_online_dummy _CNV_S_2_ERRM_DTC_R_483_CM 1 0. 1. AXIS_PTS_REF ldp_nr_1_id_err_dtc /end AXIS_DESCR
 /begin AXIS_DESCR COM_AXIS errm_online_dummy _CNV_S_6_ERRM_DTC_R_484_CM 6 0. 5. AXIS_PTS_REF ldp_nr_2_id_err_dtc /end AXIS_DESCR
/end CHARACTERISTIC
/begin CHARACTERISTIC fmy_id_bat_sens.dtc "DTC table declaration for the diagnosis instance XX" MAP 0xa10039b4 _REC_MAP_20_u2_u2_u2 65535. _CNV_A_R_LINEAR_____0_CM 0. 65535. DISPLAY_IDENTIFIER ID_ERR_DTC_BAT_SENS FORMAT "%5.0"
 /begin AXIS_DESCR COM_AXIS errm_online_dummy _CNV_S_2_ERRM_DTC_R_483_CM 1 0. 1. AXIS_PTS_REF ldp_nr_1_id_err_dtc /end AXIS_DESCR
 /begin AXIS_DESCR COM_AXIS errm_online_dummy _CNV_S_6_ERRM_DTC_R_484_CM 6 0. 5. AXIS_PTS_REF ldp_nr_2_id_err_dtc /end AXIS_DESCR
/end CHARACTERISTIC
/begin CHARACTERISTIC fmy_id_bat_sens_it.dtc "DTC table declaration for the diagnosis instance XX" MAP 0xa10039c8 _REC_MAP_20_u2_u2_u2 65535. _CNV_A_R_LINEAR_____0_CM 0. 65535. DISPLAY_IDENTIFIER ID_ERR_DTC_BAT_SENS_IT FORMAT "%5.0"
 /begin AXIS_DESCR COM_AXIS errm_online_dummy _CNV_S_2_ERRM_DTC_R_483_CM 1 0. 1. AXIS_PTS_REF ldp_nr_1_id_err_dtc /end AXIS_DESCR
 /begin AXIS_DESCR COM_AXIS errm_online_dummy _CNV_S_6_ERRM_DTC_R_484_CM 6 0. 5. AXIS_PTS_REF ldp_nr_2_id_err_dtc /end AXIS_DESCR
/end CHARACTERISTIC
/begin CHARACTERISTIC fmy_id_bat_sens_it_el.dtc "DTC table declaration for the diagnosis instance XX" MAP 0xa10039dc _REC_MAP_20_u2_u2_u2 65535. _CNV_A_R_LINEAR_____0_CM 0. 65535. DISPLAY_IDENTIFIER ID_ERR_DTC_BAT_SENS_IT_EL FORMAT "%5.0"
 /begin AXIS_DESCR COM_AXIS errm_online_dummy _CNV_S_2_ERRM_DTC_R_483_CM 1 0. 1. AXIS_PTS_REF ldp_nr_1_id_err_dtc /end AXIS_DESCR
 /begin AXIS_DESCR COM_AXIS errm_online_dummy _CNV_S_6_ERRM_DTC_R_484_CM 6 0. 5. AXIS_PTS_REF ldp_nr_2_id_err_dtc /end AXIS_DESCR
/end CHARACTERISTIC
/begin CHARACTERISTIC fmy_id_ecu_nvmy.dtc "DTC table declaration for the diagnosis instance XX" MAP 0xa1003fa4 _REC_MAP_20_u2_u2_u2 65535. _CNV_A_R_LINEAR_____0_CM 0. 65535. DISPLAY_IDENTIFIER ID_ERR_DTC_ECU_NVMY FORMAT "%5.0"
 /begin AXIS_DESCR COM_AXIS errm_online_dummy _CNV_S_2_ERRM_DTC_R_483_CM 1 0. 1. AXIS_PTS_REF ldp_nr_1_id_err_dtc /end AXIS_DESCR
 /begin AXIS_DESCR COM_AXIS errm_online_dummy _CNV_S_6_ERRM_DTC_R_484_CM 6 0. 5. AXIS_PTS_REF ldp_nr_2_id_err_dtc /end AXIS_DESCR
/end CHARACTERISTIC
/begin CHARACTERISTIC fmy_id_gs.dtc "DTC table declaration for the diagnosis instance XX" MAP 0xa100415c _REC_MAP_20_u2_u2_u2 65535. _CNV_A_R_LINEAR_____0_CM 0. 65535. DISPLAY_IDENTIFIER ID_ERR_DTC_GS FORMAT "%5.0"
 /begin AXIS_DESCR COM_AXIS errm_online_dummy _CNV_S_2_ERRM_DTC_R_483_CM 1 0. 1. AXIS_PTS_REF ldp_nr_1_id_err_dtc /end AXIS_DESCR
 /begin AXIS_DESCR COM_AXIS errm_online_dummy _CNV_S_6_ERRM_DTC_R_484_CM 6 0. 5. AXIS_PTS_REF ldp_nr_2_id_err_dtc /end AXIS_DESCR
/end CHARACTERISTIC
/begin CHARACTERISTIC fmy_id_plaus_igk_bn.dtc "DTC table declaration for the diagnosis instance XX" MAP 0xa1004828 _REC_MAP_20_u2_u2_u2 65535. _CNV_A_R_LINEAR_____0_CM 0. 65535. DISPLAY_IDENTIFIER ID_ERR_DTC_PLAUS_IGK_BN FORMAT "%5.0"
 /begin AXIS_DESCR COM_AXIS errm_online_dummy _CNV_S_2_ERRM_DTC_R_483_CM 1 0. 1. AXIS_PTS_REF ldp_nr_1_id_err_dtc /end AXIS_DESCR
 /begin AXIS_DESCR COM_AXIS errm_online_dummy _CNV_S_6_ERRM_DTC_R_484_CM 6 0. 5. AXIS_PTS_REF ldp_nr_2_id_err_dtc /end AXIS_DESCR
/end CHARACTERISTIC
/begin CHARACTERISTIC fmy_id_tq_req_can.dtc "DTC table declaration for the diagnosis instance XX" MAP 0xa1004f6c _REC_MAP_20_u2_u2_u2 65535. _CNV_A_R_LINEAR_____0_CM 0. 65535. DISPLAY_IDENTIFIER ID_ERR_DTC_TQ_REQ_CAN FORMAT "%5.0"
 /begin AXIS_DESCR COM_AXIS errm_online_dummy _CNV_S_2_ERRM_DTC_R_483_CM 1 0. 1. AXIS_PTS_REF ldp_nr_1_id_err_dtc /end AXIS_DESCR
 /begin AXIS_DESCR COM_AXIS errm_online_dummy _CNV_S_6_ERRM_DTC_R_484_CM 6 0. 5. AXIS_PTS_REF ldp_nr_2_id_err_dtc /end AXIS_DESCR
/end CHARACTERISTIC
/begin CHARACTERISTIC fmy_id_map_dip_sens.dtc "DTC table declaration for the diagnosis instance XX" MAP 0xa100451c _REC_MAP_20_u2_u2_u2 65535. _CNV_A_R_LINEAR_____0_CM 0. 65535. DISPLAY_IDENTIFIER ID_ERR_DTC_MAP_DIP_SENS FORMAT "%5.0"
 /begin AXIS_DESCR COM_AXIS errm_online_dummy _CNV_S_2_ERRM_DTC_R_483_CM 1 0. 1. AXIS_PTS_REF ldp_nr_1_id_err_dtc /end AXIS_DESCR
 /begin AXIS_DESCR COM_AXIS errm_online_dummy _CNV_S_6_ERRM_DTC_R_484_CM 6 0. 5. AXIS_PTS_REF ldp_nr_2_id_err_dtc /end AXIS_DESCR
/end CHARACTERISTIC
/begin CHARACTERISTIC fmy_id_mec_ivvt_in.dtc "DTC table declaration for the diagnosis instance XX" MAP 0xa1004558 _REC_MAP_20_u2_u2_u2 65535. _CNV_A_R_LINEAR_____0_CM 0. 65535. DISPLAY_IDENTIFIER ID_ERR_DTC_MEC_IVVT_IN FORMAT "%5.0"
 /begin AXIS_DESCR COM_AXIS errm_online_dummy _CNV_S_2_ERRM_DTC_R_483_CM 1 0. 1. AXIS_PTS_REF ldp_nr_1_id_err_dtc /end AXIS_DESCR
 /begin AXIS_DESCR COM_AXIS errm_online_dummy _CNV_S_6_ERRM_DTC_R_484_CM 6 0. 5. AXIS_PTS_REF ldp_nr_2_id_err_dtc /end AXIS_DESCR
/end CHARACTERISTIC
/begin CHARACTERISTIC fmy_id_mec_ivvt_ex.dtc "DTC table declaration for the diagnosis instance XX" MAP 0xa1004544 _REC_MAP_20_u2_u2_u2 65535. _CNV_A_R_LINEAR_____0_CM 0. 65535. DISPLAY_IDENTIFIER ID_ERR_DTC_MEC_IVVT_EX FORMAT "%5.0"
 /begin AXIS_DESCR COM_AXIS errm_online_dummy _CNV_S_2_ERRM_DTC_R_483_CM 1 0. 1. AXIS_PTS_REF ldp_nr_1_id_err_dtc /end AXIS_DESCR
 /begin AXIS_DESCR COM_AXIS errm_online_dummy _CNV_S_6_ERRM_DTC_R_484_CM 6 0. 5. AXIS_PTS_REF ldp_nr_2_id_err_dtc /end AXIS_DESCR
/end CHARACTERISTIC
/begin CHARACTERISTIC fmy_id_tout_nox_sens_1.dtc "DTC table declaration for the diagnosis instance XX" MAP 0xa1004e54 _REC_MAP_20_u2_u2_u2 65535. _CNV_A_R_LINEAR_____0_CM 0. 65535. DISPLAY_IDENTIFIER ID_ERR_DTC_TOUT_NOX_SENS_1 FORMAT "%5.0"
 /begin AXIS_DESCR COM_AXIS errm_online_dummy _CNV_S_2_ERRM_DTC_R_483_CM 1 0. 1. AXIS_PTS_REF ldp_nr_1_id_err_dtc /end AXIS_DESCR
 /begin AXIS_DESCR COM_AXIS errm_online_dummy _CNV_S_6_ERRM_DTC_R_484_CM 6 0. 5. AXIS_PTS_REF ldp_nr_2_id_err_dtc /end AXIS_DESCR
/end CHARACTERISTIC
/begin CHARACTERISTIC fmy_id_tout_nox_sens_2.dtc "DTC table declaration for the diagnosis instance XX" MAP 0xa1004e68 _REC_MAP_20_u2_u2_u2 65535. _CNV_A_R_LINEAR_____0_CM 0. 65535. DISPLAY_IDENTIFIER ID_ERR_DTC_TOUT_NOX_SENS_2 FORMAT "%5.0"
 /begin AXIS_DESCR COM_AXIS errm_online_dummy _CNV_S_2_ERRM_DTC_R_483_CM 1 0. 1. AXIS_PTS_REF ldp_nr_1_id_err_dtc /end AXIS_DESCR
 /begin AXIS_DESCR COM_AXIS errm_online_dummy _CNV_S_6_ERRM_DTC_R_484_CM 6 0. 5. AXIS_PTS_REF ldp_nr_2_id_err_dtc /end AXIS_DESCR
/end CHARACTERISTIC
/begin CHARACTERISTIC fmy_id_vvl_rot.dtc "DTC table declaration for the diagnosis instance XX" MAP 0xa10050fc _REC_MAP_20_u2_u2_u2 65535. _CNV_A_R_LINEAR_____0_CM 0. 65535. DISPLAY_IDENTIFIER ID_ERR_DTC_VVL_ROT FORMAT "%5.0"
 /begin AXIS_DESCR COM_AXIS errm_online_dummy _CNV_S_2_ERRM_DTC_R_483_CM 1 0. 1. AXIS_PTS_REF ldp_nr_1_id_err_dtc /end AXIS_DESCR
 /begin AXIS_DESCR COM_AXIS errm_online_dummy _CNV_S_6_ERRM_DTC_R_484_CM 6 0. 5. AXIS_PTS_REF ldp_nr_2_id_err_dtc /end AXIS_DESCR
/end CHARACTERISTIC
/begin CHARACTERISTIC fmy_id_rly_vvl.dtc "DTC table declaration for the diagnosis instance XX" MAP 0xa1004a30 _REC_MAP_20_u2_u2_u2 65535. _CNV_A_R_LINEAR_____0_CM 0. 65535. DISPLAY_IDENTIFIER ID_ERR_DTC_RLY_VVL FORMAT "%5.0"
 /begin AXIS_DESCR COM_AXIS errm_online_dummy _CNV_S_2_ERRM_DTC_R_483_CM 1 0. 1. AXIS_PTS_REF ldp_nr_1_id_err_dtc /end AXIS_DESCR
 /begin AXIS_DESCR COM_AXIS errm_online_dummy _CNV_S_6_ERRM_DTC_R_484_CM 6 0. 5. AXIS_PTS_REF ldp_nr_2_id_err_dtc /end AXIS_DESCR
/end CHARACTERISTIC
/begin CHARACTERISTIC fmy_id_nox_sens_1.dtc "DTC table declaration for the diagnosis instance XX" MAP 0xa10046d4 _REC_MAP_20_u2_u2_u2 65535. _CNV_A_R_LINEAR_____0_CM 0. 65535. DISPLAY_IDENTIFIER ID_ERR_DTC_NOX_SENS_1 FORMAT "%5.0"
 /begin AXIS_DESCR COM_AXIS errm_online_dummy _CNV_S_2_ERRM_DTC_R_483_CM 1 0. 1. AXIS_PTS_REF ldp_nr_1_id_err_dtc /end AXIS_DESCR
 /begin AXIS_DESCR COM_AXIS errm_online_dummy _CNV_S_6_ERRM_DTC_R_484_CM 6 0. 5. AXIS_PTS_REF ldp_nr_2_id_err_dtc /end AXIS_DESCR
/end CHARACTERISTIC
/begin CHARACTERISTIC fmy_id_ovl_ecu_vvl.dtc "DTC table declaration for the diagnosis instance XX" MAP 0xa10047c4 _REC_MAP_20_u2_u2_u2 65535. _CNV_A_R_LINEAR_____0_CM 0. 65535. DISPLAY_IDENTIFIER ID_ERR_DTC_OVL_ECU_VVL FORMAT "%5.0"
 /begin AXIS_DESCR COM_AXIS errm_online_dummy _CNV_S_2_ERRM_DTC_R_483_CM 1 0. 1. AXIS_PTS_REF ldp_nr_1_id_err_dtc /end AXIS_DESCR
 /begin AXIS_DESCR COM_AXIS errm_online_dummy _CNV_S_6_ERRM_DTC_R_484_CM 6 0. 5. AXIS_PTS_REF ldp_nr_2_id_err_dtc /end AXIS_DESCR
/end CHARACTERISTIC
/begin CHARACTERISTIC fmy_id_dr_sc_vvl.dtc "DTC table declaration for the diagnosis instance XX" MAP 0xa1003edc _REC_MAP_20_u2_u2_u2 65535. _CNV_A_R_LINEAR_____0_CM 0. 65535. DISPLAY_IDENTIFIER ID_ERR_DTC_DR_SC_VVL FORMAT "%5.0"
 /begin AXIS_DESCR COM_AXIS errm_online_dummy _CNV_S_2_ERRM_DTC_R_483_CM 1 0. 1. AXIS_PTS_REF ldp_nr_1_id_err_dtc /end AXIS_DESCR
 /begin AXIS_DESCR COM_AXIS errm_online_dummy _CNV_S_6_ERRM_DTC_R_484_CM 6 0. 5. AXIS_PTS_REF ldp_nr_2_id_err_dtc /end AXIS_DESCR
/end CHARACTERISTIC
/begin CHARACTERISTIC fmy_id_crit_ovl_ecu_vvl.dtc "DTC table declaration for the diagnosis instance XX" MAP 0xa1003d38 _REC_MAP_20_u2_u2_u2 65535. _CNV_A_R_LINEAR_____0_CM 0. 65535. DISPLAY_IDENTIFIER ID_ERR_DTC_CRIT_OVL_ECU_VVL FORMAT "%5.0"
 /begin AXIS_DESCR COM_AXIS errm_online_dummy _CNV_S_2_ERRM_DTC_R_483_CM 1 0. 1. AXIS_PTS_REF ldp_nr_1_id_err_dtc /end AXIS_DESCR
 /begin AXIS_DESCR COM_AXIS errm_online_dummy _CNV_S_6_ERRM_DTC_R_484_CM 6 0. 5. AXIS_PTS_REF ldp_nr_2_id_err_dtc /end AXIS_DESCR
/end CHARACTERISTIC
/begin CHARACTERISTIC fmy_id_nox_sens_2.dtc "DTC table declaration for the diagnosis instance XX" MAP 0xa10046e8 _REC_MAP_20_u2_u2_u2 65535. _CNV_A_R_LINEAR_____0_CM 0. 65535. DISPLAY_IDENTIFIER ID_ERR_DTC_NOX_SENS_2 FORMAT "%5.0"
 /begin AXIS_DESCR COM_AXIS errm_online_dummy _CNV_S_2_ERRM_DTC_R_483_CM 1 0. 1. AXIS_PTS_REF ldp_nr_1_id_err_dtc /end AXIS_DESCR
 /begin AXIS_DESCR COM_AXIS errm_online_dummy _CNV_S_6_ERRM_DTC_R_484_CM 6 0. 5. AXIS_PTS_REF ldp_nr_2_id_err_dtc /end AXIS_DESCR
/end CHARACTERISTIC
/begin CHARACTERISTIC fmy_id_cur_h_vvl.dtc "DTC table declaration for the diagnosis instance XX" MAP 0xa1003dc4 _REC_MAP_20_u2_u2_u2 65535. _CNV_A_R_LINEAR_____0_CM 0. 65535. DISPLAY_IDENTIFIER ID_ERR_DTC_CUR_H_VVL FORMAT "%5.0"
 /begin AXIS_DESCR COM_AXIS errm_online_dummy _CNV_S_2_ERRM_DTC_R_483_CM 1 0. 1. AXIS_PTS_REF ldp_nr_1_id_err_dtc /end AXIS_DESCR
 /begin AXIS_DESCR COM_AXIS errm_online_dummy _CNV_S_6_ERRM_DTC_R_484_CM 6 0. 5. AXIS_PTS_REF ldp_nr_2_id_err_dtc /end AXIS_DESCR
/end CHARACTERISTIC
/begin CHARACTERISTIC fmy_id_teg_pcat_down_1.dtc "DTC table declaration for the diagnosis instance XX" MAP 0xa1004d28 _REC_MAP_20_u2_u2_u2 65535. _CNV_A_R_LINEAR_____0_CM 0. 65535. DISPLAY_IDENTIFIER ID_ERR_DTC_TEG_PCAT_DOWN_1 FORMAT "%5.0"
 /begin AXIS_DESCR COM_AXIS errm_online_dummy _CNV_S_2_ERRM_DTC_R_483_CM 1 0. 1. AXIS_PTS_REF ldp_nr_1_id_err_dtc /end AXIS_DESCR
 /begin AXIS_DESCR COM_AXIS errm_online_dummy _CNV_S_6_ERRM_DTC_R_484_CM 6 0. 5. AXIS_PTS_REF ldp_nr_2_id_err_dtc /end AXIS_DESCR
/end CHARACTERISTIC
/begin CHARACTERISTIC fmy_id_teg_pcat_down_2.dtc "DTC table declaration for the diagnosis instance XX" MAP 0xa1004d3c _REC_MAP_20_u2_u2_u2 65535. _CNV_A_R_LINEAR_____0_CM 0. 65535. DISPLAY_IDENTIFIER ID_ERR_DTC_TEG_PCAT_DOWN_2 FORMAT "%5.0"
 /begin AXIS_DESCR COM_AXIS errm_online_dummy _CNV_S_2_ERRM_DTC_R_483_CM 1 0. 1. AXIS_PTS_REF ldp_nr_1_id_err_dtc /end AXIS_DESCR
 /begin AXIS_DESCR COM_AXIS errm_online_dummy _CNV_S_6_ERRM_DTC_R_484_CM 6 0. 5. AXIS_PTS_REF ldp_nr_2_id_err_dtc /end AXIS_DESCR
/end CHARACTERISTIC
/begin CHARACTERISTIC fmy_id_t_seg_er.dtc "DTC table declaration for the diagnosis instance XX" MAP 0xa1004c4c _REC_MAP_20_u2_u2_u2 65535. _CNV_A_R_LINEAR_____0_CM 0. 65535. DISPLAY_IDENTIFIER ID_ERR_DTC_T_SEG_ER FORMAT "%5.0"
 /begin AXIS_DESCR COM_AXIS errm_online_dummy _CNV_S_2_ERRM_DTC_R_483_CM 1 0. 1. AXIS_PTS_REF ldp_nr_1_id_err_dtc /end AXIS_DESCR
 /begin AXIS_DESCR COM_AXIS errm_online_dummy _CNV_S_6_ERRM_DTC_R_484_CM 6 0. 5. AXIS_PTS_REF ldp_nr_2_id_err_dtc /end AXIS_DESCR
/end CHARACTERISTIC
/begin CHARACTERISTIC fmy_id_seg_ad_er.dtc "DTC table declaration for the diagnosis instance XX" MAP 0xa1004aa8 _REC_MAP_20_u2_u2_u2 65535. _CNV_A_R_LINEAR_____0_CM 0. 65535. DISPLAY_IDENTIFIER ID_ERR_DTC_SEG_AD_ER FORMAT "%5.0"
 /begin AXIS_DESCR COM_AXIS errm_online_dummy _CNV_S_2_ERRM_DTC_R_483_CM 1 0. 1. AXIS_PTS_REF ldp_nr_1_id_err_dtc /end AXIS_DESCR
 /begin AXIS_DESCR COM_AXIS errm_online_dummy _CNV_S_6_ERRM_DTC_R_484_CM 6 0. 5. AXIS_PTS_REF ldp_nr_2_id_err_dtc /end AXIS_DESCR
/end CHARACTERISTIC
/begin CHARACTERISTIC fmy_id_vs_plaus.dtc "DTC table declaration for the diagnosis instance XX" MAP 0xa10050e8 _REC_MAP_20_u2_u2_u2 65535. _CNV_A_R_LINEAR_____0_CM 0. 65535. DISPLAY_IDENTIFIER ID_ERR_DTC_VS_PLAUS FORMAT "%5.0"
 /begin AXIS_DESCR COM_AXIS errm_online_dummy _CNV_S_2_ERRM_DTC_R_483_CM 1 0. 1. AXIS_PTS_REF ldp_nr_1_id_err_dtc /end AXIS_DESCR
 /begin AXIS_DESCR COM_AXIS errm_online_dummy _CNV_S_6_ERRM_DTC_R_484_CM 6 0. 5. AXIS_PTS_REF ldp_nr_2_id_err_dtc /end AXIS_DESCR
/end CHARACTERISTIC
/begin CHARACTERISTIC fmy_id_ftl_obd.dtc "DTC table declaration for the diagnosis instance XX" MAP 0xa10040e4 _REC_MAP_20_u2_u2_u2 65535. _CNV_A_R_LINEAR_____0_CM 0. 65535. DISPLAY_IDENTIFIER ID_ERR_DTC_FTL_OBD FORMAT "%5.0"
 /begin AXIS_DESCR COM_AXIS errm_online_dummy _CNV_S_2_ERRM_DTC_R_483_CM 1 0. 1. AXIS_PTS_REF ldp_nr_1_id_err_dtc /end AXIS_DESCR
 /begin AXIS_DESCR COM_AXIS errm_online_dummy _CNV_S_6_ERRM_DTC_R_484_CM 6 0. 5. AXIS_PTS_REF ldp_nr_2_id_err_dtc /end AXIS_DESCR
/end CHARACTERISTIC
/begin CHARACTERISTIC fmy_id_ftl_can.dtc "DTC table declaration for the diagnosis instance XX" MAP 0xa10040bc _REC_MAP_20_u2_u2_u2 65535. _CNV_A_R_LINEAR_____0_CM 0. 65535. DISPLAY_IDENTIFIER ID_ERR_DTC_FTL_CAN FORMAT "%5.0"
 /begin AXIS_DESCR COM_AXIS errm_online_dummy _CNV_S_2_ERRM_DTC_R_483_CM 1 0. 1. AXIS_PTS_REF ldp_nr_1_id_err_dtc /end AXIS_DESCR
 /begin AXIS_DESCR COM_AXIS errm_online_dummy _CNV_S_6_ERRM_DTC_R_484_CM 6 0. 5. AXIS_PTS_REF ldp_nr_2_id_err_dtc /end AXIS_DESCR
/end CHARACTERISTIC
/begin CHARACTERISTIC fmy_id_tia_plaus.dtc "DTC table declaration for the diagnosis instance XX" MAP 0xa1004d78 _REC_MAP_20_u2_u2_u2 65535. _CNV_A_R_LINEAR_____0_CM 0. 65535. DISPLAY_IDENTIFIER ID_ERR_DTC_TIA_PLAUS FORMAT "%5.0"
 /begin AXIS_DESCR COM_AXIS errm_online_dummy _CNV_S_2_ERRM_DTC_R_483_CM 1 0. 1. AXIS_PTS_REF ldp_nr_1_id_err_dtc /end AXIS_DESCR
 /begin AXIS_DESCR COM_AXIS errm_online_dummy _CNV_S_6_ERRM_DTC_R_484_CM 6 0. 5. AXIS_PTS_REF ldp_nr_2_id_err_dtc /end AXIS_DESCR
/end CHARACTERISTIC
/begin CHARACTERISTIC fmy_id_tam_can.dtc "DTC table declaration for the diagnosis instance XX" MAP 0xa1004c60 _REC_MAP_20_u2_u2_u2 65535. _CNV_A_R_LINEAR_____0_CM 0. 65535. DISPLAY_IDENTIFIER ID_ERR_DTC_TAM_CAN FORMAT "%5.0"
 /begin AXIS_DESCR COM_AXIS errm_online_dummy _CNV_S_2_ERRM_DTC_R_483_CM 1 0. 1. AXIS_PTS_REF ldp_nr_1_id_err_dtc /end AXIS_DESCR
 /begin AXIS_DESCR COM_AXIS errm_online_dummy _CNV_S_6_ERRM_DTC_R_484_CM 6 0. 5. AXIS_PTS_REF ldp_nr_2_id_err_dtc /end AXIS_DESCR
/end CHARACTERISTIC
/begin CHARACTERISTIC fmy_id_tam_plaus.dtc "DTC table declaration for the diagnosis instance XX" MAP 0xa1004c74 _REC_MAP_20_u2_u2_u2 65535. _CNV_A_R_LINEAR_____0_CM 0. 65535. DISPLAY_IDENTIFIER ID_ERR_DTC_TAM_PLAUS FORMAT "%5.0"
 /begin AXIS_DESCR COM_AXIS errm_online_dummy _CNV_S_2_ERRM_DTC_R_483_CM 1 0. 1. AXIS_PTS_REF ldp_nr_1_id_err_dtc /end AXIS_DESCR
 /begin AXIS_DESCR COM_AXIS errm_online_dummy _CNV_S_6_ERRM_DTC_R_484_CM 6 0. 5. AXIS_PTS_REF ldp_nr_2_id_err_dtc /end AXIS_DESCR
/end CHARACTERISTIC
/begin CHARACTERISTIC fmy_id_map_dip_shift.dtc "DTC table declaration for the diagnosis instance XX" MAP 0xa1004530 _REC_MAP_20_u2_u2_u2 65535. _CNV_A_R_LINEAR_____0_CM 0. 65535. DISPLAY_IDENTIFIER ID_ERR_DTC_MAP_DIP_SHIFT FORMAT "%5.0"
 /begin AXIS_DESCR COM_AXIS errm_online_dummy _CNV_S_2_ERRM_DTC_R_483_CM 1 0. 1. AXIS_PTS_REF ldp_nr_1_id_err_dtc /end AXIS_DESCR
 /begin AXIS_DESCR COM_AXIS errm_online_dummy _CNV_S_6_ERRM_DTC_R_484_CM 6 0. 5. AXIS_PTS_REF ldp_nr_2_id_err_dtc /end AXIS_DESCR
/end CHARACTERISTIC
/begin CHARACTERISTIC fmy_id_cat_diag_1.dtc "DTC table declaration for the diagnosis instance XX" MAP 0xa1003c70 _REC_MAP_20_u2_u2_u2 65535. _CNV_A_R_LINEAR_____0_CM 0. 65535. DISPLAY_IDENTIFIER ID_ERR_DTC_CAT_DIAG_1 FORMAT "%5.0"
 /begin AXIS_DESCR COM_AXIS errm_online_dummy _CNV_S_2_ERRM_DTC_R_483_CM 1 0. 1. AXIS_PTS_REF ldp_nr_1_id_err_dtc /end AXIS_DESCR
 /begin AXIS_DESCR COM_AXIS errm_online_dummy _CNV_S_6_ERRM_DTC_R_484_CM 6 0. 5. AXIS_PTS_REF ldp_nr_2_id_err_dtc /end AXIS_DESCR
/end CHARACTERISTIC
/begin CHARACTERISTIC fmy_id_cat_diag_2.dtc "DTC table declaration for the diagnosis instance XX" MAP 0xa1003c84 _REC_MAP_20_u2_u2_u2 65535. _CNV_A_R_LINEAR_____0_CM 0. 65535. DISPLAY_IDENTIFIER ID_ERR_DTC_CAT_DIAG_2 FORMAT "%5.0"
 /begin AXIS_DESCR COM_AXIS errm_online_dummy _CNV_S_2_ERRM_DTC_R_483_CM 1 0. 1. AXIS_PTS_REF ldp_nr_1_id_err_dtc /end AXIS_DESCR
 /begin AXIS_DESCR COM_AXIS errm_online_dummy _CNV_S_6_ERRM_DTC_R_484_CM 6 0. 5. AXIS_PTS_REF ldp_nr_2_id_err_dtc /end AXIS_DESCR
/end CHARACTERISTIC
/begin CHARACTERISTIC fmy_id_cat_diag_afl_1.dtc "DTC table declaration for the diagnosis instance XX" MAP 0xa1003c98 _REC_MAP_20_u2_u2_u2 65535. _CNV_A_R_LINEAR_____0_CM 0. 65535. DISPLAY_IDENTIFIER ID_ERR_DTC_CAT_DIAG_AFL_1 FORMAT "%5.0"
 /begin AXIS_DESCR COM_AXIS errm_online_dummy _CNV_S_2_ERRM_DTC_R_483_CM 1 0. 1. AXIS_PTS_REF ldp_nr_1_id_err_dtc /end AXIS_DESCR
 /begin AXIS_DESCR COM_AXIS errm_online_dummy _CNV_S_6_ERRM_DTC_R_484_CM 6 0. 5. AXIS_PTS_REF ldp_nr_2_id_err_dtc /end AXIS_DESCR
/end CHARACTERISTIC
/begin CHARACTERISTIC fmy_id_cat_diag_afl_2.dtc "DTC table declaration for the diagnosis instance XX" MAP 0xa1003cac _REC_MAP_20_u2_u2_u2 65535. _CNV_A_R_LINEAR_____0_CM 0. 65535. DISPLAY_IDENTIFIER ID_ERR_DTC_CAT_DIAG_AFL_2 FORMAT "%5.0"
 /begin AXIS_DESCR COM_AXIS errm_online_dummy _CNV_S_2_ERRM_DTC_R_483_CM 1 0. 1. AXIS_PTS_REF ldp_nr_1_id_err_dtc /end AXIS_DESCR
 /begin AXIS_DESCR COM_AXIS errm_online_dummy _CNV_S_6_ERRM_DTC_R_484_CM 6 0. 5. AXIS_PTS_REF ldp_nr_2_id_err_dtc /end AXIS_DESCR
/end CHARACTERISTIC
/begin CHARACTERISTIC fmy_id_scg_ls_down_1.dtc "DTC table declaration for the diagnosis instance XX" MAP 0xa1004a58 _REC_MAP_20_u2_u2_u2 65535. _CNV_A_R_LINEAR_____0_CM 0. 65535. DISPLAY_IDENTIFIER ID_ERR_DTC_SCG_LS_DOWN_1 FORMAT "%5.0"
 /begin AXIS_DESCR COM_AXIS errm_online_dummy _CNV_S_2_ERRM_DTC_R_483_CM 1 0. 1. AXIS_PTS_REF ldp_nr_1_id_err_dtc /end AXIS_DESCR
 /begin AXIS_DESCR COM_AXIS errm_online_dummy _CNV_S_6_ERRM_DTC_R_484_CM 6 0. 5. AXIS_PTS_REF ldp_nr_2_id_err_dtc /end AXIS_DESCR
/end CHARACTERISTIC
/begin CHARACTERISTIC fmy_id_scp_ls_down_1.dtc "DTC table declaration for the diagnosis instance XX" MAP 0xa1004a80 _REC_MAP_20_u2_u2_u2 65535. _CNV_A_R_LINEAR_____0_CM 0. 65535. DISPLAY_IDENTIFIER ID_ERR_DTC_SCP_LS_DOWN_1 FORMAT "%5.0"
 /begin AXIS_DESCR COM_AXIS errm_online_dummy _CNV_S_2_ERRM_DTC_R_483_CM 1 0. 1. AXIS_PTS_REF ldp_nr_1_id_err_dtc /end AXIS_DESCR
 /begin AXIS_DESCR COM_AXIS errm_online_dummy _CNV_S_6_ERRM_DTC_R_484_CM 6 0. 5. AXIS_PTS_REF ldp_nr_2_id_err_dtc /end AXIS_DESCR
/end CHARACTERISTIC
/begin CHARACTERISTIC fmy_id_oc_ls_down_1.dtc "DTC table declaration for the diagnosis instance XX" MAP 0xa1004774 _REC_MAP_20_u2_u2_u2 65535. _CNV_A_R_LINEAR_____0_CM 0. 65535. DISPLAY_IDENTIFIER ID_ERR_DTC_OC_LS_DOWN_1 FORMAT "%5.0"
 /begin AXIS_DESCR COM_AXIS errm_online_dummy _CNV_S_2_ERRM_DTC_R_483_CM 1 0. 1. AXIS_PTS_REF ldp_nr_1_id_err_dtc /end AXIS_DESCR
 /begin AXIS_DESCR COM_AXIS errm_online_dummy _CNV_S_6_ERRM_DTC_R_484_CM 6 0. 5. AXIS_PTS_REF ldp_nr_2_id_err_dtc /end AXIS_DESCR
/end CHARACTERISTIC
/begin CHARACTERISTIC fmy_id_puc_ls_down_1.dtc "DTC table declaration for the diagnosis instance XX" MAP 0xa1004850 _REC_MAP_20_u2_u2_u2 65535. _CNV_A_R_LINEAR_____0_CM 0. 65535. DISPLAY_IDENTIFIER ID_ERR_DTC_PUC_LS_DOWN_1 FORMAT "%5.0"
 /begin AXIS_DESCR COM_AXIS errm_online_dummy _CNV_S_2_ERRM_DTC_R_483_CM 1 0. 1. AXIS_PTS_REF ldp_nr_1_id_err_dtc /end AXIS_DESCR
 /begin AXIS_DESCR COM_AXIS errm_online_dummy _CNV_S_6_ERRM_DTC_R_484_CM 6 0. 5. AXIS_PTS_REF ldp_nr_2_id_err_dtc /end AXIS_DESCR
/end CHARACTERISTIC
/begin CHARACTERISTIC fmy_id_fl_ls_down_1.dtc "DTC table declaration for the diagnosis instance XX" MAP 0xa100406c _REC_MAP_20_u2_u2_u2 65535. _CNV_A_R_LINEAR_____0_CM 0. 65535. DISPLAY_IDENTIFIER ID_ERR_DTC_FL_LS_DOWN_1 FORMAT "%5.0"
 /begin AXIS_DESCR COM_AXIS errm_online_dummy _CNV_S_2_ERRM_DTC_R_483_CM 1 0. 1. AXIS_PTS_REF ldp_nr_1_id_err_dtc /end AXIS_DESCR
 /begin AXIS_DESCR COM_AXIS errm_online_dummy _CNV_S_6_ERRM_DTC_R_484_CM 6 0. 5. AXIS_PTS_REF ldp_nr_2_id_err_dtc /end AXIS_DESCR
/end CHARACTERISTIC
/begin CHARACTERISTIC fmy_id_lsl_up_if_1.dtc "DTC table declaration for the diagnosis instance XX" MAP 0xa10044cc _REC_MAP_20_u2_u2_u2 65535. _CNV_A_R_LINEAR_____0_CM 0. 65535. DISPLAY_IDENTIFIER ID_ERR_DTC_LSL_UP_IF_1 FORMAT "%5.0"
 /begin AXIS_DESCR COM_AXIS errm_online_dummy _CNV_S_2_ERRM_DTC_R_483_CM 1 0. 1. AXIS_PTS_REF ldp_nr_1_id_err_dtc /end AXIS_DESCR
 /begin AXIS_DESCR COM_AXIS errm_online_dummy _CNV_S_6_ERRM_DTC_R_484_CM 6 0. 5. AXIS_PTS_REF ldp_nr_2_id_err_dtc /end AXIS_DESCR
/end CHARACTERISTIC
/begin CHARACTERISTIC fmy_id_el_lsl_up_1.dtc "DTC table declaration for the diagnosis instance XX" MAP 0xa1004044 _REC_MAP_20_u2_u2_u2 65535. _CNV_A_R_LINEAR_____0_CM 0. 65535. DISPLAY_IDENTIFIER ID_ERR_DTC_EL_LSL_UP_1 FORMAT "%5.0"
 /begin AXIS_DESCR COM_AXIS errm_online_dummy _CNV_S_2_ERRM_DTC_R_483_CM 1 0. 1. AXIS_PTS_REF ldp_nr_1_id_err_dtc /end AXIS_DESCR
 /begin AXIS_DESCR COM_AXIS errm_online_dummy _CNV_S_6_ERRM_DTC_R_484_CM 6 0. 5. AXIS_PTS_REF ldp_nr_2_id_err_dtc /end AXIS_DESCR
/end CHARACTERISTIC
/begin CHARACTERISTIC fmy_id_lsh_up_1.dtc "DTC table declaration for the diagnosis instance XX" MAP 0xa10044a4 _REC_MAP_20_u2_u2_u2 65535. _CNV_A_R_LINEAR_____0_CM 0. 65535. DISPLAY_IDENTIFIER ID_ERR_DTC_LSH_UP_1 FORMAT "%5.0"
 /begin AXIS_DESCR COM_AXIS errm_online_dummy _CNV_S_2_ERRM_DTC_R_483_CM 1 0. 1. AXIS_PTS_REF ldp_nr_1_id_err_dtc /end AXIS_DESCR
 /begin AXIS_DESCR COM_AXIS errm_online_dummy _CNV_S_6_ERRM_DTC_R_484_CM 6 0. 5. AXIS_PTS_REF ldp_nr_2_id_err_dtc /end AXIS_DESCR
/end CHARACTERISTIC
/begin CHARACTERISTIC fmy_id_lsh_down_1.dtc "DTC table declaration for the diagnosis instance XX" MAP 0xa1004454 _REC_MAP_20_u2_u2_u2 65535. _CNV_A_R_LINEAR_____0_CM 0. 65535. DISPLAY_IDENTIFIER ID_ERR_DTC_LSH_DOWN_1 FORMAT "%5.0"
 /begin AXIS_DESCR COM_AXIS errm_online_dummy _CNV_S_2_ERRM_DTC_R_483_CM 1 0. 1. AXIS_PTS_REF ldp_nr_1_id_err_dtc /end AXIS_DESCR
 /begin AXIS_DESCR COM_AXIS errm_online_dummy _CNV_S_6_ERRM_DTC_R_484_CM 6 0. 5. AXIS_PTS_REF ldp_nr_2_id_err_dtc /end AXIS_DESCR
/end CHARACTERISTIC
/begin CHARACTERISTIC fmy_id_vls_down_dif_1.dtc "DTC table declaration for the diagnosis instance XX" MAP 0xa10050ac _REC_MAP_20_u2_u2_u2 65535. _CNV_A_R_LINEAR_____0_CM 0. 65535. DISPLAY_IDENTIFIER ID_ERR_DTC_VLS_DOWN_DIF_1 FORMAT "%5.0"
 /begin AXIS_DESCR COM_AXIS errm_online_dummy _CNV_S_2_ERRM_DTC_R_483_CM 1 0. 1. AXIS_PTS_REF ldp_nr_1_id_err_dtc /end AXIS_DESCR
 /begin AXIS_DESCR COM_AXIS errm_online_dummy _CNV_S_6_ERRM_DTC_R_484_CM 6 0. 5. AXIS_PTS_REF ldp_nr_2_id_err_dtc /end AXIS_DESCR
/end CHARACTERISTIC
/begin CHARACTERISTIC fmy_id_lsh_lsl_up_1.dtc "DTC table declaration for the diagnosis instance XX" MAP 0xa100447c _REC_MAP_20_u2_u2_u2 65535. _CNV_A_R_LINEAR_____0_CM 0. 65535. DISPLAY_IDENTIFIER ID_ERR_DTC_LSH_LSL_UP_1 FORMAT "%5.0"
 /begin AXIS_DESCR COM_AXIS errm_online_dummy _CNV_S_2_ERRM_DTC_R_483_CM 1 0. 1. AXIS_PTS_REF ldp_nr_1_id_err_dtc /end AXIS_DESCR
 /begin AXIS_DESCR COM_AXIS errm_online_dummy _CNV_S_6_ERRM_DTC_R_484_CM 6 0. 5. AXIS_PTS_REF ldp_nr_2_id_err_dtc /end AXIS_DESCR
/end CHARACTERISTIC
/begin CHARACTERISTIC fmy_id_air_lsl_up_1.dtc "DTC table declaration for the diagnosis instance XX" MAP 0xa1003914 _REC_MAP_20_u2_u2_u2 65535. _CNV_A_R_LINEAR_____0_CM 0. 65535. DISPLAY_IDENTIFIER ID_ERR_DTC_AIR_LSL_UP_1 FORMAT "%5.0"
 /begin AXIS_DESCR COM_AXIS errm_online_dummy _CNV_S_2_ERRM_DTC_R_483_CM 1 0. 1. AXIS_PTS_REF ldp_nr_1_id_err_dtc /end AXIS_DESCR
 /begin AXIS_DESCR COM_AXIS errm_online_dummy _CNV_S_6_ERRM_DTC_R_484_CM 6 0. 5. AXIS_PTS_REF ldp_nr_2_id_err_dtc /end AXIS_DESCR
/end CHARACTERISTIC
/begin CHARACTERISTIC fmy_id_pue_ls_down_1.dtc "DTC table declaration for the diagnosis instance XX" MAP 0xa10048a0 _REC_MAP_20_u2_u2_u2 65535. _CNV_A_R_LINEAR_____0_CM 0. 65535. DISPLAY_IDENTIFIER ID_ERR_DTC_PUE_LS_DOWN_1 FORMAT "%5.0"
 /begin AXIS_DESCR COM_AXIS errm_online_dummy _CNV_S_2_ERRM_DTC_R_483_CM 1 0. 1. AXIS_PTS_REF ldp_nr_1_id_err_dtc /end AXIS_DESCR
 /begin AXIS_DESCR COM_AXIS errm_online_dummy _CNV_S_6_ERRM_DTC_R_484_CM 6 0. 5. AXIS_PTS_REF ldp_nr_2_id_err_dtc /end AXIS_DESCR
/end CHARACTERISTIC
/begin CHARACTERISTIC fmy_id_swt_ls_down_1.dtc "DTC table declaration for the diagnosis instance XX" MAP 0xa1004bc0 _REC_MAP_20_u2_u2_u2 65535. _CNV_A_R_LINEAR_____0_CM 0. 65535. DISPLAY_IDENTIFIER ID_ERR_DTC_SWT_LS_DOWN_1 FORMAT "%5.0"
 /begin AXIS_DESCR COM_AXIS errm_online_dummy _CNV_S_2_ERRM_DTC_R_483_CM 1 0. 1. AXIS_PTS_REF ldp_nr_1_id_err_dtc /end AXIS_DESCR
 /begin AXIS_DESCR COM_AXIS errm_online_dummy _CNV_S_6_ERRM_DTC_R_484_CM 6 0. 5. AXIS_PTS_REF ldp_nr_2_id_err_dtc /end AXIS_DESCR
/end CHARACTERISTIC
/begin CHARACTERISTIC fmy_id_obd_lsh_down_1.dtc "DTC table declaration for the diagnosis instance XX" MAP 0xa1004724 _REC_MAP_20_u2_u2_u2 65535. _CNV_A_R_LINEAR_____0_CM 0. 65535. DISPLAY_IDENTIFIER ID_ERR_DTC_OBD_LSH_DOWN_1 FORMAT "%5.0"
 /begin AXIS_DESCR COM_AXIS errm_online_dummy _CNV_S_2_ERRM_DTC_R_483_CM 1 0. 1. AXIS_PTS_REF ldp_nr_1_id_err_dtc /end AXIS_DESCR
 /begin AXIS_DESCR COM_AXIS errm_online_dummy _CNV_S_6_ERRM_DTC_R_484_CM 6 0. 5. AXIS_PTS_REF ldp_nr_2_id_err_dtc /end AXIS_DESCR
/end CHARACTERISTIC
/begin CHARACTERISTIC fmy_id_dyn_vld_ls_up_1.dtc "DTC table declaration for the diagnosis instance XX" MAP 0xa1003ef0 _REC_MAP_20_u2_u2_u2 65535. _CNV_A_R_LINEAR_____0_CM 0. 65535. DISPLAY_IDENTIFIER ID_ERR_DTC_DYN_VLD_LS_UP_1 FORMAT "%5.0"
 /begin AXIS_DESCR COM_AXIS errm_online_dummy _CNV_S_2_ERRM_DTC_R_483_CM 1 0. 1. AXIS_PTS_REF ldp_nr_1_id_err_dtc /end AXIS_DESCR
 /begin AXIS_DESCR COM_AXIS errm_online_dummy _CNV_S_6_ERRM_DTC_R_484_CM 6 0. 5. AXIS_PTS_REF ldp_nr_2_id_err_dtc /end AXIS_DESCR
/end CHARACTERISTIC
/begin CHARACTERISTIC fmy_id_puc_vld_ls_up_1.dtc "DTC table declaration for the diagnosis instance XX" MAP 0xa1004878 _REC_MAP_20_u2_u2_u2 65535. _CNV_A_R_LINEAR_____0_CM 0. 65535. DISPLAY_IDENTIFIER ID_ERR_DTC_PUC_VLD_LS_UP_1 FORMAT "%5.0"
 /begin AXIS_DESCR COM_AXIS errm_online_dummy _CNV_S_2_ERRM_DTC_R_483_CM 1 0. 1. AXIS_PTS_REF ldp_nr_1_id_err_dtc /end AXIS_DESCR
 /begin AXIS_DESCR COM_AXIS errm_online_dummy _CNV_S_6_ERRM_DTC_R_484_CM 6 0. 5. AXIS_PTS_REF ldp_nr_2_id_err_dtc /end AXIS_DESCR
/end CHARACTERISTIC
/begin CHARACTERISTIC fmy_id_obd_vld_lsh_up_1.dtc "DTC table declaration for the diagnosis instance XX" MAP 0xa100474c _REC_MAP_20_u2_u2_u2 65535. _CNV_A_R_LINEAR_____0_CM 0. 65535. DISPLAY_IDENTIFIER ID_ERR_DTC_OBD_VLD_LSH_UP_1 FORMAT "%5.0"
 /begin AXIS_DESCR COM_AXIS errm_online_dummy _CNV_S_2_ERRM_DTC_R_483_CM 1 0. 1. AXIS_PTS_REF ldp_nr_1_id_err_dtc /end AXIS_DESCR
 /begin AXIS_DESCR COM_AXIS errm_online_dummy _CNV_S_6_ERRM_DTC_R_484_CM 6 0. 5. AXIS_PTS_REF ldp_nr_2_id_err_dtc /end AXIS_DESCR
/end CHARACTERISTIC
/begin CHARACTERISTIC fmy_id_chk_ls_down_1.dtc "DTC table declaration for the diagnosis instance XX" MAP 0xa1003cfc _REC_MAP_20_u2_u2_u2 65535. _CNV_A_R_LINEAR_____0_CM 0. 65535. DISPLAY_IDENTIFIER ID_ERR_DTC_CHK_LS_DOWN_1 FORMAT "%5.0"
 /begin AXIS_DESCR COM_AXIS errm_online_dummy _CNV_S_2_ERRM_DTC_R_483_CM 1 0. 1. AXIS_PTS_REF ldp_nr_1_id_err_dtc /end AXIS_DESCR
 /begin AXIS_DESCR COM_AXIS errm_online_dummy _CNV_S_6_ERRM_DTC_R_484_CM 6 0. 5. AXIS_PTS_REF ldp_nr_2_id_err_dtc /end AXIS_DESCR
/end CHARACTERISTIC
/begin CHARACTERISTIC fmy_id_shift_afl_lsl_up_1.dtc "DTC table declaration for the diagnosis instance XX" MAP 0xa1004ae4 _REC_MAP_20_u2_u2_u2 65535. _CNV_A_R_LINEAR_____0_CM 0. 65535. DISPLAY_IDENTIFIER ID_ERR_DTC_SHIFT_AFL_LSL_UP_1 FORMAT "%5.0"
 /begin AXIS_DESCR COM_AXIS errm_online_dummy _CNV_S_2_ERRM_DTC_R_483_CM 1 0. 1. AXIS_PTS_REF ldp_nr_1_id_err_dtc /end AXIS_DESCR
 /begin AXIS_DESCR COM_AXIS errm_online_dummy _CNV_S_6_ERRM_DTC_R_484_CM 6 0. 5. AXIS_PTS_REF ldp_nr_2_id_err_dtc /end AXIS_DESCR
/end CHARACTERISTIC
/begin CHARACTERISTIC fmy_id_shift_afr_lsl_up_1.dtc "DTC table declaration for the diagnosis instance XX" MAP 0xa1004b0c _REC_MAP_20_u2_u2_u2 65535. _CNV_A_R_LINEAR_____0_CM 0. 65535. DISPLAY_IDENTIFIER ID_ERR_DTC_SHIFT_AFR_LSL_UP_1 FORMAT "%5.0"
 /begin AXIS_DESCR COM_AXIS errm_online_dummy _CNV_S_2_ERRM_DTC_R_483_CM 1 0. 1. AXIS_PTS_REF ldp_nr_1_id_err_dtc /end AXIS_DESCR
 /begin AXIS_DESCR COM_AXIS errm_online_dummy _CNV_S_6_ERRM_DTC_R_484_CM 6 0. 5. AXIS_PTS_REF ldp_nr_2_id_err_dtc /end AXIS_DESCR
/end CHARACTERISTIC
/begin CHARACTERISTIC fmy_id_oc_lsl_up_1.dtc "DTC table declaration for the diagnosis instance XX" MAP 0xa100479c _REC_MAP_20_u2_u2_u2 65535. _CNV_A_R_LINEAR_____0_CM 0. 65535. DISPLAY_IDENTIFIER ID_ERR_DTC_OC_LSL_UP_1 FORMAT "%5.0"
 /begin AXIS_DESCR COM_AXIS errm_online_dummy _CNV_S_2_ERRM_DTC_R_483_CM 1 0. 1. AXIS_PTS_REF ldp_nr_1_id_err_dtc /end AXIS_DESCR
 /begin AXIS_DESCR COM_AXIS errm_online_dummy _CNV_S_6_ERRM_DTC_R_484_CM 6 0. 5. AXIS_PTS_REF ldp_nr_2_id_err_dtc /end AXIS_DESCR
/end CHARACTERISTIC
/begin CHARACTERISTIC fmy_id_delta_i_lam_1.dtc "DTC table declaration for the diagnosis instance XX" MAP 0xa1003e50 _REC_MAP_20_u2_u2_u2 65535. _CNV_A_R_LINEAR_____0_CM 0. 65535. DISPLAY_IDENTIFIER ID_ERR_DTC_DELTA_I_LAM_1 FORMAT "%5.0"
 /begin AXIS_DESCR COM_AXIS errm_online_dummy _CNV_S_2_ERRM_DTC_R_483_CM 1 0. 1. AXIS_PTS_REF ldp_nr_1_id_err_dtc /end AXIS_DESCR
 /begin AXIS_DESCR COM_AXIS errm_online_dummy _CNV_S_6_ERRM_DTC_R_484_CM 6 0. 5. AXIS_PTS_REF ldp_nr_2_id_err_dtc /end AXIS_DESCR
/end CHARACTERISTIC
/begin CHARACTERISTIC fmy_id_rgn_nt_ls_down_1.dtc "DTC table declaration for the diagnosis instance XX" MAP 0xa1004990 _REC_MAP_20_u2_u2_u2 65535. _CNV_A_R_LINEAR_____0_CM 0. 65535. DISPLAY_IDENTIFIER ID_ERR_DTC_RGN_NT_LS_DOWN_1 FORMAT "%5.0"
 /begin AXIS_DESCR COM_AXIS errm_online_dummy _CNV_S_2_ERRM_DTC_R_483_CM 1 0. 1. AXIS_PTS_REF ldp_nr_1_id_err_dtc /end AXIS_DESCR
 /begin AXIS_DESCR COM_AXIS errm_online_dummy _CNV_S_6_ERRM_DTC_R_484_CM 6 0. 5. AXIS_PTS_REF ldp_nr_2_id_err_dtc /end AXIS_DESCR
/end CHARACTERISTIC
/begin CHARACTERISTIC fmy_id_chg_ls_down.dtc "DTC table declaration for the diagnosis instance XX" MAP 0xa1003cc0 _REC_MAP_20_u2_u2_u2 65535. _CNV_A_R_LINEAR_____0_CM 0. 65535. DISPLAY_IDENTIFIER ID_ERR_DTC_CHG_LS_DOWN FORMAT "%5.0"
 /begin AXIS_DESCR COM_AXIS errm_online_dummy _CNV_S_2_ERRM_DTC_R_483_CM 1 0. 1. AXIS_PTS_REF ldp_nr_1_id_err_dtc /end AXIS_DESCR
 /begin AXIS_DESCR COM_AXIS errm_online_dummy _CNV_S_6_ERRM_DTC_R_484_CM 6 0. 5. AXIS_PTS_REF ldp_nr_2_id_err_dtc /end AXIS_DESCR
/end CHARACTERISTIC
/begin CHARACTERISTIC fmy_id_scg_ls_down_2.dtc "DTC table declaration for the diagnosis instance XX" MAP 0xa1004a6c _REC_MAP_20_u2_u2_u2 65535. _CNV_A_R_LINEAR_____0_CM 0. 65535. DISPLAY_IDENTIFIER ID_ERR_DTC_SCG_LS_DOWN_2 FORMAT "%5.0"
 /begin AXIS_DESCR COM_AXIS errm_online_dummy _CNV_S_2_ERRM_DTC_R_483_CM 1 0. 1. AXIS_PTS_REF ldp_nr_1_id_err_dtc /end AXIS_DESCR
 /begin AXIS_DESCR COM_AXIS errm_online_dummy _CNV_S_6_ERRM_DTC_R_484_CM 6 0. 5. AXIS_PTS_REF ldp_nr_2_id_err_dtc /end AXIS_DESCR
/end CHARACTERISTIC
/begin CHARACTERISTIC fmy_id_scp_ls_down_2.dtc "DTC table declaration for the diagnosis instance XX" MAP 0xa1004a94 _REC_MAP_20_u2_u2_u2 65535. _CNV_A_R_LINEAR_____0_CM 0. 65535. DISPLAY_IDENTIFIER ID_ERR_DTC_SCP_LS_DOWN_2 FORMAT "%5.0"
 /begin AXIS_DESCR COM_AXIS errm_online_dummy _CNV_S_2_ERRM_DTC_R_483_CM 1 0. 1. AXIS_PTS_REF ldp_nr_1_id_err_dtc /end AXIS_DESCR
 /begin AXIS_DESCR COM_AXIS errm_online_dummy _CNV_S_6_ERRM_DTC_R_484_CM 6 0. 5. AXIS_PTS_REF ldp_nr_2_id_err_dtc /end AXIS_DESCR
/end CHARACTERISTIC
/begin CHARACTERISTIC fmy_id_oc_ls_down_2.dtc "DTC table declaration for the diagnosis instance XX" MAP 0xa1004788 _REC_MAP_20_u2_u2_u2 65535. _CNV_A_R_LINEAR_____0_CM 0. 65535. DISPLAY_IDENTIFIER ID_ERR_DTC_OC_LS_DOWN_2 FORMAT "%5.0"
 /begin AXIS_DESCR COM_AXIS errm_online_dummy _CNV_S_2_ERRM_DTC_R_483_CM 1 0. 1. AXIS_PTS_REF ldp_nr_1_id_err_dtc /end AXIS_DESCR
 /begin AXIS_DESCR COM_AXIS errm_online_dummy _CNV_S_6_ERRM_DTC_R_484_CM 6 0. 5. AXIS_PTS_REF ldp_nr_2_id_err_dtc /end AXIS_DESCR
/end CHARACTERISTIC
/begin CHARACTERISTIC fmy_id_puc_ls_down_2.dtc "DTC table declaration for the diagnosis instance XX" MAP 0xa1004864 _REC_MAP_20_u2_u2_u2 65535. _CNV_A_R_LINEAR_____0_CM 0. 65535. DISPLAY_IDENTIFIER ID_ERR_DTC_PUC_LS_DOWN_2 FORMAT "%5.0"
 /begin AXIS_DESCR COM_AXIS errm_online_dummy _CNV_S_2_ERRM_DTC_R_483_CM 1 0. 1. AXIS_PTS_REF ldp_nr_1_id_err_dtc /end AXIS_DESCR
 /begin AXIS_DESCR COM_AXIS errm_online_dummy _CNV_S_6_ERRM_DTC_R_484_CM 6 0. 5. AXIS_PTS_REF ldp_nr_2_id_err_dtc /end AXIS_DESCR
/end CHARACTERISTIC
/begin CHARACTERISTIC fmy_id_fl_ls_down_2.dtc "DTC table declaration for the diagnosis instance XX" MAP 0xa1004080 _REC_MAP_20_u2_u2_u2 65535. _CNV_A_R_LINEAR_____0_CM 0. 65535. DISPLAY_IDENTIFIER ID_ERR_DTC_FL_LS_DOWN_2 FORMAT "%5.0"
 /begin AXIS_DESCR COM_AXIS errm_online_dummy _CNV_S_2_ERRM_DTC_R_483_CM 1 0. 1. AXIS_PTS_REF ldp_nr_1_id_err_dtc /end AXIS_DESCR
 /begin AXIS_DESCR COM_AXIS errm_online_dummy _CNV_S_6_ERRM_DTC_R_484_CM 6 0. 5. AXIS_PTS_REF ldp_nr_2_id_err_dtc /end AXIS_DESCR
/end CHARACTERISTIC
/begin CHARACTERISTIC fmy_id_lsl_up_if_2.dtc "DTC table declaration for the diagnosis instance XX" MAP 0xa10044e0 _REC_MAP_20_u2_u2_u2 65535. _CNV_A_R_LINEAR_____0_CM 0. 65535. DISPLAY_IDENTIFIER ID_ERR_DTC_LSL_UP_IF_2 FORMAT "%5.0"
 /begin AXIS_DESCR COM_AXIS errm_online_dummy _CNV_S_2_ERRM_DTC_R_483_CM 1 0. 1. AXIS_PTS_REF ldp_nr_1_id_err_dtc /end AXIS_DESCR
 /begin AXIS_DESCR COM_AXIS errm_online_dummy _CNV_S_6_ERRM_DTC_R_484_CM 6 0. 5. AXIS_PTS_REF ldp_nr_2_id_err_dtc /end AXIS_DESCR
/end CHARACTERISTIC
/begin CHARACTERISTIC fmy_id_el_lsl_up_2.dtc "DTC table declaration for the diagnosis instance XX" MAP 0xa1004058 _REC_MAP_20_u2_u2_u2 65535. _CNV_A_R_LINEAR_____0_CM 0. 65535. DISPLAY_IDENTIFIER ID_ERR_DTC_EL_LSL_UP_2 FORMAT "%5.0"
 /begin AXIS_DESCR COM_AXIS errm_online_dummy _CNV_S_2_ERRM_DTC_R_483_CM 1 0. 1. AXIS_PTS_REF ldp_nr_1_id_err_dtc /end AXIS_DESCR
 /begin AXIS_DESCR COM_AXIS errm_online_dummy _CNV_S_6_ERRM_DTC_R_484_CM 6 0. 5. AXIS_PTS_REF ldp_nr_2_id_err_dtc /end AXIS_DESCR
/end CHARACTERISTIC
/begin CHARACTERISTIC fmy_id_lsh_up_2.dtc "DTC table declaration for the diagnosis instance XX" MAP 0xa10044b8 _REC_MAP_20_u2_u2_u2 65535. _CNV_A_R_LINEAR_____0_CM 0. 65535. DISPLAY_IDENTIFIER ID_ERR_DTC_LSH_UP_2 FORMAT "%5.0"
 /begin AXIS_DESCR COM_AXIS errm_online_dummy _CNV_S_2_ERRM_DTC_R_483_CM 1 0. 1. AXIS_PTS_REF ldp_nr_1_id_err_dtc /end AXIS_DESCR
 /begin AXIS_DESCR COM_AXIS errm_online_dummy _CNV_S_6_ERRM_DTC_R_484_CM 6 0. 5. AXIS_PTS_REF ldp_nr_2_id_err_dtc /end AXIS_DESCR
/end CHARACTERISTIC
/begin CHARACTERISTIC fmy_id_lsh_down_2.dtc "DTC table declaration for the diagnosis instance XX" MAP 0xa1004468 _REC_MAP_20_u2_u2_u2 65535. _CNV_A_R_LINEAR_____0_CM 0. 65535. DISPLAY_IDENTIFIER ID_ERR_DTC_LSH_DOWN_2 FORMAT "%5.0"
 /begin AXIS_DESCR COM_AXIS errm_online_dummy _CNV_S_2_ERRM_DTC_R_483_CM 1 0. 1. AXIS_PTS_REF ldp_nr_1_id_err_dtc /end AXIS_DESCR
 /begin AXIS_DESCR COM_AXIS errm_online_dummy _CNV_S_6_ERRM_DTC_R_484_CM 6 0. 5. AXIS_PTS_REF ldp_nr_2_id_err_dtc /end AXIS_DESCR
/end CHARACTERISTIC
/begin CHARACTERISTIC fmy_id_vls_down_dif_2.dtc "DTC table declaration for the diagnosis instance XX" MAP 0xa10050c0 _REC_MAP_20_u2_u2_u2 65535. _CNV_A_R_LINEAR_____0_CM 0. 65535. DISPLAY_IDENTIFIER ID_ERR_DTC_VLS_DOWN_DIF_2 FORMAT "%5.0"
 /begin AXIS_DESCR COM_AXIS errm_online_dummy _CNV_S_2_ERRM_DTC_R_483_CM 1 0. 1. AXIS_PTS_REF ldp_nr_1_id_err_dtc /end AXIS_DESCR
 /begin AXIS_DESCR COM_AXIS errm_online_dummy _CNV_S_6_ERRM_DTC_R_484_CM 6 0. 5. AXIS_PTS_REF ldp_nr_2_id_err_dtc /end AXIS_DESCR
/end CHARACTERISTIC
/begin CHARACTERISTIC fmy_id_lsh_lsl_up_2.dtc "DTC table declaration for the diagnosis instance XX" MAP 0xa1004490 _REC_MAP_20_u2_u2_u2 65535. _CNV_A_R_LINEAR_____0_CM 0. 65535. DISPLAY_IDENTIFIER ID_ERR_DTC_LSH_LSL_UP_2 FORMAT "%5.0"
 /begin AXIS_DESCR COM_AXIS errm_online_dummy _CNV_S_2_ERRM_DTC_R_483_CM 1 0. 1. AXIS_PTS_REF ldp_nr_1_id_err_dtc /end AXIS_DESCR
 /begin AXIS_DESCR COM_AXIS errm_online_dummy _CNV_S_6_ERRM_DTC_R_484_CM 6 0. 5. AXIS_PTS_REF ldp_nr_2_id_err_dtc /end AXIS_DESCR
/end CHARACTERISTIC
/begin CHARACTERISTIC fmy_id_air_lsl_up_2.dtc "DTC table declaration for the diagnosis instance XX" MAP 0xa1003928 _REC_MAP_20_u2_u2_u2 65535. _CNV_A_R_LINEAR_____0_CM 0. 65535. DISPLAY_IDENTIFIER ID_ERR_DTC_AIR_LSL_UP_2 FORMAT "%5.0"
 /begin AXIS_DESCR COM_AXIS errm_online_dummy _CNV_S_2_ERRM_DTC_R_483_CM 1 0. 1. AXIS_PTS_REF ldp_nr_1_id_err_dtc /end AXIS_DESCR
 /begin AXIS_DESCR COM_AXIS errm_online_dummy _CNV_S_6_ERRM_DTC_R_484_CM 6 0. 5. AXIS_PTS_REF ldp_nr_2_id_err_dtc /end AXIS_DESCR
/end CHARACTERISTIC
/begin CHARACTERISTIC fmy_id_pue_ls_down_2.dtc "DTC table declaration for the diagnosis instance XX" MAP 0xa10048b4 _REC_MAP_20_u2_u2_u2 65535. _CNV_A_R_LINEAR_____0_CM 0. 65535. DISPLAY_IDENTIFIER ID_ERR_DTC_PUE_LS_DOWN_2 FORMAT "%5.0"
 /begin AXIS_DESCR COM_AXIS errm_online_dummy _CNV_S_2_ERRM_DTC_R_483_CM 1 0. 1. AXIS_PTS_REF ldp_nr_1_id_err_dtc /end AXIS_DESCR
 /begin AXIS_DESCR COM_AXIS errm_online_dummy _CNV_S_6_ERRM_DTC_R_484_CM 6 0. 5. AXIS_PTS_REF ldp_nr_2_id_err_dtc /end AXIS_DESCR
/end CHARACTERISTIC
/begin CHARACTERISTIC fmy_id_swt_ls_down_2.dtc "DTC table declaration for the diagnosis instance XX" MAP 0xa1004bd4 _REC_MAP_20_u2_u2_u2 65535. _CNV_A_R_LINEAR_____0_CM 0. 65535. DISPLAY_IDENTIFIER ID_ERR_DTC_SWT_LS_DOWN_2 FORMAT "%5.0"
 /begin AXIS_DESCR COM_AXIS errm_online_dummy _CNV_S_2_ERRM_DTC_R_483_CM 1 0. 1. AXIS_PTS_REF ldp_nr_1_id_err_dtc /end AXIS_DESCR
 /begin AXIS_DESCR COM_AXIS errm_online_dummy _CNV_S_6_ERRM_DTC_R_484_CM 6 0. 5. AXIS_PTS_REF ldp_nr_2_id_err_dtc /end AXIS_DESCR
/end CHARACTERISTIC
/begin CHARACTERISTIC fmy_id_obd_lsh_down_2.dtc "DTC table declaration for the diagnosis instance XX" MAP 0xa1004738 _REC_MAP_20_u2_u2_u2 65535. _CNV_A_R_LINEAR_____0_CM 0. 65535. DISPLAY_IDENTIFIER ID_ERR_DTC_OBD_LSH_DOWN_2 FORMAT "%5.0"
 /begin AXIS_DESCR COM_AXIS errm_online_dummy _CNV_S_2_ERRM_DTC_R_483_CM 1 0. 1. AXIS_PTS_REF ldp_nr_1_id_err_dtc /end AXIS_DESCR
 /begin AXIS_DESCR COM_AXIS errm_online_dummy _CNV_S_6_ERRM_DTC_R_484_CM 6 0. 5. AXIS_PTS_REF ldp_nr_2_id_err_dtc /end AXIS_DESCR
/end CHARACTERISTIC
/begin CHARACTERISTIC fmy_id_dyn_vld_ls_up_2.dtc "DTC table declaration for the diagnosis instance XX" MAP 0xa1003f04 _REC_MAP_20_u2_u2_u2 65535. _CNV_A_R_LINEAR_____0_CM 0. 65535. DISPLAY_IDENTIFIER ID_ERR_DTC_DYN_VLD_LS_UP_2 FORMAT "%5.0"
 /begin AXIS_DESCR COM_AXIS errm_online_dummy _CNV_S_2_ERRM_DTC_R_483_CM 1 0. 1. AXIS_PTS_REF ldp_nr_1_id_err_dtc /end AXIS_DESCR
 /begin AXIS_DESCR COM_AXIS errm_online_dummy _CNV_S_6_ERRM_DTC_R_484_CM 6 0. 5. AXIS_PTS_REF ldp_nr_2_id_err_dtc /end AXIS_DESCR
/end CHARACTERISTIC
/begin CHARACTERISTIC fmy_id_puc_vld_ls_up_2.dtc "DTC table declaration for the diagnosis instance XX" MAP 0xa100488c _REC_MAP_20_u2_u2_u2 65535. _CNV_A_R_LINEAR_____0_CM 0. 65535. DISPLAY_IDENTIFIER ID_ERR_DTC_PUC_VLD_LS_UP_2 FORMAT "%5.0"
 /begin AXIS_DESCR COM_AXIS errm_online_dummy _CNV_S_2_ERRM_DTC_R_483_CM 1 0. 1. AXIS_PTS_REF ldp_nr_1_id_err_dtc /end AXIS_DESCR
 /begin AXIS_DESCR COM_AXIS errm_online_dummy _CNV_S_6_ERRM_DTC_R_484_CM 6 0. 5. AXIS_PTS_REF ldp_nr_2_id_err_dtc /end AXIS_DESCR
/end CHARACTERISTIC
/begin CHARACTERISTIC fmy_id_obd_vld_lsh_up_2.dtc "DTC table declaration for the diagnosis instance XX" MAP 0xa1004760 _REC_MAP_20_u2_u2_u2 65535. _CNV_A_R_LINEAR_____0_CM 0. 65535. DISPLAY_IDENTIFIER ID_ERR_DTC_OBD_VLD_LSH_UP_2 FORMAT "%5.0"
 /begin AXIS_DESCR COM_AXIS errm_online_dummy _CNV_S_2_ERRM_DTC_R_483_CM 1 0. 1. AXIS_PTS_REF ldp_nr_1_id_err_dtc /end AXIS_DESCR
 /begin AXIS_DESCR COM_AXIS errm_online_dummy _CNV_S_6_ERRM_DTC_R_484_CM 6 0. 5. AXIS_PTS_REF ldp_nr_2_id_err_dtc /end AXIS_DESCR
/end CHARACTERISTIC
/begin CHARACTERISTIC fmy_id_chk_ls_down_2.dtc "DTC table declaration for the diagnosis instance XX" MAP 0xa1003d10 _REC_MAP_20_u2_u2_u2 65535. _CNV_A_R_LINEAR_____0_CM 0. 65535. DISPLAY_IDENTIFIER ID_ERR_DTC_CHK_LS_DOWN_2 FORMAT "%5.0"
 /begin AXIS_DESCR COM_AXIS errm_online_dummy _CNV_S_2_ERRM_DTC_R_483_CM 1 0. 1. AXIS_PTS_REF ldp_nr_1_id_err_dtc /end AXIS_DESCR
 /begin AXIS_DESCR COM_AXIS errm_online_dummy _CNV_S_6_ERRM_DTC_R_484_CM 6 0. 5. AXIS_PTS_REF ldp_nr_2_id_err_dtc /end AXIS_DESCR
/end CHARACTERISTIC
/begin CHARACTERISTIC fmy_id_shift_afl_lsl_up_2.dtc "DTC table declaration for the diagnosis instance XX" MAP 0xa1004af8 _REC_MAP_20_u2_u2_u2 65535. _CNV_A_R_LINEAR_____0_CM 0. 65535. DISPLAY_IDENTIFIER ID_ERR_DTC_SHIFT_AFL_LSL_UP_2 FORMAT "%5.0"
 /begin AXIS_DESCR COM_AXIS errm_online_dummy _CNV_S_2_ERRM_DTC_R_483_CM 1 0. 1. AXIS_PTS_REF ldp_nr_1_id_err_dtc /end AXIS_DESCR
 /begin AXIS_DESCR COM_AXIS errm_online_dummy _CNV_S_6_ERRM_DTC_R_484_CM 6 0. 5. AXIS_PTS_REF ldp_nr_2_id_err_dtc /end AXIS_DESCR
/end CHARACTERISTIC
/begin CHARACTERISTIC fmy_id_shift_afr_lsl_up_2.dtc "DTC table declaration for the diagnosis instance XX" MAP 0xa1004b20 _REC_MAP_20_u2_u2_u2 65535. _CNV_A_R_LINEAR_____0_CM 0. 65535. DISPLAY_IDENTIFIER ID_ERR_DTC_SHIFT_AFR_LSL_UP_2 FORMAT "%5.0"
 /begin AXIS_DESCR COM_AXIS errm_online_dummy _CNV_S_2_ERRM_DTC_R_483_CM 1 0. 1. AXIS_PTS_REF ldp_nr_1_id_err_dtc /end AXIS_DESCR
 /begin AXIS_DESCR COM_AXIS errm_online_dummy _CNV_S_6_ERRM_DTC_R_484_CM 6 0. 5. AXIS_PTS_REF ldp_nr_2_id_err_dtc /end AXIS_DESCR
/end CHARACTERISTIC
/begin CHARACTERISTIC fmy_id_oc_lsl_up_2.dtc "DTC table declaration for the diagnosis instance XX" MAP 0xa10047b0 _REC_MAP_20_u2_u2_u2 65535. _CNV_A_R_LINEAR_____0_CM 0. 65535. DISPLAY_IDENTIFIER ID_ERR_DTC_OC_LSL_UP_2 FORMAT "%5.0"
 /begin AXIS_DESCR COM_AXIS errm_online_dummy _CNV_S_2_ERRM_DTC_R_483_CM 1 0. 1. AXIS_PTS_REF ldp_nr_1_id_err_dtc /end AXIS_DESCR
 /begin AXIS_DESCR COM_AXIS errm_online_dummy _CNV_S_6_ERRM_DTC_R_484_CM 6 0. 5. AXIS_PTS_REF ldp_nr_2_id_err_dtc /end AXIS_DESCR
/end CHARACTERISTIC
/begin CHARACTERISTIC fmy_id_delta_i_lam_2.dtc "DTC table declaration for the diagnosis instance XX" MAP 0xa1003e64 _REC_MAP_20_u2_u2_u2 65535. _CNV_A_R_LINEAR_____0_CM 0. 65535. DISPLAY_IDENTIFIER ID_ERR_DTC_DELTA_I_LAM_2 FORMAT "%5.0"
 /begin AXIS_DESCR COM_AXIS errm_online_dummy _CNV_S_2_ERRM_DTC_R_483_CM 1 0. 1. AXIS_PTS_REF ldp_nr_1_id_err_dtc /end AXIS_DESCR
 /begin AXIS_DESCR COM_AXIS errm_online_dummy _CNV_S_6_ERRM_DTC_R_484_CM 6 0. 5. AXIS_PTS_REF ldp_nr_2_id_err_dtc /end AXIS_DESCR
/end CHARACTERISTIC
/begin CHARACTERISTIC fmy_id_rgn_nt_ls_down_2.dtc "DTC table declaration for the diagnosis instance XX" MAP 0xa10049a4 _REC_MAP_20_u2_u2_u2 65535. _CNV_A_R_LINEAR_____0_CM 0. 65535. DISPLAY_IDENTIFIER ID_ERR_DTC_RGN_NT_LS_DOWN_2 FORMAT "%5.0"
 /begin AXIS_DESCR COM_AXIS errm_online_dummy _CNV_S_2_ERRM_DTC_R_483_CM 1 0. 1. AXIS_PTS_REF ldp_nr_1_id_err_dtc /end AXIS_DESCR
 /begin AXIS_DESCR COM_AXIS errm_online_dummy _CNV_S_6_ERRM_DTC_R_484_CM 6 0. 5. AXIS_PTS_REF ldp_nr_2_id_err_dtc /end AXIS_DESCR
/end CHARACTERISTIC
/begin CHARACTERISTIC fmy_id_chg_ls_up.dtc "DTC table declaration for the diagnosis instance XX" MAP 0xa1003cd4 _REC_MAP_20_u2_u2_u2 65535. _CNV_A_R_LINEAR_____0_CM 0. 65535. DISPLAY_IDENTIFIER ID_ERR_DTC_CHG_LS_UP FORMAT "%5.0"
 /begin AXIS_DESCR COM_AXIS errm_online_dummy _CNV_S_2_ERRM_DTC_R_483_CM 1 0. 1. AXIS_PTS_REF ldp_nr_1_id_err_dtc /end AXIS_DESCR
 /begin AXIS_DESCR COM_AXIS errm_online_dummy _CNV_S_6_ERRM_DTC_R_484_CM 6 0. 5. AXIS_PTS_REF ldp_nr_2_id_err_dtc /end AXIS_DESCR
/end CHARACTERISTIC
/begin CHARACTERISTIC fmy_id_alter_com.dtc "DTC table declaration for the diagnosis instance XX" MAP 0xa1003978 _REC_MAP_20_u2_u2_u2 65535. _CNV_A_R_LINEAR_____0_CM 0. 65535. DISPLAY_IDENTIFIER ID_ERR_DTC_ALTER_COM FORMAT "%5.0"
 /begin AXIS_DESCR COM_AXIS errm_online_dummy _CNV_S_2_ERRM_DTC_R_483_CM 1 0. 1. AXIS_PTS_REF ldp_nr_1_id_err_dtc /end AXIS_DESCR
 /begin AXIS_DESCR COM_AXIS errm_online_dummy _CNV_S_6_ERRM_DTC_R_484_CM 6 0. 5. AXIS_PTS_REF ldp_nr_2_id_err_dtc /end AXIS_DESCR
/end CHARACTERISTIC
/begin CHARACTERISTIC fmy_id_cwp_com.dtc "DTC table declaration for the diagnosis instance XX" MAP 0xa1003dd8 _REC_MAP_20_u2_u2_u2 65535. _CNV_A_R_LINEAR_____0_CM 0. 65535. DISPLAY_IDENTIFIER ID_ERR_DTC_CWP_COM FORMAT "%5.0"
 /begin AXIS_DESCR COM_AXIS errm_online_dummy _CNV_S_2_ERRM_DTC_R_483_CM 1 0. 1. AXIS_PTS_REF ldp_nr_1_id_err_dtc /end AXIS_DESCR
 /begin AXIS_DESCR COM_AXIS errm_online_dummy _CNV_S_6_ERRM_DTC_R_484_CM 6 0. 5. AXIS_PTS_REF ldp_nr_2_id_err_dtc /end AXIS_DESCR
/end CHARACTERISTIC
/begin CHARACTERISTIC fmy_id_qoil_com.dtc "DTC table declaration for the diagnosis instance XX" MAP 0xa1004940 _REC_MAP_20_u2_u2_u2 65535. _CNV_A_R_LINEAR_____0_CM 0. 65535. DISPLAY_IDENTIFIER ID_ERR_DTC_QOIL_COM FORMAT "%5.0"
 /begin AXIS_DESCR COM_AXIS errm_online_dummy _CNV_S_2_ERRM_DTC_R_483_CM 1 0. 1. AXIS_PTS_REF ldp_nr_1_id_err_dtc /end AXIS_DESCR
 /begin AXIS_DESCR COM_AXIS errm_online_dummy _CNV_S_6_ERRM_DTC_R_484_CM 6 0. 5. AXIS_PTS_REF ldp_nr_2_id_err_dtc /end AXIS_DESCR
/end CHARACTERISTIC
/begin CHARACTERISTIC fmy_id_sens_bat_smt_com.dtc "DTC table declaration for the diagnosis instance XX" MAP 0xa1004ad0 _REC_MAP_20_u2_u2_u2 65535. _CNV_A_R_LINEAR_____0_CM 0. 65535. DISPLAY_IDENTIFIER ID_ERR_DTC_SENS_BAT_SMT_COM FORMAT "%5.0"
 /begin AXIS_DESCR COM_AXIS errm_online_dummy _CNV_S_2_ERRM_DTC_R_483_CM 1 0. 1. AXIS_PTS_REF ldp_nr_1_id_err_dtc /end AXIS_DESCR
 /begin AXIS_DESCR COM_AXIS errm_online_dummy _CNV_S_6_ERRM_DTC_R_484_CM 6 0. 5. AXIS_PTS_REF ldp_nr_2_id_err_dtc /end AXIS_DESCR
/end CHARACTERISTIC
/begin CHARACTERISTIC fmy_id_ecraspwm_fb.dtc "DTC table declaration for the diagnosis instance XX" MAP 0xa1003f68 _REC_MAP_20_u2_u2_u2 65535. _CNV_A_R_LINEAR_____0_CM 0. 65535. DISPLAY_IDENTIFIER ID_ERR_DTC_ECRASPWM_FB FORMAT "%5.0"
 /begin AXIS_DESCR COM_AXIS errm_online_dummy _CNV_S_2_ERRM_DTC_R_483_CM 1 0. 1. AXIS_PTS_REF ldp_nr_1_id_err_dtc /end AXIS_DESCR
 /begin AXIS_DESCR COM_AXIS errm_online_dummy _CNV_S_6_ERRM_DTC_R_484_CM 6 0. 5. AXIS_PTS_REF ldp_nr_2_id_err_dtc /end AXIS_DESCR
/end CHARACTERISTIC
/begin CHARACTERISTIC fmy_id_ecras_el.dtc "DTC table declaration for the diagnosis instance XX" MAP 0xa1003f54 _REC_MAP_20_u2_u2_u2 65535. _CNV_A_R_LINEAR_____0_CM 0. 65535. DISPLAY_IDENTIFIER ID_ERR_DTC_ECRAS_EL FORMAT "%5.0"
 /begin AXIS_DESCR COM_AXIS errm_online_dummy _CNV_S_2_ERRM_DTC_R_483_CM 1 0. 1. AXIS_PTS_REF ldp_nr_1_id_err_dtc /end AXIS_DESCR
 /begin AXIS_DESCR COM_AXIS errm_online_dummy _CNV_S_6_ERRM_DTC_R_484_CM 6 0. 5. AXIS_PTS_REF ldp_nr_2_id_err_dtc /end AXIS_DESCR
/end CHARACTERISTIC
/begin CHARACTERISTIC fmy_id_warm_rst.dtc "DTC table declaration for the diagnosis instance XX" MAP 0xa1005110 _REC_MAP_20_u2_u2_u2 65535. _CNV_A_R_LINEAR_____0_CM 0. 65535. DISPLAY_IDENTIFIER ID_ERR_DTC_WARM_RST FORMAT "%5.0"
 /begin AXIS_DESCR COM_AXIS errm_online_dummy _CNV_S_2_ERRM_DTC_R_483_CM 1 0. 1. AXIS_PTS_REF ldp_nr_1_id_err_dtc /end AXIS_DESCR
 /begin AXIS_DESCR COM_AXIS errm_online_dummy _CNV_S_6_ERRM_DTC_R_484_CM 6 0. 5. AXIS_PTS_REF ldp_nr_2_id_err_dtc /end AXIS_DESCR
/end CHARACTERISTIC
/begin CHARACTERISTIC fmy_id_acr_ad.dtc "DTC table declaration for the diagnosis instance XX" MAP 0xa10038d8 _REC_MAP_20_u2_u2_u2 65535. _CNV_A_R_LINEAR_____0_CM 0. 65535. DISPLAY_IDENTIFIER ID_ERR_DTC_ACR_AD FORMAT "%5.0"
 /begin AXIS_DESCR COM_AXIS errm_online_dummy _CNV_S_2_ERRM_DTC_R_483_CM 1 0. 1. AXIS_PTS_REF ldp_nr_1_id_err_dtc /end AXIS_DESCR
 /begin AXIS_DESCR COM_AXIS errm_online_dummy _CNV_S_6_ERRM_DTC_R_484_CM 6 0. 5. AXIS_PTS_REF ldp_nr_2_id_err_dtc /end AXIS_DESCR
/end CHARACTERISTIC
/begin CHARACTERISTIC fmy_id_sens_acr.dtc "DTC table declaration for the diagnosis instance XX" MAP 0xa1004abc _REC_MAP_20_u2_u2_u2 65535. _CNV_A_R_LINEAR_____0_CM 0. 65535. DISPLAY_IDENTIFIER ID_ERR_DTC_SENS_ACR FORMAT "%5.0"
 /begin AXIS_DESCR COM_AXIS errm_online_dummy _CNV_S_2_ERRM_DTC_R_483_CM 1 0. 1. AXIS_PTS_REF ldp_nr_1_id_err_dtc /end AXIS_DESCR
 /begin AXIS_DESCR COM_AXIS errm_online_dummy _CNV_S_6_ERRM_DTC_R_484_CM 6 0. 5. AXIS_PTS_REF ldp_nr_2_id_err_dtc /end AXIS_DESCR
/end CHARACTERISTIC
/begin CHARACTERISTIC fmy_id_acr_ctl.dtc "DTC table declaration for the diagnosis instance XX" MAP 0xa10038ec _REC_MAP_20_u2_u2_u2 65535. _CNV_A_R_LINEAR_____0_CM 0. 65535. DISPLAY_IDENTIFIER ID_ERR_DTC_ACR_CTL FORMAT "%5.0"
 /begin AXIS_DESCR COM_AXIS errm_online_dummy _CNV_S_2_ERRM_DTC_R_483_CM 1 0. 1. AXIS_PTS_REF ldp_nr_1_id_err_dtc /end AXIS_DESCR
 /begin AXIS_DESCR COM_AXIS errm_online_dummy _CNV_S_6_ERRM_DTC_R_484_CM 6 0. 5. AXIS_PTS_REF ldp_nr_2_id_err_dtc /end AXIS_DESCR
/end CHARACTERISTIC
/begin CHARACTERISTIC fmy_id_acr_dr.dtc "DTC table declaration for the diagnosis instance XX" MAP 0xa1003900 _REC_MAP_20_u2_u2_u2 65535. _CNV_A_R_LINEAR_____0_CM 0. 65535. DISPLAY_IDENTIFIER ID_ERR_DTC_ACR_DR FORMAT "%5.0"
 /begin AXIS_DESCR COM_AXIS errm_online_dummy _CNV_S_2_ERRM_DTC_R_483_CM 1 0. 1. AXIS_PTS_REF ldp_nr_1_id_err_dtc /end AXIS_DESCR
 /begin AXIS_DESCR COM_AXIS errm_online_dummy _CNV_S_6_ERRM_DTC_R_484_CM 6 0. 5. AXIS_PTS_REF ldp_nr_2_id_err_dtc /end AXIS_DESCR
/end CHARACTERISTIC
/begin CHARACTERISTIC fmy_id_var_cod.dtc "DTC table declaration for the diagnosis instance XX" MAP 0xa1004ff8 _REC_MAP_20_u2_u2_u2 65535. _CNV_A_R_LINEAR_____0_CM 0. 65535. DISPLAY_IDENTIFIER ID_ERR_DTC_VAR_COD FORMAT "%5.0"
 /begin AXIS_DESCR COM_AXIS errm_online_dummy _CNV_S_2_ERRM_DTC_R_483_CM 1 0. 1. AXIS_PTS_REF ldp_nr_1_id_err_dtc /end AXIS_DESCR
 /begin AXIS_DESCR COM_AXIS errm_online_dummy _CNV_S_6_ERRM_DTC_R_484_CM 6 0. 5. AXIS_PTS_REF ldp_nr_2_id_err_dtc /end AXIS_DESCR
/end CHARACTERISTIC
/begin CHARACTERISTIC fmy_id_veh_pow_var.dtc "DTC table declaration for the diagnosis instance XX" MAP 0xa1005034 _REC_MAP_20_u2_u2_u2 65535. _CNV_A_R_LINEAR_____0_CM 0. 65535. DISPLAY_IDENTIFIER ID_ERR_DTC_VEH_POW_VAR FORMAT "%5.0"
 /begin AXIS_DESCR COM_AXIS errm_online_dummy _CNV_S_2_ERRM_DTC_R_483_CM 1 0. 1. AXIS_PTS_REF ldp_nr_1_id_err_dtc /end AXIS_DESCR
 /begin AXIS_DESCR COM_AXIS errm_online_dummy _CNV_S_6_ERRM_DTC_R_484_CM 6 0. 5. AXIS_PTS_REF ldp_nr_2_id_err_dtc /end AXIS_DESCR
/end CHARACTERISTIC
/begin CHARACTERISTIC fmy_id_fup_mfp_plaus.dtc "DTC table declaration for the diagnosis instance XX" MAP 0xa1004120 _REC_MAP_20_u2_u2_u2 65535. _CNV_A_R_LINEAR_____0_CM 0. 65535. DISPLAY_IDENTIFIER ID_ERR_DTC_FUP_MFP_PLAUS FORMAT "%5.0"
 /begin AXIS_DESCR COM_AXIS errm_online_dummy _CNV_S_2_ERRM_DTC_R_483_CM 1 0. 1. AXIS_PTS_REF ldp_nr_1_id_err_dtc /end AXIS_DESCR
 /begin AXIS_DESCR COM_AXIS errm_online_dummy _CNV_S_6_ERRM_DTC_R_484_CM 6 0. 5. AXIS_PTS_REF ldp_nr_2_id_err_dtc /end AXIS_DESCR
/end CHARACTERISTIC
/begin CHARACTERISTIC fmy_id_h_prs_sys.dtc "DTC table declaration for the diagnosis instance XX" MAP 0xa1004170 _REC_MAP_20_u2_u2_u2 65535. _CNV_A_R_LINEAR_____0_CM 0. 65535. DISPLAY_IDENTIFIER ID_ERR_DTC_H_PRS_SYS FORMAT "%5.0"
 /begin AXIS_DESCR COM_AXIS errm_online_dummy _CNV_S_2_ERRM_DTC_R_483_CM 1 0. 1. AXIS_PTS_REF ldp_nr_1_id_err_dtc /end AXIS_DESCR
 /begin AXIS_DESCR COM_AXIS errm_online_dummy _CNV_S_6_ERRM_DTC_R_484_CM 6 0. 5. AXIS_PTS_REF ldp_nr_2_id_err_dtc /end AXIS_DESCR
/end CHARACTERISTIC
/begin CHARACTERISTIC fmy_id_vcv_plaus.dtc "DTC table declaration for the diagnosis instance XX" MAP 0xa1005020 _REC_MAP_20_u2_u2_u2 65535. _CNV_A_R_LINEAR_____0_CM 0. 65535. DISPLAY_IDENTIFIER ID_ERR_DTC_VCV_PLAUS FORMAT "%5.0"
 /begin AXIS_DESCR COM_AXIS errm_online_dummy _CNV_S_2_ERRM_DTC_R_483_CM 1 0. 1. AXIS_PTS_REF ldp_nr_1_id_err_dtc /end AXIS_DESCR
 /begin AXIS_DESCR COM_AXIS errm_online_dummy _CNV_S_6_ERRM_DTC_R_484_CM 6 0. 5. AXIS_PTS_REF ldp_nr_2_id_err_dtc /end AXIS_DESCR
/end CHARACTERISTIC
/begin CHARACTERISTIC fmy_id_fup.dtc "DTC table declaration for the diagnosis instance XX" MAP 0xa10040f8 _REC_MAP_20_u2_u2_u2 65535. _CNV_A_R_LINEAR_____0_CM 0. 65535. DISPLAY_IDENTIFIER ID_ERR_DTC_FUP FORMAT "%5.0"
 /begin AXIS_DESCR COM_AXIS errm_online_dummy _CNV_S_2_ERRM_DTC_R_483_CM 1 0. 1. AXIS_PTS_REF ldp_nr_1_id_err_dtc /end AXIS_DESCR
 /begin AXIS_DESCR COM_AXIS errm_online_dummy _CNV_S_6_ERRM_DTC_R_484_CM 6 0. 5. AXIS_PTS_REF ldp_nr_2_id_err_dtc /end AXIS_DESCR
/end CHARACTERISTIC
/begin CHARACTERISTIC fmy_id_vcv.dtc "DTC table declaration for the diagnosis instance XX" MAP 0xa100500c _REC_MAP_20_u2_u2_u2 65535. _CNV_A_R_LINEAR_____0_CM 0. 65535. DISPLAY_IDENTIFIER ID_ERR_DTC_VCV FORMAT "%5.0"
 /begin AXIS_DESCR COM_AXIS errm_online_dummy _CNV_S_2_ERRM_DTC_R_483_CM 1 0. 1. AXIS_PTS_REF ldp_nr_1_id_err_dtc /end AXIS_DESCR
 /begin AXIS_DESCR COM_AXIS errm_online_dummy _CNV_S_6_ERRM_DTC_R_484_CM 6 0. 5. AXIS_PTS_REF ldp_nr_2_id_err_dtc /end AXIS_DESCR
/end CHARACTERISTIC
/begin CHARACTERISTIC fmy_id_fup_efp.dtc "DTC table declaration for the diagnosis instance XX" MAP 0xa100410c _REC_MAP_20_u2_u2_u2 65535. _CNV_A_R_LINEAR_____0_CM 0. 65535. DISPLAY_IDENTIFIER ID_ERR_DTC_FUP_EFP FORMAT "%5.0"
 /begin AXIS_DESCR COM_AXIS errm_online_dummy _CNV_S_2_ERRM_DTC_R_483_CM 1 0. 1. AXIS_PTS_REF ldp_nr_1_id_err_dtc /end AXIS_DESCR
 /begin AXIS_DESCR COM_AXIS errm_online_dummy _CNV_S_6_ERRM_DTC_R_484_CM 6 0. 5. AXIS_PTS_REF ldp_nr_2_id_err_dtc /end AXIS_DESCR
/end CHARACTERISTIC
/begin CHARACTERISTIC fmy_id_efppwm_plaus.dtc "DTC table declaration for the diagnosis instance XX" MAP 0xa1004008 _REC_MAP_20_u2_u2_u2 65535. _CNV_A_R_LINEAR_____0_CM 0. 65535. DISPLAY_IDENTIFIER ID_ERR_DTC_EFPPWM_PLAUS FORMAT "%5.0"
 /begin AXIS_DESCR COM_AXIS errm_online_dummy _CNV_S_2_ERRM_DTC_R_483_CM 1 0. 1. AXIS_PTS_REF ldp_nr_1_id_err_dtc /end AXIS_DESCR
 /begin AXIS_DESCR COM_AXIS errm_online_dummy _CNV_S_6_ERRM_DTC_R_484_CM 6 0. 5. AXIS_PTS_REF ldp_nr_2_id_err_dtc /end AXIS_DESCR
/end CHARACTERISTIC
/begin CHARACTERISTIC fmy_id_l_prs_sys.dtc "DTC table declaration for the diagnosis instance XX" MAP 0xa1004404 _REC_MAP_20_u2_u2_u2 65535. _CNV_A_R_LINEAR_____0_CM 0. 65535. DISPLAY_IDENTIFIER ID_ERR_DTC_L_PRS_SYS FORMAT "%5.0"
 /begin AXIS_DESCR COM_AXIS errm_online_dummy _CNV_S_2_ERRM_DTC_R_483_CM 1 0. 1. AXIS_PTS_REF ldp_nr_1_id_err_dtc /end AXIS_DESCR
 /begin AXIS_DESCR COM_AXIS errm_online_dummy _CNV_S_6_ERRM_DTC_R_484_CM 6 0. 5. AXIS_PTS_REF ldp_nr_2_id_err_dtc /end AXIS_DESCR
/end CHARACTERISTIC
/begin CHARACTERISTIC fmy_id_conv_mon_1.dtc "DTC table declaration for the diagnosis instance XX" MAP 0xa1003d24 _REC_MAP_20_u2_u2_u2 65535. _CNV_A_R_LINEAR_____0_CM 0. 65535. DISPLAY_IDENTIFIER ID_ERR_DTC_CONV_MON_1 FORMAT "%5.0"
 /begin AXIS_DESCR COM_AXIS errm_online_dummy _CNV_S_2_ERRM_DTC_R_483_CM 1 0. 1. AXIS_PTS_REF ldp_nr_1_id_err_dtc /end AXIS_DESCR
 /begin AXIS_DESCR COM_AXIS errm_online_dummy _CNV_S_6_ERRM_DTC_R_484_CM 6 0. 5. AXIS_PTS_REF ldp_nr_2_id_err_dtc /end AXIS_DESCR
/end CHARACTERISTIC
/begin CHARACTERISTIC fmy_id_n_32_mon_1.dtc "DTC table declaration for the diagnosis instance XX" MAP 0xa10046ac _REC_MAP_20_u2_u2_u2 65535. _CNV_A_R_LINEAR_____0_CM 0. 65535. DISPLAY_IDENTIFIER ID_ERR_DTC_N_32_MON_1 FORMAT "%5.0"
 /begin AXIS_DESCR COM_AXIS errm_online_dummy _CNV_S_2_ERRM_DTC_R_483_CM 1 0. 1. AXIS_PTS_REF ldp_nr_1_id_err_dtc /end AXIS_DESCR
 /begin AXIS_DESCR COM_AXIS errm_online_dummy _CNV_S_6_ERRM_DTC_R_484_CM 6 0. 5. AXIS_PTS_REF ldp_nr_2_id_err_dtc /end AXIS_DESCR
/end CHARACTERISTIC
/begin CHARACTERISTIC fmy_id_pvs_mon_1.dtc "DTC table declaration for the diagnosis instance XX" MAP 0xa1004918 _REC_MAP_20_u2_u2_u2 65535. _CNV_A_R_LINEAR_____0_CM 0. 65535. DISPLAY_IDENTIFIER ID_ERR_DTC_PVS_MON_1 FORMAT "%5.0"
 /begin AXIS_DESCR COM_AXIS errm_online_dummy _CNV_S_2_ERRM_DTC_R_483_CM 1 0. 1. AXIS_PTS_REF ldp_nr_1_id_err_dtc /end AXIS_DESCR
 /begin AXIS_DESCR COM_AXIS errm_online_dummy _CNV_S_6_ERRM_DTC_R_484_CM 6 0. 5. AXIS_PTS_REF ldp_nr_2_id_err_dtc /end AXIS_DESCR
/end CHARACTERISTIC
/begin CHARACTERISTIC fmy_id_tq_dif_isc_mon_1.dtc "DTC table declaration for the diagnosis instance XX" MAP 0xa1004f44 _REC_MAP_20_u2_u2_u2 65535. _CNV_A_R_LINEAR_____0_CM 0. 65535. DISPLAY_IDENTIFIER ID_ERR_DTC_TQ_DIF_ISC_MON_1 FORMAT "%5.0"
 /begin AXIS_DESCR COM_AXIS errm_online_dummy _CNV_S_2_ERRM_DTC_R_483_CM 1 0. 1. AXIS_PTS_REF ldp_nr_1_id_err_dtc /end AXIS_DESCR
 /begin AXIS_DESCR COM_AXIS errm_online_dummy _CNV_S_6_ERRM_DTC_R_484_CM 6 0. 5. AXIS_PTS_REF ldp_nr_2_id_err_dtc /end AXIS_DESCR
/end CHARACTERISTIC
/begin CHARACTERISTIC fmy_id_tq_req_mon_1.dtc "DTC table declaration for the diagnosis instance XX" MAP 0xa1004f80 _REC_MAP_20_u2_u2_u2 65535. _CNV_A_R_LINEAR_____0_CM 0. 65535. DISPLAY_IDENTIFIER ID_ERR_DTC_TQ_REQ_MON_1 FORMAT "%5.0"
 /begin AXIS_DESCR COM_AXIS errm_online_dummy _CNV_S_2_ERRM_DTC_R_483_CM 1 0. 1. AXIS_PTS_REF ldp_nr_1_id_err_dtc /end AXIS_DESCR
 /begin AXIS_DESCR COM_AXIS errm_online_dummy _CNV_S_6_ERRM_DTC_R_484_CM 6 0. 5. AXIS_PTS_REF ldp_nr_2_id_err_dtc /end AXIS_DESCR
/end CHARACTERISTIC
/begin CHARACTERISTIC fmy_id_tq_ext_mon_1.dtc "DTC table declaration for the diagnosis instance XX" MAP 0xa1004f58 _REC_MAP_20_u2_u2_u2 65535. _CNV_A_R_LINEAR_____0_CM 0. 65535. DISPLAY_IDENTIFIER ID_ERR_DTC_TQ_EXT_MON_1 FORMAT "%5.0"
 /begin AXIS_DESCR COM_AXIS errm_online_dummy _CNV_S_2_ERRM_DTC_R_483_CM 1 0. 1. AXIS_PTS_REF ldp_nr_1_id_err_dtc /end AXIS_DESCR
 /begin AXIS_DESCR COM_AXIS errm_online_dummy _CNV_S_6_ERRM_DTC_R_484_CM 6 0. 5. AXIS_PTS_REF ldp_nr_2_id_err_dtc /end AXIS_DESCR
/end CHARACTERISTIC
/begin CHARACTERISTIC fmy_id_tqi_av_mon_1.dtc "DTC table declaration for the diagnosis instance XX" MAP 0xa1004f94 _REC_MAP_20_u2_u2_u2 65535. _CNV_A_R_LINEAR_____0_CM 0. 65535. DISPLAY_IDENTIFIER ID_ERR_DTC_TQI_AV_MON_1 FORMAT "%5.0"
 /begin AXIS_DESCR COM_AXIS errm_online_dummy _CNV_S_2_ERRM_DTC_R_483_CM 1 0. 1. AXIS_PTS_REF ldp_nr_1_id_err_dtc /end AXIS_DESCR
 /begin AXIS_DESCR COM_AXIS errm_online_dummy _CNV_S_6_ERRM_DTC_R_484_CM 6 0. 5. AXIS_PTS_REF ldp_nr_2_id_err_dtc /end AXIS_DESCR
/end CHARACTERISTIC
/begin CHARACTERISTIC fmy_id_tqi_n_max_mon_1.dtc "DTC table declaration for the diagnosis instance XX" MAP 0xa1004fbc _REC_MAP_20_u2_u2_u2 65535. _CNV_A_R_LINEAR_____0_CM 0. 65535. DISPLAY_IDENTIFIER ID_ERR_DTC_TQI_N_MAX_MON_1 FORMAT "%5.0"
 /begin AXIS_DESCR COM_AXIS errm_online_dummy _CNV_S_2_ERRM_DTC_R_483_CM 1 0. 1. AXIS_PTS_REF ldp_nr_1_id_err_dtc /end AXIS_DESCR
 /begin AXIS_DESCR COM_AXIS errm_online_dummy _CNV_S_6_ERRM_DTC_R_484_CM 6 0. 5. AXIS_PTS_REF ldp_nr_2_id_err_dtc /end AXIS_DESCR
/end CHARACTERISTIC
/begin CHARACTERISTIC fmy_id_mff_mon_1.dtc "DTC table declaration for the diagnosis instance XX" MAP 0xa100456c _REC_MAP_20_u2_u2_u2 65535. _CNV_A_R_LINEAR_____0_CM 0. 65535. DISPLAY_IDENTIFIER ID_ERR_DTC_MFF_MON_1 FORMAT "%5.0"
 /begin AXIS_DESCR COM_AXIS errm_online_dummy _CNV_S_2_ERRM_DTC_R_483_CM 1 0. 1. AXIS_PTS_REF ldp_nr_1_id_err_dtc /end AXIS_DESCR
 /begin AXIS_DESCR COM_AXIS errm_online_dummy _CNV_S_6_ERRM_DTC_R_484_CM 6 0. 5. AXIS_PTS_REF ldp_nr_2_id_err_dtc /end AXIS_DESCR
/end CHARACTERISTIC
/begin CHARACTERISTIC fmy_id_cru_mon_1.dtc "DTC table declaration for the diagnosis instance XX" MAP 0xa1003d9c _REC_MAP_20_u2_u2_u2 65535. _CNV_A_R_LINEAR_____0_CM 0. 65535. DISPLAY_IDENTIFIER ID_ERR_DTC_CRU_MON_1 FORMAT "%5.0"
 /begin AXIS_DESCR COM_AXIS errm_online_dummy _CNV_S_2_ERRM_DTC_R_483_CM 1 0. 1. AXIS_PTS_REF ldp_nr_1_id_err_dtc /end AXIS_DESCR
 /begin AXIS_DESCR COM_AXIS errm_online_dummy _CNV_S_6_ERRM_DTC_R_484_CM 6 0. 5. AXIS_PTS_REF ldp_nr_2_id_err_dtc /end AXIS_DESCR
/end CHARACTERISTIC
/begin MEASUREMENT fmy_ram_dyn[0].err_dtc "DTC code stored in memory for failure IDX" UWORD _CNV_A_R_LINEAR_____0_CM 1 100. 0. 65535. DISPLAY_IDENTIFIER ERR_DTC[0] ECU_ADDRESS 0xd0004100 FORMAT "%5.0" /end MEASUREMENT
/begin MEASUREMENT fmy_ram_dyn[0].err_info_dyn.err_sym_lst "Memorized the last detected symptom of the failure IDX (for the DTC building)" UWORD _CNV_S_16_RANGE_ERR__488_CM 1 100. 0. 15. DISPLAY_IDENTIFIER ERR_SYM_LST[0] ECU_ADDRESS 0xd0004104 BIT_MASK 0xF /end MEASUREMENT
/begin MEASUREMENT fmy_ram_dyn[0].err_info_dyn.err_sym_mem "Memorized detected symptom of the failure IDX (for the DTC building)" UWORD _CNV_S_16_RANGE_ERR__488_CM 1 100. 0. 15. DISPLAY_IDENTIFIER ERR_SYM_MEM[0] ECU_ADDRESS 0xd0004104 BIT_MASK 0xF000 /end MEASUREMENT
/begin MEASUREMENT fmy_ram_dyn[1].err_dtc "DTC code stored in memory for failure IDX" UWORD _CNV_A_R_LINEAR_____0_CM 1 100. 0. 65535. DISPLAY_IDENTIFIER ERR_DTC[1] ECU_ADDRESS 0xd000410e FORMAT "%5.0" /end MEASUREMENT
/begin MEASUREMENT fmy_ram_dyn[1].err_info_dyn.err_sym_lst "Memorized the last detected symptom of the failure IDX (for the DTC building)" UWORD _CNV_S_16_RANGE_ERR__488_CM 1 100. 0. 15. DISPLAY_IDENTIFIER ERR_SYM_LST[1] ECU_ADDRESS 0xd0004112 BIT_MASK 0xF /end MEASUREMENT
/begin MEASUREMENT fmy_ram_dyn[1].err_info_dyn.err_sym_mem "Memorized detected symptom of the failure IDX (for the DTC building)" UWORD _CNV_S_16_RANGE_ERR__488_CM 1 100. 0. 15. DISPLAY_IDENTIFIER ERR_SYM_MEM[1] ECU_ADDRESS 0xd0004112 BIT_MASK 0xF000 /end MEASUREMENT
/begin MEASUREMENT fmy_ram_dyn[2].err_dtc "DTC code stored in memory for failure IDX" UWORD _CNV_A_R_LINEAR_____0_CM 1 100. 0. 65535. DISPLAY_IDENTIFIER ERR_DTC[2] ECU_ADDRESS 0xd000411c FORMAT "%5.0" /end MEASUREMENT
/begin MEASUREMENT fmy_ram_dyn[2].err_info_dyn.err_sym_lst "Memorized the last detected symptom of the failure IDX (for the DTC building)" UWORD _CNV_S_16_RANGE_ERR__488_CM 1 100. 0. 15. DISPLAY_IDENTIFIER ERR_SYM_LST[2] ECU_ADDRESS 0xd0004120 BIT_MASK 0xF /end MEASUREMENT
/begin MEASUREMENT fmy_ram_dyn[2].err_info_dyn.err_sym_mem "Memorized detected symptom of the failure IDX (for the DTC building)" UWORD _CNV_S_16_RANGE_ERR__488_CM 1 100. 0. 15. DISPLAY_IDENTIFIER ERR_SYM_MEM[2] ECU_ADDRESS 0xd0004120 BIT_MASK 0xF000 /end MEASUREMENT
/begin MEASUREMENT fmy_ram_dyn[3].err_dtc "DTC code stored in memory for failure IDX" UWORD _CNV_A_R_LINEAR_____0_CM 1 100. 0. 65535. DISPLAY_IDENTIFIER ERR_DTC[3] ECU_ADDRESS 0xd000412a FORMAT "%5.0" /end MEASUREMENT
/begin MEASUREMENT fmy_ram_dyn[3].err_info_dyn.err_sym_lst "Memorized the last detected symptom of the failure IDX (for the DTC building)" UWORD _CNV_S_16_RANGE_ERR__488_CM 1 100. 0. 15. DISPLAY_IDENTIFIER ERR_SYM_LST[3] ECU_ADDRESS 0xd000412e BIT_MASK 0xF /end MEASUREMENT
/begin MEASUREMENT fmy_ram_dyn[3].err_info_dyn.err_sym_mem "Memorized detected symptom of the failure IDX (for the DTC building)" UWORD _CNV_S_16_RANGE_ERR__488_CM 1 100. 0. 15. DISPLAY_IDENTIFIER ERR_SYM_MEM[3] ECU_ADDRESS 0xd000412e BIT_MASK 0xF000 /end MEASUREMENT
/begin MEASUREMENT fmy_ram_dyn[4].err_dtc "DTC code stored in memory for failure IDX" UWORD _CNV_A_R_LINEAR_____0_CM 1 100. 0. 65535. DISPLAY_IDENTIFIER ERR_DTC[4] ECU_ADDRESS 0xd0004138 FORMAT "%5.0" /end MEASUREMENT
/begin MEASUREMENT fmy_ram_dyn[4].err_info_dyn.err_sym_lst "Memorized the last detected symptom of the failure IDX (for the DTC building)" UWORD _CNV_S_16_RANGE_ERR__488_CM 1 100. 0. 15. DISPLAY_IDENTIFIER ERR_SYM_LST[4] ECU_ADDRESS 0xd000413c BIT_MASK 0xF /end MEASUREMENT
/begin MEASUREMENT fmy_ram_dyn[4].err_info_dyn.err_sym_mem "Memorized detected symptom of the failure IDX (for the DTC building)" UWORD _CNV_S_16_RANGE_ERR__488_CM 1 100. 0. 15. DISPLAY_IDENTIFIER ERR_SYM_MEM[4] ECU_ADDRESS 0xd000413c BIT_MASK 0xF000 /end MEASUREMENT
/begin MEASUREMENT fmy_ram_dyn[5].err_dtc "DTC code stored in memory for failure IDX" UWORD _CNV_A_R_LINEAR_____0_CM 1 100. 0. 65535. DISPLAY_IDENTIFIER ERR_DTC[5] ECU_ADDRESS 0xd0004146 FORMAT "%5.0" /end MEASUREMENT
/begin MEASUREMENT fmy_ram_dyn[5].err_info_dyn.err_sym_lst "Memorized the last detected symptom of the failure IDX (for the DTC building)" UWORD _CNV_S_16_RANGE_ERR__488_CM 1 100. 0. 15. DISPLAY_IDENTIFIER ERR_SYM_LST[5] ECU_ADDRESS 0xd000414a BIT_MASK 0xF /end MEASUREMENT
/begin MEASUREMENT fmy_ram_dyn[5].err_info_dyn.err_sym_mem "Memorized detected symptom of the failure IDX (for the DTC building)" UWORD _CNV_S_16_RANGE_ERR__488_CM 1 100. 0. 15. DISPLAY_IDENTIFIER ERR_SYM_MEM[5] ECU_ADDRESS 0xd000414a BIT_MASK 0xF000 /end MEASUREMENT
/begin MEASUREMENT fmy_ram_dyn[6].err_dtc "DTC code stored in memory for failure IDX" UWORD _CNV_A_R_LINEAR_____0_CM 1 100. 0. 65535. DISPLAY_IDENTIFIER ERR_DTC[6] ECU_ADDRESS 0xd0004154 FORMAT "%5.0" /end MEASUREMENT
/begin MEASUREMENT fmy_ram_dyn[6].err_info_dyn.err_sym_lst "Memorized the last detected symptom of the failure IDX (for the DTC building)" UWORD _CNV_S_16_RANGE_ERR__488_CM 1 100. 0. 15. DISPLAY_IDENTIFIER ERR_SYM_LST[6] ECU_ADDRESS 0xd0004158 BIT_MASK 0xF /end MEASUREMENT
/begin MEASUREMENT fmy_ram_dyn[6].err_info_dyn.err_sym_mem "Memorized detected symptom of the failure IDX (for the DTC building)" UWORD _CNV_S_16_RANGE_ERR__488_CM 1 100. 0. 15. DISPLAY_IDENTIFIER ERR_SYM_MEM[6] ECU_ADDRESS 0xd0004158 BIT_MASK 0xF000 /end MEASUREMENT
/begin MEASUREMENT fmy_ram_dyn[7].err_dtc "DTC code stored in memory for failure IDX" UWORD _CNV_A_R_LINEAR_____0_CM 1 100. 0. 65535. DISPLAY_IDENTIFIER ERR_DTC[7] ECU_ADDRESS 0xd0004162 FORMAT "%5.0" /end MEASUREMENT
/begin MEASUREMENT fmy_ram_dyn[7].err_info_dyn.err_sym_lst "Memorized the last detected symptom of the failure IDX (for the DTC building)" UWORD _CNV_S_16_RANGE_ERR__488_CM 1 100. 0. 15. DISPLAY_IDENTIFIER ERR_SYM_LST[7] ECU_ADDRESS 0xd0004166 BIT_MASK 0xF /end MEASUREMENT
/begin MEASUREMENT fmy_ram_dyn[7].err_info_dyn.err_sym_mem "Memorized detected symptom of the failure IDX (for the DTC building)" UWORD _CNV_S_16_RANGE_ERR__488_CM 1 100. 0. 15. DISPLAY_IDENTIFIER ERR_SYM_MEM[7] ECU_ADDRESS 0xd0004166 BIT_MASK 0xF000 /end MEASUREMENT
/begin MEASUREMENT fmy_ram_dyn[8].err_dtc "DTC code stored in memory for failure IDX" UWORD _CNV_A_R_LINEAR_____0_CM 1 100. 0. 65535. DISPLAY_IDENTIFIER ERR_DTC[8] ECU_ADDRESS 0xd0004170 FORMAT "%5.0" /end MEASUREMENT
/begin MEASUREMENT fmy_ram_dyn[8].err_info_dyn.err_sym_lst "Memorized the last detected symptom of the failure IDX (for the DTC building)" UWORD _CNV_S_16_RANGE_ERR__488_CM 1 100. 0. 15. DISPLAY_IDENTIFIER ERR_SYM_LST[8] ECU_ADDRESS 0xd0004174 BIT_MASK 0xF /end MEASUREMENT
/begin MEASUREMENT fmy_ram_dyn[8].err_info_dyn.err_sym_mem "Memorized detected symptom of the failure IDX (for the DTC building)" UWORD _CNV_S_16_RANGE_ERR__488_CM 1 100. 0. 15. DISPLAY_IDENTIFIER ERR_SYM_MEM[8] ECU_ADDRESS 0xd0004174 BIT_MASK 0xF000 /end MEASUREMENT
/begin MEASUREMENT fmy_ram_dyn[9].err_dtc "DTC code stored in memory for failure IDX" UWORD _CNV_A_R_LINEAR_____0_CM 1 100. 0. 65535. DISPLAY_IDENTIFIER ERR_DTC[9] ECU_ADDRESS 0xd000417e FORMAT "%5.0" /end MEASUREMENT
/begin MEASUREMENT fmy_ram_dyn[9].err_info_dyn.err_sym_lst "Memorized the last detected symptom of the failure IDX (for the DTC building)" UWORD _CNV_S_16_RANGE_ERR__488_CM 1 100. 0. 15. DISPLAY_IDENTIFIER ERR_SYM_LST[9] ECU_ADDRESS 0xd0004182 BIT_MASK 0xF /end MEASUREMENT
/begin MEASUREMENT fmy_ram_dyn[9].err_info_dyn.err_sym_mem "Memorized detected symptom of the failure IDX (for the DTC building)" UWORD _CNV_S_16_RANGE_ERR__488_CM 1 100. 0. 15. DISPLAY_IDENTIFIER ERR_SYM_MEM[9] ECU_ADDRESS 0xd0004182 BIT_MASK 0xF000 /end MEASUREMENT
/begin MEASUREMENT errm_online_dummy "" UWORD _CNV_A_R_LINEAR_____0_CM 1 100. 0. 65535. DISPLAY_IDENTIFIER DUMMY ECU_ADDRESS 0xd0004a28 FORMAT "%5.0" /end MEASUREMENT
/begin AXIS_PTS ldp_nr_1_id_err_dtc "" 0xa100389a errm_online_dummy _REC_AXS_20_u2 1. _CNV_S_2_ERRM_DTC_R_483_CM 1 0. 1. /end AXIS_PTS
/begin AXIS_PTS ldp_nr_2_id_err_dtc "" 0xa10038a0 errm_online_dummy _REC_AXS_20_u2 5. _CNV_S_6_ERRM_DTC_R_484_CM 6 0. 5. /end AXIS_PTS
/begin COMPU_METHOD _CNV_A_R_LINEAR_____0_CM "" RAT_FUNC "%6.3" "-" COEFFS 0 1. 0. 0 0 1 /end COMPU_METHOD
/begin COMPU_METHOD _CNV_S_2_ERRM_DTC_R_483_CM "" TAB_VERB "%6.3" "-" COMPU_TAB_REF _CNV_S_2_ERRM_DTC_R_483 /end COMPU_METHOD
/begin COMPU_VTAB _CNV_S_2_ERRM_DTC_R_483 "" TAB_VERB 2 0 "OBD" 1 "CUS" /end COMPU_VTAB
/begin COMPU_METHOD _CNV_S_6_ERRM_DTC_R_484_CM "" TAB_VERB "%6.3" "-" COMPU_TAB_REF _CNV_S_6_ERRM_DTC_R_484 /end COMPU_METHOD
/begin COMPU_VTAB _CNV_S_6_ERRM_DTC_R_484 "" TAB_VERB 6 0 "SYM0" 1 "SYM1" 2 "SYM2" 3 "SYM3" 4 "GLOBAL" 5 "DTC" /end COMPU_VTAB
/begin COMPU_METHOD _CNV_S_16_RANGE_ERR__488_CM "" TAB_VERB "%6.3" "" COMPU_TAB_REF _CNV_S_16_RANGE_ERR__488 /end COMPU_METHOD
/begin COMPU_VTAB _CNV_S_16_RANGE_ERR__488 "" TAB_VERB 16 0 "NO_SYM" 1 "SYM_0" 2 "SYM_1" 3 "SYM_0, SYM_1" 4 "SYM_2" 5 "SYM_0, SYM_2" 6 "SYM_1, SYM_2" 7 "SYM_0, SYM_1, SYM_2" 8 "SYM_3" 9 "SYM_0, SYM_3" 10 "SYM_1, SYM_3" 11 "SYM_0, SYM_1,SYM_3" 12 "SYM_2, SYM_3" 13 "SYM_0, SYM_2, SYM_3" 14 "SYM_1, SYM_2, SYM_3" 15 "SYM_0, SYM_1, SYM_2, SYM_3" /end COMPU_VTAB
/begin RECORD_LAYOUT _REC_AXS_20_u2 NO_AXIS_PTS_X 1 UWORD AXIS_PTS_X 2 UWORD INDEX_INCR DIRECT /end RECORD_LAYOUT
/begin RECORD_LAYOUT _REC_MAP_20_u2_u2_u2 FNC_VALUES 1 UWORD COLUMN_DIR DIRECT /end RECORD_LAYOUT
/begin FUNCTION ERRM_Diagnosis_Trouble_Code_Mngt "Diagnosis_Trouble_Code_Mngt"
 /begin DEF_CHARACTERISTIC fmy_id_imob_1.dtc fmy_id_imob_2.dtc fmy_id_imob_3.dtc fmy_id_tco_el.dtc fmy_id_tco_grd.dtc fmy_id_tco_stuck.dtc fmy_id_tco_plaus.dtc fmy_id_tco_2_el.dtc fmy_id_tco_2_grd.dtc fmy_id_tco_2_plaus.dtc fmy_id_ect_el.dtc fmy_id_ecf_el_1.dtc fmy_id_ecfpwm_fb_1.dtc fmy_id_th.dtc fmy_id_ftl_min.dtc fmy_id_tia_el.dtc fmy_id_amp.dtc fmy_id_amp_plaus.dtc fmy_id_maf.dtc fmy_id_iv_0.dtc fmy_id_iv_1.dtc fmy_id_iv_2.dtc fmy_id_iv_3.dtc fmy_id_iv_4.dtc fmy_id_iv_5.dtc fmy_id_rly_efp.dtc fmy_id_el_cps.dtc fmy_id_slv_ivvt_in.dtc fmy_id_slv_ivvt_ex.dtc fmy_id_ecu_cks.dtc fmy_id_tout_etcu_1.dtc fmy_id_tout_etcu_2.dtc fmy_id_tout_icl_2.dtc fmy_id_tout_icl_3.dtc fmy_id_tout_asr_1.dtc fmy_id_tout_asr_3.dtc fmy_id_tout_asr_4.dtc fmy_id_tout_pste_1.dtc fmy_id_tout_amt_1.dtc fmy_id_vs.dtc fmy_id_knks_1.dtc fmy_id_knks_2.dtc fmy_id_igc_scp_0.dtc fmy_id_igc_scp_1.dtc fmy_id_igc_scp_2.dtc fmy_id_igc_scp_3.dtc fmy_id_igc_scp_4.dtc fmy_id_igc_scp_5.dtc fmy_id_igc_scg_0.dtc fmy_id_igc_scg_1.dtc fmy_id_igc_scg_2.dtc fmy_id_igc_scg_3.dtc fmy_id_igc_scg_4.dtc fmy_id_igc_scg_5.dtc fmy_id_igc_ol_0.dtc fmy_id_igc_ol_1.dtc fmy_id_igc_ol_2.dtc fmy_id_igc_ol_3.dtc fmy_id_igc_ol_4.dtc fmy_id_igc_ol_5.dtc fmy_id_tps_1.dtc fmy_id_tps_2.dtc fmy_id_tps_maf_1.dtc fmy_id_tps_maf_2.dtc fmy_id_tps_ratio.dtc fmy_id_v_ref_1.dtc fmy_id_v_ref_2.dtc fmy_id_pvs_1.dtc fmy_id_pvs_2.dtc fmy_id_pvs_ratio.dtc fmy_id_pvs_double.dtc fmy_id_pvs_bls_not_plaus.dtc fmy_id_mtc_dr.dtc fmy_id_mtc_ctl_1.dtc fmy_id_mtc_ctl_2.dtc fmy_id_mtc_ctl_3.dtc fmy_id_tps_ad.dtc fmy_id_tps_ad_bol.dtc fmy_id_tps_st_chk_1.dtc fmy_id_tps_st_chk_2.dtc fmy_id_gen.dtc fmy_id_gen_diag.dtc fmy_id_alter_bn.dtc fmy_id_alter_bn_bat.dtc fmy_id_vim_1_el.dtc fmy_id_vim_2_el.dtc fmy_id_vimpwm_1_fb.dtc fmy_id_vimpwm_2_fb.dtc fmy_id_t_es.dtc fmy_id_map_dip_plaus.dtc fmy_id_toil_level.dtc fmy_id_vim_plaus.dtc fmy_id_alter_bn_rgn.dtc fmy_id_per_cam_in_1.dtc fmy_id_per_cam_ex_1.dtc fmy_id_syn_cam_in_1.dtc fmy_id_syn_cam_ex_1.dtc fmy_id_ref_crk_cam_in_1.dtc fmy_id_ref_crk_cam_ex_1.dtc fmy_id_crk_tooth.dtc fmy_id_crk_tooth_per.dtc fmy_id_crk_syn.dtc fmy_id_crk_plaus.dtc fmy_id_plaus_cam_in_1.dtc fmy_id_plaus_cam_ex_1.dtc fmy_id_syn_crk_cam_in_1.dtc fmy_id_syn_crk_cam_ex_1.dtc fmy_id_can_boff_B.dtc fmy_id_can_boff_C.dtc fmy_id_rly_main.dtc fmy_id_rly_main_dly.dtc fmy_id_rly_accout.dtc fmy_id_isc.dtc fmy_id_im_bls_plaus.dtc fmy_id_im_bts_plaus.dtc fmy_id_msw_tog.dtc fmy_id_msw_2.dtc fmy_id_msw_3.dtc fmy_id_mis_0.dtc fmy_id_mis_1.dtc fmy_id_mis_2.dtc fmy_id_mis_3.dtc fmy_id_mis_4.dtc fmy_id_mis_5.dtc fmy_id_mis_mpl.dtc fmy_id_mis_ftl_l.dtc fmy_id_fsd_1.dtc fmy_id_fsd_2.dtc fmy_id_ef.dtc fmy_id_tecu.dtc fmy_id_ebox_cfa.dtc fmy_id_ecu_ram.dtc fmy_id_tqi_lim.dtc fmy_id_obd2_lsh_down_1.dtc fmy_id_obd2_lsh_down_2.dtc fmy_id_dmtls.dtc fmy_id_dmtl_pump.dtc fmy_id_dmtlm.dtc fmy_id_rough_leak.dtc fmy_id_small_leak.dtc fmy_id_chk_fuc.dtc fmy_id_sof.dtc fmy_id_sof_req.dtc fmy_id_rly_crcv_heat.dtc fmy_id_rly_st.dtc fmy_id_bsd.dtc fmy_id_poil_swi.dtc fmy_id_tout_efp_can.dtc fmy_id_diagcps.dtc fmy_id_dcc.dtc fmy_id_ldm.dtc fmy_id_dmtlh.dtc fmy_id_cs.dtc fmy_id_spi_mps.dtc fmy_id_spi_knk.dtc fmy_id_bn_tq_dcc.dtc fmy_id_bn_tq_pste_2.dtc fmy_id_bn_ars.dtc fmy_id_bn_cas.dtc fmy_id_bn_tq_tcs.dtc fmy_id_bn_vs_tcs.dtc fmy_id_bn_tcs.dtc fmy_id_bn_tq_etcu.dtc fmy_id_bn_etcu.dtc fmy_id_bn_etcu_2.dtc fmy_id_bn_etcu_disp.dtc fmy_id_bn_tq_amt.dtc fmy_id_bn_acc.dtc fmy_id_bn_t_icl.dtc fmy_id_bn_veh_mod.dtc fmy_id_bn_km_icl.dtc fmy_id_bn_icl.dtc fmy_id_bn_pow_vb.dtc fmy_id_bn_pow_gen.dtc fmy_id_bn_msw.dtc fmy_id_bn_ang_pste.dtc fmy_id_bn_gear_rev.dtc fmy_id_bn_ltg_hdlp_l.dtc fmy_id_bn_ldm.dtc fmy_id_bn_trl.dtc fmy_id_bn_hiv.dtc fmy_id_bn_t_clk.dtc fmy_id_bn_efp_crash.dtc fmy_id_bn_efp.dtc fmy_id_load_tps_plaus.dtc fmy_id_egy_min.dtc fmy_id_efp_crash.dtc fmy_id_efp.dtc fmy_id_locan_boff.dtc fmy_id_cwp_plaus.dtc fmy_id_cwp_int_off.dtc fmy_id_cwp_pwr.dtc fmy_id_cwp_com_plaus.dtc fmy_id_qoil_sens.dtc fmy_id_bat_sens.dtc fmy_id_bat_sens_it.dtc fmy_id_bat_sens_it_el.dtc fmy_id_ecu_nvmy.dtc fmy_id_gs.dtc fmy_id_plaus_igk_bn.dtc fmy_id_tq_req_can.dtc fmy_id_map_dip_sens.dtc fmy_id_mec_ivvt_in.dtc fmy_id_mec_ivvt_ex.dtc fmy_id_tout_nox_sens_1.dtc fmy_id_tout_nox_sens_2.dtc fmy_id_vvl_rot.dtc fmy_id_rly_vvl.dtc fmy_id_nox_sens_1.dtc fmy_id_ovl_ecu_vvl.dtc fmy_id_dr_sc_vvl.dtc fmy_id_crit_ovl_ecu_vvl.dtc fmy_id_nox_sens_2.dtc fmy_id_cur_h_vvl.dtc fmy_id_teg_pcat_down_1.dtc fmy_id_teg_pcat_down_2.dtc fmy_id_t_seg_er.dtc fmy_id_seg_ad_er.dtc fmy_id_vs_plaus.dtc fmy_id_ftl_obd.dtc fmy_id_ftl_can.dtc fmy_id_tia_plaus.dtc fmy_id_tam_can.dtc fmy_id_tam_plaus.dtc fmy_id_map_dip_shift.dtc fmy_id_cat_diag_1.dtc fmy_id_cat_diag_2.dtc fmy_id_cat_diag_afl_1.dtc fmy_id_cat_diag_afl_2.dtc fmy_id_scg_ls_down_1.dtc fmy_id_scp_ls_down_1.dtc fmy_id_oc_ls_down_1.dtc fmy_id_puc_ls_down_1.dtc fmy_id_fl_ls_down_1.dtc fmy_id_lsl_up_if_1.dtc fmy_id_el_lsl_up_1.dtc fmy_id_lsh_up_1.dtc fmy_id_lsh_down_1.dtc fmy_id_vls_down_dif_1.dtc fmy_id_lsh_lsl_up_1.dtc fmy_id_air_lsl_up_1.dtc fmy_id_pue_ls_down_1.dtc fmy_id_swt_ls_down_1.dtc fmy_id_obd_lsh_down_1.dtc fmy_id_dyn_vld_ls_up_1.dtc fmy_id_puc_vld_ls_up_1.dtc fmy_id_obd_vld_lsh_up_1.dtc fmy_id_chk_ls_down_1.dtc fmy_id_shift_afl_lsl_up_1.dtc fmy_id_shift_afr_lsl_up_1.dtc fmy_id_oc_lsl_up_1.dtc fmy_id_delta_i_lam_1.dtc fmy_id_rgn_nt_ls_down_1.dtc fmy_id_chg_ls_down.dtc fmy_id_scg_ls_down_2.dtc fmy_id_scp_ls_down_2.dtc fmy_id_oc_ls_down_2.dtc fmy_id_puc_ls_down_2.dtc fmy_id_fl_ls_down_2.dtc fmy_id_lsl_up_if_2.dtc fmy_id_el_lsl_up_2.dtc fmy_id_lsh_up_2.dtc fmy_id_lsh_down_2.dtc fmy_id_vls_down_dif_2.dtc fmy_id_lsh_lsl_up_2.dtc fmy_id_air_lsl_up_2.dtc fmy_id_pue_ls_down_2.dtc fmy_id_swt_ls_down_2.dtc fmy_id_obd_lsh_down_2.dtc fmy_id_dyn_vld_ls_up_2.dtc fmy_id_puc_vld_ls_up_2.dtc fmy_id_obd_vld_lsh_up_2.dtc fmy_id_chk_ls_down_2.dtc fmy_id_shift_afl_lsl_up_2.dtc fmy_id_shift_afr_lsl_up_2.dtc fmy_id_oc_lsl_up_2.dtc fmy_id_delta_i_lam_2.dtc fmy_id_rgn_nt_ls_down_2.dtc fmy_id_chg_ls_up.dtc fmy_id_alter_com.dtc fmy_id_cwp_com.dtc fmy_id_qoil_com.dtc fmy_id_sens_bat_smt_com.dtc fmy_id_ecraspwm_fb.dtc fmy_id_ecras_el.dtc fmy_id_warm_rst.dtc fmy_id_acr_ad.dtc fmy_id_sens_acr.dtc fmy_id_acr_ctl.dtc fmy_id_acr_dr.dtc fmy_id_var_cod.dtc fmy_id_veh_pow_var.dtc fmy_id_fup_mfp_plaus.dtc fmy_id_h_prs_sys.dtc fmy_id_vcv_plaus.dtc fmy_id_fup.dtc fmy_id_vcv.dtc fmy_id_fup_efp.dtc fmy_id_efppwm_plaus.dtc fmy_id_l_prs_sys.dtc fmy_id_conv_mon_1.dtc fmy_id_n_32_mon_1.dtc fmy_id_pvs_mon_1.dtc fmy_id_tq_dif_isc_mon_1.dtc fmy_id_tq_req_mon_1.dtc fmy_id_tq_ext_mon_1.dtc fmy_id_tqi_av_mon_1.dtc fmy_id_tqi_n_max_mon_1.dtc fmy_id_mff_mon_1.dtc fmy_id_cru_mon_1.dtc ldp_nr_1_id_err_dtc ldp_nr_2_id_err_dtc /end DEF_CHARACTERISTIC
 /begin OUT_MEASUREMENT fmy_ram_dyn[0].err_dtc fmy_ram_dyn[0].err_info_dyn.err_sym_lst fmy_ram_dyn[0].err_info_dyn.err_sym_mem fmy_ram_dyn[1].err_dtc fmy_ram_dyn[1].err_info_dyn.err_sym_lst fmy_ram_dyn[1].err_info_dyn.err_sym_mem fmy_ram_dyn[2].err_dtc fmy_ram_dyn[2].err_info_dyn.err_sym_lst fmy_ram_dyn[2].err_info_dyn.err_sym_mem fmy_ram_dyn[3].err_dtc fmy_ram_dyn[3].err_info_dyn.err_sym_lst fmy_ram_dyn[3].err_info_dyn.err_sym_mem fmy_ram_dyn[4].err_dtc fmy_ram_dyn[4].err_info_dyn.err_sym_lst fmy_ram_dyn[4].err_info_dyn.err_sym_mem fmy_ram_dyn[5].err_dtc fmy_ram_dyn[5].err_info_dyn.err_sym_lst fmy_ram_dyn[5].err_info_dyn.err_sym_mem fmy_ram_dyn[6].err_dtc fmy_ram_dyn[6].err_info_dyn.err_sym_lst fmy_ram_dyn[6].err_info_dyn.err_sym_mem fmy_ram_dyn[7].err_dtc fmy_ram_dyn[7].err_info_dyn.err_sym_lst fmy_ram_dyn[7].err_info_dyn.err_sym_mem fmy_ram_dyn[8].err_dtc fmy_ram_dyn[8].err_info_dyn.err_sym_lst fmy_ram_dyn[8].err_info_dyn.err_sym_mem fmy_ram_dyn[9].err_dtc fmy_ram_dyn[9].err_info_dyn.err_sym_lst fmy_ram_dyn[9].err_info_dyn.err_sym_mem errm_online_dummy /end OUT_MEASUREMENT
/end FUNCTION
/end MODULE
/end PROJECT
