ASAP2_VERSION 1 41
/begin PROJECT MSD85 "Spray Guided DI-System with Piezo Injectors for 8-Cylinder"
/begin HEADER "_default_HeaderComment" PROJECT_NO _91 /end HEADER
/begin MODULE _default_ModuleName "_default_ModuleLongIdentifier"
/begin MOD_COMMON "_default_ModCommonComment" DEPOSIT ABSOLUTE BYTE_ORDER MSB_LAST ALIGNMENT_BYTE 1 ALIGNMENT_WORD 2 ALIGNMENT_LONG 2 ALIGNMENT_FLOAT32_IEEE 2 ALIGNMENT_FLOAT64_IEEE 4 /end MOD_COMMON
/begin MEASUREMENT fmy_stat_tout_nox_sens_2.err_info_stat.lv_ready "readiness status of the diagnosis instance TOUT_NOX_SENS_2" UWORD _CNV_S_2_RANGE__0___1_CM 1 100. 0. 1. DISPLAY_IDENTIFIER LV_READY_TOUT_NOX_SENS_2 ECU_ADDRESS 0xd0009a72 BIT_MASK 0x10 /end MEASUREMENT
/begin MEASUREMENT fmy_stat_tout_nox_sens_2.err_info_stat.lv_end_diag "end of diagnosis of the diagnosis instance TOUT_NOX_SENS_2" UWORD _CNV_S_2_RANGE__0___1_CM 1 100. 0. 1. DISPLAY_IDENTIFIER LV_END_DIAG_TOUT_NOX_SENS_2 ECU_ADDRESS 0xd0009a72 BIT_MASK 0x20 /end MEASUREMENT
/begin MEASUREMENT fmy_stat_tout_nox_sens_2.err_info_stat.lv_cdn_diag "diagnosis condition of the diagnosis instance TOUT_NOX_SENS_2" UWORD _CNV_S_2_RANGE__0___1_CM 1 100. 0. 1. DISPLAY_IDENTIFIER LV_CDN_DIAG_TOUT_NOX_SENS_2 ECU_ADDRESS 0xd0009a72 BIT_MASK 0x40 /end MEASUREMENT
/begin MEASUREMENT fmy_stat_tout_nox_sens_2.err_info_stat.err_sym "symptoms of the diagnosis instance TOUT_NOX_SENS_2" UWORD _CNV_S_16_RANGE_ERR__349_CM 1 100. 0. 15. DISPLAY_IDENTIFIER ERR_SYM_TOUT_NOX_SENS_2 ECU_ADDRESS 0xd0009a72 BIT_MASK 0x780 /end MEASUREMENT
/begin MEASUREMENT fmy_stat_vvl_rot.ctr_abc "anti bounce counter for diagnosis instance VVL_ROT" UBYTE _CNV_A_R_LINEAR_____0_CM 1 100. 0. 255. DISPLAY_IDENTIFIER CTR_ABC_VVL_ROT ECU_ADDRESS 0xd0009b04 FORMAT "%3.0" /end MEASUREMENT
/begin MEASUREMENT fmy_stat_vvl_rot.ctr_end_diag "counter for end of diagnosis for diagnosis instance VVL_ROT" UBYTE _CNV_A_R_LINEAR_____0_CM 1 100. 0. 255. DISPLAY_IDENTIFIER CTR_ABC_END_DIAG_VVL_ROT ECU_ADDRESS 0xd0009b05 FORMAT "%3.0" /end MEASUREMENT
/begin MEASUREMENT fmy_stat_vvl_rot.err_info_stat.lv_err_mem "storage in dynamic failure memory of the diagnosis instance VVL_ROT" UWORD _CNV_S_2_RANGE__0___1_CM 1 100. 0. 1. DISPLAY_IDENTIFIER LV_ERR_MEM_VVL_ROT ECU_ADDRESS 0xd0009b06 BIT_MASK 0x8 /end MEASUREMENT
/begin MEASUREMENT fmy_stat_vvl_rot.err_info_stat.lv_ready "readiness status of the diagnosis instance VVL_ROT" UWORD _CNV_S_2_RANGE__0___1_CM 1 100. 0. 1. DISPLAY_IDENTIFIER LV_READY_VVL_ROT ECU_ADDRESS 0xd0009b06 BIT_MASK 0x10 /end MEASUREMENT
/begin MEASUREMENT fmy_stat_vvl_rot.err_info_stat.lv_end_diag "end of diagnosis of the diagnosis instance VVL_ROT" UWORD _CNV_S_2_RANGE__0___1_CM 1 100. 0. 1. DISPLAY_IDENTIFIER LV_END_DIAG_VVL_ROT ECU_ADDRESS 0xd0009b06 BIT_MASK 0x20 /end MEASUREMENT
/begin MEASUREMENT fmy_stat_vvl_rot.err_info_stat.lv_cdn_diag "diagnosis condition of the diagnosis instance VVL_ROT" UWORD _CNV_S_2_RANGE__0___1_CM 1 100. 0. 1. DISPLAY_IDENTIFIER LV_CDN_DIAG_VVL_ROT ECU_ADDRESS 0xd0009b06 BIT_MASK 0x40 /end MEASUREMENT
/begin MEASUREMENT fmy_stat_vvl_rot.err_info_stat.err_sym "symptoms of the diagnosis instance VVL_ROT" UWORD _CNV_S_16_RANGE_ERR__349_CM 1 100. 0. 15. DISPLAY_IDENTIFIER ERR_SYM_VVL_ROT ECU_ADDRESS 0xd0009b06 BIT_MASK 0x780 /end MEASUREMENT
/begin MEASUREMENT fmy_stat_rly_vvl.ctr_abc "anti bounce counter for diagnosis instance RLY_VVL" UBYTE _CNV_A_R_LINEAR_____0_CM 1 100. 0. 255. DISPLAY_IDENTIFIER CTR_ABC_RLY_VVL ECU_ADDRESS 0xd000995c FORMAT "%3.0" /end MEASUREMENT
/begin MEASUREMENT fmy_stat_rly_vvl.ctr_end_diag "counter for end of diagnosis for diagnosis instance RLY_VVL" UBYTE _CNV_A_R_LINEAR_____0_CM 1 100. 0. 255. DISPLAY_IDENTIFIER CTR_ABC_END_DIAG_RLY_VVL ECU_ADDRESS 0xd000995d FORMAT "%3.0" /end MEASUREMENT
/begin MEASUREMENT fmy_stat_rly_vvl.err_info_stat.lv_err_mem "storage in dynamic failure memory of the diagnosis instance RLY_VVL" UWORD _CNV_S_2_RANGE__0___1_CM 1 100. 0. 1. DISPLAY_IDENTIFIER LV_ERR_MEM_RLY_VVL ECU_ADDRESS 0xd000995e BIT_MASK 0x8 /end MEASUREMENT
/begin MEASUREMENT fmy_stat_rly_vvl.err_info_stat.lv_ready "readiness status of the diagnosis instance RLY_VVL" UWORD _CNV_S_2_RANGE__0___1_CM 1 100. 0. 1. DISPLAY_IDENTIFIER LV_READY_RLY_VVL ECU_ADDRESS 0xd000995e BIT_MASK 0x10 /end MEASUREMENT
/begin MEASUREMENT fmy_stat_rly_vvl.err_info_stat.lv_end_diag "end of diagnosis of the diagnosis instance RLY_VVL" UWORD _CNV_S_2_RANGE__0___1_CM 1 100. 0. 1. DISPLAY_IDENTIFIER LV_END_DIAG_RLY_VVL ECU_ADDRESS 0xd000995e BIT_MASK 0x20 /end MEASUREMENT
/begin MEASUREMENT fmy_stat_rly_vvl.err_info_stat.lv_cdn_diag "diagnosis condition of the diagnosis instance RLY_VVL" UWORD _CNV_S_2_RANGE__0___1_CM 1 100. 0. 1. DISPLAY_IDENTIFIER LV_CDN_DIAG_RLY_VVL ECU_ADDRESS 0xd000995e BIT_MASK 0x40 /end MEASUREMENT
/begin MEASUREMENT fmy_stat_rly_vvl.err_info_stat.err_sym "symptoms of the diagnosis instance RLY_VVL" UWORD _CNV_S_16_RANGE_ERR__349_CM 1 100. 0. 15. DISPLAY_IDENTIFIER ERR_SYM_RLY_VVL ECU_ADDRESS 0xd000995e BIT_MASK 0x780 /end MEASUREMENT
/begin MEASUREMENT fmy_stat_nox_sens_1.ctr_abc "anti bounce counter for diagnosis instance NOX_SENS_1" UBYTE _CNV_A_R_LINEAR_____0_CM 1 100. 0. 255. DISPLAY_IDENTIFIER CTR_ABC_NOX_SENS_1 ECU_ADDRESS 0xd0009874 FORMAT "%3.0" /end MEASUREMENT
/begin MEASUREMENT fmy_stat_nox_sens_1.ctr_end_diag "counter for end of diagnosis for diagnosis instance NOX_SENS_1" UBYTE _CNV_A_R_LINEAR_____0_CM 1 100. 0. 255. DISPLAY_IDENTIFIER CTR_ABC_END_DIAG_NOX_SENS_1 ECU_ADDRESS 0xd0009875 FORMAT "%3.0" /end MEASUREMENT
/begin MEASUREMENT fmy_stat_nox_sens_1.err_info_stat.lv_err_mem "storage in dynamic failure memory of the diagnosis instance NOX_SENS_1" UWORD _CNV_S_2_RANGE__0___1_CM 1 100. 0. 1. DISPLAY_IDENTIFIER LV_ERR_MEM_NOX_SENS_1 ECU_ADDRESS 0xd0009876 BIT_MASK 0x8 /end MEASUREMENT
/begin MEASUREMENT fmy_stat_nox_sens_1.err_info_stat.lv_ready "readiness status of the diagnosis instance NOX_SENS_1" UWORD _CNV_S_2_RANGE__0___1_CM 1 100. 0. 1. DISPLAY_IDENTIFIER LV_READY_NOX_SENS_1 ECU_ADDRESS 0xd0009876 BIT_MASK 0x10 /end MEASUREMENT
/begin MEASUREMENT fmy_stat_nox_sens_1.err_info_stat.lv_end_diag "end of diagnosis of the diagnosis instance NOX_SENS_1" UWORD _CNV_S_2_RANGE__0___1_CM 1 100. 0. 1. DISPLAY_IDENTIFIER LV_END_DIAG_NOX_SENS_1 ECU_ADDRESS 0xd0009876 BIT_MASK 0x20 /end MEASUREMENT
/begin MEASUREMENT fmy_stat_nox_sens_1.err_info_stat.lv_cdn_diag "diagnosis condition of the diagnosis instance NOX_SENS_1" UWORD _CNV_S_2_RANGE__0___1_CM 1 100. 0. 1. DISPLAY_IDENTIFIER LV_CDN_DIAG_NOX_SENS_1 ECU_ADDRESS 0xd0009876 BIT_MASK 0x40 /end MEASUREMENT
/begin MEASUREMENT fmy_stat_nox_sens_1.err_info_stat.err_sym "symptoms of the diagnosis instance NOX_SENS_1" UWORD _CNV_S_16_RANGE_ERR__349_CM 1 100. 0. 15. DISPLAY_IDENTIFIER ERR_SYM_NOX_SENS_1 ECU_ADDRESS 0xd0009876 BIT_MASK 0x780 /end MEASUREMENT
/begin MEASUREMENT fmy_stat_ns_obd_1_1.ctr_abc "anti bounce counter for diagnosis instance NS_OBD_1_1" UBYTE _CNV_A_R_LINEAR_____0_CM 1 100. 0. 255. DISPLAY_IDENTIFIER CTR_ABC_NS_OBD_1_1 ECU_ADDRESS 0xd000987c FORMAT "%3.0" /end MEASUREMENT
/begin MEASUREMENT fmy_stat_ns_obd_1_1.ctr_end_diag "counter for end of diagnosis for diagnosis instance NS_OBD_1_1" UBYTE _CNV_A_R_LINEAR_____0_CM 1 100. 0. 255. DISPLAY_IDENTIFIER CTR_ABC_END_DIAG_NS_OBD_1_1 ECU_ADDRESS 0xd000987d FORMAT "%3.0" /end MEASUREMENT
/begin MEASUREMENT fmy_stat_ns_obd_1_1.err_info_stat.lv_err_mem "storage in dynamic failure memory of the diagnosis instance NS_OBD_1_1" UWORD _CNV_S_2_RANGE__0___1_CM 1 100. 0. 1. DISPLAY_IDENTIFIER LV_ERR_MEM_NS_OBD_1_1 ECU_ADDRESS 0xd000987e BIT_MASK 0x8 /end MEASUREMENT
/begin MEASUREMENT fmy_stat_ns_obd_1_1.err_info_stat.lv_ready "readiness status of the diagnosis instance NS_OBD_1_1" UWORD _CNV_S_2_RANGE__0___1_CM 1 100. 0. 1. DISPLAY_IDENTIFIER LV_READY_NS_OBD_1_1 ECU_ADDRESS 0xd000987e BIT_MASK 0x10 /end MEASUREMENT
/begin MEASUREMENT fmy_stat_ns_obd_1_1.err_info_stat.lv_end_diag "end of diagnosis of the diagnosis instance NS_OBD_1_1" UWORD _CNV_S_2_RANGE__0___1_CM 1 100. 0. 1. DISPLAY_IDENTIFIER LV_END_DIAG_NS_OBD_1_1 ECU_ADDRESS 0xd000987e BIT_MASK 0x20 /end MEASUREMENT
/begin MEASUREMENT fmy_stat_ns_obd_1_1.err_info_stat.lv_cdn_diag "diagnosis condition of the diagnosis instance NS_OBD_1_1" UWORD _CNV_S_2_RANGE__0___1_CM 1 100. 0. 1. DISPLAY_IDENTIFIER LV_CDN_DIAG_NS_OBD_1_1 ECU_ADDRESS 0xd000987e BIT_MASK 0x40 /end MEASUREMENT
/begin MEASUREMENT fmy_stat_ns_obd_1_1.err_info_stat.err_sym "symptoms of the diagnosis instance NS_OBD_1_1" UWORD _CNV_S_16_RANGE_ERR__349_CM 1 100. 0. 15. DISPLAY_IDENTIFIER ERR_SYM_NS_OBD_1_1 ECU_ADDRESS 0xd000987e BIT_MASK 0x780 /end MEASUREMENT
/begin MEASUREMENT fmy_stat_ns_obd_1_2.ctr_abc "anti bounce counter for diagnosis instance NS_OBD_1_2" UBYTE _CNV_A_R_LINEAR_____0_CM 1 100. 0. 255. DISPLAY_IDENTIFIER CTR_ABC_NS_OBD_1_2 ECU_ADDRESS 0xd0009880 FORMAT "%3.0" /end MEASUREMENT
/begin MEASUREMENT fmy_stat_ns_obd_1_2.ctr_end_diag "counter for end of diagnosis for diagnosis instance NS_OBD_1_2" UBYTE _CNV_A_R_LINEAR_____0_CM 1 100. 0. 255. DISPLAY_IDENTIFIER CTR_ABC_END_DIAG_NS_OBD_1_2 ECU_ADDRESS 0xd0009881 FORMAT "%3.0" /end MEASUREMENT
/begin MEASUREMENT fmy_stat_ns_obd_1_2.err_info_stat.lv_err_mem "storage in dynamic failure memory of the diagnosis instance NS_OBD_1_2" UWORD _CNV_S_2_RANGE__0___1_CM 1 100. 0. 1. DISPLAY_IDENTIFIER LV_ERR_MEM_NS_OBD_1_2 ECU_ADDRESS 0xd0009882 BIT_MASK 0x8 /end MEASUREMENT
/begin MEASUREMENT fmy_stat_ns_obd_1_2.err_info_stat.lv_ready "readiness status of the diagnosis instance NS_OBD_1_2" UWORD _CNV_S_2_RANGE__0___1_CM 1 100. 0. 1. DISPLAY_IDENTIFIER LV_READY_NS_OBD_1_2 ECU_ADDRESS 0xd0009882 BIT_MASK 0x10 /end MEASUREMENT
/begin MEASUREMENT fmy_stat_ns_obd_1_2.err_info_stat.lv_end_diag "end of diagnosis of the diagnosis instance NS_OBD_1_2" UWORD _CNV_S_2_RANGE__0___1_CM 1 100. 0. 1. DISPLAY_IDENTIFIER LV_END_DIAG_NS_OBD_1_2 ECU_ADDRESS 0xd0009882 BIT_MASK 0x20 /end MEASUREMENT
/begin MEASUREMENT fmy_stat_ns_obd_1_2.err_info_stat.lv_cdn_diag "diagnosis condition of the diagnosis instance NS_OBD_1_2" UWORD _CNV_S_2_RANGE__0___1_CM 1 100. 0. 1. DISPLAY_IDENTIFIER LV_CDN_DIAG_NS_OBD_1_2 ECU_ADDRESS 0xd0009882 BIT_MASK 0x40 /end MEASUREMENT
/begin MEASUREMENT fmy_stat_ns_obd_1_2.err_info_stat.err_sym "symptoms of the diagnosis instance NS_OBD_1_2" UWORD _CNV_S_16_RANGE_ERR__349_CM 1 100. 0. 15. DISPLAY_IDENTIFIER ERR_SYM_NS_OBD_1_2 ECU_ADDRESS 0xd0009882 BIT_MASK 0x780 /end MEASUREMENT
/begin MEASUREMENT fmy_stat_ovl_ecu_vvl.ctr_abc "anti bounce counter for diagnosis instance OVL_ECU_VVL" UBYTE _CNV_A_R_LINEAR_____0_CM 1 100. 0. 255. DISPLAY_IDENTIFIER CTR_ABC_OVL_ECU_VVL ECU_ADDRESS 0xd00098ac FORMAT "%3.0" /end MEASUREMENT
/begin MEASUREMENT fmy_stat_ovl_ecu_vvl.ctr_end_diag "counter for end of diagnosis for diagnosis instance OVL_ECU_VVL" UBYTE _CNV_A_R_LINEAR_____0_CM 1 100. 0. 255. DISPLAY_IDENTIFIER CTR_ABC_END_DIAG_OVL_ECU_VVL ECU_ADDRESS 0xd00098ad FORMAT "%3.0" /end MEASUREMENT
/begin MEASUREMENT fmy_stat_ovl_ecu_vvl.err_info_stat.lv_err_mem "storage in dynamic failure memory of the diagnosis instance OVL_ECU_VVL" UWORD _CNV_S_2_RANGE__0___1_CM 1 100. 0. 1. DISPLAY_IDENTIFIER LV_ERR_MEM_OVL_ECU_VVL ECU_ADDRESS 0xd00098ae BIT_MASK 0x8 /end MEASUREMENT
/begin MEASUREMENT fmy_stat_ovl_ecu_vvl.err_info_stat.lv_ready "readiness status of the diagnosis instance OVL_ECU_VVL" UWORD _CNV_S_2_RANGE__0___1_CM 1 100. 0. 1. DISPLAY_IDENTIFIER LV_READY_OVL_ECU_VVL ECU_ADDRESS 0xd00098ae BIT_MASK 0x10 /end MEASUREMENT
/begin MEASUREMENT fmy_stat_ovl_ecu_vvl.err_info_stat.lv_end_diag "end of diagnosis of the diagnosis instance OVL_ECU_VVL" UWORD _CNV_S_2_RANGE__0___1_CM 1 100. 0. 1. DISPLAY_IDENTIFIER LV_END_DIAG_OVL_ECU_VVL ECU_ADDRESS 0xd00098ae BIT_MASK 0x20 /end MEASUREMENT
/begin MEASUREMENT fmy_stat_ovl_ecu_vvl.err_info_stat.lv_cdn_diag "diagnosis condition of the diagnosis instance OVL_ECU_VVL" UWORD _CNV_S_2_RANGE__0___1_CM 1 100. 0. 1. DISPLAY_IDENTIFIER LV_CDN_DIAG_OVL_ECU_VVL ECU_ADDRESS 0xd00098ae BIT_MASK 0x40 /end MEASUREMENT
/begin MEASUREMENT fmy_stat_ovl_ecu_vvl.err_info_stat.err_sym "symptoms of the diagnosis instance OVL_ECU_VVL" UWORD _CNV_S_16_RANGE_ERR__349_CM 1 100. 0. 15. DISPLAY_IDENTIFIER ERR_SYM_OVL_ECU_VVL ECU_ADDRESS 0xd00098ae BIT_MASK 0x780 /end MEASUREMENT
/begin MEASUREMENT fmy_stat_dr_sc_vvl.ctr_abc "anti bounce counter for diagnosis instance DR_SC_VVL" UBYTE _CNV_A_R_LINEAR_____0_CM 1 100. 0. 255. DISPLAY_IDENTIFIER CTR_ABC_DR_SC_VVL ECU_ADDRESS 0xd0009604 FORMAT "%3.0" /end MEASUREMENT
/begin MEASUREMENT fmy_stat_dr_sc_vvl.ctr_end_diag "counter for end of diagnosis for diagnosis instance DR_SC_VVL" UBYTE _CNV_A_R_LINEAR_____0_CM 1 100. 0. 255. DISPLAY_IDENTIFIER CTR_ABC_END_DIAG_DR_SC_VVL ECU_ADDRESS 0xd0009605 FORMAT "%3.0" /end MEASUREMENT
/begin MEASUREMENT fmy_stat_dr_sc_vvl.err_info_stat.lv_err_mem "storage in dynamic failure memory of the diagnosis instance DR_SC_VVL" UWORD _CNV_S_2_RANGE__0___1_CM 1 100. 0. 1. DISPLAY_IDENTIFIER LV_ERR_MEM_DR_SC_VVL ECU_ADDRESS 0xd0009606 BIT_MASK 0x8 /end MEASUREMENT
/begin MEASUREMENT fmy_stat_dr_sc_vvl.err_info_stat.lv_ready "readiness status of the diagnosis instance DR_SC_VVL" UWORD _CNV_S_2_RANGE__0___1_CM 1 100. 0. 1. DISPLAY_IDENTIFIER LV_READY_DR_SC_VVL ECU_ADDRESS 0xd0009606 BIT_MASK 0x10 /end MEASUREMENT
/begin MEASUREMENT fmy_stat_dr_sc_vvl.err_info_stat.lv_end_diag "end of diagnosis of the diagnosis instance DR_SC_VVL" UWORD _CNV_S_2_RANGE__0___1_CM 1 100. 0. 1. DISPLAY_IDENTIFIER LV_END_DIAG_DR_SC_VVL ECU_ADDRESS 0xd0009606 BIT_MASK 0x20 /end MEASUREMENT
/begin MEASUREMENT fmy_stat_dr_sc_vvl.err_info_stat.lv_cdn_diag "diagnosis condition of the diagnosis instance DR_SC_VVL" UWORD _CNV_S_2_RANGE__0___1_CM 1 100. 0. 1. DISPLAY_IDENTIFIER LV_CDN_DIAG_DR_SC_VVL ECU_ADDRESS 0xd0009606 BIT_MASK 0x40 /end MEASUREMENT
/begin MEASUREMENT fmy_stat_dr_sc_vvl.err_info_stat.err_sym "symptoms of the diagnosis instance DR_SC_VVL" UWORD _CNV_S_16_RANGE_ERR__349_CM 1 100. 0. 15. DISPLAY_IDENTIFIER ERR_SYM_DR_SC_VVL ECU_ADDRESS 0xd0009606 BIT_MASK 0x780 /end MEASUREMENT
/begin MEASUREMENT fmy_stat_crit_ovl_ecu_vvl.ctr_abc "anti bounce counter for diagnosis instance CRIT_OVL_ECU_VVL" UBYTE _CNV_A_R_LINEAR_____0_CM 1 100. 0. 255. DISPLAY_IDENTIFIER CTR_ABC_CRIT_OVL_ECU_VVL ECU_ADDRESS 0xd0009568 FORMAT "%3.0" /end MEASUREMENT
/begin MEASUREMENT fmy_stat_crit_ovl_ecu_vvl.ctr_end_diag "counter for end of diagnosis for diagnosis instance CRIT_OVL_ECU_VVL" UBYTE _CNV_A_R_LINEAR_____0_CM 1 100. 0. 255. DISPLAY_IDENTIFIER CTR_ABC_END_DIAG_CRIT_OVL_ECU_VVL ECU_ADDRESS 0xd0009569 FORMAT "%3.0" /end MEASUREMENT
/begin MEASUREMENT fmy_stat_crit_ovl_ecu_vvl.err_info_stat.lv_err_mem "storage in dynamic failure memory of the diagnosis instance CRIT_OVL_ECU_VVL" UWORD _CNV_S_2_RANGE__0___1_CM 1 100. 0. 1. DISPLAY_IDENTIFIER LV_ERR_MEM_CRIT_OVL_ECU_VVL ECU_ADDRESS 0xd000956a BIT_MASK 0x8 /end MEASUREMENT
/begin MEASUREMENT fmy_stat_crit_ovl_ecu_vvl.err_info_stat.lv_ready "readiness status of the diagnosis instance CRIT_OVL_ECU_VVL" UWORD _CNV_S_2_RANGE__0___1_CM 1 100. 0. 1. DISPLAY_IDENTIFIER LV_READY_CRIT_OVL_ECU_VVL ECU_ADDRESS 0xd000956a BIT_MASK 0x10 /end MEASUREMENT
/begin MEASUREMENT fmy_stat_crit_ovl_ecu_vvl.err_info_stat.lv_end_diag "end of diagnosis of the diagnosis instance CRIT_OVL_ECU_VVL" UWORD _CNV_S_2_RANGE__0___1_CM 1 100. 0. 1. DISPLAY_IDENTIFIER LV_END_DIAG_CRIT_OVL_ECU_VVL ECU_ADDRESS 0xd000956a BIT_MASK 0x20 /end MEASUREMENT
/begin MEASUREMENT fmy_stat_crit_ovl_ecu_vvl.err_info_stat.lv_cdn_diag "diagnosis condition of the diagnosis instance CRIT_OVL_ECU_VVL" UWORD _CNV_S_2_RANGE__0___1_CM 1 100. 0. 1. DISPLAY_IDENTIFIER LV_CDN_DIAG_CRIT_OVL_ECU_VVL ECU_ADDRESS 0xd000956a BIT_MASK 0x40 /end MEASUREMENT
/begin MEASUREMENT fmy_stat_crit_ovl_ecu_vvl.err_info_stat.err_sym "symptoms of the diagnosis instance CRIT_OVL_ECU_VVL" UWORD _CNV_S_16_RANGE_ERR__349_CM 1 100. 0. 15. DISPLAY_IDENTIFIER ERR_SYM_CRIT_OVL_ECU_VVL ECU_ADDRESS 0xd000956a BIT_MASK 0x780 /end MEASUREMENT
/begin MEASUREMENT fmy_stat_nox_sens_2.ctr_abc "anti bounce counter for diagnosis instance NOX_SENS_2" UBYTE _CNV_A_R_LINEAR_____0_CM 1 100. 0. 255. DISPLAY_IDENTIFIER CTR_ABC_NOX_SENS_2 ECU_ADDRESS 0xd0009878 FORMAT "%3.0" /end MEASUREMENT
/begin MEASUREMENT fmy_stat_nox_sens_2.ctr_end_diag "counter for end of diagnosis for diagnosis instance NOX_SENS_2" UBYTE _CNV_A_R_LINEAR_____0_CM 1 100. 0. 255. DISPLAY_IDENTIFIER CTR_ABC_END_DIAG_NOX_SENS_2 ECU_ADDRESS 0xd0009879 FORMAT "%3.0" /end MEASUREMENT
/begin MEASUREMENT fmy_stat_nox_sens_2.err_info_stat.lv_err_mem "storage in dynamic failure memory of the diagnosis instance NOX_SENS_2" UWORD _CNV_S_2_RANGE__0___1_CM 1 100. 0. 1. DISPLAY_IDENTIFIER LV_ERR_MEM_NOX_SENS_2 ECU_ADDRESS 0xd000987a BIT_MASK 0x8 /end MEASUREMENT
/begin MEASUREMENT fmy_stat_nox_sens_2.err_info_stat.lv_ready "readiness status of the diagnosis instance NOX_SENS_2" UWORD _CNV_S_2_RANGE__0___1_CM 1 100. 0. 1. DISPLAY_IDENTIFIER LV_READY_NOX_SENS_2 ECU_ADDRESS 0xd000987a BIT_MASK 0x10 /end MEASUREMENT
/begin MEASUREMENT fmy_stat_nox_sens_2.err_info_stat.lv_end_diag "end of diagnosis of the diagnosis instance NOX_SENS_2" UWORD _CNV_S_2_RANGE__0___1_CM 1 100. 0. 1. DISPLAY_IDENTIFIER LV_END_DIAG_NOX_SENS_2 ECU_ADDRESS 0xd000987a BIT_MASK 0x20 /end MEASUREMENT
/begin MEASUREMENT fmy_stat_nox_sens_2.err_info_stat.lv_cdn_diag "diagnosis condition of the diagnosis instance NOX_SENS_2" UWORD _CNV_S_2_RANGE__0___1_CM 1 100. 0. 1. DISPLAY_IDENTIFIER LV_CDN_DIAG_NOX_SENS_2 ECU_ADDRESS 0xd000987a BIT_MASK 0x40 /end MEASUREMENT
/begin MEASUREMENT fmy_stat_nox_sens_2.err_info_stat.err_sym "symptoms of the diagnosis instance NOX_SENS_2" UWORD _CNV_S_16_RANGE_ERR__349_CM 1 100. 0. 15. DISPLAY_IDENTIFIER ERR_SYM_NOX_SENS_2 ECU_ADDRESS 0xd000987a BIT_MASK 0x780 /end MEASUREMENT
/begin MEASUREMENT fmy_stat_cur_h_vvl.ctr_abc "anti bounce counter for diagnosis instance CUR_H_VVL" UBYTE _CNV_A_R_LINEAR_____0_CM 1 100. 0. 255. DISPLAY_IDENTIFIER CTR_ABC_CUR_H_VVL ECU_ADDRESS 0xd000958c FORMAT "%3.0" /end MEASUREMENT
/begin MEASUREMENT fmy_stat_cur_h_vvl.ctr_end_diag "counter for end of diagnosis for diagnosis instance CUR_H_VVL" UBYTE _CNV_A_R_LINEAR_____0_CM 1 100. 0. 255. DISPLAY_IDENTIFIER CTR_ABC_END_DIAG_CUR_H_VVL ECU_ADDRESS 0xd000958d FORMAT "%3.0" /end MEASUREMENT
/begin MEASUREMENT fmy_stat_cur_h_vvl.err_info_stat.lv_err_mem "storage in dynamic failure memory of the diagnosis instance CUR_H_VVL" UWORD _CNV_S_2_RANGE__0___1_CM 1 100. 0. 1. DISPLAY_IDENTIFIER LV_ERR_MEM_CUR_H_VVL ECU_ADDRESS 0xd000958e BIT_MASK 0x8 /end MEASUREMENT
/begin MEASUREMENT fmy_stat_cur_h_vvl.err_info_stat.lv_ready "readiness status of the diagnosis instance CUR_H_VVL" UWORD _CNV_S_2_RANGE__0___1_CM 1 100. 0. 1. DISPLAY_IDENTIFIER LV_READY_CUR_H_VVL ECU_ADDRESS 0xd000958e BIT_MASK 0x10 /end MEASUREMENT
/begin MEASUREMENT fmy_stat_cur_h_vvl.err_info_stat.lv_end_diag "end of diagnosis of the diagnosis instance CUR_H_VVL" UWORD _CNV_S_2_RANGE__0___1_CM 1 100. 0. 1. DISPLAY_IDENTIFIER LV_END_DIAG_CUR_H_VVL ECU_ADDRESS 0xd000958e BIT_MASK 0x20 /end MEASUREMENT
/begin MEASUREMENT fmy_stat_cur_h_vvl.err_info_stat.lv_cdn_diag "diagnosis condition of the diagnosis instance CUR_H_VVL" UWORD _CNV_S_2_RANGE__0___1_CM 1 100. 0. 1. DISPLAY_IDENTIFIER LV_CDN_DIAG_CUR_H_VVL ECU_ADDRESS 0xd000958e BIT_MASK 0x40 /end MEASUREMENT
/begin MEASUREMENT fmy_stat_cur_h_vvl.err_info_stat.err_sym "symptoms of the diagnosis instance CUR_H_VVL" UWORD _CNV_S_16_RANGE_ERR__349_CM 1 100. 0. 15. DISPLAY_IDENTIFIER ERR_SYM_CUR_H_VVL ECU_ADDRESS 0xd000958e BIT_MASK 0x780 /end MEASUREMENT
/begin MEASUREMENT fmy_stat_teg_pcat_down.ctr_abc "anti bounce counter for diagnosis instance TEG_PCAT_DOWN" UBYTE _CNV_A_R_LINEAR_____0_CM 1 100. 0. 255. DISPLAY_IDENTIFIER CTR_ABC_TEG_PCAT_DOWN ECU_ADDRESS 0xd0009a30 FORMAT "%3.0" /end MEASUREMENT
/begin MEASUREMENT fmy_stat_teg_pcat_down.ctr_end_diag "counter for end of diagnosis for diagnosis instance TEG_PCAT_DOWN" UBYTE _CNV_A_R_LINEAR_____0_CM 1 100. 0. 255. DISPLAY_IDENTIFIER CTR_ABC_END_DIAG_TEG_PCAT_DOWN ECU_ADDRESS 0xd0009a31 FORMAT "%3.0" /end MEASUREMENT
/begin MEASUREMENT fmy_stat_teg_pcat_down.err_info_stat.lv_err_mem "storage in dynamic failure memory of the diagnosis instance TEG_PCAT_DOWN" UWORD _CNV_S_2_RANGE__0___1_CM 1 100. 0. 1. DISPLAY_IDENTIFIER LV_ERR_MEM_TEG_PCAT_DOWN ECU_ADDRESS 0xd0009a32 BIT_MASK 0x8 /end MEASUREMENT
/begin MEASUREMENT fmy_stat_teg_pcat_down.err_info_stat.lv_ready "readiness status of the diagnosis instance TEG_PCAT_DOWN" UWORD _CNV_S_2_RANGE__0___1_CM 1 100. 0. 1. DISPLAY_IDENTIFIER LV_READY_TEG_PCAT_DOWN ECU_ADDRESS 0xd0009a32 BIT_MASK 0x10 /end MEASUREMENT
/begin MEASUREMENT fmy_stat_teg_pcat_down.err_info_stat.lv_end_diag "end of diagnosis of the diagnosis instance TEG_PCAT_DOWN" UWORD _CNV_S_2_RANGE__0___1_CM 1 100. 0. 1. DISPLAY_IDENTIFIER LV_END_DIAG_TEG_PCAT_DOWN ECU_ADDRESS 0xd0009a32 BIT_MASK 0x20 /end MEASUREMENT
/begin MEASUREMENT fmy_stat_teg_pcat_down.err_info_stat.lv_cdn_diag "diagnosis condition of the diagnosis instance TEG_PCAT_DOWN" UWORD _CNV_S_2_RANGE__0___1_CM 1 100. 0. 1. DISPLAY_IDENTIFIER LV_CDN_DIAG_TEG_PCAT_DOWN ECU_ADDRESS 0xd0009a32 BIT_MASK 0x40 /end MEASUREMENT
/begin MEASUREMENT fmy_stat_teg_pcat_down.err_info_stat.err_sym "symptoms of the diagnosis instance TEG_PCAT_DOWN" UWORD _CNV_S_16_RANGE_ERR__349_CM 1 100. 0. 15. DISPLAY_IDENTIFIER ERR_SYM_TEG_PCAT_DOWN ECU_ADDRESS 0xd0009a32 BIT_MASK 0x780 /end MEASUREMENT
/begin MEASUREMENT fmy_stat_t_seg_er.ctr_abc "anti bounce counter for diagnosis instance T_SEG_ER" UBYTE _CNV_A_R_LINEAR_____0_CM 1 100. 0. 255. DISPLAY_IDENTIFIER CTR_ABC_T_SEG_ER ECU_ADDRESS 0xd00099f0 FORMAT "%3.0" /end MEASUREMENT
/begin MEASUREMENT fmy_stat_t_seg_er.ctr_end_diag "counter for end of diagnosis for diagnosis instance T_SEG_ER" UBYTE _CNV_A_R_LINEAR_____0_CM 1 100. 0. 255. DISPLAY_IDENTIFIER CTR_ABC_END_DIAG_T_SEG_ER ECU_ADDRESS 0xd00099f1 FORMAT "%3.0" /end MEASUREMENT
/begin MEASUREMENT fmy_stat_t_seg_er.err_info_stat.lv_err_mem "storage in dynamic failure memory of the diagnosis instance T_SEG_ER" UWORD _CNV_S_2_RANGE__0___1_CM 1 100. 0. 1. DISPLAY_IDENTIFIER LV_ERR_MEM_T_SEG_ER ECU_ADDRESS 0xd00099f2 BIT_MASK 0x8 /end MEASUREMENT
/begin MEASUREMENT fmy_stat_t_seg_er.err_info_stat.lv_ready "readiness status of the diagnosis instance T_SEG_ER" UWORD _CNV_S_2_RANGE__0___1_CM 1 100. 0. 1. DISPLAY_IDENTIFIER LV_READY_T_SEG_ER ECU_ADDRESS 0xd00099f2 BIT_MASK 0x10 /end MEASUREMENT
/begin MEASUREMENT fmy_stat_t_seg_er.err_info_stat.lv_end_diag "end of diagnosis of the diagnosis instance T_SEG_ER" UWORD _CNV_S_2_RANGE__0___1_CM 1 100. 0. 1. DISPLAY_IDENTIFIER LV_END_DIAG_T_SEG_ER ECU_ADDRESS 0xd00099f2 BIT_MASK 0x20 /end MEASUREMENT
/begin MEASUREMENT fmy_stat_t_seg_er.err_info_stat.lv_cdn_diag "diagnosis condition of the diagnosis instance T_SEG_ER" UWORD _CNV_S_2_RANGE__0___1_CM 1 100. 0. 1. DISPLAY_IDENTIFIER LV_CDN_DIAG_T_SEG_ER ECU_ADDRESS 0xd00099f2 BIT_MASK 0x40 /end MEASUREMENT
/begin MEASUREMENT fmy_stat_t_seg_er.err_info_stat.err_sym "symptoms of the diagnosis instance T_SEG_ER" UWORD _CNV_S_16_RANGE_ERR__349_CM 1 100. 0. 15. DISPLAY_IDENTIFIER ERR_SYM_T_SEG_ER ECU_ADDRESS 0xd00099f2 BIT_MASK 0x780 /end MEASUREMENT
/begin MEASUREMENT fmy_stat_seg_ad_er.ctr_abc "anti bounce counter for diagnosis instance SEG_AD_ER" UBYTE _CNV_A_R_LINEAR_____0_CM 1 100. 0. 255. DISPLAY_IDENTIFIER CTR_ABC_SEG_AD_ER ECU_ADDRESS 0xd0009974 FORMAT "%3.0" /end MEASUREMENT
/begin MEASUREMENT fmy_stat_seg_ad_er.ctr_end_diag "counter for end of diagnosis for diagnosis instance SEG_AD_ER" UBYTE _CNV_A_R_LINEAR_____0_CM 1 100. 0. 255. DISPLAY_IDENTIFIER CTR_ABC_END_DIAG_SEG_AD_ER ECU_ADDRESS 0xd0009975 FORMAT "%3.0" /end MEASUREMENT
/begin MEASUREMENT fmy_stat_seg_ad_er.err_info_stat.lv_err_mem "storage in dynamic failure memory of the diagnosis instance SEG_AD_ER" UWORD _CNV_S_2_RANGE__0___1_CM 1 100. 0. 1. DISPLAY_IDENTIFIER LV_ERR_MEM_SEG_AD_ER ECU_ADDRESS 0xd0009976 BIT_MASK 0x8 /end MEASUREMENT
/begin MEASUREMENT fmy_stat_seg_ad_er.err_info_stat.lv_ready "readiness status of the diagnosis instance SEG_AD_ER" UWORD _CNV_S_2_RANGE__0___1_CM 1 100. 0. 1. DISPLAY_IDENTIFIER LV_READY_SEG_AD_ER ECU_ADDRESS 0xd0009976 BIT_MASK 0x10 /end MEASUREMENT
/begin MEASUREMENT fmy_stat_seg_ad_er.err_info_stat.lv_end_diag "end of diagnosis of the diagnosis instance SEG_AD_ER" UWORD _CNV_S_2_RANGE__0___1_CM 1 100. 0. 1. DISPLAY_IDENTIFIER LV_END_DIAG_SEG_AD_ER ECU_ADDRESS 0xd0009976 BIT_MASK 0x20 /end MEASUREMENT
/begin MEASUREMENT fmy_stat_seg_ad_er.err_info_stat.lv_cdn_diag "diagnosis condition of the diagnosis instance SEG_AD_ER" UWORD _CNV_S_2_RANGE__0___1_CM 1 100. 0. 1. DISPLAY_IDENTIFIER LV_CDN_DIAG_SEG_AD_ER ECU_ADDRESS 0xd0009976 BIT_MASK 0x40 /end MEASUREMENT
/begin MEASUREMENT fmy_stat_seg_ad_er.err_info_stat.err_sym "symptoms of the diagnosis instance SEG_AD_ER" UWORD _CNV_S_16_RANGE_ERR__349_CM 1 100. 0. 15. DISPLAY_IDENTIFIER ERR_SYM_SEG_AD_ER ECU_ADDRESS 0xd0009976 BIT_MASK 0x780 /end MEASUREMENT
/begin MEASUREMENT fmy_stat_vs_plaus.ctr_abc "anti bounce counter for diagnosis instance VS_PLAUS" UBYTE _CNV_A_R_LINEAR_____0_CM 1 100. 0. 255. DISPLAY_IDENTIFIER CTR_ABC_VS_PLAUS ECU_ADDRESS 0xd0009b00 FORMAT "%3.0" /end MEASUREMENT
/begin MEASUREMENT fmy_stat_vs_plaus.ctr_end_diag "counter for end of diagnosis for diagnosis instance VS_PLAUS" UBYTE _CNV_A_R_LINEAR_____0_CM 1 100. 0. 255. DISPLAY_IDENTIFIER CTR_ABC_END_DIAG_VS_PLAUS ECU_ADDRESS 0xd0009b01 FORMAT "%3.0" /end MEASUREMENT
/begin MEASUREMENT fmy_stat_vs_plaus.err_info_stat.lv_err_mem "storage in dynamic failure memory of the diagnosis instance VS_PLAUS" UWORD _CNV_S_2_RANGE__0___1_CM 1 100. 0. 1. DISPLAY_IDENTIFIER LV_ERR_MEM_VS_PLAUS ECU_ADDRESS 0xd0009b02 BIT_MASK 0x8 /end MEASUREMENT
/begin MEASUREMENT fmy_stat_vs_plaus.err_info_stat.lv_ready "readiness status of the diagnosis instance VS_PLAUS" UWORD _CNV_S_2_RANGE__0___1_CM 1 100. 0. 1. DISPLAY_IDENTIFIER LV_READY_VS_PLAUS ECU_ADDRESS 0xd0009b02 BIT_MASK 0x10 /end MEASUREMENT
/begin MEASUREMENT fmy_stat_vs_plaus.err_info_stat.lv_end_diag "end of diagnosis of the diagnosis instance VS_PLAUS" UWORD _CNV_S_2_RANGE__0___1_CM 1 100. 0. 1. DISPLAY_IDENTIFIER LV_END_DIAG_VS_PLAUS ECU_ADDRESS 0xd0009b02 BIT_MASK 0x20 /end MEASUREMENT
/begin MEASUREMENT fmy_stat_vs_plaus.err_info_stat.lv_cdn_diag "diagnosis condition of the diagnosis instance VS_PLAUS" UWORD _CNV_S_2_RANGE__0___1_CM 1 100. 0. 1. DISPLAY_IDENTIFIER LV_CDN_DIAG_VS_PLAUS ECU_ADDRESS 0xd0009b02 BIT_MASK 0x40 /end MEASUREMENT
/begin MEASUREMENT fmy_stat_vs_plaus.err_info_stat.err_sym "symptoms of the diagnosis instance VS_PLAUS" UWORD _CNV_S_16_RANGE_ERR__349_CM 1 100. 0. 15. DISPLAY_IDENTIFIER ERR_SYM_VS_PLAUS ECU_ADDRESS 0xd0009b02 BIT_MASK 0x780 /end MEASUREMENT
/begin MEASUREMENT fmy_stat_ftl_obd.ctr_abc "anti bounce counter for diagnosis instance FTL_OBD" UBYTE _CNV_A_R_LINEAR_____0_CM 1 100. 0. 255. DISPLAY_IDENTIFIER CTR_ABC_FTL_OBD ECU_ADDRESS 0xd00096a4 FORMAT "%3.0" /end MEASUREMENT
/begin MEASUREMENT fmy_stat_ftl_obd.ctr_end_diag "counter for end of diagnosis for diagnosis instance FTL_OBD" UBYTE _CNV_A_R_LINEAR_____0_CM 1 100. 0. 255. DISPLAY_IDENTIFIER CTR_ABC_END_DIAG_FTL_OBD ECU_ADDRESS 0xd00096a5 FORMAT "%3.0" /end MEASUREMENT
/begin MEASUREMENT fmy_stat_ftl_obd.err_info_stat.lv_err_mem "storage in dynamic failure memory of the diagnosis instance FTL_OBD" UWORD _CNV_S_2_RANGE__0___1_CM 1 100. 0. 1. DISPLAY_IDENTIFIER LV_ERR_MEM_FTL_OBD ECU_ADDRESS 0xd00096a6 BIT_MASK 0x8 /end MEASUREMENT
/begin MEASUREMENT fmy_stat_ftl_obd.err_info_stat.lv_ready "readiness status of the diagnosis instance FTL_OBD" UWORD _CNV_S_2_RANGE__0___1_CM 1 100. 0. 1. DISPLAY_IDENTIFIER LV_READY_FTL_OBD ECU_ADDRESS 0xd00096a6 BIT_MASK 0x10 /end MEASUREMENT
/begin MEASUREMENT fmy_stat_ftl_obd.err_info_stat.lv_end_diag "end of diagnosis of the diagnosis instance FTL_OBD" UWORD _CNV_S_2_RANGE__0___1_CM 1 100. 0. 1. DISPLAY_IDENTIFIER LV_END_DIAG_FTL_OBD ECU_ADDRESS 0xd00096a6 BIT_MASK 0x20 /end MEASUREMENT
/begin MEASUREMENT fmy_stat_ftl_obd.err_info_stat.lv_cdn_diag "diagnosis condition of the diagnosis instance FTL_OBD" UWORD _CNV_S_2_RANGE__0___1_CM 1 100. 0. 1. DISPLAY_IDENTIFIER LV_CDN_DIAG_FTL_OBD ECU_ADDRESS 0xd00096a6 BIT_MASK 0x40 /end MEASUREMENT
/begin MEASUREMENT fmy_stat_ftl_obd.err_info_stat.err_sym "symptoms of the diagnosis instance FTL_OBD" UWORD _CNV_S_16_RANGE_ERR__349_CM 1 100. 0. 15. DISPLAY_IDENTIFIER ERR_SYM_FTL_OBD ECU_ADDRESS 0xd00096a6 BIT_MASK 0x780 /end MEASUREMENT
/begin MEASUREMENT fmy_stat_ftl_le_can.ctr_abc "anti bounce counter for diagnosis instance FTL_LE_CAN" UBYTE _CNV_A_R_LINEAR_____0_CM 1 100. 0. 255. DISPLAY_IDENTIFIER CTR_ABC_FTL_LE_CAN ECU_ADDRESS 0xd000969c FORMAT "%3.0" /end MEASUREMENT
/begin MEASUREMENT fmy_stat_ftl_le_can.ctr_end_diag "counter for end of diagnosis for diagnosis instance FTL_LE_CAN" UBYTE _CNV_A_R_LINEAR_____0_CM 1 100. 0. 255. DISPLAY_IDENTIFIER CTR_ABC_END_DIAG_FTL_LE_CAN ECU_ADDRESS 0xd000969d FORMAT "%3.0" /end MEASUREMENT
/begin MEASUREMENT fmy_stat_ftl_le_can.err_info_stat.lv_err_mem "storage in dynamic failure memory of the diagnosis instance FTL_LE_CAN" UWORD _CNV_S_2_RANGE__0___1_CM 1 100. 0. 1. DISPLAY_IDENTIFIER LV_ERR_MEM_FTL_LE_CAN ECU_ADDRESS 0xd000969e BIT_MASK 0x8 /end MEASUREMENT
/begin MEASUREMENT fmy_stat_ftl_le_can.err_info_stat.lv_ready "readiness status of the diagnosis instance FTL_LE_CAN" UWORD _CNV_S_2_RANGE__0___1_CM 1 100. 0. 1. DISPLAY_IDENTIFIER LV_READY_FTL_LE_CAN ECU_ADDRESS 0xd000969e BIT_MASK 0x10 /end MEASUREMENT
/begin MEASUREMENT fmy_stat_ftl_le_can.err_info_stat.lv_end_diag "end of diagnosis of the diagnosis instance FTL_LE_CAN" UWORD _CNV_S_2_RANGE__0___1_CM 1 100. 0. 1. DISPLAY_IDENTIFIER LV_END_DIAG_FTL_LE_CAN ECU_ADDRESS 0xd000969e BIT_MASK 0x20 /end MEASUREMENT
/begin MEASUREMENT fmy_stat_ftl_le_can.err_info_stat.lv_cdn_diag "diagnosis condition of the diagnosis instance FTL_LE_CAN" UWORD _CNV_S_2_RANGE__0___1_CM 1 100. 0. 1. DISPLAY_IDENTIFIER LV_CDN_DIAG_FTL_LE_CAN ECU_ADDRESS 0xd000969e BIT_MASK 0x40 /end MEASUREMENT
/begin MEASUREMENT fmy_stat_ftl_le_can.err_info_stat.err_sym "symptoms of the diagnosis instance FTL_LE_CAN" UWORD _CNV_S_16_RANGE_ERR__349_CM 1 100. 0. 15. DISPLAY_IDENTIFIER ERR_SYM_FTL_LE_CAN ECU_ADDRESS 0xd000969e BIT_MASK 0x780 /end MEASUREMENT
/begin MEASUREMENT fmy_stat_ftl_ri_can.ctr_abc "anti bounce counter for diagnosis instance FTL_RI_CAN" UBYTE _CNV_A_R_LINEAR_____0_CM 1 100. 0. 255. DISPLAY_IDENTIFIER CTR_ABC_FTL_RI_CAN ECU_ADDRESS 0xd00096a8 FORMAT "%3.0" /end MEASUREMENT
/begin MEASUREMENT fmy_stat_ftl_ri_can.ctr_end_diag "counter for end of diagnosis for diagnosis instance FTL_RI_CAN" UBYTE _CNV_A_R_LINEAR_____0_CM 1 100. 0. 255. DISPLAY_IDENTIFIER CTR_ABC_END_DIAG_FTL_RI_CAN ECU_ADDRESS 0xd00096a9 FORMAT "%3.0" /end MEASUREMENT
/begin MEASUREMENT fmy_stat_ftl_ri_can.err_info_stat.lv_err_mem "storage in dynamic failure memory of the diagnosis instance FTL_RI_CAN" UWORD _CNV_S_2_RANGE__0___1_CM 1 100. 0. 1. DISPLAY_IDENTIFIER LV_ERR_MEM_FTL_RI_CAN ECU_ADDRESS 0xd00096aa BIT_MASK 0x8 /end MEASUREMENT
/begin MEASUREMENT fmy_stat_ftl_ri_can.err_info_stat.lv_ready "readiness status of the diagnosis instance FTL_RI_CAN" UWORD _CNV_S_2_RANGE__0___1_CM 1 100. 0. 1. DISPLAY_IDENTIFIER LV_READY_FTL_RI_CAN ECU_ADDRESS 0xd00096aa BIT_MASK 0x10 /end MEASUREMENT
/begin MEASUREMENT fmy_stat_ftl_ri_can.err_info_stat.lv_end_diag "end of diagnosis of the diagnosis instance FTL_RI_CAN" UWORD _CNV_S_2_RANGE__0___1_CM 1 100. 0. 1. DISPLAY_IDENTIFIER LV_END_DIAG_FTL_RI_CAN ECU_ADDRESS 0xd00096aa BIT_MASK 0x20 /end MEASUREMENT
/begin MEASUREMENT fmy_stat_ftl_ri_can.err_info_stat.lv_cdn_diag "diagnosis condition of the diagnosis instance FTL_RI_CAN" UWORD _CNV_S_2_RANGE__0___1_CM 1 100. 0. 1. DISPLAY_IDENTIFIER LV_CDN_DIAG_FTL_RI_CAN ECU_ADDRESS 0xd00096aa BIT_MASK 0x40 /end MEASUREMENT
/begin MEASUREMENT fmy_stat_ftl_ri_can.err_info_stat.err_sym "symptoms of the diagnosis instance FTL_RI_CAN" UWORD _CNV_S_16_RANGE_ERR__349_CM 1 100. 0. 15. DISPLAY_IDENTIFIER ERR_SYM_FTL_RI_CAN ECU_ADDRESS 0xd00096aa BIT_MASK 0x780 /end MEASUREMENT
/begin MEASUREMENT fmy_stat_tia_plaus.ctr_abc "anti bounce counter for diagnosis instance TIA_PLAUS" UBYTE _CNV_A_R_LINEAR_____0_CM 1 100. 0. 255. DISPLAY_IDENTIFIER CTR_ABC_TIA_PLAUS ECU_ADDRESS 0xd0009a48 FORMAT "%3.0" /end MEASUREMENT
/begin MEASUREMENT fmy_stat_tia_plaus.ctr_end_diag "counter for end of diagnosis for diagnosis instance TIA_PLAUS" UBYTE _CNV_A_R_LINEAR_____0_CM 1 100. 0. 255. DISPLAY_IDENTIFIER CTR_ABC_END_DIAG_TIA_PLAUS ECU_ADDRESS 0xd0009a49 FORMAT "%3.0" /end MEASUREMENT
/begin MEASUREMENT fmy_stat_tia_plaus.err_info_stat.lv_err_mem "storage in dynamic failure memory of the diagnosis instance TIA_PLAUS" UWORD _CNV_S_2_RANGE__0___1_CM 1 100. 0. 1. DISPLAY_IDENTIFIER LV_ERR_MEM_TIA_PLAUS ECU_ADDRESS 0xd0009a4a BIT_MASK 0x8 /end MEASUREMENT
/begin MEASUREMENT fmy_stat_tia_plaus.err_info_stat.lv_ready "readiness status of the diagnosis instance TIA_PLAUS" UWORD _CNV_S_2_RANGE__0___1_CM 1 100. 0. 1. DISPLAY_IDENTIFIER LV_READY_TIA_PLAUS ECU_ADDRESS 0xd0009a4a BIT_MASK 0x10 /end MEASUREMENT
/begin MEASUREMENT fmy_stat_tia_plaus.err_info_stat.lv_end_diag "end of diagnosis of the diagnosis instance TIA_PLAUS" UWORD _CNV_S_2_RANGE__0___1_CM 1 100. 0. 1. DISPLAY_IDENTIFIER LV_END_DIAG_TIA_PLAUS ECU_ADDRESS 0xd0009a4a BIT_MASK 0x20 /end MEASUREMENT
/begin MEASUREMENT fmy_stat_tia_plaus.err_info_stat.lv_cdn_diag "diagnosis condition of the diagnosis instance TIA_PLAUS" UWORD _CNV_S_2_RANGE__0___1_CM 1 100. 0. 1. DISPLAY_IDENTIFIER LV_CDN_DIAG_TIA_PLAUS ECU_ADDRESS 0xd0009a4a BIT_MASK 0x40 /end MEASUREMENT
/begin MEASUREMENT fmy_stat_tia_plaus.err_info_stat.err_sym "symptoms of the diagnosis instance TIA_PLAUS" UWORD _CNV_S_16_RANGE_ERR__349_CM 1 100. 0. 15. DISPLAY_IDENTIFIER ERR_SYM_TIA_PLAUS ECU_ADDRESS 0xd0009a4a BIT_MASK 0x780 /end MEASUREMENT
/begin MEASUREMENT fmy_stat_tam_can.ctr_abc "anti bounce counter for diagnosis instance TAM_CAN" UBYTE _CNV_A_R_LINEAR_____0_CM 1 100. 0. 255. DISPLAY_IDENTIFIER CTR_ABC_TAM_CAN ECU_ADDRESS 0xd00099f4 FORMAT "%3.0" /end MEASUREMENT
/begin MEASUREMENT fmy_stat_tam_can.ctr_end_diag "counter for end of diagnosis for diagnosis instance TAM_CAN" UBYTE _CNV_A_R_LINEAR_____0_CM 1 100. 0. 255. DISPLAY_IDENTIFIER CTR_ABC_END_DIAG_TAM_CAN ECU_ADDRESS 0xd00099f5 FORMAT "%3.0" /end MEASUREMENT
/begin MEASUREMENT fmy_stat_tam_can.err_info_stat.lv_err_mem "storage in dynamic failure memory of the diagnosis instance TAM_CAN" UWORD _CNV_S_2_RANGE__0___1_CM 1 100. 0. 1. DISPLAY_IDENTIFIER LV_ERR_MEM_TAM_CAN ECU_ADDRESS 0xd00099f6 BIT_MASK 0x8 /end MEASUREMENT
/begin MEASUREMENT fmy_stat_tam_can.err_info_stat.lv_ready "readiness status of the diagnosis instance TAM_CAN" UWORD _CNV_S_2_RANGE__0___1_CM 1 100. 0. 1. DISPLAY_IDENTIFIER LV_READY_TAM_CAN ECU_ADDRESS 0xd00099f6 BIT_MASK 0x10 /end MEASUREMENT
/begin MEASUREMENT fmy_stat_tam_can.err_info_stat.lv_end_diag "end of diagnosis of the diagnosis instance TAM_CAN" UWORD _CNV_S_2_RANGE__0___1_CM 1 100. 0. 1. DISPLAY_IDENTIFIER LV_END_DIAG_TAM_CAN ECU_ADDRESS 0xd00099f6 BIT_MASK 0x20 /end MEASUREMENT
/begin MEASUREMENT fmy_stat_tam_can.err_info_stat.lv_cdn_diag "diagnosis condition of the diagnosis instance TAM_CAN" UWORD _CNV_S_2_RANGE__0___1_CM 1 100. 0. 1. DISPLAY_IDENTIFIER LV_CDN_DIAG_TAM_CAN ECU_ADDRESS 0xd00099f6 BIT_MASK 0x40 /end MEASUREMENT
/begin MEASUREMENT fmy_stat_tam_can.err_info_stat.err_sym "symptoms of the diagnosis instance TAM_CAN" UWORD _CNV_S_16_RANGE_ERR__349_CM 1 100. 0. 15. DISPLAY_IDENTIFIER ERR_SYM_TAM_CAN ECU_ADDRESS 0xd00099f6 BIT_MASK 0x780 /end MEASUREMENT
/begin MEASUREMENT fmy_stat_tam_plaus.ctr_abc "anti bounce counter for diagnosis instance TAM_PLAUS" UBYTE _CNV_A_R_LINEAR_____0_CM 1 100. 0. 255. DISPLAY_IDENTIFIER CTR_ABC_TAM_PLAUS ECU_ADDRESS 0xd00099f8 FORMAT "%3.0" /end MEASUREMENT
/begin MEASUREMENT fmy_stat_tam_plaus.ctr_end_diag "counter for end of diagnosis for diagnosis instance TAM_PLAUS" UBYTE _CNV_A_R_LINEAR_____0_CM 1 100. 0. 255. DISPLAY_IDENTIFIER CTR_ABC_END_DIAG_TAM_PLAUS ECU_ADDRESS 0xd00099f9 FORMAT "%3.0" /end MEASUREMENT
/begin MEASUREMENT fmy_stat_tam_plaus.err_info_stat.lv_err_mem "storage in dynamic failure memory of the diagnosis instance TAM_PLAUS" UWORD _CNV_S_2_RANGE__0___1_CM 1 100. 0. 1. DISPLAY_IDENTIFIER LV_ERR_MEM_TAM_PLAUS ECU_ADDRESS 0xd00099fa BIT_MASK 0x8 /end MEASUREMENT
/begin MEASUREMENT fmy_stat_tam_plaus.err_info_stat.lv_ready "readiness status of the diagnosis instance TAM_PLAUS" UWORD _CNV_S_2_RANGE__0___1_CM 1 100. 0. 1. DISPLAY_IDENTIFIER LV_READY_TAM_PLAUS ECU_ADDRESS 0xd00099fa BIT_MASK 0x10 /end MEASUREMENT
/begin MEASUREMENT fmy_stat_tam_plaus.err_info_stat.lv_end_diag "end of diagnosis of the diagnosis instance TAM_PLAUS" UWORD _CNV_S_2_RANGE__0___1_CM 1 100. 0. 1. DISPLAY_IDENTIFIER LV_END_DIAG_TAM_PLAUS ECU_ADDRESS 0xd00099fa BIT_MASK 0x20 /end MEASUREMENT
/begin MEASUREMENT fmy_stat_tam_plaus.err_info_stat.lv_cdn_diag "diagnosis condition of the diagnosis instance TAM_PLAUS" UWORD _CNV_S_2_RANGE__0___1_CM 1 100. 0. 1. DISPLAY_IDENTIFIER LV_CDN_DIAG_TAM_PLAUS ECU_ADDRESS 0xd00099fa BIT_MASK 0x40 /end MEASUREMENT
/begin MEASUREMENT fmy_stat_tam_plaus.err_info_stat.err_sym "symptoms of the diagnosis instance TAM_PLAUS" UWORD _CNV_S_16_RANGE_ERR__349_CM 1 100. 0. 15. DISPLAY_IDENTIFIER ERR_SYM_TAM_PLAUS ECU_ADDRESS 0xd00099fa BIT_MASK 0x780 /end MEASUREMENT
/begin MEASUREMENT fmy_stat_map_shift_1.ctr_abc "anti bounce counter for diagnosis instance MAP_SHIFT_1" UBYTE _CNV_A_R_LINEAR_____0_CM 1 100. 0. 255. DISPLAY_IDENTIFIER CTR_ABC_MAP_SHIFT_1 ECU_ADDRESS 0xd0009818 FORMAT "%3.0" /end MEASUREMENT
/begin MEASUREMENT fmy_stat_map_shift_1.ctr_end_diag "counter for end of diagnosis for diagnosis instance MAP_SHIFT_1" UBYTE _CNV_A_R_LINEAR_____0_CM 1 100. 0. 255. DISPLAY_IDENTIFIER CTR_ABC_END_DIAG_MAP_SHIFT_1 ECU_ADDRESS 0xd0009819 FORMAT "%3.0" /end MEASUREMENT
/begin MEASUREMENT fmy_stat_map_shift_1.err_info_stat.lv_err_mem "storage in dynamic failure memory of the diagnosis instance MAP_SHIFT_1" UWORD _CNV_S_2_RANGE__0___1_CM 1 100. 0. 1. DISPLAY_IDENTIFIER LV_ERR_MEM_MAP_SHIFT_1 ECU_ADDRESS 0xd000981a BIT_MASK 0x8 /end MEASUREMENT
/begin MEASUREMENT fmy_stat_map_shift_1.err_info_stat.lv_ready "readiness status of the diagnosis instance MAP_SHIFT_1" UWORD _CNV_S_2_RANGE__0___1_CM 1 100. 0. 1. DISPLAY_IDENTIFIER LV_READY_MAP_SHIFT_1 ECU_ADDRESS 0xd000981a BIT_MASK 0x10 /end MEASUREMENT
/begin MEASUREMENT fmy_stat_map_shift_1.err_info_stat.lv_end_diag "end of diagnosis of the diagnosis instance MAP_SHIFT_1" UWORD _CNV_S_2_RANGE__0___1_CM 1 100. 0. 1. DISPLAY_IDENTIFIER LV_END_DIAG_MAP_SHIFT_1 ECU_ADDRESS 0xd000981a BIT_MASK 0x20 /end MEASUREMENT
/begin MEASUREMENT fmy_stat_map_shift_1.err_info_stat.lv_cdn_diag "diagnosis condition of the diagnosis instance MAP_SHIFT_1" UWORD _CNV_S_2_RANGE__0___1_CM 1 100. 0. 1. DISPLAY_IDENTIFIER LV_CDN_DIAG_MAP_SHIFT_1 ECU_ADDRESS 0xd000981a BIT_MASK 0x40 /end MEASUREMENT
/begin MEASUREMENT fmy_stat_map_shift_1.err_info_stat.err_sym "symptoms of the diagnosis instance MAP_SHIFT_1" UWORD _CNV_S_16_RANGE_ERR__349_CM 1 100. 0. 15. DISPLAY_IDENTIFIER ERR_SYM_MAP_SHIFT_1 ECU_ADDRESS 0xd000981a BIT_MASK 0x780 /end MEASUREMENT
/begin MEASUREMENT fmy_stat_map_shift_2.ctr_abc "anti bounce counter for diagnosis instance MAP_SHIFT_2" UBYTE _CNV_A_R_LINEAR_____0_CM 1 100. 0. 255. DISPLAY_IDENTIFIER CTR_ABC_MAP_SHIFT_2 ECU_ADDRESS 0xd000981c FORMAT "%3.0" /end MEASUREMENT
/begin MEASUREMENT fmy_stat_map_shift_2.ctr_end_diag "counter for end of diagnosis for diagnosis instance MAP_SHIFT_2" UBYTE _CNV_A_R_LINEAR_____0_CM 1 100. 0. 255. DISPLAY_IDENTIFIER CTR_ABC_END_DIAG_MAP_SHIFT_2 ECU_ADDRESS 0xd000981d FORMAT "%3.0" /end MEASUREMENT
/begin MEASUREMENT fmy_stat_map_shift_2.err_info_stat.lv_err_mem "storage in dynamic failure memory of the diagnosis instance MAP_SHIFT_2" UWORD _CNV_S_2_RANGE__0___1_CM 1 100. 0. 1. DISPLAY_IDENTIFIER LV_ERR_MEM_MAP_SHIFT_2 ECU_ADDRESS 0xd000981e BIT_MASK 0x8 /end MEASUREMENT
/begin MEASUREMENT fmy_stat_map_shift_2.err_info_stat.lv_ready "readiness status of the diagnosis instance MAP_SHIFT_2" UWORD _CNV_S_2_RANGE__0___1_CM 1 100. 0. 1. DISPLAY_IDENTIFIER LV_READY_MAP_SHIFT_2 ECU_ADDRESS 0xd000981e BIT_MASK 0x10 /end MEASUREMENT
/begin MEASUREMENT fmy_stat_map_shift_2.err_info_stat.lv_end_diag "end of diagnosis of the diagnosis instance MAP_SHIFT_2" UWORD _CNV_S_2_RANGE__0___1_CM 1 100. 0. 1. DISPLAY_IDENTIFIER LV_END_DIAG_MAP_SHIFT_2 ECU_ADDRESS 0xd000981e BIT_MASK 0x20 /end MEASUREMENT
/begin MEASUREMENT fmy_stat_map_shift_2.err_info_stat.lv_cdn_diag "diagnosis condition of the diagnosis instance MAP_SHIFT_2" UWORD _CNV_S_2_RANGE__0___1_CM 1 100. 0. 1. DISPLAY_IDENTIFIER LV_CDN_DIAG_MAP_SHIFT_2 ECU_ADDRESS 0xd000981e BIT_MASK 0x40 /end MEASUREMENT
/begin MEASUREMENT fmy_stat_map_shift_2.err_info_stat.err_sym "symptoms of the diagnosis instance MAP_SHIFT_2" UWORD _CNV_S_16_RANGE_ERR__349_CM 1 100. 0. 15. DISPLAY_IDENTIFIER ERR_SYM_MAP_SHIFT_2 ECU_ADDRESS 0xd000981e BIT_MASK 0x780 /end MEASUREMENT
/begin MEASUREMENT fmy_stat_cat_diag_1.ctr_abc "anti bounce counter for diagnosis instance CAT_DIAG_1" UBYTE _CNV_A_R_LINEAR_____0_CM 1 100. 0. 255. DISPLAY_IDENTIFIER CTR_ABC_CAT_DIAG_1 ECU_ADDRESS 0xd0009484 FORMAT "%3.0" /end MEASUREMENT
/begin MEASUREMENT fmy_stat_cat_diag_1.ctr_end_diag "counter for end of diagnosis for diagnosis instance CAT_DIAG_1" UBYTE _CNV_A_R_LINEAR_____0_CM 1 100. 0. 255. DISPLAY_IDENTIFIER CTR_ABC_END_DIAG_CAT_DIAG_1 ECU_ADDRESS 0xd0009485 FORMAT "%3.0" /end MEASUREMENT
/begin MEASUREMENT fmy_stat_cat_diag_1.err_info_stat.lv_err_mem "storage in dynamic failure memory of the diagnosis instance CAT_DIAG_1" UWORD _CNV_S_2_RANGE__0___1_CM 1 100. 0. 1. DISPLAY_IDENTIFIER LV_ERR_MEM_CAT_DIAG_1 ECU_ADDRESS 0xd0009486 BIT_MASK 0x8 /end MEASUREMENT
/begin MEASUREMENT fmy_stat_cat_diag_1.err_info_stat.lv_ready "readiness status of the diagnosis instance CAT_DIAG_1" UWORD _CNV_S_2_RANGE__0___1_CM 1 100. 0. 1. DISPLAY_IDENTIFIER LV_READY_CAT_DIAG_1 ECU_ADDRESS 0xd0009486 BIT_MASK 0x10 /end MEASUREMENT
/begin MEASUREMENT fmy_stat_cat_diag_1.err_info_stat.lv_end_diag "end of diagnosis of the diagnosis instance CAT_DIAG_1" UWORD _CNV_S_2_RANGE__0___1_CM 1 100. 0. 1. DISPLAY_IDENTIFIER LV_END_DIAG_CAT_DIAG_1 ECU_ADDRESS 0xd0009486 BIT_MASK 0x20 /end MEASUREMENT
/begin MEASUREMENT fmy_stat_cat_diag_1.err_info_stat.lv_cdn_diag "diagnosis condition of the diagnosis instance CAT_DIAG_1" UWORD _CNV_S_2_RANGE__0___1_CM 1 100. 0. 1. DISPLAY_IDENTIFIER LV_CDN_DIAG_CAT_DIAG_1 ECU_ADDRESS 0xd0009486 BIT_MASK 0x40 /end MEASUREMENT
/begin MEASUREMENT fmy_stat_cat_diag_1.err_info_stat.err_sym "symptoms of the diagnosis instance CAT_DIAG_1" UWORD _CNV_S_16_RANGE_ERR__349_CM 1 100. 0. 15. DISPLAY_IDENTIFIER ERR_SYM_CAT_DIAG_1 ECU_ADDRESS 0xd0009486 BIT_MASK 0x780 /end MEASUREMENT
/begin MEASUREMENT fmy_stat_cat_diag_2.ctr_abc "anti bounce counter for diagnosis instance CAT_DIAG_2" UBYTE _CNV_A_R_LINEAR_____0_CM 1 100. 0. 255. DISPLAY_IDENTIFIER CTR_ABC_CAT_DIAG_2 ECU_ADDRESS 0xd0009488 FORMAT "%3.0" /end MEASUREMENT
/begin MEASUREMENT fmy_stat_cat_diag_2.ctr_end_diag "counter for end of diagnosis for diagnosis instance CAT_DIAG_2" UBYTE _CNV_A_R_LINEAR_____0_CM 1 100. 0. 255. DISPLAY_IDENTIFIER CTR_ABC_END_DIAG_CAT_DIAG_2 ECU_ADDRESS 0xd0009489 FORMAT "%3.0" /end MEASUREMENT
/begin MEASUREMENT fmy_stat_cat_diag_2.err_info_stat.lv_err_mem "storage in dynamic failure memory of the diagnosis instance CAT_DIAG_2" UWORD _CNV_S_2_RANGE__0___1_CM 1 100. 0. 1. DISPLAY_IDENTIFIER LV_ERR_MEM_CAT_DIAG_2 ECU_ADDRESS 0xd000948a BIT_MASK 0x8 /end MEASUREMENT
/begin MEASUREMENT fmy_stat_cat_diag_2.err_info_stat.lv_ready "readiness status of the diagnosis instance CAT_DIAG_2" UWORD _CNV_S_2_RANGE__0___1_CM 1 100. 0. 1. DISPLAY_IDENTIFIER LV_READY_CAT_DIAG_2 ECU_ADDRESS 0xd000948a BIT_MASK 0x10 /end MEASUREMENT
/begin MEASUREMENT fmy_stat_cat_diag_2.err_info_stat.lv_end_diag "end of diagnosis of the diagnosis instance CAT_DIAG_2" UWORD _CNV_S_2_RANGE__0___1_CM 1 100. 0. 1. DISPLAY_IDENTIFIER LV_END_DIAG_CAT_DIAG_2 ECU_ADDRESS 0xd000948a BIT_MASK 0x20 /end MEASUREMENT
/begin MEASUREMENT fmy_stat_cat_diag_2.err_info_stat.lv_cdn_diag "diagnosis condition of the diagnosis instance CAT_DIAG_2" UWORD _CNV_S_2_RANGE__0___1_CM 1 100. 0. 1. DISPLAY_IDENTIFIER LV_CDN_DIAG_CAT_DIAG_2 ECU_ADDRESS 0xd000948a BIT_MASK 0x40 /end MEASUREMENT
/begin MEASUREMENT fmy_stat_cat_diag_2.err_info_stat.err_sym "symptoms of the diagnosis instance CAT_DIAG_2" UWORD _CNV_S_16_RANGE_ERR__349_CM 1 100. 0. 15. DISPLAY_IDENTIFIER ERR_SYM_CAT_DIAG_2 ECU_ADDRESS 0xd000948a BIT_MASK 0x780 /end MEASUREMENT
/begin MEASUREMENT fmy_stat_cat_diag_afl_1.ctr_abc "anti bounce counter for diagnosis instance CAT_DIAG_AFL_1" UBYTE _CNV_A_R_LINEAR_____0_CM 1 100. 0. 255. DISPLAY_IDENTIFIER CTR_ABC_CAT_DIAG_AFL_1 ECU_ADDRESS 0xd000948c FORMAT "%3.0" /end MEASUREMENT
/begin MEASUREMENT fmy_stat_cat_diag_afl_1.ctr_end_diag "counter for end of diagnosis for diagnosis instance CAT_DIAG_AFL_1" UBYTE _CNV_A_R_LINEAR_____0_CM 1 100. 0. 255. DISPLAY_IDENTIFIER CTR_ABC_END_DIAG_CAT_DIAG_AFL_1 ECU_ADDRESS 0xd000948d FORMAT "%3.0" /end MEASUREMENT
/begin MEASUREMENT fmy_stat_cat_diag_afl_1.err_info_stat.lv_err_mem "storage in dynamic failure memory of the diagnosis instance CAT_DIAG_AFL_1" UWORD _CNV_S_2_RANGE__0___1_CM 1 100. 0. 1. DISPLAY_IDENTIFIER LV_ERR_MEM_CAT_DIAG_AFL_1 ECU_ADDRESS 0xd000948e BIT_MASK 0x8 /end MEASUREMENT
/begin MEASUREMENT fmy_stat_cat_diag_afl_1.err_info_stat.lv_ready "readiness status of the diagnosis instance CAT_DIAG_AFL_1" UWORD _CNV_S_2_RANGE__0___1_CM 1 100. 0. 1. DISPLAY_IDENTIFIER LV_READY_CAT_DIAG_AFL_1 ECU_ADDRESS 0xd000948e BIT_MASK 0x10 /end MEASUREMENT
/begin MEASUREMENT fmy_stat_cat_diag_afl_1.err_info_stat.lv_end_diag "end of diagnosis of the diagnosis instance CAT_DIAG_AFL_1" UWORD _CNV_S_2_RANGE__0___1_CM 1 100. 0. 1. DISPLAY_IDENTIFIER LV_END_DIAG_CAT_DIAG_AFL_1 ECU_ADDRESS 0xd000948e BIT_MASK 0x20 /end MEASUREMENT
/begin MEASUREMENT fmy_stat_cat_diag_afl_1.err_info_stat.lv_cdn_diag "diagnosis condition of the diagnosis instance CAT_DIAG_AFL_1" UWORD _CNV_S_2_RANGE__0___1_CM 1 100. 0. 1. DISPLAY_IDENTIFIER LV_CDN_DIAG_CAT_DIAG_AFL_1 ECU_ADDRESS 0xd000948e BIT_MASK 0x40 /end MEASUREMENT
/begin MEASUREMENT fmy_stat_cat_diag_afl_1.err_info_stat.err_sym "symptoms of the diagnosis instance CAT_DIAG_AFL_1" UWORD _CNV_S_16_RANGE_ERR__349_CM 1 100. 0. 15. DISPLAY_IDENTIFIER ERR_SYM_CAT_DIAG_AFL_1 ECU_ADDRESS 0xd000948e BIT_MASK 0x780 /end MEASUREMENT
/begin MEASUREMENT fmy_stat_cat_diag_afl_2.ctr_abc "anti bounce counter for diagnosis instance CAT_DIAG_AFL_2" UBYTE _CNV_A_R_LINEAR_____0_CM 1 100. 0. 255. DISPLAY_IDENTIFIER CTR_ABC_CAT_DIAG_AFL_2 ECU_ADDRESS 0xd0009490 FORMAT "%3.0" /end MEASUREMENT
/begin MEASUREMENT fmy_stat_cat_diag_afl_2.ctr_end_diag "counter for end of diagnosis for diagnosis instance CAT_DIAG_AFL_2" UBYTE _CNV_A_R_LINEAR_____0_CM 1 100. 0. 255. DISPLAY_IDENTIFIER CTR_ABC_END_DIAG_CAT_DIAG_AFL_2 ECU_ADDRESS 0xd0009491 FORMAT "%3.0" /end MEASUREMENT
/begin MEASUREMENT fmy_stat_cat_diag_afl_2.err_info_stat.lv_err_mem "storage in dynamic failure memory of the diagnosis instance CAT_DIAG_AFL_2" UWORD _CNV_S_2_RANGE__0___1_CM 1 100. 0. 1. DISPLAY_IDENTIFIER LV_ERR_MEM_CAT_DIAG_AFL_2 ECU_ADDRESS 0xd0009492 BIT_MASK 0x8 /end MEASUREMENT
/begin MEASUREMENT fmy_stat_cat_diag_afl_2.err_info_stat.lv_ready "readiness status of the diagnosis instance CAT_DIAG_AFL_2" UWORD _CNV_S_2_RANGE__0___1_CM 1 100. 0. 1. DISPLAY_IDENTIFIER LV_READY_CAT_DIAG_AFL_2 ECU_ADDRESS 0xd0009492 BIT_MASK 0x10 /end MEASUREMENT
/begin MEASUREMENT fmy_stat_cat_diag_afl_2.err_info_stat.lv_end_diag "end of diagnosis of the diagnosis instance CAT_DIAG_AFL_2" UWORD _CNV_S_2_RANGE__0___1_CM 1 100. 0. 1. DISPLAY_IDENTIFIER LV_END_DIAG_CAT_DIAG_AFL_2 ECU_ADDRESS 0xd0009492 BIT_MASK 0x20 /end MEASUREMENT
/begin MEASUREMENT fmy_stat_cat_diag_afl_2.err_info_stat.lv_cdn_diag "diagnosis condition of the diagnosis instance CAT_DIAG_AFL_2" UWORD _CNV_S_2_RANGE__0___1_CM 1 100. 0. 1. DISPLAY_IDENTIFIER LV_CDN_DIAG_CAT_DIAG_AFL_2 ECU_ADDRESS 0xd0009492 BIT_MASK 0x40 /end MEASUREMENT
/begin MEASUREMENT fmy_stat_cat_diag_afl_2.err_info_stat.err_sym "symptoms of the diagnosis instance CAT_DIAG_AFL_2" UWORD _CNV_S_16_RANGE_ERR__349_CM 1 100. 0. 15. DISPLAY_IDENTIFIER ERR_SYM_CAT_DIAG_AFL_2 ECU_ADDRESS 0xd0009492 BIT_MASK 0x780 /end MEASUREMENT
/begin MEASUREMENT fmy_stat_scg_ls_down_1.ctr_abc "anti bounce counter for diagnosis instance SCG_LS_DOWN_1" UBYTE _CNV_A_R_LINEAR_____0_CM 1 100. 0. 255. DISPLAY_IDENTIFIER CTR_ABC_SCG_LS_DOWN_1 ECU_ADDRESS 0xd0009964 FORMAT "%3.0" /end MEASUREMENT
/begin MEASUREMENT fmy_stat_scg_ls_down_1.ctr_end_diag "counter for end of diagnosis for diagnosis instance SCG_LS_DOWN_1" UBYTE _CNV_A_R_LINEAR_____0_CM 1 100. 0. 255. DISPLAY_IDENTIFIER CTR_ABC_END_DIAG_SCG_LS_DOWN_1 ECU_ADDRESS 0xd0009965 FORMAT "%3.0" /end MEASUREMENT
/begin MEASUREMENT fmy_stat_scg_ls_down_1.err_info_stat.lv_err_mem "storage in dynamic failure memory of the diagnosis instance SCG_LS_DOWN_1" UWORD _CNV_S_2_RANGE__0___1_CM 1 100. 0. 1. DISPLAY_IDENTIFIER LV_ERR_MEM_SCG_LS_DOWN_1 ECU_ADDRESS 0xd0009966 BIT_MASK 0x8 /end MEASUREMENT
/begin MEASUREMENT fmy_stat_scg_ls_down_1.err_info_stat.lv_ready "readiness status of the diagnosis instance SCG_LS_DOWN_1" UWORD _CNV_S_2_RANGE__0___1_CM 1 100. 0. 1. DISPLAY_IDENTIFIER LV_READY_SCG_LS_DOWN_1 ECU_ADDRESS 0xd0009966 BIT_MASK 0x10 /end MEASUREMENT
/begin MEASUREMENT fmy_stat_scg_ls_down_1.err_info_stat.lv_end_diag "end of diagnosis of the diagnosis instance SCG_LS_DOWN_1" UWORD _CNV_S_2_RANGE__0___1_CM 1 100. 0. 1. DISPLAY_IDENTIFIER LV_END_DIAG_SCG_LS_DOWN_1 ECU_ADDRESS 0xd0009966 BIT_MASK 0x20 /end MEASUREMENT
/begin MEASUREMENT fmy_stat_scg_ls_down_1.err_info_stat.lv_cdn_diag "diagnosis condition of the diagnosis instance SCG_LS_DOWN_1" UWORD _CNV_S_2_RANGE__0___1_CM 1 100. 0. 1. DISPLAY_IDENTIFIER LV_CDN_DIAG_SCG_LS_DOWN_1 ECU_ADDRESS 0xd0009966 BIT_MASK 0x40 /end MEASUREMENT
/begin MEASUREMENT fmy_stat_scg_ls_down_1.err_info_stat.err_sym "symptoms of the diagnosis instance SCG_LS_DOWN_1" UWORD _CNV_S_16_RANGE_ERR__349_CM 1 100. 0. 15. DISPLAY_IDENTIFIER ERR_SYM_SCG_LS_DOWN_1 ECU_ADDRESS 0xd0009966 BIT_MASK 0x780 /end MEASUREMENT
/begin MEASUREMENT fmy_stat_scp_ls_down_1.ctr_abc "anti bounce counter for diagnosis instance SCP_LS_DOWN_1" UBYTE _CNV_A_R_LINEAR_____0_CM 1 100. 0. 255. DISPLAY_IDENTIFIER CTR_ABC_SCP_LS_DOWN_1 ECU_ADDRESS 0xd000996c FORMAT "%3.0" /end MEASUREMENT
/begin MEASUREMENT fmy_stat_scp_ls_down_1.ctr_end_diag "counter for end of diagnosis for diagnosis instance SCP_LS_DOWN_1" UBYTE _CNV_A_R_LINEAR_____0_CM 1 100. 0. 255. DISPLAY_IDENTIFIER CTR_ABC_END_DIAG_SCP_LS_DOWN_1 ECU_ADDRESS 0xd000996d FORMAT "%3.0" /end MEASUREMENT
/begin MEASUREMENT fmy_stat_scp_ls_down_1.err_info_stat.lv_err_mem "storage in dynamic failure memory of the diagnosis instance SCP_LS_DOWN_1" UWORD _CNV_S_2_RANGE__0___1_CM 1 100. 0. 1. DISPLAY_IDENTIFIER LV_ERR_MEM_SCP_LS_DOWN_1 ECU_ADDRESS 0xd000996e BIT_MASK 0x8 /end MEASUREMENT
/begin MEASUREMENT fmy_stat_scp_ls_down_1.err_info_stat.lv_ready "readiness status of the diagnosis instance SCP_LS_DOWN_1" UWORD _CNV_S_2_RANGE__0___1_CM 1 100. 0. 1. DISPLAY_IDENTIFIER LV_READY_SCP_LS_DOWN_1 ECU_ADDRESS 0xd000996e BIT_MASK 0x10 /end MEASUREMENT
/begin MEASUREMENT fmy_stat_scp_ls_down_1.err_info_stat.lv_end_diag "end of diagnosis of the diagnosis instance SCP_LS_DOWN_1" UWORD _CNV_S_2_RANGE__0___1_CM 1 100. 0. 1. DISPLAY_IDENTIFIER LV_END_DIAG_SCP_LS_DOWN_1 ECU_ADDRESS 0xd000996e BIT_MASK 0x20 /end MEASUREMENT
/begin MEASUREMENT fmy_stat_scp_ls_down_1.err_info_stat.lv_cdn_diag "diagnosis condition of the diagnosis instance SCP_LS_DOWN_1" UWORD _CNV_S_2_RANGE__0___1_CM 1 100. 0. 1. DISPLAY_IDENTIFIER LV_CDN_DIAG_SCP_LS_DOWN_1 ECU_ADDRESS 0xd000996e BIT_MASK 0x40 /end MEASUREMENT
/begin MEASUREMENT fmy_stat_scp_ls_down_1.err_info_stat.err_sym "symptoms of the diagnosis instance SCP_LS_DOWN_1" UWORD _CNV_S_16_RANGE_ERR__349_CM 1 100. 0. 15. DISPLAY_IDENTIFIER ERR_SYM_SCP_LS_DOWN_1 ECU_ADDRESS 0xd000996e BIT_MASK 0x780 /end MEASUREMENT
/begin MEASUREMENT fmy_stat_oc_ls_down_1.ctr_abc "anti bounce counter for diagnosis instance OC_LS_DOWN_1" UBYTE _CNV_A_R_LINEAR_____0_CM 1 100. 0. 255. DISPLAY_IDENTIFIER CTR_ABC_OC_LS_DOWN_1 ECU_ADDRESS 0xd0009894 FORMAT "%3.0" /end MEASUREMENT
/begin MEASUREMENT fmy_stat_oc_ls_down_1.ctr_end_diag "counter for end of diagnosis for diagnosis instance OC_LS_DOWN_1" UBYTE _CNV_A_R_LINEAR_____0_CM 1 100. 0. 255. DISPLAY_IDENTIFIER CTR_ABC_END_DIAG_OC_LS_DOWN_1 ECU_ADDRESS 0xd0009895 FORMAT "%3.0" /end MEASUREMENT
/begin MEASUREMENT fmy_stat_oc_ls_down_1.err_info_stat.lv_err_mem "storage in dynamic failure memory of the diagnosis instance OC_LS_DOWN_1" UWORD _CNV_S_2_RANGE__0___1_CM 1 100. 0. 1. DISPLAY_IDENTIFIER LV_ERR_MEM_OC_LS_DOWN_1 ECU_ADDRESS 0xd0009896 BIT_MASK 0x8 /end MEASUREMENT
/begin MEASUREMENT fmy_stat_oc_ls_down_1.err_info_stat.lv_ready "readiness status of the diagnosis instance OC_LS_DOWN_1" UWORD _CNV_S_2_RANGE__0___1_CM 1 100. 0. 1. DISPLAY_IDENTIFIER LV_READY_OC_LS_DOWN_1 ECU_ADDRESS 0xd0009896 BIT_MASK 0x10 /end MEASUREMENT
/begin MEASUREMENT fmy_stat_oc_ls_down_1.err_info_stat.lv_end_diag "end of diagnosis of the diagnosis instance OC_LS_DOWN_1" UWORD _CNV_S_2_RANGE__0___1_CM 1 100. 0. 1. DISPLAY_IDENTIFIER LV_END_DIAG_OC_LS_DOWN_1 ECU_ADDRESS 0xd0009896 BIT_MASK 0x20 /end MEASUREMENT
/begin MEASUREMENT fmy_stat_oc_ls_down_1.err_info_stat.lv_cdn_diag "diagnosis condition of the diagnosis instance OC_LS_DOWN_1" UWORD _CNV_S_2_RANGE__0___1_CM 1 100. 0. 1. DISPLAY_IDENTIFIER LV_CDN_DIAG_OC_LS_DOWN_1 ECU_ADDRESS 0xd0009896 BIT_MASK 0x40 /end MEASUREMENT
/begin MEASUREMENT fmy_stat_oc_ls_down_1.err_info_stat.err_sym "symptoms of the diagnosis instance OC_LS_DOWN_1" UWORD _CNV_S_16_RANGE_ERR__349_CM 1 100. 0. 15. DISPLAY_IDENTIFIER ERR_SYM_OC_LS_DOWN_1 ECU_ADDRESS 0xd0009896 BIT_MASK 0x780 /end MEASUREMENT
/begin MEASUREMENT fmy_stat_puc_ls_down_1.ctr_abc "anti bounce counter for diagnosis instance PUC_LS_DOWN_1" UBYTE _CNV_A_R_LINEAR_____0_CM 1 100. 0. 255. DISPLAY_IDENTIFIER CTR_ABC_PUC_LS_DOWN_1 ECU_ADDRESS 0xd00098ec FORMAT "%3.0" /end MEASUREMENT
/begin MEASUREMENT fmy_stat_puc_ls_down_1.ctr_end_diag "counter for end of diagnosis for diagnosis instance PUC_LS_DOWN_1" UBYTE _CNV_A_R_LINEAR_____0_CM 1 100. 0. 255. DISPLAY_IDENTIFIER CTR_ABC_END_DIAG_PUC_LS_DOWN_1 ECU_ADDRESS 0xd00098ed FORMAT "%3.0" /end MEASUREMENT
/begin MEASUREMENT fmy_stat_puc_ls_down_1.err_info_stat.lv_err_mem "storage in dynamic failure memory of the diagnosis instance PUC_LS_DOWN_1" UWORD _CNV_S_2_RANGE__0___1_CM 1 100. 0. 1. DISPLAY_IDENTIFIER LV_ERR_MEM_PUC_LS_DOWN_1 ECU_ADDRESS 0xd00098ee BIT_MASK 0x8 /end MEASUREMENT
/begin MEASUREMENT fmy_stat_puc_ls_down_1.err_info_stat.lv_ready "readiness status of the diagnosis instance PUC_LS_DOWN_1" UWORD _CNV_S_2_RANGE__0___1_CM 1 100. 0. 1. DISPLAY_IDENTIFIER LV_READY_PUC_LS_DOWN_1 ECU_ADDRESS 0xd00098ee BIT_MASK 0x10 /end MEASUREMENT
/begin MEASUREMENT fmy_stat_puc_ls_down_1.err_info_stat.lv_end_diag "end of diagnosis of the diagnosis instance PUC_LS_DOWN_1" UWORD _CNV_S_2_RANGE__0___1_CM 1 100. 0. 1. DISPLAY_IDENTIFIER LV_END_DIAG_PUC_LS_DOWN_1 ECU_ADDRESS 0xd00098ee BIT_MASK 0x20 /end MEASUREMENT
/begin MEASUREMENT fmy_stat_puc_ls_down_1.err_info_stat.lv_cdn_diag "diagnosis condition of the diagnosis instance PUC_LS_DOWN_1" UWORD _CNV_S_2_RANGE__0___1_CM 1 100. 0. 1. DISPLAY_IDENTIFIER LV_CDN_DIAG_PUC_LS_DOWN_1 ECU_ADDRESS 0xd00098ee BIT_MASK 0x40 /end MEASUREMENT
/begin MEASUREMENT fmy_stat_puc_ls_down_1.err_info_stat.err_sym "symptoms of the diagnosis instance PUC_LS_DOWN_1" UWORD _CNV_S_16_RANGE_ERR__349_CM 1 100. 0. 15. DISPLAY_IDENTIFIER ERR_SYM_PUC_LS_DOWN_1 ECU_ADDRESS 0xd00098ee BIT_MASK 0x780 /end MEASUREMENT
/begin MEASUREMENT fmy_stat_fl_ls_down_1.ctr_abc "anti bounce counter for diagnosis instance FL_LS_DOWN_1" UBYTE _CNV_A_R_LINEAR_____0_CM 1 100. 0. 255. DISPLAY_IDENTIFIER CTR_ABC_FL_LS_DOWN_1 ECU_ADDRESS 0xd000967c FORMAT "%3.0" /end MEASUREMENT
/begin MEASUREMENT fmy_stat_fl_ls_down_1.ctr_end_diag "counter for end of diagnosis for diagnosis instance FL_LS_DOWN_1" UBYTE _CNV_A_R_LINEAR_____0_CM 1 100. 0. 255. DISPLAY_IDENTIFIER CTR_ABC_END_DIAG_FL_LS_DOWN_1 ECU_ADDRESS 0xd000967d FORMAT "%3.0" /end MEASUREMENT
/begin MEASUREMENT fmy_stat_fl_ls_down_1.err_info_stat.lv_err_mem "storage in dynamic failure memory of the diagnosis instance FL_LS_DOWN_1" UWORD _CNV_S_2_RANGE__0___1_CM 1 100. 0. 1. DISPLAY_IDENTIFIER LV_ERR_MEM_FL_LS_DOWN_1 ECU_ADDRESS 0xd000967e BIT_MASK 0x8 /end MEASUREMENT
/begin MEASUREMENT fmy_stat_fl_ls_down_1.err_info_stat.lv_ready "readiness status of the diagnosis instance FL_LS_DOWN_1" UWORD _CNV_S_2_RANGE__0___1_CM 1 100. 0. 1. DISPLAY_IDENTIFIER LV_READY_FL_LS_DOWN_1 ECU_ADDRESS 0xd000967e BIT_MASK 0x10 /end MEASUREMENT
/begin MEASUREMENT fmy_stat_fl_ls_down_1.err_info_stat.lv_end_diag "end of diagnosis of the diagnosis instance FL_LS_DOWN_1" UWORD _CNV_S_2_RANGE__0___1_CM 1 100. 0. 1. DISPLAY_IDENTIFIER LV_END_DIAG_FL_LS_DOWN_1 ECU_ADDRESS 0xd000967e BIT_MASK 0x20 /end MEASUREMENT
/begin MEASUREMENT fmy_stat_fl_ls_down_1.err_info_stat.lv_cdn_diag "diagnosis condition of the diagnosis instance FL_LS_DOWN_1" UWORD _CNV_S_2_RANGE__0___1_CM 1 100. 0. 1. DISPLAY_IDENTIFIER LV_CDN_DIAG_FL_LS_DOWN_1 ECU_ADDRESS 0xd000967e BIT_MASK 0x40 /end MEASUREMENT
/begin MEASUREMENT fmy_stat_fl_ls_down_1.err_info_stat.err_sym "symptoms of the diagnosis instance FL_LS_DOWN_1" UWORD _CNV_S_16_RANGE_ERR__349_CM 1 100. 0. 15. DISPLAY_IDENTIFIER ERR_SYM_FL_LS_DOWN_1 ECU_ADDRESS 0xd000967e BIT_MASK 0x780 /end MEASUREMENT
/begin MEASUREMENT fmy_stat_lsl_up_if_1.ctr_abc "anti bounce counter for diagnosis instance LSL_UP_IF_1" UBYTE _CNV_A_R_LINEAR_____0_CM 1 100. 0. 255. DISPLAY_IDENTIFIER CTR_ABC_LSL_UP_IF_1 ECU_ADDRESS 0xd00097e4 FORMAT "%3.0" /end MEASUREMENT
/begin MEASUREMENT fmy_stat_lsl_up_if_1.ctr_end_diag "counter for end of diagnosis for diagnosis instance LSL_UP_IF_1" UBYTE _CNV_A_R_LINEAR_____0_CM 1 100. 0. 255. DISPLAY_IDENTIFIER CTR_ABC_END_DIAG_LSL_UP_IF_1 ECU_ADDRESS 0xd00097e5 FORMAT "%3.0" /end MEASUREMENT
/begin MEASUREMENT fmy_stat_lsl_up_if_1.err_info_stat.lv_err_mem "storage in dynamic failure memory of the diagnosis instance LSL_UP_IF_1" UWORD _CNV_S_2_RANGE__0___1_CM 1 100. 0. 1. DISPLAY_IDENTIFIER LV_ERR_MEM_LSL_UP_IF_1 ECU_ADDRESS 0xd00097e6 BIT_MASK 0x8 /end MEASUREMENT
/begin MEASUREMENT fmy_stat_lsl_up_if_1.err_info_stat.lv_ready "readiness status of the diagnosis instance LSL_UP_IF_1" UWORD _CNV_S_2_RANGE__0___1_CM 1 100. 0. 1. DISPLAY_IDENTIFIER LV_READY_LSL_UP_IF_1 ECU_ADDRESS 0xd00097e6 BIT_MASK 0x10 /end MEASUREMENT
/begin MEASUREMENT fmy_stat_lsl_up_if_1.err_info_stat.lv_end_diag "end of diagnosis of the diagnosis instance LSL_UP_IF_1" UWORD _CNV_S_2_RANGE__0___1_CM 1 100. 0. 1. DISPLAY_IDENTIFIER LV_END_DIAG_LSL_UP_IF_1 ECU_ADDRESS 0xd00097e6 BIT_MASK 0x20 /end MEASUREMENT
/begin MEASUREMENT fmy_stat_lsl_up_if_1.err_info_stat.lv_cdn_diag "diagnosis condition of the diagnosis instance LSL_UP_IF_1" UWORD _CNV_S_2_RANGE__0___1_CM 1 100. 0. 1. DISPLAY_IDENTIFIER LV_CDN_DIAG_LSL_UP_IF_1 ECU_ADDRESS 0xd00097e6 BIT_MASK 0x40 /end MEASUREMENT
/begin MEASUREMENT fmy_stat_lsl_up_if_1.err_info_stat.err_sym "symptoms of the diagnosis instance LSL_UP_IF_1" UWORD _CNV_S_16_RANGE_ERR__349_CM 1 100. 0. 15. DISPLAY_IDENTIFIER ERR_SYM_LSL_UP_IF_1 ECU_ADDRESS 0xd00097e6 BIT_MASK 0x780 /end MEASUREMENT
/begin MEASUREMENT fmy_stat_el_lsl_up_1.ctr_abc "anti bounce counter for diagnosis instance EL_LSL_UP_1" UBYTE _CNV_A_R_LINEAR_____0_CM 1 100. 0. 255. DISPLAY_IDENTIFIER CTR_ABC_EL_LSL_UP_1 ECU_ADDRESS 0xd000965c FORMAT "%3.0" /end MEASUREMENT
/begin MEASUREMENT fmy_stat_el_lsl_up_1.ctr_end_diag "counter for end of diagnosis for diagnosis instance EL_LSL_UP_1" UBYTE _CNV_A_R_LINEAR_____0_CM 1 100. 0. 255. DISPLAY_IDENTIFIER CTR_ABC_END_DIAG_EL_LSL_UP_1 ECU_ADDRESS 0xd000965d FORMAT "%3.0" /end MEASUREMENT
/begin MEASUREMENT fmy_stat_el_lsl_up_1.err_info_stat.lv_err_mem "storage in dynamic failure memory of the diagnosis instance EL_LSL_UP_1" UWORD _CNV_S_2_RANGE__0___1_CM 1 100. 0. 1. DISPLAY_IDENTIFIER LV_ERR_MEM_EL_LSL_UP_1 ECU_ADDRESS 0xd000965e BIT_MASK 0x8 /end MEASUREMENT
/begin MEASUREMENT fmy_stat_el_lsl_up_1.err_info_stat.lv_ready "readiness status of the diagnosis instance EL_LSL_UP_1" UWORD _CNV_S_2_RANGE__0___1_CM 1 100. 0. 1. DISPLAY_IDENTIFIER LV_READY_EL_LSL_UP_1 ECU_ADDRESS 0xd000965e BIT_MASK 0x10 /end MEASUREMENT
/begin MEASUREMENT fmy_stat_el_lsl_up_1.err_info_stat.lv_end_diag "end of diagnosis of the diagnosis instance EL_LSL_UP_1" UWORD _CNV_S_2_RANGE__0___1_CM 1 100. 0. 1. DISPLAY_IDENTIFIER LV_END_DIAG_EL_LSL_UP_1 ECU_ADDRESS 0xd000965e BIT_MASK 0x20 /end MEASUREMENT
/begin MEASUREMENT fmy_stat_el_lsl_up_1.err_info_stat.lv_cdn_diag "diagnosis condition of the diagnosis instance EL_LSL_UP_1" UWORD _CNV_S_2_RANGE__0___1_CM 1 100. 0. 1. DISPLAY_IDENTIFIER LV_CDN_DIAG_EL_LSL_UP_1 ECU_ADDRESS 0xd000965e BIT_MASK 0x40 /end MEASUREMENT
/begin MEASUREMENT fmy_stat_el_lsl_up_1.err_info_stat.err_sym "symptoms of the diagnosis instance EL_LSL_UP_1" UWORD _CNV_S_16_RANGE_ERR__349_CM 1 100. 0. 15. DISPLAY_IDENTIFIER ERR_SYM_EL_LSL_UP_1 ECU_ADDRESS 0xd000965e BIT_MASK 0x780 /end MEASUREMENT
/begin MEASUREMENT fmy_stat_lsh_up_1.ctr_abc "anti bounce counter for diagnosis instance LSH_UP_1" UBYTE _CNV_A_R_LINEAR_____0_CM 1 100. 0. 255. DISPLAY_IDENTIFIER CTR_ABC_LSH_UP_1 ECU_ADDRESS 0xd00097dc FORMAT "%3.0" /end MEASUREMENT
/begin MEASUREMENT fmy_stat_lsh_up_1.ctr_end_diag "counter for end of diagnosis for diagnosis instance LSH_UP_1" UBYTE _CNV_A_R_LINEAR_____0_CM 1 100. 0. 255. DISPLAY_IDENTIFIER CTR_ABC_END_DIAG_LSH_UP_1 ECU_ADDRESS 0xd00097dd FORMAT "%3.0" /end MEASUREMENT
/begin MEASUREMENT fmy_stat_lsh_up_1.err_info_stat.lv_err_mem "storage in dynamic failure memory of the diagnosis instance LSH_UP_1" UWORD _CNV_S_2_RANGE__0___1_CM 1 100. 0. 1. DISPLAY_IDENTIFIER LV_ERR_MEM_LSH_UP_1 ECU_ADDRESS 0xd00097de BIT_MASK 0x8 /end MEASUREMENT
/begin MEASUREMENT fmy_stat_lsh_up_1.err_info_stat.lv_ready "readiness status of the diagnosis instance LSH_UP_1" UWORD _CNV_S_2_RANGE__0___1_CM 1 100. 0. 1. DISPLAY_IDENTIFIER LV_READY_LSH_UP_1 ECU_ADDRESS 0xd00097de BIT_MASK 0x10 /end MEASUREMENT
/begin MEASUREMENT fmy_stat_lsh_up_1.err_info_stat.lv_end_diag "end of diagnosis of the diagnosis instance LSH_UP_1" UWORD _CNV_S_2_RANGE__0___1_CM 1 100. 0. 1. DISPLAY_IDENTIFIER LV_END_DIAG_LSH_UP_1 ECU_ADDRESS 0xd00097de BIT_MASK 0x20 /end MEASUREMENT
/begin MEASUREMENT fmy_stat_lsh_up_1.err_info_stat.lv_cdn_diag "diagnosis condition of the diagnosis instance LSH_UP_1" UWORD _CNV_S_2_RANGE__0___1_CM 1 100. 0. 1. DISPLAY_IDENTIFIER LV_CDN_DIAG_LSH_UP_1 ECU_ADDRESS 0xd00097de BIT_MASK 0x40 /end MEASUREMENT
/begin MEASUREMENT fmy_stat_lsh_up_1.err_info_stat.err_sym "symptoms of the diagnosis instance LSH_UP_1" UWORD _CNV_S_16_RANGE_ERR__349_CM 1 100. 0. 15. DISPLAY_IDENTIFIER ERR_SYM_LSH_UP_1 ECU_ADDRESS 0xd00097de BIT_MASK 0x780 /end MEASUREMENT
/begin MEASUREMENT fmy_stat_lsh_down_1.ctr_abc "anti bounce counter for diagnosis instance LSH_DOWN_1" UBYTE _CNV_A_R_LINEAR_____0_CM 1 100. 0. 255. DISPLAY_IDENTIFIER CTR_ABC_LSH_DOWN_1 ECU_ADDRESS 0xd00097cc FORMAT "%3.0" /end MEASUREMENT
/begin MEASUREMENT fmy_stat_lsh_down_1.ctr_end_diag "counter for end of diagnosis for diagnosis instance LSH_DOWN_1" UBYTE _CNV_A_R_LINEAR_____0_CM 1 100. 0. 255. DISPLAY_IDENTIFIER CTR_ABC_END_DIAG_LSH_DOWN_1 ECU_ADDRESS 0xd00097cd FORMAT "%3.0" /end MEASUREMENT
/begin MEASUREMENT fmy_stat_lsh_down_1.err_info_stat.lv_err_mem "storage in dynamic failure memory of the diagnosis instance LSH_DOWN_1" UWORD _CNV_S_2_RANGE__0___1_CM 1 100. 0. 1. DISPLAY_IDENTIFIER LV_ERR_MEM_LSH_DOWN_1 ECU_ADDRESS 0xd00097ce BIT_MASK 0x8 /end MEASUREMENT
/begin MEASUREMENT fmy_stat_lsh_down_1.err_info_stat.lv_ready "readiness status of the diagnosis instance LSH_DOWN_1" UWORD _CNV_S_2_RANGE__0___1_CM 1 100. 0. 1. DISPLAY_IDENTIFIER LV_READY_LSH_DOWN_1 ECU_ADDRESS 0xd00097ce BIT_MASK 0x10 /end MEASUREMENT
/begin MEASUREMENT fmy_stat_lsh_down_1.err_info_stat.lv_end_diag "end of diagnosis of the diagnosis instance LSH_DOWN_1" UWORD _CNV_S_2_RANGE__0___1_CM 1 100. 0. 1. DISPLAY_IDENTIFIER LV_END_DIAG_LSH_DOWN_1 ECU_ADDRESS 0xd00097ce BIT_MASK 0x20 /end MEASUREMENT
/begin MEASUREMENT fmy_stat_lsh_down_1.err_info_stat.lv_cdn_diag "diagnosis condition of the diagnosis instance LSH_DOWN_1" UWORD _CNV_S_2_RANGE__0___1_CM 1 100. 0. 1. DISPLAY_IDENTIFIER LV_CDN_DIAG_LSH_DOWN_1 ECU_ADDRESS 0xd00097ce BIT_MASK 0x40 /end MEASUREMENT
/begin MEASUREMENT fmy_stat_lsh_down_1.err_info_stat.err_sym "symptoms of the diagnosis instance LSH_DOWN_1" UWORD _CNV_S_16_RANGE_ERR__349_CM 1 100. 0. 15. DISPLAY_IDENTIFIER ERR_SYM_LSH_DOWN_1 ECU_ADDRESS 0xd00097ce BIT_MASK 0x780 /end MEASUREMENT
/begin MEASUREMENT fmy_stat_vls_down_dif_1.ctr_abc "anti bounce counter for diagnosis instance VLS_DOWN_DIF_1" UBYTE _CNV_A_R_LINEAR_____0_CM 1 100. 0. 255. DISPLAY_IDENTIFIER CTR_ABC_VLS_DOWN_DIF_1 ECU_ADDRESS 0xd0009af4 FORMAT "%3.0" /end MEASUREMENT
/begin MEASUREMENT fmy_stat_vls_down_dif_1.ctr_end_diag "counter for end of diagnosis for diagnosis instance VLS_DOWN_DIF_1" UBYTE _CNV_A_R_LINEAR_____0_CM 1 100. 0. 255. DISPLAY_IDENTIFIER CTR_ABC_END_DIAG_VLS_DOWN_DIF_1 ECU_ADDRESS 0xd0009af5 FORMAT "%3.0" /end MEASUREMENT
/begin MEASUREMENT fmy_stat_vls_down_dif_1.err_info_stat.lv_err_mem "storage in dynamic failure memory of the diagnosis instance VLS_DOWN_DIF_1" UWORD _CNV_S_2_RANGE__0___1_CM 1 100. 0. 1. DISPLAY_IDENTIFIER LV_ERR_MEM_VLS_DOWN_DIF_1 ECU_ADDRESS 0xd0009af6 BIT_MASK 0x8 /end MEASUREMENT
/begin MEASUREMENT fmy_stat_vls_down_dif_1.err_info_stat.lv_ready "readiness status of the diagnosis instance VLS_DOWN_DIF_1" UWORD _CNV_S_2_RANGE__0___1_CM 1 100. 0. 1. DISPLAY_IDENTIFIER LV_READY_VLS_DOWN_DIF_1 ECU_ADDRESS 0xd0009af6 BIT_MASK 0x10 /end MEASUREMENT
/begin MEASUREMENT fmy_stat_vls_down_dif_1.err_info_stat.lv_end_diag "end of diagnosis of the diagnosis instance VLS_DOWN_DIF_1" UWORD _CNV_S_2_RANGE__0___1_CM 1 100. 0. 1. DISPLAY_IDENTIFIER LV_END_DIAG_VLS_DOWN_DIF_1 ECU_ADDRESS 0xd0009af6 BIT_MASK 0x20 /end MEASUREMENT
/begin MEASUREMENT fmy_stat_vls_down_dif_1.err_info_stat.lv_cdn_diag "diagnosis condition of the diagnosis instance VLS_DOWN_DIF_1" UWORD _CNV_S_2_RANGE__0___1_CM 1 100. 0. 1. DISPLAY_IDENTIFIER LV_CDN_DIAG_VLS_DOWN_DIF_1 ECU_ADDRESS 0xd0009af6 BIT_MASK 0x40 /end MEASUREMENT
/begin MEASUREMENT fmy_stat_vls_down_dif_1.err_info_stat.err_sym "symptoms of the diagnosis instance VLS_DOWN_DIF_1" UWORD _CNV_S_16_RANGE_ERR__349_CM 1 100. 0. 15. DISPLAY_IDENTIFIER ERR_SYM_VLS_DOWN_DIF_1 ECU_ADDRESS 0xd0009af6 BIT_MASK 0x780 /end MEASUREMENT
/begin MEASUREMENT fmy_stat_lsh_lsl_up_1.ctr_abc "anti bounce counter for diagnosis instance LSH_LSL_UP_1" UBYTE _CNV_A_R_LINEAR_____0_CM 1 100. 0. 255. DISPLAY_IDENTIFIER CTR_ABC_LSH_LSL_UP_1 ECU_ADDRESS 0xd00097d4 FORMAT "%3.0" /end MEASUREMENT
/begin MEASUREMENT fmy_stat_lsh_lsl_up_1.ctr_end_diag "counter for end of diagnosis for diagnosis instance LSH_LSL_UP_1" UBYTE _CNV_A_R_LINEAR_____0_CM 1 100. 0. 255. DISPLAY_IDENTIFIER CTR_ABC_END_DIAG_LSH_LSL_UP_1 ECU_ADDRESS 0xd00097d5 FORMAT "%3.0" /end MEASUREMENT
/begin MEASUREMENT fmy_stat_lsh_lsl_up_1.err_info_stat.lv_err_mem "storage in dynamic failure memory of the diagnosis instance LSH_LSL_UP_1" UWORD _CNV_S_2_RANGE__0___1_CM 1 100. 0. 1. DISPLAY_IDENTIFIER LV_ERR_MEM_LSH_LSL_UP_1 ECU_ADDRESS 0xd00097d6 BIT_MASK 0x8 /end MEASUREMENT
/begin MEASUREMENT fmy_stat_lsh_lsl_up_1.err_info_stat.lv_ready "readiness status of the diagnosis instance LSH_LSL_UP_1" UWORD _CNV_S_2_RANGE__0___1_CM 1 100. 0. 1. DISPLAY_IDENTIFIER LV_READY_LSH_LSL_UP_1 ECU_ADDRESS 0xd00097d6 BIT_MASK 0x10 /end MEASUREMENT
/begin MEASUREMENT fmy_stat_lsh_lsl_up_1.err_info_stat.lv_end_diag "end of diagnosis of the diagnosis instance LSH_LSL_UP_1" UWORD _CNV_S_2_RANGE__0___1_CM 1 100. 0. 1. DISPLAY_IDENTIFIER LV_END_DIAG_LSH_LSL_UP_1 ECU_ADDRESS 0xd00097d6 BIT_MASK 0x20 /end MEASUREMENT
/begin MEASUREMENT fmy_stat_lsh_lsl_up_1.err_info_stat.lv_cdn_diag "diagnosis condition of the diagnosis instance LSH_LSL_UP_1" UWORD _CNV_S_2_RANGE__0___1_CM 1 100. 0. 1. DISPLAY_IDENTIFIER LV_CDN_DIAG_LSH_LSL_UP_1 ECU_ADDRESS 0xd00097d6 BIT_MASK 0x40 /end MEASUREMENT
/begin MEASUREMENT fmy_stat_lsh_lsl_up_1.err_info_stat.err_sym "symptoms of the diagnosis instance LSH_LSL_UP_1" UWORD _CNV_S_16_RANGE_ERR__349_CM 1 100. 0. 15. DISPLAY_IDENTIFIER ERR_SYM_LSH_LSL_UP_1 ECU_ADDRESS 0xd00097d6 BIT_MASK 0x780 /end MEASUREMENT
/begin MEASUREMENT fmy_stat_air_lsl_up_1.ctr_abc "anti bounce counter for diagnosis instance AIR_LSL_UP_1" UBYTE _CNV_A_R_LINEAR_____0_CM 1 100. 0. 255. DISPLAY_IDENTIFIER CTR_ABC_AIR_LSL_UP_1 ECU_ADDRESS 0xd00093c4 FORMAT "%3.0" /end MEASUREMENT
/begin MEASUREMENT fmy_stat_air_lsl_up_1.ctr_end_diag "counter for end of diagnosis for diagnosis instance AIR_LSL_UP_1" UBYTE _CNV_A_R_LINEAR_____0_CM 1 100. 0. 255. DISPLAY_IDENTIFIER CTR_ABC_END_DIAG_AIR_LSL_UP_1 ECU_ADDRESS 0xd00093c5 FORMAT "%3.0" /end MEASUREMENT
/begin MEASUREMENT fmy_stat_air_lsl_up_1.err_info_stat.lv_err_mem "storage in dynamic failure memory of the diagnosis instance AIR_LSL_UP_1" UWORD _CNV_S_2_RANGE__0___1_CM 1 100. 0. 1. DISPLAY_IDENTIFIER LV_ERR_MEM_AIR_LSL_UP_1 ECU_ADDRESS 0xd00093c6 BIT_MASK 0x8 /end MEASUREMENT
/begin MEASUREMENT fmy_stat_air_lsl_up_1.err_info_stat.lv_ready "readiness status of the diagnosis instance AIR_LSL_UP_1" UWORD _CNV_S_2_RANGE__0___1_CM 1 100. 0. 1. DISPLAY_IDENTIFIER LV_READY_AIR_LSL_UP_1 ECU_ADDRESS 0xd00093c6 BIT_MASK 0x10 /end MEASUREMENT
/begin MEASUREMENT fmy_stat_air_lsl_up_1.err_info_stat.lv_end_diag "end of diagnosis of the diagnosis instance AIR_LSL_UP_1" UWORD _CNV_S_2_RANGE__0___1_CM 1 100. 0. 1. DISPLAY_IDENTIFIER LV_END_DIAG_AIR_LSL_UP_1 ECU_ADDRESS 0xd00093c6 BIT_MASK 0x20 /end MEASUREMENT
/begin MEASUREMENT fmy_stat_air_lsl_up_1.err_info_stat.lv_cdn_diag "diagnosis condition of the diagnosis instance AIR_LSL_UP_1" UWORD _CNV_S_2_RANGE__0___1_CM 1 100. 0. 1. DISPLAY_IDENTIFIER LV_CDN_DIAG_AIR_LSL_UP_1 ECU_ADDRESS 0xd00093c6 BIT_MASK 0x40 /end MEASUREMENT
/begin MEASUREMENT fmy_stat_air_lsl_up_1.err_info_stat.err_sym "symptoms of the diagnosis instance AIR_LSL_UP_1" UWORD _CNV_S_16_RANGE_ERR__349_CM 1 100. 0. 15. DISPLAY_IDENTIFIER ERR_SYM_AIR_LSL_UP_1 ECU_ADDRESS 0xd00093c6 BIT_MASK 0x780 /end MEASUREMENT
/begin MEASUREMENT fmy_stat_pue_ls_down_1.ctr_abc "anti bounce counter for diagnosis instance PUE_LS_DOWN_1" UBYTE _CNV_A_R_LINEAR_____0_CM 1 100. 0. 255. DISPLAY_IDENTIFIER CTR_ABC_PUE_LS_DOWN_1 ECU_ADDRESS 0xd00098fc FORMAT "%3.0" /end MEASUREMENT
/begin MEASUREMENT fmy_stat_pue_ls_down_1.ctr_end_diag "counter for end of diagnosis for diagnosis instance PUE_LS_DOWN_1" UBYTE _CNV_A_R_LINEAR_____0_CM 1 100. 0. 255. DISPLAY_IDENTIFIER CTR_ABC_END_DIAG_PUE_LS_DOWN_1 ECU_ADDRESS 0xd00098fd FORMAT "%3.0" /end MEASUREMENT
/begin MEASUREMENT fmy_stat_pue_ls_down_1.err_info_stat.lv_err_mem "storage in dynamic failure memory of the diagnosis instance PUE_LS_DOWN_1" UWORD _CNV_S_2_RANGE__0___1_CM 1 100. 0. 1. DISPLAY_IDENTIFIER LV_ERR_MEM_PUE_LS_DOWN_1 ECU_ADDRESS 0xd00098fe BIT_MASK 0x8 /end MEASUREMENT
/begin MEASUREMENT fmy_stat_pue_ls_down_1.err_info_stat.lv_ready "readiness status of the diagnosis instance PUE_LS_DOWN_1" UWORD _CNV_S_2_RANGE__0___1_CM 1 100. 0. 1. DISPLAY_IDENTIFIER LV_READY_PUE_LS_DOWN_1 ECU_ADDRESS 0xd00098fe BIT_MASK 0x10 /end MEASUREMENT
/begin MEASUREMENT fmy_stat_pue_ls_down_1.err_info_stat.lv_end_diag "end of diagnosis of the diagnosis instance PUE_LS_DOWN_1" UWORD _CNV_S_2_RANGE__0___1_CM 1 100. 0. 1. DISPLAY_IDENTIFIER LV_END_DIAG_PUE_LS_DOWN_1 ECU_ADDRESS 0xd00098fe BIT_MASK 0x20 /end MEASUREMENT
/begin MEASUREMENT fmy_stat_pue_ls_down_1.err_info_stat.lv_cdn_diag "diagnosis condition of the diagnosis instance PUE_LS_DOWN_1" UWORD _CNV_S_2_RANGE__0___1_CM 1 100. 0. 1. DISPLAY_IDENTIFIER LV_CDN_DIAG_PUE_LS_DOWN_1 ECU_ADDRESS 0xd00098fe BIT_MASK 0x40 /end MEASUREMENT
/begin MEASUREMENT fmy_stat_pue_ls_down_1.err_info_stat.err_sym "symptoms of the diagnosis instance PUE_LS_DOWN_1" UWORD _CNV_S_16_RANGE_ERR__349_CM 1 100. 0. 15. DISPLAY_IDENTIFIER ERR_SYM_PUE_LS_DOWN_1 ECU_ADDRESS 0xd00098fe BIT_MASK 0x780 /end MEASUREMENT
/begin MEASUREMENT fmy_stat_swt_ls_down_1.ctr_abc "anti bounce counter for diagnosis instance SWT_LS_DOWN_1" UBYTE _CNV_A_R_LINEAR_____0_CM 1 100. 0. 255. DISPLAY_IDENTIFIER CTR_ABC_SWT_LS_DOWN_1 ECU_ADDRESS 0xd00099c4 FORMAT "%3.0" /end MEASUREMENT
/begin MEASUREMENT fmy_stat_swt_ls_down_1.ctr_end_diag "counter for end of diagnosis for diagnosis instance SWT_LS_DOWN_1" UBYTE _CNV_A_R_LINEAR_____0_CM 1 100. 0. 255. DISPLAY_IDENTIFIER CTR_ABC_END_DIAG_SWT_LS_DOWN_1 ECU_ADDRESS 0xd00099c5 FORMAT "%3.0" /end MEASUREMENT
/begin MEASUREMENT fmy_stat_swt_ls_down_1.err_info_stat.lv_err_mem "storage in dynamic failure memory of the diagnosis instance SWT_LS_DOWN_1" UWORD _CNV_S_2_RANGE__0___1_CM 1 100. 0. 1. DISPLAY_IDENTIFIER LV_ERR_MEM_SWT_LS_DOWN_1 ECU_ADDRESS 0xd00099c6 BIT_MASK 0x8 /end MEASUREMENT
/begin MEASUREMENT fmy_stat_swt_ls_down_1.err_info_stat.lv_ready "readiness status of the diagnosis instance SWT_LS_DOWN_1" UWORD _CNV_S_2_RANGE__0___1_CM 1 100. 0. 1. DISPLAY_IDENTIFIER LV_READY_SWT_LS_DOWN_1 ECU_ADDRESS 0xd00099c6 BIT_MASK 0x10 /end MEASUREMENT
/begin MEASUREMENT fmy_stat_swt_ls_down_1.err_info_stat.lv_end_diag "end of diagnosis of the diagnosis instance SWT_LS_DOWN_1" UWORD _CNV_S_2_RANGE__0___1_CM 1 100. 0. 1. DISPLAY_IDENTIFIER LV_END_DIAG_SWT_LS_DOWN_1 ECU_ADDRESS 0xd00099c6 BIT_MASK 0x20 /end MEASUREMENT
/begin MEASUREMENT fmy_stat_swt_ls_down_1.err_info_stat.lv_cdn_diag "diagnosis condition of the diagnosis instance SWT_LS_DOWN_1" UWORD _CNV_S_2_RANGE__0___1_CM 1 100. 0. 1. DISPLAY_IDENTIFIER LV_CDN_DIAG_SWT_LS_DOWN_1 ECU_ADDRESS 0xd00099c6 BIT_MASK 0x40 /end MEASUREMENT
/begin MEASUREMENT fmy_stat_swt_ls_down_1.err_info_stat.err_sym "symptoms of the diagnosis instance SWT_LS_DOWN_1" UWORD _CNV_S_16_RANGE_ERR__349_CM 1 100. 0. 15. DISPLAY_IDENTIFIER ERR_SYM_SWT_LS_DOWN_1 ECU_ADDRESS 0xd00099c6 BIT_MASK 0x780 /end MEASUREMENT
/begin MEASUREMENT fmy_stat_obd_lsh_down_1.ctr_abc "anti bounce counter for diagnosis instance OBD_LSH_DOWN_1" UBYTE _CNV_A_R_LINEAR_____0_CM 1 100. 0. 255. DISPLAY_IDENTIFIER CTR_ABC_OBD_LSH_DOWN_1 ECU_ADDRESS 0xd0009884 FORMAT "%3.0" /end MEASUREMENT
/begin MEASUREMENT fmy_stat_obd_lsh_down_1.ctr_end_diag "counter for end of diagnosis for diagnosis instance OBD_LSH_DOWN_1" UBYTE _CNV_A_R_LINEAR_____0_CM 1 100. 0. 255. DISPLAY_IDENTIFIER CTR_ABC_END_DIAG_OBD_LSH_DOWN_1 ECU_ADDRESS 0xd0009885 FORMAT "%3.0" /end MEASUREMENT
/begin MEASUREMENT fmy_stat_obd_lsh_down_1.err_info_stat.lv_err_mem "storage in dynamic failure memory of the diagnosis instance OBD_LSH_DOWN_1" UWORD _CNV_S_2_RANGE__0___1_CM 1 100. 0. 1. DISPLAY_IDENTIFIER LV_ERR_MEM_OBD_LSH_DOWN_1 ECU_ADDRESS 0xd0009886 BIT_MASK 0x8 /end MEASUREMENT
/begin MEASUREMENT fmy_stat_obd_lsh_down_1.err_info_stat.lv_ready "readiness status of the diagnosis instance OBD_LSH_DOWN_1" UWORD _CNV_S_2_RANGE__0___1_CM 1 100. 0. 1. DISPLAY_IDENTIFIER LV_READY_OBD_LSH_DOWN_1 ECU_ADDRESS 0xd0009886 BIT_MASK 0x10 /end MEASUREMENT
/begin MEASUREMENT fmy_stat_obd_lsh_down_1.err_info_stat.lv_end_diag "end of diagnosis of the diagnosis instance OBD_LSH_DOWN_1" UWORD _CNV_S_2_RANGE__0___1_CM 1 100. 0. 1. DISPLAY_IDENTIFIER LV_END_DIAG_OBD_LSH_DOWN_1 ECU_ADDRESS 0xd0009886 BIT_MASK 0x20 /end MEASUREMENT
/begin MEASUREMENT fmy_stat_obd_lsh_down_1.err_info_stat.lv_cdn_diag "diagnosis condition of the diagnosis instance OBD_LSH_DOWN_1" UWORD _CNV_S_2_RANGE__0___1_CM 1 100. 0. 1. DISPLAY_IDENTIFIER LV_CDN_DIAG_OBD_LSH_DOWN_1 ECU_ADDRESS 0xd0009886 BIT_MASK 0x40 /end MEASUREMENT
/begin MEASUREMENT fmy_stat_obd_lsh_down_1.err_info_stat.err_sym "symptoms of the diagnosis instance OBD_LSH_DOWN_1" UWORD _CNV_S_16_RANGE_ERR__349_CM 1 100. 0. 15. DISPLAY_IDENTIFIER ERR_SYM_OBD_LSH_DOWN_1 ECU_ADDRESS 0xd0009886 BIT_MASK 0x780 /end MEASUREMENT
/begin MEASUREMENT fmy_stat_dyn_vld_ls_up_1.ctr_abc "anti bounce counter for diagnosis instance DYN_VLD_LS_UP_1" UBYTE _CNV_A_R_LINEAR_____0_CM 1 100. 0. 255. DISPLAY_IDENTIFIER CTR_ABC_DYN_VLD_LS_UP_1 ECU_ADDRESS 0xd0009610 FORMAT "%3.0" /end MEASUREMENT
/begin MEASUREMENT fmy_stat_dyn_vld_ls_up_1.ctr_end_diag "counter for end of diagnosis for diagnosis instance DYN_VLD_LS_UP_1" UBYTE _CNV_A_R_LINEAR_____0_CM 1 100. 0. 255. DISPLAY_IDENTIFIER CTR_ABC_END_DIAG_DYN_VLD_LS_UP_1 ECU_ADDRESS 0xd0009611 FORMAT "%3.0" /end MEASUREMENT
/begin MEASUREMENT fmy_stat_dyn_vld_ls_up_1.err_info_stat.lv_err_mem "storage in dynamic failure memory of the diagnosis instance DYN_VLD_LS_UP_1" UWORD _CNV_S_2_RANGE__0___1_CM 1 100. 0. 1. DISPLAY_IDENTIFIER LV_ERR_MEM_DYN_VLD_LS_UP_1 ECU_ADDRESS 0xd0009612 BIT_MASK 0x8 /end MEASUREMENT
/begin MEASUREMENT fmy_stat_dyn_vld_ls_up_1.err_info_stat.lv_ready "readiness status of the diagnosis instance DYN_VLD_LS_UP_1" UWORD _CNV_S_2_RANGE__0___1_CM 1 100. 0. 1. DISPLAY_IDENTIFIER LV_READY_DYN_VLD_LS_UP_1 ECU_ADDRESS 0xd0009612 BIT_MASK 0x10 /end MEASUREMENT
/begin MEASUREMENT fmy_stat_dyn_vld_ls_up_1.err_info_stat.lv_end_diag "end of diagnosis of the diagnosis instance DYN_VLD_LS_UP_1" UWORD _CNV_S_2_RANGE__0___1_CM 1 100. 0. 1. DISPLAY_IDENTIFIER LV_END_DIAG_DYN_VLD_LS_UP_1 ECU_ADDRESS 0xd0009612 BIT_MASK 0x20 /end MEASUREMENT
/begin MEASUREMENT fmy_stat_dyn_vld_ls_up_1.err_info_stat.lv_cdn_diag "diagnosis condition of the diagnosis instance DYN_VLD_LS_UP_1" UWORD _CNV_S_2_RANGE__0___1_CM 1 100. 0. 1. DISPLAY_IDENTIFIER LV_CDN_DIAG_DYN_VLD_LS_UP_1 ECU_ADDRESS 0xd0009612 BIT_MASK 0x40 /end MEASUREMENT
/begin MEASUREMENT fmy_stat_dyn_vld_ls_up_1.err_info_stat.err_sym "symptoms of the diagnosis instance DYN_VLD_LS_UP_1" UWORD _CNV_S_16_RANGE_ERR__349_CM 1 100. 0. 15. DISPLAY_IDENTIFIER ERR_SYM_DYN_VLD_LS_UP_1 ECU_ADDRESS 0xd0009612 BIT_MASK 0x780 /end MEASUREMENT
/begin MEASUREMENT fmy_stat_puc_vld_ls_up_1.ctr_abc "anti bounce counter for diagnosis instance PUC_VLD_LS_UP_1" UBYTE _CNV_A_R_LINEAR_____0_CM 1 100. 0. 255. DISPLAY_IDENTIFIER CTR_ABC_PUC_VLD_LS_UP_1 ECU_ADDRESS 0xd00098f4 FORMAT "%3.0" /end MEASUREMENT
/begin MEASUREMENT fmy_stat_puc_vld_ls_up_1.ctr_end_diag "counter for end of diagnosis for diagnosis instance PUC_VLD_LS_UP_1" UBYTE _CNV_A_R_LINEAR_____0_CM 1 100. 0. 255. DISPLAY_IDENTIFIER CTR_ABC_END_DIAG_PUC_VLD_LS_UP_1 ECU_ADDRESS 0xd00098f5 FORMAT "%3.0" /end MEASUREMENT
/begin MEASUREMENT fmy_stat_puc_vld_ls_up_1.err_info_stat.lv_err_mem "storage in dynamic failure memory of the diagnosis instance PUC_VLD_LS_UP_1" UWORD _CNV_S_2_RANGE__0___1_CM 1 100. 0. 1. DISPLAY_IDENTIFIER LV_ERR_MEM_PUC_VLD_LS_UP_1 ECU_ADDRESS 0xd00098f6 BIT_MASK 0x8 /end MEASUREMENT
/begin MEASUREMENT fmy_stat_puc_vld_ls_up_1.err_info_stat.lv_ready "readiness status of the diagnosis instance PUC_VLD_LS_UP_1" UWORD _CNV_S_2_RANGE__0___1_CM 1 100. 0. 1. DISPLAY_IDENTIFIER LV_READY_PUC_VLD_LS_UP_1 ECU_ADDRESS 0xd00098f6 BIT_MASK 0x10 /end MEASUREMENT
/begin MEASUREMENT fmy_stat_puc_vld_ls_up_1.err_info_stat.lv_end_diag "end of diagnosis of the diagnosis instance PUC_VLD_LS_UP_1" UWORD _CNV_S_2_RANGE__0___1_CM 1 100. 0. 1. DISPLAY_IDENTIFIER LV_END_DIAG_PUC_VLD_LS_UP_1 ECU_ADDRESS 0xd00098f6 BIT_MASK 0x20 /end MEASUREMENT
/begin MEASUREMENT fmy_stat_puc_vld_ls_up_1.err_info_stat.lv_cdn_diag "diagnosis condition of the diagnosis instance PUC_VLD_LS_UP_1" UWORD _CNV_S_2_RANGE__0___1_CM 1 100. 0. 1. DISPLAY_IDENTIFIER LV_CDN_DIAG_PUC_VLD_LS_UP_1 ECU_ADDRESS 0xd00098f6 BIT_MASK 0x40 /end MEASUREMENT
/begin MEASUREMENT fmy_stat_puc_vld_ls_up_1.err_info_stat.err_sym "symptoms of the diagnosis instance PUC_VLD_LS_UP_1" UWORD _CNV_S_16_RANGE_ERR__349_CM 1 100. 0. 15. DISPLAY_IDENTIFIER ERR_SYM_PUC_VLD_LS_UP_1 ECU_ADDRESS 0xd00098f6 BIT_MASK 0x780 /end MEASUREMENT
/begin MEASUREMENT fmy_stat_obd_vld_lsh_up_1.ctr_abc "anti bounce counter for diagnosis instance OBD_VLD_LSH_UP_1" UBYTE _CNV_A_R_LINEAR_____0_CM 1 100. 0. 255. DISPLAY_IDENTIFIER CTR_ABC_OBD_VLD_LSH_UP_1 ECU_ADDRESS 0xd000988c FORMAT "%3.0" /end MEASUREMENT
/begin MEASUREMENT fmy_stat_obd_vld_lsh_up_1.ctr_end_diag "counter for end of diagnosis for diagnosis instance OBD_VLD_LSH_UP_1" UBYTE _CNV_A_R_LINEAR_____0_CM 1 100. 0. 255. DISPLAY_IDENTIFIER CTR_ABC_END_DIAG_OBD_VLD_LSH_UP_1 ECU_ADDRESS 0xd000988d FORMAT "%3.0" /end MEASUREMENT
/begin MEASUREMENT fmy_stat_obd_vld_lsh_up_1.err_info_stat.lv_err_mem "storage in dynamic failure memory of the diagnosis instance OBD_VLD_LSH_UP_1" UWORD _CNV_S_2_RANGE__0___1_CM 1 100. 0. 1. DISPLAY_IDENTIFIER LV_ERR_MEM_OBD_VLD_LSH_UP_1 ECU_ADDRESS 0xd000988e BIT_MASK 0x8 /end MEASUREMENT
/begin MEASUREMENT fmy_stat_obd_vld_lsh_up_1.err_info_stat.lv_ready "readiness status of the diagnosis instance OBD_VLD_LSH_UP_1" UWORD _CNV_S_2_RANGE__0___1_CM 1 100. 0. 1. DISPLAY_IDENTIFIER LV_READY_OBD_VLD_LSH_UP_1 ECU_ADDRESS 0xd000988e BIT_MASK 0x10 /end MEASUREMENT
/begin MEASUREMENT fmy_stat_obd_vld_lsh_up_1.err_info_stat.lv_end_diag "end of diagnosis of the diagnosis instance OBD_VLD_LSH_UP_1" UWORD _CNV_S_2_RANGE__0___1_CM 1 100. 0. 1. DISPLAY_IDENTIFIER LV_END_DIAG_OBD_VLD_LSH_UP_1 ECU_ADDRESS 0xd000988e BIT_MASK 0x20 /end MEASUREMENT
/begin MEASUREMENT fmy_stat_obd_vld_lsh_up_1.err_info_stat.lv_cdn_diag "diagnosis condition of the diagnosis instance OBD_VLD_LSH_UP_1" UWORD _CNV_S_2_RANGE__0___1_CM 1 100. 0. 1. DISPLAY_IDENTIFIER LV_CDN_DIAG_OBD_VLD_LSH_UP_1 ECU_ADDRESS 0xd000988e BIT_MASK 0x40 /end MEASUREMENT
/begin MEASUREMENT fmy_stat_obd_vld_lsh_up_1.err_info_stat.err_sym "symptoms of the diagnosis instance OBD_VLD_LSH_UP_1" UWORD _CNV_S_16_RANGE_ERR__349_CM 1 100. 0. 15. DISPLAY_IDENTIFIER ERR_SYM_OBD_VLD_LSH_UP_1 ECU_ADDRESS 0xd000988e BIT_MASK 0x780 /end MEASUREMENT
/begin MEASUREMENT fmy_stat_chk_ls_down_1.ctr_abc "anti bounce counter for diagnosis instance CHK_LS_DOWN_1" UBYTE _CNV_A_R_LINEAR_____0_CM 1 100. 0. 255. DISPLAY_IDENTIFIER CTR_ABC_CHK_LS_DOWN_1 ECU_ADDRESS 0xd00094a0 FORMAT "%3.0" /end MEASUREMENT
/begin MEASUREMENT fmy_stat_chk_ls_down_1.ctr_end_diag "counter for end of diagnosis for diagnosis instance CHK_LS_DOWN_1" UBYTE _CNV_A_R_LINEAR_____0_CM 1 100. 0. 255. DISPLAY_IDENTIFIER CTR_ABC_END_DIAG_CHK_LS_DOWN_1 ECU_ADDRESS 0xd00094a1 FORMAT "%3.0" /end MEASUREMENT
/begin MEASUREMENT fmy_stat_chk_ls_down_1.err_info_stat.lv_err_mem "storage in dynamic failure memory of the diagnosis instance CHK_LS_DOWN_1" UWORD _CNV_S_2_RANGE__0___1_CM 1 100. 0. 1. DISPLAY_IDENTIFIER LV_ERR_MEM_CHK_LS_DOWN_1 ECU_ADDRESS 0xd00094a2 BIT_MASK 0x8 /end MEASUREMENT
/begin MEASUREMENT fmy_stat_chk_ls_down_1.err_info_stat.lv_ready "readiness status of the diagnosis instance CHK_LS_DOWN_1" UWORD _CNV_S_2_RANGE__0___1_CM 1 100. 0. 1. DISPLAY_IDENTIFIER LV_READY_CHK_LS_DOWN_1 ECU_ADDRESS 0xd00094a2 BIT_MASK 0x10 /end MEASUREMENT
/begin MEASUREMENT fmy_stat_chk_ls_down_1.err_info_stat.lv_end_diag "end of diagnosis of the diagnosis instance CHK_LS_DOWN_1" UWORD _CNV_S_2_RANGE__0___1_CM 1 100. 0. 1. DISPLAY_IDENTIFIER LV_END_DIAG_CHK_LS_DOWN_1 ECU_ADDRESS 0xd00094a2 BIT_MASK 0x20 /end MEASUREMENT
/begin MEASUREMENT fmy_stat_chk_ls_down_1.err_info_stat.lv_cdn_diag "diagnosis condition of the diagnosis instance CHK_LS_DOWN_1" UWORD _CNV_S_2_RANGE__0___1_CM 1 100. 0. 1. DISPLAY_IDENTIFIER LV_CDN_DIAG_CHK_LS_DOWN_1 ECU_ADDRESS 0xd00094a2 BIT_MASK 0x40 /end MEASUREMENT
/begin MEASUREMENT fmy_stat_chk_ls_down_1.err_info_stat.err_sym "symptoms of the diagnosis instance CHK_LS_DOWN_1" UWORD _CNV_S_16_RANGE_ERR__349_CM 1 100. 0. 15. DISPLAY_IDENTIFIER ERR_SYM_CHK_LS_DOWN_1 ECU_ADDRESS 0xd00094a2 BIT_MASK 0x780 /end MEASUREMENT
/begin MEASUREMENT fmy_stat_shift_afl_lsl_up_1.ctr_abc "anti bounce counter for diagnosis instance SHIFT_AFL_LSL_UP_1" UBYTE _CNV_A_R_LINEAR_____0_CM 1 100. 0. 255. DISPLAY_IDENTIFIER CTR_ABC_SHIFT_AFL_LSL_UP_1 ECU_ADDRESS 0xd0009984 FORMAT "%3.0" /end MEASUREMENT
/begin MEASUREMENT fmy_stat_shift_afl_lsl_up_1.ctr_end_diag "counter for end of diagnosis for diagnosis instance SHIFT_AFL_LSL_UP_1" UBYTE _CNV_A_R_LINEAR_____0_CM 1 100. 0. 255. DISPLAY_IDENTIFIER CTR_ABC_END_DIAG_SHIFT_AFL_LSL_UP_1 ECU_ADDRESS 0xd0009985 FORMAT "%3.0" /end MEASUREMENT
/begin MEASUREMENT fmy_stat_shift_afl_lsl_up_1.err_info_stat.lv_err_mem "storage in dynamic failure memory of the diagnosis instance SHIFT_AFL_LSL_UP_1" UWORD _CNV_S_2_RANGE__0___1_CM 1 100. 0. 1. DISPLAY_IDENTIFIER LV_ERR_MEM_SHIFT_AFL_LSL_UP_1 ECU_ADDRESS 0xd0009986 BIT_MASK 0x8 /end MEASUREMENT
/begin MEASUREMENT fmy_stat_shift_afl_lsl_up_1.err_info_stat.lv_ready "readiness status of the diagnosis instance SHIFT_AFL_LSL_UP_1" UWORD _CNV_S_2_RANGE__0___1_CM 1 100. 0. 1. DISPLAY_IDENTIFIER LV_READY_SHIFT_AFL_LSL_UP_1 ECU_ADDRESS 0xd0009986 BIT_MASK 0x10 /end MEASUREMENT
/begin MEASUREMENT fmy_stat_shift_afl_lsl_up_1.err_info_stat.lv_end_diag "end of diagnosis of the diagnosis instance SHIFT_AFL_LSL_UP_1" UWORD _CNV_S_2_RANGE__0___1_CM 1 100. 0. 1. DISPLAY_IDENTIFIER LV_END_DIAG_SHIFT_AFL_LSL_UP_1 ECU_ADDRESS 0xd0009986 BIT_MASK 0x20 /end MEASUREMENT
/begin MEASUREMENT fmy_stat_shift_afl_lsl_up_1.err_info_stat.lv_cdn_diag "diagnosis condition of the diagnosis instance SHIFT_AFL_LSL_UP_1" UWORD _CNV_S_2_RANGE__0___1_CM 1 100. 0. 1. DISPLAY_IDENTIFIER LV_CDN_DIAG_SHIFT_AFL_LSL_UP_1 ECU_ADDRESS 0xd0009986 BIT_MASK 0x40 /end MEASUREMENT
/begin MEASUREMENT fmy_stat_shift_afl_lsl_up_1.err_info_stat.err_sym "symptoms of the diagnosis instance SHIFT_AFL_LSL_UP_1" UWORD _CNV_S_16_RANGE_ERR__349_CM 1 100. 0. 15. DISPLAY_IDENTIFIER ERR_SYM_SHIFT_AFL_LSL_UP_1 ECU_ADDRESS 0xd0009986 BIT_MASK 0x780 /end MEASUREMENT
/begin MEASUREMENT fmy_stat_shift_afr_lsl_up_1.ctr_abc "anti bounce counter for diagnosis instance SHIFT_AFR_LSL_UP_1" UBYTE _CNV_A_R_LINEAR_____0_CM 1 100. 0. 255. DISPLAY_IDENTIFIER CTR_ABC_SHIFT_AFR_LSL_UP_1 ECU_ADDRESS 0xd000998c FORMAT "%3.0" /end MEASUREMENT
/begin MEASUREMENT fmy_stat_shift_afr_lsl_up_1.ctr_end_diag "counter for end of diagnosis for diagnosis instance SHIFT_AFR_LSL_UP_1" UBYTE _CNV_A_R_LINEAR_____0_CM 1 100. 0. 255. DISPLAY_IDENTIFIER CTR_ABC_END_DIAG_SHIFT_AFR_LSL_UP_1 ECU_ADDRESS 0xd000998d FORMAT "%3.0" /end MEASUREMENT
/begin MEASUREMENT fmy_stat_shift_afr_lsl_up_1.err_info_stat.lv_err_mem "storage in dynamic failure memory of the diagnosis instance SHIFT_AFR_LSL_UP_1" UWORD _CNV_S_2_RANGE__0___1_CM 1 100. 0. 1. DISPLAY_IDENTIFIER LV_ERR_MEM_SHIFT_AFR_LSL_UP_1 ECU_ADDRESS 0xd000998e BIT_MASK 0x8 /end MEASUREMENT
/begin MEASUREMENT fmy_stat_shift_afr_lsl_up_1.err_info_stat.lv_ready "readiness status of the diagnosis instance SHIFT_AFR_LSL_UP_1" UWORD _CNV_S_2_RANGE__0___1_CM 1 100. 0. 1. DISPLAY_IDENTIFIER LV_READY_SHIFT_AFR_LSL_UP_1 ECU_ADDRESS 0xd000998e BIT_MASK 0x10 /end MEASUREMENT
/begin MEASUREMENT fmy_stat_shift_afr_lsl_up_1.err_info_stat.lv_end_diag "end of diagnosis of the diagnosis instance SHIFT_AFR_LSL_UP_1" UWORD _CNV_S_2_RANGE__0___1_CM 1 100. 0. 1. DISPLAY_IDENTIFIER LV_END_DIAG_SHIFT_AFR_LSL_UP_1 ECU_ADDRESS 0xd000998e BIT_MASK 0x20 /end MEASUREMENT
/begin MEASUREMENT fmy_stat_shift_afr_lsl_up_1.err_info_stat.lv_cdn_diag "diagnosis condition of the diagnosis instance SHIFT_AFR_LSL_UP_1" UWORD _CNV_S_2_RANGE__0___1_CM 1 100. 0. 1. DISPLAY_IDENTIFIER LV_CDN_DIAG_SHIFT_AFR_LSL_UP_1 ECU_ADDRESS 0xd000998e BIT_MASK 0x40 /end MEASUREMENT
/begin MEASUREMENT fmy_stat_shift_afr_lsl_up_1.err_info_stat.err_sym "symptoms of the diagnosis instance SHIFT_AFR_LSL_UP_1" UWORD _CNV_S_16_RANGE_ERR__349_CM 1 100. 0. 15. DISPLAY_IDENTIFIER ERR_SYM_SHIFT_AFR_LSL_UP_1 ECU_ADDRESS 0xd000998e BIT_MASK 0x780 /end MEASUREMENT
/begin MEASUREMENT fmy_stat_oc_lsl_up_1.ctr_abc "anti bounce counter for diagnosis instance OC_LSL_UP_1" UBYTE _CNV_A_R_LINEAR_____0_CM 1 100. 0. 255. DISPLAY_IDENTIFIER CTR_ABC_OC_LSL_UP_1 ECU_ADDRESS 0xd000989c FORMAT "%3.0" /end MEASUREMENT
/begin MEASUREMENT fmy_stat_oc_lsl_up_1.ctr_end_diag "counter for end of diagnosis for diagnosis instance OC_LSL_UP_1" UBYTE _CNV_A_R_LINEAR_____0_CM 1 100. 0. 255. DISPLAY_IDENTIFIER CTR_ABC_END_DIAG_OC_LSL_UP_1 ECU_ADDRESS 0xd000989d FORMAT "%3.0" /end MEASUREMENT
/begin MEASUREMENT fmy_stat_oc_lsl_up_1.err_info_stat.lv_err_mem "storage in dynamic failure memory of the diagnosis instance OC_LSL_UP_1" UWORD _CNV_S_2_RANGE__0___1_CM 1 100. 0. 1. DISPLAY_IDENTIFIER LV_ERR_MEM_OC_LSL_UP_1 ECU_ADDRESS 0xd000989e BIT_MASK 0x8 /end MEASUREMENT
/begin MEASUREMENT fmy_stat_oc_lsl_up_1.err_info_stat.lv_ready "readiness status of the diagnosis instance OC_LSL_UP_1" UWORD _CNV_S_2_RANGE__0___1_CM 1 100. 0. 1. DISPLAY_IDENTIFIER LV_READY_OC_LSL_UP_1 ECU_ADDRESS 0xd000989e BIT_MASK 0x10 /end MEASUREMENT
/begin MEASUREMENT fmy_stat_oc_lsl_up_1.err_info_stat.lv_end_diag "end of diagnosis of the diagnosis instance OC_LSL_UP_1" UWORD _CNV_S_2_RANGE__0___1_CM 1 100. 0. 1. DISPLAY_IDENTIFIER LV_END_DIAG_OC_LSL_UP_1 ECU_ADDRESS 0xd000989e BIT_MASK 0x20 /end MEASUREMENT
/begin MEASUREMENT fmy_stat_oc_lsl_up_1.err_info_stat.lv_cdn_diag "diagnosis condition of the diagnosis instance OC_LSL_UP_1" UWORD _CNV_S_2_RANGE__0___1_CM 1 100. 0. 1. DISPLAY_IDENTIFIER LV_CDN_DIAG_OC_LSL_UP_1 ECU_ADDRESS 0xd000989e BIT_MASK 0x40 /end MEASUREMENT
/begin MEASUREMENT fmy_stat_oc_lsl_up_1.err_info_stat.err_sym "symptoms of the diagnosis instance OC_LSL_UP_1" UWORD _CNV_S_16_RANGE_ERR__349_CM 1 100. 0. 15. DISPLAY_IDENTIFIER ERR_SYM_OC_LSL_UP_1 ECU_ADDRESS 0xd000989e BIT_MASK 0x780 /end MEASUREMENT
/begin MEASUREMENT fmy_stat_delta_i_lam_1.ctr_abc "anti bounce counter for diagnosis instance DELTA_I_LAM_1" UBYTE _CNV_A_R_LINEAR_____0_CM 1 100. 0. 255. DISPLAY_IDENTIFIER CTR_ABC_DELTA_I_LAM_1 ECU_ADDRESS 0xd00095e8 FORMAT "%3.0" /end MEASUREMENT
/begin MEASUREMENT fmy_stat_delta_i_lam_1.ctr_end_diag "counter for end of diagnosis for diagnosis instance DELTA_I_LAM_1" UBYTE _CNV_A_R_LINEAR_____0_CM 1 100. 0. 255. DISPLAY_IDENTIFIER CTR_ABC_END_DIAG_DELTA_I_LAM_1 ECU_ADDRESS 0xd00095e9 FORMAT "%3.0" /end MEASUREMENT
/begin MEASUREMENT fmy_stat_delta_i_lam_1.err_info_stat.lv_err_mem "storage in dynamic failure memory of the diagnosis instance DELTA_I_LAM_1" UWORD _CNV_S_2_RANGE__0___1_CM 1 100. 0. 1. DISPLAY_IDENTIFIER LV_ERR_MEM_DELTA_I_LAM_1 ECU_ADDRESS 0xd00095ea BIT_MASK 0x8 /end MEASUREMENT
/begin MEASUREMENT fmy_stat_delta_i_lam_1.err_info_stat.lv_ready "readiness status of the diagnosis instance DELTA_I_LAM_1" UWORD _CNV_S_2_RANGE__0___1_CM 1 100. 0. 1. DISPLAY_IDENTIFIER LV_READY_DELTA_I_LAM_1 ECU_ADDRESS 0xd00095ea BIT_MASK 0x10 /end MEASUREMENT
/begin MEASUREMENT fmy_stat_delta_i_lam_1.err_info_stat.lv_end_diag "end of diagnosis of the diagnosis instance DELTA_I_LAM_1" UWORD _CNV_S_2_RANGE__0___1_CM 1 100. 0. 1. DISPLAY_IDENTIFIER LV_END_DIAG_DELTA_I_LAM_1 ECU_ADDRESS 0xd00095ea BIT_MASK 0x20 /end MEASUREMENT
/begin MEASUREMENT fmy_stat_delta_i_lam_1.err_info_stat.lv_cdn_diag "diagnosis condition of the diagnosis instance DELTA_I_LAM_1" UWORD _CNV_S_2_RANGE__0___1_CM 1 100. 0. 1. DISPLAY_IDENTIFIER LV_CDN_DIAG_DELTA_I_LAM_1 ECU_ADDRESS 0xd00095ea BIT_MASK 0x40 /end MEASUREMENT
/begin MEASUREMENT fmy_stat_delta_i_lam_1.err_info_stat.err_sym "symptoms of the diagnosis instance DELTA_I_LAM_1" UWORD _CNV_S_16_RANGE_ERR__349_CM 1 100. 0. 15. DISPLAY_IDENTIFIER ERR_SYM_DELTA_I_LAM_1 ECU_ADDRESS 0xd00095ea BIT_MASK 0x780 /end MEASUREMENT
/begin MEASUREMENT fmy_stat_ofs_lsl_up_1.ctr_abc "anti bounce counter for diagnosis instance OFS_LSL_UP_1" UBYTE _CNV_A_R_LINEAR_____0_CM 1 100. 0. 255. DISPLAY_IDENTIFIER CTR_ABC_OFS_LSL_UP_1 ECU_ADDRESS 0xd00098a4 FORMAT "%3.0" /end MEASUREMENT
/begin MEASUREMENT fmy_stat_ofs_lsl_up_1.ctr_end_diag "counter for end of diagnosis for diagnosis instance OFS_LSL_UP_1" UBYTE _CNV_A_R_LINEAR_____0_CM 1 100. 0. 255. DISPLAY_IDENTIFIER CTR_ABC_END_DIAG_OFS_LSL_UP_1 ECU_ADDRESS 0xd00098a5 FORMAT "%3.0" /end MEASUREMENT
/begin MEASUREMENT fmy_stat_ofs_lsl_up_1.err_info_stat.lv_err_mem "storage in dynamic failure memory of the diagnosis instance OFS_LSL_UP_1" UWORD _CNV_S_2_RANGE__0___1_CM 1 100. 0. 1. DISPLAY_IDENTIFIER LV_ERR_MEM_OFS_LSL_UP_1 ECU_ADDRESS 0xd00098a6 BIT_MASK 0x8 /end MEASUREMENT
/begin MEASUREMENT fmy_stat_ofs_lsl_up_1.err_info_stat.lv_ready "readiness status of the diagnosis instance OFS_LSL_UP_1" UWORD _CNV_S_2_RANGE__0___1_CM 1 100. 0. 1. DISPLAY_IDENTIFIER LV_READY_OFS_LSL_UP_1 ECU_ADDRESS 0xd00098a6 BIT_MASK 0x10 /end MEASUREMENT
/begin MEASUREMENT fmy_stat_ofs_lsl_up_1.err_info_stat.lv_end_diag "end of diagnosis of the diagnosis instance OFS_LSL_UP_1" UWORD _CNV_S_2_RANGE__0___1_CM 1 100. 0. 1. DISPLAY_IDENTIFIER LV_END_DIAG_OFS_LSL_UP_1 ECU_ADDRESS 0xd00098a6 BIT_MASK 0x20 /end MEASUREMENT
/begin MEASUREMENT fmy_stat_ofs_lsl_up_1.err_info_stat.lv_cdn_diag "diagnosis condition of the diagnosis instance OFS_LSL_UP_1" UWORD _CNV_S_2_RANGE__0___1_CM 1 100. 0. 1. DISPLAY_IDENTIFIER LV_CDN_DIAG_OFS_LSL_UP_1 ECU_ADDRESS 0xd00098a6 BIT_MASK 0x40 /end MEASUREMENT
/begin MEASUREMENT fmy_stat_ofs_lsl_up_1.err_info_stat.err_sym "symptoms of the diagnosis instance OFS_LSL_UP_1" UWORD _CNV_S_16_RANGE_ERR__349_CM 1 100. 0. 15. DISPLAY_IDENTIFIER ERR_SYM_OFS_LSL_UP_1 ECU_ADDRESS 0xd00098a6 BIT_MASK 0x780 /end MEASUREMENT
/begin MEASUREMENT fmy_stat_ttip_mes_lsh_up_1.ctr_abc "anti bounce counter for diagnosis instance TTIP_MES_LSH_UP_1" UBYTE _CNV_A_R_LINEAR_____0_CM 1 100. 0. 255. DISPLAY_IDENTIFIER CTR_ABC_TTIP_MES_LSH_UP_1 ECU_ADDRESS 0xd0009ad4 FORMAT "%3.0" /end MEASUREMENT
/begin MEASUREMENT fmy_stat_ttip_mes_lsh_up_1.ctr_end_diag "counter for end of diagnosis for diagnosis instance TTIP_MES_LSH_UP_1" UBYTE _CNV_A_R_LINEAR_____0_CM 1 100. 0. 255. DISPLAY_IDENTIFIER CTR_ABC_END_DIAG_TTIP_MES_LSH_UP_1 ECU_ADDRESS 0xd0009ad5 FORMAT "%3.0" /end MEASUREMENT
/begin MEASUREMENT fmy_stat_ttip_mes_lsh_up_1.err_info_stat.lv_err_mem "storage in dynamic failure memory of the diagnosis instance TTIP_MES_LSH_UP_1" UWORD _CNV_S_2_RANGE__0___1_CM 1 100. 0. 1. DISPLAY_IDENTIFIER LV_ERR_MEM_TTIP_MES_LSH_UP_1 ECU_ADDRESS 0xd0009ad6 BIT_MASK 0x8 /end MEASUREMENT
/begin MEASUREMENT fmy_stat_ttip_mes_lsh_up_1.err_info_stat.lv_ready "readiness status of the diagnosis instance TTIP_MES_LSH_UP_1" UWORD _CNV_S_2_RANGE__0___1_CM 1 100. 0. 1. DISPLAY_IDENTIFIER LV_READY_TTIP_MES_LSH_UP_1 ECU_ADDRESS 0xd0009ad6 BIT_MASK 0x10 /end MEASUREMENT
/begin MEASUREMENT fmy_stat_ttip_mes_lsh_up_1.err_info_stat.lv_end_diag "end of diagnosis of the diagnosis instance TTIP_MES_LSH_UP_1" UWORD _CNV_S_2_RANGE__0___1_CM 1 100. 0. 1. DISPLAY_IDENTIFIER LV_END_DIAG_TTIP_MES_LSH_UP_1 ECU_ADDRESS 0xd0009ad6 BIT_MASK 0x20 /end MEASUREMENT
/begin MEASUREMENT fmy_stat_ttip_mes_lsh_up_1.err_info_stat.lv_cdn_diag "diagnosis condition of the diagnosis instance TTIP_MES_LSH_UP_1" UWORD _CNV_S_2_RANGE__0___1_CM 1 100. 0. 1. DISPLAY_IDENTIFIER LV_CDN_DIAG_TTIP_MES_LSH_UP_1 ECU_ADDRESS 0xd0009ad6 BIT_MASK 0x40 /end MEASUREMENT
/begin MEASUREMENT fmy_stat_ttip_mes_lsh_up_1.err_info_stat.err_sym "symptoms of the diagnosis instance TTIP_MES_LSH_UP_1" UWORD _CNV_S_16_RANGE_ERR__349_CM 1 100. 0. 15. DISPLAY_IDENTIFIER ERR_SYM_TTIP_MES_LSH_UP_1 ECU_ADDRESS 0xd0009ad6 BIT_MASK 0x780 /end MEASUREMENT
/begin MEASUREMENT fmy_stat_ctl_lsl_up_1.ctr_abc "anti bounce counter for diagnosis instance CTL_LSL_UP_1" UBYTE _CNV_A_R_LINEAR_____0_CM 1 100. 0. 255. DISPLAY_IDENTIFIER CTR_ABC_CTL_LSL_UP_1 ECU_ADDRESS 0xd0009584 FORMAT "%3.0" /end MEASUREMENT
/begin MEASUREMENT fmy_stat_ctl_lsl_up_1.ctr_end_diag "counter for end of diagnosis for diagnosis instance CTL_LSL_UP_1" UBYTE _CNV_A_R_LINEAR_____0_CM 1 100. 0. 255. DISPLAY_IDENTIFIER CTR_ABC_END_DIAG_CTL_LSL_UP_1 ECU_ADDRESS 0xd0009585 FORMAT "%3.0" /end MEASUREMENT
/begin MEASUREMENT fmy_stat_ctl_lsl_up_1.err_info_stat.lv_err_mem "storage in dynamic failure memory of the diagnosis instance CTL_LSL_UP_1" UWORD _CNV_S_2_RANGE__0___1_CM 1 100. 0. 1. DISPLAY_IDENTIFIER LV_ERR_MEM_CTL_LSL_UP_1 ECU_ADDRESS 0xd0009586 BIT_MASK 0x8 /end MEASUREMENT
/begin MEASUREMENT fmy_stat_ctl_lsl_up_1.err_info_stat.lv_ready "readiness status of the diagnosis instance CTL_LSL_UP_1" UWORD _CNV_S_2_RANGE__0___1_CM 1 100. 0. 1. DISPLAY_IDENTIFIER LV_READY_CTL_LSL_UP_1 ECU_ADDRESS 0xd0009586 BIT_MASK 0x10 /end MEASUREMENT
/begin MEASUREMENT fmy_stat_ctl_lsl_up_1.err_info_stat.lv_end_diag "end of diagnosis of the diagnosis instance CTL_LSL_UP_1" UWORD _CNV_S_2_RANGE__0___1_CM 1 100. 0. 1. DISPLAY_IDENTIFIER LV_END_DIAG_CTL_LSL_UP_1 ECU_ADDRESS 0xd0009586 BIT_MASK 0x20 /end MEASUREMENT
/begin MEASUREMENT fmy_stat_ctl_lsl_up_1.err_info_stat.lv_cdn_diag "diagnosis condition of the diagnosis instance CTL_LSL_UP_1" UWORD _CNV_S_2_RANGE__0___1_CM 1 100. 0. 1. DISPLAY_IDENTIFIER LV_CDN_DIAG_CTL_LSL_UP_1 ECU_ADDRESS 0xd0009586 BIT_MASK 0x40 /end MEASUREMENT
/begin MEASUREMENT fmy_stat_ctl_lsl_up_1.err_info_stat.err_sym "symptoms of the diagnosis instance CTL_LSL_UP_1" UWORD _CNV_S_16_RANGE_ERR__349_CM 1 100. 0. 15. DISPLAY_IDENTIFIER ERR_SYM_CTL_LSL_UP_1 ECU_ADDRESS 0xd0009586 BIT_MASK 0x780 /end MEASUREMENT
/begin MEASUREMENT fmy_stat_chg_ls_down.ctr_abc "anti bounce counter for diagnosis instance CHG_LS_DOWN" UBYTE _CNV_A_R_LINEAR_____0_CM 1 100. 0. 255. DISPLAY_IDENTIFIER CTR_ABC_CHG_LS_DOWN ECU_ADDRESS 0xd0009494 FORMAT "%3.0" /end MEASUREMENT
/begin MEASUREMENT fmy_stat_chg_ls_down.ctr_end_diag "counter for end of diagnosis for diagnosis instance CHG_LS_DOWN" UBYTE _CNV_A_R_LINEAR_____0_CM 1 100. 0. 255. DISPLAY_IDENTIFIER CTR_ABC_END_DIAG_CHG_LS_DOWN ECU_ADDRESS 0xd0009495 FORMAT "%3.0" /end MEASUREMENT
/begin MEASUREMENT fmy_stat_chg_ls_down.err_info_stat.lv_err_mem "storage in dynamic failure memory of the diagnosis instance CHG_LS_DOWN" UWORD _CNV_S_2_RANGE__0___1_CM 1 100. 0. 1. DISPLAY_IDENTIFIER LV_ERR_MEM_CHG_LS_DOWN ECU_ADDRESS 0xd0009496 BIT_MASK 0x8 /end MEASUREMENT
/begin MEASUREMENT fmy_stat_chg_ls_down.err_info_stat.lv_ready "readiness status of the diagnosis instance CHG_LS_DOWN" UWORD _CNV_S_2_RANGE__0___1_CM 1 100. 0. 1. DISPLAY_IDENTIFIER LV_READY_CHG_LS_DOWN ECU_ADDRESS 0xd0009496 BIT_MASK 0x10 /end MEASUREMENT
/begin MEASUREMENT fmy_stat_chg_ls_down.err_info_stat.lv_end_diag "end of diagnosis of the diagnosis instance CHG_LS_DOWN" UWORD _CNV_S_2_RANGE__0___1_CM 1 100. 0. 1. DISPLAY_IDENTIFIER LV_END_DIAG_CHG_LS_DOWN ECU_ADDRESS 0xd0009496 BIT_MASK 0x20 /end MEASUREMENT
/begin MEASUREMENT fmy_stat_chg_ls_down.err_info_stat.lv_cdn_diag "diagnosis condition of the diagnosis instance CHG_LS_DOWN" UWORD _CNV_S_2_RANGE__0___1_CM 1 100. 0. 1. DISPLAY_IDENTIFIER LV_CDN_DIAG_CHG_LS_DOWN ECU_ADDRESS 0xd0009496 BIT_MASK 0x40 /end MEASUREMENT
/begin MEASUREMENT fmy_stat_chg_ls_down.err_info_stat.err_sym "symptoms of the diagnosis instance CHG_LS_DOWN" UWORD _CNV_S_16_RANGE_ERR__349_CM 1 100. 0. 15. DISPLAY_IDENTIFIER ERR_SYM_CHG_LS_DOWN ECU_ADDRESS 0xd0009496 BIT_MASK 0x780 /end MEASUREMENT
/begin MEASUREMENT fmy_stat_scg_ls_down_2.ctr_abc "anti bounce counter for diagnosis instance SCG_LS_DOWN_2" UBYTE _CNV_A_R_LINEAR_____0_CM 1 100. 0. 255. DISPLAY_IDENTIFIER CTR_ABC_SCG_LS_DOWN_2 ECU_ADDRESS 0xd0009968 FORMAT "%3.0" /end MEASUREMENT
/begin MEASUREMENT fmy_stat_scg_ls_down_2.ctr_end_diag "counter for end of diagnosis for diagnosis instance SCG_LS_DOWN_2" UBYTE _CNV_A_R_LINEAR_____0_CM 1 100. 0. 255. DISPLAY_IDENTIFIER CTR_ABC_END_DIAG_SCG_LS_DOWN_2 ECU_ADDRESS 0xd0009969 FORMAT "%3.0" /end MEASUREMENT
/begin MEASUREMENT fmy_stat_scg_ls_down_2.err_info_stat.lv_err_mem "storage in dynamic failure memory of the diagnosis instance SCG_LS_DOWN_2" UWORD _CNV_S_2_RANGE__0___1_CM 1 100. 0. 1. DISPLAY_IDENTIFIER LV_ERR_MEM_SCG_LS_DOWN_2 ECU_ADDRESS 0xd000996a BIT_MASK 0x8 /end MEASUREMENT
/begin MEASUREMENT fmy_stat_scg_ls_down_2.err_info_stat.lv_ready "readiness status of the diagnosis instance SCG_LS_DOWN_2" UWORD _CNV_S_2_RANGE__0___1_CM 1 100. 0. 1. DISPLAY_IDENTIFIER LV_READY_SCG_LS_DOWN_2 ECU_ADDRESS 0xd000996a BIT_MASK 0x10 /end MEASUREMENT
/begin MEASUREMENT fmy_stat_scg_ls_down_2.err_info_stat.lv_end_diag "end of diagnosis of the diagnosis instance SCG_LS_DOWN_2" UWORD _CNV_S_2_RANGE__0___1_CM 1 100. 0. 1. DISPLAY_IDENTIFIER LV_END_DIAG_SCG_LS_DOWN_2 ECU_ADDRESS 0xd000996a BIT_MASK 0x20 /end MEASUREMENT
/begin MEASUREMENT fmy_stat_scg_ls_down_2.err_info_stat.lv_cdn_diag "diagnosis condition of the diagnosis instance SCG_LS_DOWN_2" UWORD _CNV_S_2_RANGE__0___1_CM 1 100. 0. 1. DISPLAY_IDENTIFIER LV_CDN_DIAG_SCG_LS_DOWN_2 ECU_ADDRESS 0xd000996a BIT_MASK 0x40 /end MEASUREMENT
/begin MEASUREMENT fmy_stat_scg_ls_down_2.err_info_stat.err_sym "symptoms of the diagnosis instance SCG_LS_DOWN_2" UWORD _CNV_S_16_RANGE_ERR__349_CM 1 100. 0. 15. DISPLAY_IDENTIFIER ERR_SYM_SCG_LS_DOWN_2 ECU_ADDRESS 0xd000996a BIT_MASK 0x780 /end MEASUREMENT
/begin MEASUREMENT fmy_stat_scp_ls_down_2.ctr_abc "anti bounce counter for diagnosis instance SCP_LS_DOWN_2" UBYTE _CNV_A_R_LINEAR_____0_CM 1 100. 0. 255. DISPLAY_IDENTIFIER CTR_ABC_SCP_LS_DOWN_2 ECU_ADDRESS 0xd0009970 FORMAT "%3.0" /end MEASUREMENT
/begin MEASUREMENT fmy_stat_scp_ls_down_2.ctr_end_diag "counter for end of diagnosis for diagnosis instance SCP_LS_DOWN_2" UBYTE _CNV_A_R_LINEAR_____0_CM 1 100. 0. 255. DISPLAY_IDENTIFIER CTR_ABC_END_DIAG_SCP_LS_DOWN_2 ECU_ADDRESS 0xd0009971 FORMAT "%3.0" /end MEASUREMENT
/begin MEASUREMENT fmy_stat_scp_ls_down_2.err_info_stat.lv_err_mem "storage in dynamic failure memory of the diagnosis instance SCP_LS_DOWN_2" UWORD _CNV_S_2_RANGE__0___1_CM 1 100. 0. 1. DISPLAY_IDENTIFIER LV_ERR_MEM_SCP_LS_DOWN_2 ECU_ADDRESS 0xd0009972 BIT_MASK 0x8 /end MEASUREMENT
/begin MEASUREMENT fmy_stat_scp_ls_down_2.err_info_stat.lv_ready "readiness status of the diagnosis instance SCP_LS_DOWN_2" UWORD _CNV_S_2_RANGE__0___1_CM 1 100. 0. 1. DISPLAY_IDENTIFIER LV_READY_SCP_LS_DOWN_2 ECU_ADDRESS 0xd0009972 BIT_MASK 0x10 /end MEASUREMENT
/begin MEASUREMENT fmy_stat_scp_ls_down_2.err_info_stat.lv_end_diag "end of diagnosis of the diagnosis instance SCP_LS_DOWN_2" UWORD _CNV_S_2_RANGE__0___1_CM 1 100. 0. 1. DISPLAY_IDENTIFIER LV_END_DIAG_SCP_LS_DOWN_2 ECU_ADDRESS 0xd0009972 BIT_MASK 0x20 /end MEASUREMENT
/begin MEASUREMENT fmy_stat_scp_ls_down_2.err_info_stat.lv_cdn_diag "diagnosis condition of the diagnosis instance SCP_LS_DOWN_2" UWORD _CNV_S_2_RANGE__0___1_CM 1 100. 0. 1. DISPLAY_IDENTIFIER LV_CDN_DIAG_SCP_LS_DOWN_2 ECU_ADDRESS 0xd0009972 BIT_MASK 0x40 /end MEASUREMENT
/begin MEASUREMENT fmy_stat_scp_ls_down_2.err_info_stat.err_sym "symptoms of the diagnosis instance SCP_LS_DOWN_2" UWORD _CNV_S_16_RANGE_ERR__349_CM 1 100. 0. 15. DISPLAY_IDENTIFIER ERR_SYM_SCP_LS_DOWN_2 ECU_ADDRESS 0xd0009972 BIT_MASK 0x780 /end MEASUREMENT
/begin MEASUREMENT fmy_stat_oc_ls_down_2.ctr_abc "anti bounce counter for diagnosis instance OC_LS_DOWN_2" UBYTE _CNV_A_R_LINEAR_____0_CM 1 100. 0. 255. DISPLAY_IDENTIFIER CTR_ABC_OC_LS_DOWN_2 ECU_ADDRESS 0xd0009898 FORMAT "%3.0" /end MEASUREMENT
/begin MEASUREMENT fmy_stat_oc_ls_down_2.ctr_end_diag "counter for end of diagnosis for diagnosis instance OC_LS_DOWN_2" UBYTE _CNV_A_R_LINEAR_____0_CM 1 100. 0. 255. DISPLAY_IDENTIFIER CTR_ABC_END_DIAG_OC_LS_DOWN_2 ECU_ADDRESS 0xd0009899 FORMAT "%3.0" /end MEASUREMENT
/begin MEASUREMENT fmy_stat_oc_ls_down_2.err_info_stat.lv_err_mem "storage in dynamic failure memory of the diagnosis instance OC_LS_DOWN_2" UWORD _CNV_S_2_RANGE__0___1_CM 1 100. 0. 1. DISPLAY_IDENTIFIER LV_ERR_MEM_OC_LS_DOWN_2 ECU_ADDRESS 0xd000989a BIT_MASK 0x8 /end MEASUREMENT
/begin MEASUREMENT fmy_stat_oc_ls_down_2.err_info_stat.lv_ready "readiness status of the diagnosis instance OC_LS_DOWN_2" UWORD _CNV_S_2_RANGE__0___1_CM 1 100. 0. 1. DISPLAY_IDENTIFIER LV_READY_OC_LS_DOWN_2 ECU_ADDRESS 0xd000989a BIT_MASK 0x10 /end MEASUREMENT
/begin MEASUREMENT fmy_stat_oc_ls_down_2.err_info_stat.lv_end_diag "end of diagnosis of the diagnosis instance OC_LS_DOWN_2" UWORD _CNV_S_2_RANGE__0___1_CM 1 100. 0. 1. DISPLAY_IDENTIFIER LV_END_DIAG_OC_LS_DOWN_2 ECU_ADDRESS 0xd000989a BIT_MASK 0x20 /end MEASUREMENT
/begin MEASUREMENT fmy_stat_oc_ls_down_2.err_info_stat.lv_cdn_diag "diagnosis condition of the diagnosis instance OC_LS_DOWN_2" UWORD _CNV_S_2_RANGE__0___1_CM 1 100. 0. 1. DISPLAY_IDENTIFIER LV_CDN_DIAG_OC_LS_DOWN_2 ECU_ADDRESS 0xd000989a BIT_MASK 0x40 /end MEASUREMENT
/begin MEASUREMENT fmy_stat_oc_ls_down_2.err_info_stat.err_sym "symptoms of the diagnosis instance OC_LS_DOWN_2" UWORD _CNV_S_16_RANGE_ERR__349_CM 1 100. 0. 15. DISPLAY_IDENTIFIER ERR_SYM_OC_LS_DOWN_2 ECU_ADDRESS 0xd000989a BIT_MASK 0x780 /end MEASUREMENT
/begin MEASUREMENT fmy_stat_puc_ls_down_2.ctr_abc "anti bounce counter for diagnosis instance PUC_LS_DOWN_2" UBYTE _CNV_A_R_LINEAR_____0_CM 1 100. 0. 255. DISPLAY_IDENTIFIER CTR_ABC_PUC_LS_DOWN_2 ECU_ADDRESS 0xd00098f0 FORMAT "%3.0" /end MEASUREMENT
/begin MEASUREMENT fmy_stat_puc_ls_down_2.ctr_end_diag "counter for end of diagnosis for diagnosis instance PUC_LS_DOWN_2" UBYTE _CNV_A_R_LINEAR_____0_CM 1 100. 0. 255. DISPLAY_IDENTIFIER CTR_ABC_END_DIAG_PUC_LS_DOWN_2 ECU_ADDRESS 0xd00098f1 FORMAT "%3.0" /end MEASUREMENT
/begin MEASUREMENT fmy_stat_puc_ls_down_2.err_info_stat.lv_err_mem "storage in dynamic failure memory of the diagnosis instance PUC_LS_DOWN_2" UWORD _CNV_S_2_RANGE__0___1_CM 1 100. 0. 1. DISPLAY_IDENTIFIER LV_ERR_MEM_PUC_LS_DOWN_2 ECU_ADDRESS 0xd00098f2 BIT_MASK 0x8 /end MEASUREMENT
/begin MEASUREMENT fmy_stat_puc_ls_down_2.err_info_stat.lv_ready "readiness status of the diagnosis instance PUC_LS_DOWN_2" UWORD _CNV_S_2_RANGE__0___1_CM 1 100. 0. 1. DISPLAY_IDENTIFIER LV_READY_PUC_LS_DOWN_2 ECU_ADDRESS 0xd00098f2 BIT_MASK 0x10 /end MEASUREMENT
/begin MEASUREMENT fmy_stat_puc_ls_down_2.err_info_stat.lv_end_diag "end of diagnosis of the diagnosis instance PUC_LS_DOWN_2" UWORD _CNV_S_2_RANGE__0___1_CM 1 100. 0. 1. DISPLAY_IDENTIFIER LV_END_DIAG_PUC_LS_DOWN_2 ECU_ADDRESS 0xd00098f2 BIT_MASK 0x20 /end MEASUREMENT
/begin MEASUREMENT fmy_stat_puc_ls_down_2.err_info_stat.lv_cdn_diag "diagnosis condition of the diagnosis instance PUC_LS_DOWN_2" UWORD _CNV_S_2_RANGE__0___1_CM 1 100. 0. 1. DISPLAY_IDENTIFIER LV_CDN_DIAG_PUC_LS_DOWN_2 ECU_ADDRESS 0xd00098f2 BIT_MASK 0x40 /end MEASUREMENT
/begin MEASUREMENT fmy_stat_puc_ls_down_2.err_info_stat.err_sym "symptoms of the diagnosis instance PUC_LS_DOWN_2" UWORD _CNV_S_16_RANGE_ERR__349_CM 1 100. 0. 15. DISPLAY_IDENTIFIER ERR_SYM_PUC_LS_DOWN_2 ECU_ADDRESS 0xd00098f2 BIT_MASK 0x780 /end MEASUREMENT
/begin MEASUREMENT fmy_stat_fl_ls_down_2.ctr_abc "anti bounce counter for diagnosis instance FL_LS_DOWN_2" UBYTE _CNV_A_R_LINEAR_____0_CM 1 100. 0. 255. DISPLAY_IDENTIFIER CTR_ABC_FL_LS_DOWN_2 ECU_ADDRESS 0xd0009680 FORMAT "%3.0" /end MEASUREMENT
/begin MEASUREMENT fmy_stat_fl_ls_down_2.ctr_end_diag "counter for end of diagnosis for diagnosis instance FL_LS_DOWN_2" UBYTE _CNV_A_R_LINEAR_____0_CM 1 100. 0. 255. DISPLAY_IDENTIFIER CTR_ABC_END_DIAG_FL_LS_DOWN_2 ECU_ADDRESS 0xd0009681 FORMAT "%3.0" /end MEASUREMENT
/begin MEASUREMENT fmy_stat_fl_ls_down_2.err_info_stat.lv_err_mem "storage in dynamic failure memory of the diagnosis instance FL_LS_DOWN_2" UWORD _CNV_S_2_RANGE__0___1_CM 1 100. 0. 1. DISPLAY_IDENTIFIER LV_ERR_MEM_FL_LS_DOWN_2 ECU_ADDRESS 0xd0009682 BIT_MASK 0x8 /end MEASUREMENT
/begin MEASUREMENT fmy_stat_fl_ls_down_2.err_info_stat.lv_ready "readiness status of the diagnosis instance FL_LS_DOWN_2" UWORD _CNV_S_2_RANGE__0___1_CM 1 100. 0. 1. DISPLAY_IDENTIFIER LV_READY_FL_LS_DOWN_2 ECU_ADDRESS 0xd0009682 BIT_MASK 0x10 /end MEASUREMENT
/begin MEASUREMENT fmy_stat_fl_ls_down_2.err_info_stat.lv_end_diag "end of diagnosis of the diagnosis instance FL_LS_DOWN_2" UWORD _CNV_S_2_RANGE__0___1_CM 1 100. 0. 1. DISPLAY_IDENTIFIER LV_END_DIAG_FL_LS_DOWN_2 ECU_ADDRESS 0xd0009682 BIT_MASK 0x20 /end MEASUREMENT
/begin MEASUREMENT fmy_stat_fl_ls_down_2.err_info_stat.lv_cdn_diag "diagnosis condition of the diagnosis instance FL_LS_DOWN_2" UWORD _CNV_S_2_RANGE__0___1_CM 1 100. 0. 1. DISPLAY_IDENTIFIER LV_CDN_DIAG_FL_LS_DOWN_2 ECU_ADDRESS 0xd0009682 BIT_MASK 0x40 /end MEASUREMENT
/begin MEASUREMENT fmy_stat_fl_ls_down_2.err_info_stat.err_sym "symptoms of the diagnosis instance FL_LS_DOWN_2" UWORD _CNV_S_16_RANGE_ERR__349_CM 1 100. 0. 15. DISPLAY_IDENTIFIER ERR_SYM_FL_LS_DOWN_2 ECU_ADDRESS 0xd0009682 BIT_MASK 0x780 /end MEASUREMENT
/begin MEASUREMENT fmy_stat_lsl_up_if_2.ctr_abc "anti bounce counter for diagnosis instance LSL_UP_IF_2" UBYTE _CNV_A_R_LINEAR_____0_CM 1 100. 0. 255. DISPLAY_IDENTIFIER CTR_ABC_LSL_UP_IF_2 ECU_ADDRESS 0xd00097e8 FORMAT "%3.0" /end MEASUREMENT
/begin MEASUREMENT fmy_stat_lsl_up_if_2.ctr_end_diag "counter for end of diagnosis for diagnosis instance LSL_UP_IF_2" UBYTE _CNV_A_R_LINEAR_____0_CM 1 100. 0. 255. DISPLAY_IDENTIFIER CTR_ABC_END_DIAG_LSL_UP_IF_2 ECU_ADDRESS 0xd00097e9 FORMAT "%3.0" /end MEASUREMENT
/begin MEASUREMENT fmy_stat_lsl_up_if_2.err_info_stat.lv_err_mem "storage in dynamic failure memory of the diagnosis instance LSL_UP_IF_2" UWORD _CNV_S_2_RANGE__0___1_CM 1 100. 0. 1. DISPLAY_IDENTIFIER LV_ERR_MEM_LSL_UP_IF_2 ECU_ADDRESS 0xd00097ea BIT_MASK 0x8 /end MEASUREMENT
/begin MEASUREMENT fmy_stat_lsl_up_if_2.err_info_stat.lv_ready "readiness status of the diagnosis instance LSL_UP_IF_2" UWORD _CNV_S_2_RANGE__0___1_CM 1 100. 0. 1. DISPLAY_IDENTIFIER LV_READY_LSL_UP_IF_2 ECU_ADDRESS 0xd00097ea BIT_MASK 0x10 /end MEASUREMENT
/begin MEASUREMENT fmy_stat_lsl_up_if_2.err_info_stat.lv_end_diag "end of diagnosis of the diagnosis instance LSL_UP_IF_2" UWORD _CNV_S_2_RANGE__0___1_CM 1 100. 0. 1. DISPLAY_IDENTIFIER LV_END_DIAG_LSL_UP_IF_2 ECU_ADDRESS 0xd00097ea BIT_MASK 0x20 /end MEASUREMENT
/begin MEASUREMENT fmy_stat_lsl_up_if_2.err_info_stat.lv_cdn_diag "diagnosis condition of the diagnosis instance LSL_UP_IF_2" UWORD _CNV_S_2_RANGE__0___1_CM 1 100. 0. 1. DISPLAY_IDENTIFIER LV_CDN_DIAG_LSL_UP_IF_2 ECU_ADDRESS 0xd00097ea BIT_MASK 0x40 /end MEASUREMENT
/begin MEASUREMENT fmy_stat_lsl_up_if_2.err_info_stat.err_sym "symptoms of the diagnosis instance LSL_UP_IF_2" UWORD _CNV_S_16_RANGE_ERR__349_CM 1 100. 0. 15. DISPLAY_IDENTIFIER ERR_SYM_LSL_UP_IF_2 ECU_ADDRESS 0xd00097ea BIT_MASK 0x780 /end MEASUREMENT
/begin MEASUREMENT fmy_stat_el_lsl_up_2.ctr_abc "anti bounce counter for diagnosis instance EL_LSL_UP_2" UBYTE _CNV_A_R_LINEAR_____0_CM 1 100. 0. 255. DISPLAY_IDENTIFIER CTR_ABC_EL_LSL_UP_2 ECU_ADDRESS 0xd0009660 FORMAT "%3.0" /end MEASUREMENT
/begin MEASUREMENT fmy_stat_el_lsl_up_2.ctr_end_diag "counter for end of diagnosis for diagnosis instance EL_LSL_UP_2" UBYTE _CNV_A_R_LINEAR_____0_CM 1 100. 0. 255. DISPLAY_IDENTIFIER CTR_ABC_END_DIAG_EL_LSL_UP_2 ECU_ADDRESS 0xd0009661 FORMAT "%3.0" /end MEASUREMENT
/begin MEASUREMENT fmy_stat_el_lsl_up_2.err_info_stat.lv_err_mem "storage in dynamic failure memory of the diagnosis instance EL_LSL_UP_2" UWORD _CNV_S_2_RANGE__0___1_CM 1 100. 0. 1. DISPLAY_IDENTIFIER LV_ERR_MEM_EL_LSL_UP_2 ECU_ADDRESS 0xd0009662 BIT_MASK 0x8 /end MEASUREMENT
/begin MEASUREMENT fmy_stat_el_lsl_up_2.err_info_stat.lv_ready "readiness status of the diagnosis instance EL_LSL_UP_2" UWORD _CNV_S_2_RANGE__0___1_CM 1 100. 0. 1. DISPLAY_IDENTIFIER LV_READY_EL_LSL_UP_2 ECU_ADDRESS 0xd0009662 BIT_MASK 0x10 /end MEASUREMENT
/begin MEASUREMENT fmy_stat_el_lsl_up_2.err_info_stat.lv_end_diag "end of diagnosis of the diagnosis instance EL_LSL_UP_2" UWORD _CNV_S_2_RANGE__0___1_CM 1 100. 0. 1. DISPLAY_IDENTIFIER LV_END_DIAG_EL_LSL_UP_2 ECU_ADDRESS 0xd0009662 BIT_MASK 0x20 /end MEASUREMENT
/begin MEASUREMENT fmy_stat_el_lsl_up_2.err_info_stat.lv_cdn_diag "diagnosis condition of the diagnosis instance EL_LSL_UP_2" UWORD _CNV_S_2_RANGE__0___1_CM 1 100. 0. 1. DISPLAY_IDENTIFIER LV_CDN_DIAG_EL_LSL_UP_2 ECU_ADDRESS 0xd0009662 BIT_MASK 0x40 /end MEASUREMENT
/begin MEASUREMENT fmy_stat_el_lsl_up_2.err_info_stat.err_sym "symptoms of the diagnosis instance EL_LSL_UP_2" UWORD _CNV_S_16_RANGE_ERR__349_CM 1 100. 0. 15. DISPLAY_IDENTIFIER ERR_SYM_EL_LSL_UP_2 ECU_ADDRESS 0xd0009662 BIT_MASK 0x780 /end MEASUREMENT
/begin MEASUREMENT fmy_stat_lsh_up_2.ctr_abc "anti bounce counter for diagnosis instance LSH_UP_2" UBYTE _CNV_A_R_LINEAR_____0_CM 1 100. 0. 255. DISPLAY_IDENTIFIER CTR_ABC_LSH_UP_2 ECU_ADDRESS 0xd00097e0 FORMAT "%3.0" /end MEASUREMENT
/begin MEASUREMENT fmy_stat_lsh_up_2.ctr_end_diag "counter for end of diagnosis for diagnosis instance LSH_UP_2" UBYTE _CNV_A_R_LINEAR_____0_CM 1 100. 0. 255. DISPLAY_IDENTIFIER CTR_ABC_END_DIAG_LSH_UP_2 ECU_ADDRESS 0xd00097e1 FORMAT "%3.0" /end MEASUREMENT
/begin MEASUREMENT fmy_stat_lsh_up_2.err_info_stat.lv_err_mem "storage in dynamic failure memory of the diagnosis instance LSH_UP_2" UWORD _CNV_S_2_RANGE__0___1_CM 1 100. 0. 1. DISPLAY_IDENTIFIER LV_ERR_MEM_LSH_UP_2 ECU_ADDRESS 0xd00097e2 BIT_MASK 0x8 /end MEASUREMENT
/begin MEASUREMENT fmy_stat_lsh_up_2.err_info_stat.lv_ready "readiness status of the diagnosis instance LSH_UP_2" UWORD _CNV_S_2_RANGE__0___1_CM 1 100. 0. 1. DISPLAY_IDENTIFIER LV_READY_LSH_UP_2 ECU_ADDRESS 0xd00097e2 BIT_MASK 0x10 /end MEASUREMENT
/begin MEASUREMENT fmy_stat_lsh_up_2.err_info_stat.lv_end_diag "end of diagnosis of the diagnosis instance LSH_UP_2" UWORD _CNV_S_2_RANGE__0___1_CM 1 100. 0. 1. DISPLAY_IDENTIFIER LV_END_DIAG_LSH_UP_2 ECU_ADDRESS 0xd00097e2 BIT_MASK 0x20 /end MEASUREMENT
/begin MEASUREMENT fmy_stat_lsh_up_2.err_info_stat.lv_cdn_diag "diagnosis condition of the diagnosis instance LSH_UP_2" UWORD _CNV_S_2_RANGE__0___1_CM 1 100. 0. 1. DISPLAY_IDENTIFIER LV_CDN_DIAG_LSH_UP_2 ECU_ADDRESS 0xd00097e2 BIT_MASK 0x40 /end MEASUREMENT
/begin MEASUREMENT fmy_stat_lsh_up_2.err_info_stat.err_sym "symptoms of the diagnosis instance LSH_UP_2" UWORD _CNV_S_16_RANGE_ERR__349_CM 1 100. 0. 15. DISPLAY_IDENTIFIER ERR_SYM_LSH_UP_2 ECU_ADDRESS 0xd00097e2 BIT_MASK 0x780 /end MEASUREMENT
/begin MEASUREMENT fmy_stat_lsh_down_2.ctr_abc "anti bounce counter for diagnosis instance LSH_DOWN_2" UBYTE _CNV_A_R_LINEAR_____0_CM 1 100. 0. 255. DISPLAY_IDENTIFIER CTR_ABC_LSH_DOWN_2 ECU_ADDRESS 0xd00097d0 FORMAT "%3.0" /end MEASUREMENT
/begin MEASUREMENT fmy_stat_lsh_down_2.ctr_end_diag "counter for end of diagnosis for diagnosis instance LSH_DOWN_2" UBYTE _CNV_A_R_LINEAR_____0_CM 1 100. 0. 255. DISPLAY_IDENTIFIER CTR_ABC_END_DIAG_LSH_DOWN_2 ECU_ADDRESS 0xd00097d1 FORMAT "%3.0" /end MEASUREMENT
/begin MEASUREMENT fmy_stat_lsh_down_2.err_info_stat.lv_err_mem "storage in dynamic failure memory of the diagnosis instance LSH_DOWN_2" UWORD _CNV_S_2_RANGE__0___1_CM 1 100. 0. 1. DISPLAY_IDENTIFIER LV_ERR_MEM_LSH_DOWN_2 ECU_ADDRESS 0xd00097d2 BIT_MASK 0x8 /end MEASUREMENT
/begin MEASUREMENT fmy_stat_lsh_down_2.err_info_stat.lv_ready "readiness status of the diagnosis instance LSH_DOWN_2" UWORD _CNV_S_2_RANGE__0___1_CM 1 100. 0. 1. DISPLAY_IDENTIFIER LV_READY_LSH_DOWN_2 ECU_ADDRESS 0xd00097d2 BIT_MASK 0x10 /end MEASUREMENT
/begin MEASUREMENT fmy_stat_lsh_down_2.err_info_stat.lv_end_diag "end of diagnosis of the diagnosis instance LSH_DOWN_2" UWORD _CNV_S_2_RANGE__0___1_CM 1 100. 0. 1. DISPLAY_IDENTIFIER LV_END_DIAG_LSH_DOWN_2 ECU_ADDRESS 0xd00097d2 BIT_MASK 0x20 /end MEASUREMENT
/begin MEASUREMENT fmy_stat_lsh_down_2.err_info_stat.lv_cdn_diag "diagnosis condition of the diagnosis instance LSH_DOWN_2" UWORD _CNV_S_2_RANGE__0___1_CM 1 100. 0. 1. DISPLAY_IDENTIFIER LV_CDN_DIAG_LSH_DOWN_2 ECU_ADDRESS 0xd00097d2 BIT_MASK 0x40 /end MEASUREMENT
/begin MEASUREMENT fmy_stat_lsh_down_2.err_info_stat.err_sym "symptoms of the diagnosis instance LSH_DOWN_2" UWORD _CNV_S_16_RANGE_ERR__349_CM 1 100. 0. 15. DISPLAY_IDENTIFIER ERR_SYM_LSH_DOWN_2 ECU_ADDRESS 0xd00097d2 BIT_MASK 0x780 /end MEASUREMENT
/begin MEASUREMENT fmy_stat_vls_down_dif_2.ctr_abc "anti bounce counter for diagnosis instance VLS_DOWN_DIF_2" UBYTE _CNV_A_R_LINEAR_____0_CM 1 100. 0. 255. DISPLAY_IDENTIFIER CTR_ABC_VLS_DOWN_DIF_2 ECU_ADDRESS 0xd0009af8 FORMAT "%3.0" /end MEASUREMENT
/begin MEASUREMENT fmy_stat_vls_down_dif_2.ctr_end_diag "counter for end of diagnosis for diagnosis instance VLS_DOWN_DIF_2" UBYTE _CNV_A_R_LINEAR_____0_CM 1 100. 0. 255. DISPLAY_IDENTIFIER CTR_ABC_END_DIAG_VLS_DOWN_DIF_2 ECU_ADDRESS 0xd0009af9 FORMAT "%3.0" /end MEASUREMENT
/begin MEASUREMENT fmy_stat_vls_down_dif_2.err_info_stat.lv_err_mem "storage in dynamic failure memory of the diagnosis instance VLS_DOWN_DIF_2" UWORD _CNV_S_2_RANGE__0___1_CM 1 100. 0. 1. DISPLAY_IDENTIFIER LV_ERR_MEM_VLS_DOWN_DIF_2 ECU_ADDRESS 0xd0009afa BIT_MASK 0x8 /end MEASUREMENT
/begin MEASUREMENT fmy_stat_vls_down_dif_2.err_info_stat.lv_ready "readiness status of the diagnosis instance VLS_DOWN_DIF_2" UWORD _CNV_S_2_RANGE__0___1_CM 1 100. 0. 1. DISPLAY_IDENTIFIER LV_READY_VLS_DOWN_DIF_2 ECU_ADDRESS 0xd0009afa BIT_MASK 0x10 /end MEASUREMENT
/begin MEASUREMENT fmy_stat_vls_down_dif_2.err_info_stat.lv_end_diag "end of diagnosis of the diagnosis instance VLS_DOWN_DIF_2" UWORD _CNV_S_2_RANGE__0___1_CM 1 100. 0. 1. DISPLAY_IDENTIFIER LV_END_DIAG_VLS_DOWN_DIF_2 ECU_ADDRESS 0xd0009afa BIT_MASK 0x20 /end MEASUREMENT
/begin MEASUREMENT fmy_stat_vls_down_dif_2.err_info_stat.lv_cdn_diag "diagnosis condition of the diagnosis instance VLS_DOWN_DIF_2" UWORD _CNV_S_2_RANGE__0___1_CM 1 100. 0. 1. DISPLAY_IDENTIFIER LV_CDN_DIAG_VLS_DOWN_DIF_2 ECU_ADDRESS 0xd0009afa BIT_MASK 0x40 /end MEASUREMENT
/begin MEASUREMENT fmy_stat_vls_down_dif_2.err_info_stat.err_sym "symptoms of the diagnosis instance VLS_DOWN_DIF_2" UWORD _CNV_S_16_RANGE_ERR__349_CM 1 100. 0. 15. DISPLAY_IDENTIFIER ERR_SYM_VLS_DOWN_DIF_2 ECU_ADDRESS 0xd0009afa BIT_MASK 0x780 /end MEASUREMENT
/begin MEASUREMENT fmy_stat_lsh_lsl_up_2.ctr_abc "anti bounce counter for diagnosis instance LSH_LSL_UP_2" UBYTE _CNV_A_R_LINEAR_____0_CM 1 100. 0. 255. DISPLAY_IDENTIFIER CTR_ABC_LSH_LSL_UP_2 ECU_ADDRESS 0xd00097d8 FORMAT "%3.0" /end MEASUREMENT
/begin MEASUREMENT fmy_stat_lsh_lsl_up_2.ctr_end_diag "counter for end of diagnosis for diagnosis instance LSH_LSL_UP_2" UBYTE _CNV_A_R_LINEAR_____0_CM 1 100. 0. 255. DISPLAY_IDENTIFIER CTR_ABC_END_DIAG_LSH_LSL_UP_2 ECU_ADDRESS 0xd00097d9 FORMAT "%3.0" /end MEASUREMENT
/begin MEASUREMENT fmy_stat_lsh_lsl_up_2.err_info_stat.lv_err_mem "storage in dynamic failure memory of the diagnosis instance LSH_LSL_UP_2" UWORD _CNV_S_2_RANGE__0___1_CM 1 100. 0. 1. DISPLAY_IDENTIFIER LV_ERR_MEM_LSH_LSL_UP_2 ECU_ADDRESS 0xd00097da BIT_MASK 0x8 /end MEASUREMENT
/begin MEASUREMENT fmy_stat_lsh_lsl_up_2.err_info_stat.lv_ready "readiness status of the diagnosis instance LSH_LSL_UP_2" UWORD _CNV_S_2_RANGE__0___1_CM 1 100. 0. 1. DISPLAY_IDENTIFIER LV_READY_LSH_LSL_UP_2 ECU_ADDRESS 0xd00097da BIT_MASK 0x10 /end MEASUREMENT
/begin MEASUREMENT fmy_stat_lsh_lsl_up_2.err_info_stat.lv_end_diag "end of diagnosis of the diagnosis instance LSH_LSL_UP_2" UWORD _CNV_S_2_RANGE__0___1_CM 1 100. 0. 1. DISPLAY_IDENTIFIER LV_END_DIAG_LSH_LSL_UP_2 ECU_ADDRESS 0xd00097da BIT_MASK 0x20 /end MEASUREMENT
/begin MEASUREMENT fmy_stat_lsh_lsl_up_2.err_info_stat.lv_cdn_diag "diagnosis condition of the diagnosis instance LSH_LSL_UP_2" UWORD _CNV_S_2_RANGE__0___1_CM 1 100. 0. 1. DISPLAY_IDENTIFIER LV_CDN_DIAG_LSH_LSL_UP_2 ECU_ADDRESS 0xd00097da BIT_MASK 0x40 /end MEASUREMENT
/begin MEASUREMENT fmy_stat_lsh_lsl_up_2.err_info_stat.err_sym "symptoms of the diagnosis instance LSH_LSL_UP_2" UWORD _CNV_S_16_RANGE_ERR__349_CM 1 100. 0. 15. DISPLAY_IDENTIFIER ERR_SYM_LSH_LSL_UP_2 ECU_ADDRESS 0xd00097da BIT_MASK 0x780 /end MEASUREMENT
/begin MEASUREMENT fmy_stat_air_lsl_up_2.ctr_abc "anti bounce counter for diagnosis instance AIR_LSL_UP_2" UBYTE _CNV_A_R_LINEAR_____0_CM 1 100. 0. 255. DISPLAY_IDENTIFIER CTR_ABC_AIR_LSL_UP_2 ECU_ADDRESS 0xd00093c8 FORMAT "%3.0" /end MEASUREMENT
/begin MEASUREMENT fmy_stat_air_lsl_up_2.ctr_end_diag "counter for end of diagnosis for diagnosis instance AIR_LSL_UP_2" UBYTE _CNV_A_R_LINEAR_____0_CM 1 100. 0. 255. DISPLAY_IDENTIFIER CTR_ABC_END_DIAG_AIR_LSL_UP_2 ECU_ADDRESS 0xd00093c9 FORMAT "%3.0" /end MEASUREMENT
/begin MEASUREMENT fmy_stat_air_lsl_up_2.err_info_stat.lv_err_mem "storage in dynamic failure memory of the diagnosis instance AIR_LSL_UP_2" UWORD _CNV_S_2_RANGE__0___1_CM 1 100. 0. 1. DISPLAY_IDENTIFIER LV_ERR_MEM_AIR_LSL_UP_2 ECU_ADDRESS 0xd00093ca BIT_MASK 0x8 /end MEASUREMENT
/begin MEASUREMENT fmy_stat_air_lsl_up_2.err_info_stat.lv_ready "readiness status of the diagnosis instance AIR_LSL_UP_2" UWORD _CNV_S_2_RANGE__0___1_CM 1 100. 0. 1. DISPLAY_IDENTIFIER LV_READY_AIR_LSL_UP_2 ECU_ADDRESS 0xd00093ca BIT_MASK 0x10 /end MEASUREMENT
/begin MEASUREMENT fmy_stat_air_lsl_up_2.err_info_stat.lv_end_diag "end of diagnosis of the diagnosis instance AIR_LSL_UP_2" UWORD _CNV_S_2_RANGE__0___1_CM 1 100. 0. 1. DISPLAY_IDENTIFIER LV_END_DIAG_AIR_LSL_UP_2 ECU_ADDRESS 0xd00093ca BIT_MASK 0x20 /end MEASUREMENT
/begin MEASUREMENT fmy_stat_air_lsl_up_2.err_info_stat.lv_cdn_diag "diagnosis condition of the diagnosis instance AIR_LSL_UP_2" UWORD _CNV_S_2_RANGE__0___1_CM 1 100. 0. 1. DISPLAY_IDENTIFIER LV_CDN_DIAG_AIR_LSL_UP_2 ECU_ADDRESS 0xd00093ca BIT_MASK 0x40 /end MEASUREMENT
/begin MEASUREMENT fmy_stat_air_lsl_up_2.err_info_stat.err_sym "symptoms of the diagnosis instance AIR_LSL_UP_2" UWORD _CNV_S_16_RANGE_ERR__349_CM 1 100. 0. 15. DISPLAY_IDENTIFIER ERR_SYM_AIR_LSL_UP_2 ECU_ADDRESS 0xd00093ca BIT_MASK 0x780 /end MEASUREMENT
/begin MEASUREMENT fmy_stat_pue_ls_down_2.ctr_abc "anti bounce counter for diagnosis instance PUE_LS_DOWN_2" UBYTE _CNV_A_R_LINEAR_____0_CM 1 100. 0. 255. DISPLAY_IDENTIFIER CTR_ABC_PUE_LS_DOWN_2 ECU_ADDRESS 0xd0009900 FORMAT "%3.0" /end MEASUREMENT
/begin MEASUREMENT fmy_stat_pue_ls_down_2.ctr_end_diag "counter for end of diagnosis for diagnosis instance PUE_LS_DOWN_2" UBYTE _CNV_A_R_LINEAR_____0_CM 1 100. 0. 255. DISPLAY_IDENTIFIER CTR_ABC_END_DIAG_PUE_LS_DOWN_2 ECU_ADDRESS 0xd0009901 FORMAT "%3.0" /end MEASUREMENT
/begin MEASUREMENT fmy_stat_pue_ls_down_2.err_info_stat.lv_err_mem "storage in dynamic failure memory of the diagnosis instance PUE_LS_DOWN_2" UWORD _CNV_S_2_RANGE__0___1_CM 1 100. 0. 1. DISPLAY_IDENTIFIER LV_ERR_MEM_PUE_LS_DOWN_2 ECU_ADDRESS 0xd0009902 BIT_MASK 0x8 /end MEASUREMENT
/begin MEASUREMENT fmy_stat_pue_ls_down_2.err_info_stat.lv_ready "readiness status of the diagnosis instance PUE_LS_DOWN_2" UWORD _CNV_S_2_RANGE__0___1_CM 1 100. 0. 1. DISPLAY_IDENTIFIER LV_READY_PUE_LS_DOWN_2 ECU_ADDRESS 0xd0009902 BIT_MASK 0x10 /end MEASUREMENT
/begin MEASUREMENT fmy_stat_pue_ls_down_2.err_info_stat.lv_end_diag "end of diagnosis of the diagnosis instance PUE_LS_DOWN_2" UWORD _CNV_S_2_RANGE__0___1_CM 1 100. 0. 1. DISPLAY_IDENTIFIER LV_END_DIAG_PUE_LS_DOWN_2 ECU_ADDRESS 0xd0009902 BIT_MASK 0x20 /end MEASUREMENT
/begin MEASUREMENT fmy_stat_pue_ls_down_2.err_info_stat.lv_cdn_diag "diagnosis condition of the diagnosis instance PUE_LS_DOWN_2" UWORD _CNV_S_2_RANGE__0___1_CM 1 100. 0. 1. DISPLAY_IDENTIFIER LV_CDN_DIAG_PUE_LS_DOWN_2 ECU_ADDRESS 0xd0009902 BIT_MASK 0x40 /end MEASUREMENT
/begin MEASUREMENT fmy_stat_pue_ls_down_2.err_info_stat.err_sym "symptoms of the diagnosis instance PUE_LS_DOWN_2" UWORD _CNV_S_16_RANGE_ERR__349_CM 1 100. 0. 15. DISPLAY_IDENTIFIER ERR_SYM_PUE_LS_DOWN_2 ECU_ADDRESS 0xd0009902 BIT_MASK 0x780 /end MEASUREMENT
/begin MEASUREMENT fmy_stat_swt_ls_down_2.ctr_abc "anti bounce counter for diagnosis instance SWT_LS_DOWN_2" UBYTE _CNV_A_R_LINEAR_____0_CM 1 100. 0. 255. DISPLAY_IDENTIFIER CTR_ABC_SWT_LS_DOWN_2 ECU_ADDRESS 0xd00099c8 FORMAT "%3.0" /end MEASUREMENT
/begin MEASUREMENT fmy_stat_swt_ls_down_2.ctr_end_diag "counter for end of diagnosis for diagnosis instance SWT_LS_DOWN_2" UBYTE _CNV_A_R_LINEAR_____0_CM 1 100. 0. 255. DISPLAY_IDENTIFIER CTR_ABC_END_DIAG_SWT_LS_DOWN_2 ECU_ADDRESS 0xd00099c9 FORMAT "%3.0" /end MEASUREMENT
/begin MEASUREMENT fmy_stat_swt_ls_down_2.err_info_stat.lv_err_mem "storage in dynamic failure memory of the diagnosis instance SWT_LS_DOWN_2" UWORD _CNV_S_2_RANGE__0___1_CM 1 100. 0. 1. DISPLAY_IDENTIFIER LV_ERR_MEM_SWT_LS_DOWN_2 ECU_ADDRESS 0xd00099ca BIT_MASK 0x8 /end MEASUREMENT
/begin MEASUREMENT fmy_stat_swt_ls_down_2.err_info_stat.lv_ready "readiness status of the diagnosis instance SWT_LS_DOWN_2" UWORD _CNV_S_2_RANGE__0___1_CM 1 100. 0. 1. DISPLAY_IDENTIFIER LV_READY_SWT_LS_DOWN_2 ECU_ADDRESS 0xd00099ca BIT_MASK 0x10 /end MEASUREMENT
/begin MEASUREMENT fmy_stat_swt_ls_down_2.err_info_stat.lv_end_diag "end of diagnosis of the diagnosis instance SWT_LS_DOWN_2" UWORD _CNV_S_2_RANGE__0___1_CM 1 100. 0. 1. DISPLAY_IDENTIFIER LV_END_DIAG_SWT_LS_DOWN_2 ECU_ADDRESS 0xd00099ca BIT_MASK 0x20 /end MEASUREMENT
/begin MEASUREMENT fmy_stat_swt_ls_down_2.err_info_stat.lv_cdn_diag "diagnosis condition of the diagnosis instance SWT_LS_DOWN_2" UWORD _CNV_S_2_RANGE__0___1_CM 1 100. 0. 1. DISPLAY_IDENTIFIER LV_CDN_DIAG_SWT_LS_DOWN_2 ECU_ADDRESS 0xd00099ca BIT_MASK 0x40 /end MEASUREMENT
/begin MEASUREMENT fmy_stat_swt_ls_down_2.err_info_stat.err_sym "symptoms of the diagnosis instance SWT_LS_DOWN_2" UWORD _CNV_S_16_RANGE_ERR__349_CM 1 100. 0. 15. DISPLAY_IDENTIFIER ERR_SYM_SWT_LS_DOWN_2 ECU_ADDRESS 0xd00099ca BIT_MASK 0x780 /end MEASUREMENT
/begin MEASUREMENT fmy_stat_obd_lsh_down_2.ctr_abc "anti bounce counter for diagnosis instance OBD_LSH_DOWN_2" UBYTE _CNV_A_R_LINEAR_____0_CM 1 100. 0. 255. DISPLAY_IDENTIFIER CTR_ABC_OBD_LSH_DOWN_2 ECU_ADDRESS 0xd0009888 FORMAT "%3.0" /end MEASUREMENT
/begin MEASUREMENT fmy_stat_obd_lsh_down_2.ctr_end_diag "counter for end of diagnosis for diagnosis instance OBD_LSH_DOWN_2" UBYTE _CNV_A_R_LINEAR_____0_CM 1 100. 0. 255. DISPLAY_IDENTIFIER CTR_ABC_END_DIAG_OBD_LSH_DOWN_2 ECU_ADDRESS 0xd0009889 FORMAT "%3.0" /end MEASUREMENT
/begin MEASUREMENT fmy_stat_obd_lsh_down_2.err_info_stat.lv_err_mem "storage in dynamic failure memory of the diagnosis instance OBD_LSH_DOWN_2" UWORD _CNV_S_2_RANGE__0___1_CM 1 100. 0. 1. DISPLAY_IDENTIFIER LV_ERR_MEM_OBD_LSH_DOWN_2 ECU_ADDRESS 0xd000988a BIT_MASK 0x8 /end MEASUREMENT
/begin MEASUREMENT fmy_stat_obd_lsh_down_2.err_info_stat.lv_ready "readiness status of the diagnosis instance OBD_LSH_DOWN_2" UWORD _CNV_S_2_RANGE__0___1_CM 1 100. 0. 1. DISPLAY_IDENTIFIER LV_READY_OBD_LSH_DOWN_2 ECU_ADDRESS 0xd000988a BIT_MASK 0x10 /end MEASUREMENT
/begin MEASUREMENT fmy_stat_obd_lsh_down_2.err_info_stat.lv_end_diag "end of diagnosis of the diagnosis instance OBD_LSH_DOWN_2" UWORD _CNV_S_2_RANGE__0___1_CM 1 100. 0. 1. DISPLAY_IDENTIFIER LV_END_DIAG_OBD_LSH_DOWN_2 ECU_ADDRESS 0xd000988a BIT_MASK 0x20 /end MEASUREMENT
/begin MEASUREMENT fmy_stat_obd_lsh_down_2.err_info_stat.lv_cdn_diag "diagnosis condition of the diagnosis instance OBD_LSH_DOWN_2" UWORD _CNV_S_2_RANGE__0___1_CM 1 100. 0. 1. DISPLAY_IDENTIFIER LV_CDN_DIAG_OBD_LSH_DOWN_2 ECU_ADDRESS 0xd000988a BIT_MASK 0x40 /end MEASUREMENT
/begin MEASUREMENT fmy_stat_obd_lsh_down_2.err_info_stat.err_sym "symptoms of the diagnosis instance OBD_LSH_DOWN_2" UWORD _CNV_S_16_RANGE_ERR__349_CM 1 100. 0. 15. DISPLAY_IDENTIFIER ERR_SYM_OBD_LSH_DOWN_2 ECU_ADDRESS 0xd000988a BIT_MASK 0x780 /end MEASUREMENT
/begin MEASUREMENT fmy_stat_dyn_vld_ls_up_2.ctr_abc "anti bounce counter for diagnosis instance DYN_VLD_LS_UP_2" UBYTE _CNV_A_R_LINEAR_____0_CM 1 100. 0. 255. DISPLAY_IDENTIFIER CTR_ABC_DYN_VLD_LS_UP_2 ECU_ADDRESS 0xd0009614 FORMAT "%3.0" /end MEASUREMENT
/begin MEASUREMENT fmy_stat_dyn_vld_ls_up_2.ctr_end_diag "counter for end of diagnosis for diagnosis instance DYN_VLD_LS_UP_2" UBYTE _CNV_A_R_LINEAR_____0_CM 1 100. 0. 255. DISPLAY_IDENTIFIER CTR_ABC_END_DIAG_DYN_VLD_LS_UP_2 ECU_ADDRESS 0xd0009615 FORMAT "%3.0" /end MEASUREMENT
/begin MEASUREMENT fmy_stat_dyn_vld_ls_up_2.err_info_stat.lv_err_mem "storage in dynamic failure memory of the diagnosis instance DYN_VLD_LS_UP_2" UWORD _CNV_S_2_RANGE__0___1_CM 1 100. 0. 1. DISPLAY_IDENTIFIER LV_ERR_MEM_DYN_VLD_LS_UP_2 ECU_ADDRESS 0xd0009616 BIT_MASK 0x8 /end MEASUREMENT
/begin MEASUREMENT fmy_stat_dyn_vld_ls_up_2.err_info_stat.lv_ready "readiness status of the diagnosis instance DYN_VLD_LS_UP_2" UWORD _CNV_S_2_RANGE__0___1_CM 1 100. 0. 1. DISPLAY_IDENTIFIER LV_READY_DYN_VLD_LS_UP_2 ECU_ADDRESS 0xd0009616 BIT_MASK 0x10 /end MEASUREMENT
/begin MEASUREMENT fmy_stat_dyn_vld_ls_up_2.err_info_stat.lv_end_diag "end of diagnosis of the diagnosis instance DYN_VLD_LS_UP_2" UWORD _CNV_S_2_RANGE__0___1_CM 1 100. 0. 1. DISPLAY_IDENTIFIER LV_END_DIAG_DYN_VLD_LS_UP_2 ECU_ADDRESS 0xd0009616 BIT_MASK 0x20 /end MEASUREMENT
/begin MEASUREMENT fmy_stat_dyn_vld_ls_up_2.err_info_stat.lv_cdn_diag "diagnosis condition of the diagnosis instance DYN_VLD_LS_UP_2" UWORD _CNV_S_2_RANGE__0___1_CM 1 100. 0. 1. DISPLAY_IDENTIFIER LV_CDN_DIAG_DYN_VLD_LS_UP_2 ECU_ADDRESS 0xd0009616 BIT_MASK 0x40 /end MEASUREMENT
/begin MEASUREMENT fmy_stat_dyn_vld_ls_up_2.err_info_stat.err_sym "symptoms of the diagnosis instance DYN_VLD_LS_UP_2" UWORD _CNV_S_16_RANGE_ERR__349_CM 1 100. 0. 15. DISPLAY_IDENTIFIER ERR_SYM_DYN_VLD_LS_UP_2 ECU_ADDRESS 0xd0009616 BIT_MASK 0x780 /end MEASUREMENT
/begin MEASUREMENT fmy_stat_puc_vld_ls_up_2.ctr_abc "anti bounce counter for diagnosis instance PUC_VLD_LS_UP_2" UBYTE _CNV_A_R_LINEAR_____0_CM 1 100. 0. 255. DISPLAY_IDENTIFIER CTR_ABC_PUC_VLD_LS_UP_2 ECU_ADDRESS 0xd00098f8 FORMAT "%3.0" /end MEASUREMENT
/begin MEASUREMENT fmy_stat_puc_vld_ls_up_2.ctr_end_diag "counter for end of diagnosis for diagnosis instance PUC_VLD_LS_UP_2" UBYTE _CNV_A_R_LINEAR_____0_CM 1 100. 0. 255. DISPLAY_IDENTIFIER CTR_ABC_END_DIAG_PUC_VLD_LS_UP_2 ECU_ADDRESS 0xd00098f9 FORMAT "%3.0" /end MEASUREMENT
/begin MEASUREMENT fmy_stat_puc_vld_ls_up_2.err_info_stat.lv_err_mem "storage in dynamic failure memory of the diagnosis instance PUC_VLD_LS_UP_2" UWORD _CNV_S_2_RANGE__0___1_CM 1 100. 0. 1. DISPLAY_IDENTIFIER LV_ERR_MEM_PUC_VLD_LS_UP_2 ECU_ADDRESS 0xd00098fa BIT_MASK 0x8 /end MEASUREMENT
/begin MEASUREMENT fmy_stat_puc_vld_ls_up_2.err_info_stat.lv_ready "readiness status of the diagnosis instance PUC_VLD_LS_UP_2" UWORD _CNV_S_2_RANGE__0___1_CM 1 100. 0. 1. DISPLAY_IDENTIFIER LV_READY_PUC_VLD_LS_UP_2 ECU_ADDRESS 0xd00098fa BIT_MASK 0x10 /end MEASUREMENT
/begin MEASUREMENT fmy_stat_puc_vld_ls_up_2.err_info_stat.lv_end_diag "end of diagnosis of the diagnosis instance PUC_VLD_LS_UP_2" UWORD _CNV_S_2_RANGE__0___1_CM 1 100. 0. 1. DISPLAY_IDENTIFIER LV_END_DIAG_PUC_VLD_LS_UP_2 ECU_ADDRESS 0xd00098fa BIT_MASK 0x20 /end MEASUREMENT
/begin MEASUREMENT fmy_stat_puc_vld_ls_up_2.err_info_stat.lv_cdn_diag "diagnosis condition of the diagnosis instance PUC_VLD_LS_UP_2" UWORD _CNV_S_2_RANGE__0___1_CM 1 100. 0. 1. DISPLAY_IDENTIFIER LV_CDN_DIAG_PUC_VLD_LS_UP_2 ECU_ADDRESS 0xd00098fa BIT_MASK 0x40 /end MEASUREMENT
/begin MEASUREMENT fmy_stat_puc_vld_ls_up_2.err_info_stat.err_sym "symptoms of the diagnosis instance PUC_VLD_LS_UP_2" UWORD _CNV_S_16_RANGE_ERR__349_CM 1 100. 0. 15. DISPLAY_IDENTIFIER ERR_SYM_PUC_VLD_LS_UP_2 ECU_ADDRESS 0xd00098fa BIT_MASK 0x780 /end MEASUREMENT
/begin MEASUREMENT fmy_stat_obd_vld_lsh_up_2.ctr_abc "anti bounce counter for diagnosis instance OBD_VLD_LSH_UP_2" UBYTE _CNV_A_R_LINEAR_____0_CM 1 100. 0. 255. DISPLAY_IDENTIFIER CTR_ABC_OBD_VLD_LSH_UP_2 ECU_ADDRESS 0xd0009890 FORMAT "%3.0" /end MEASUREMENT
/begin MEASUREMENT fmy_stat_obd_vld_lsh_up_2.ctr_end_diag "counter for end of diagnosis for diagnosis instance OBD_VLD_LSH_UP_2" UBYTE _CNV_A_R_LINEAR_____0_CM 1 100. 0. 255. DISPLAY_IDENTIFIER CTR_ABC_END_DIAG_OBD_VLD_LSH_UP_2 ECU_ADDRESS 0xd0009891 FORMAT "%3.0" /end MEASUREMENT
/begin MEASUREMENT fmy_stat_obd_vld_lsh_up_2.err_info_stat.lv_err_mem "storage in dynamic failure memory of the diagnosis instance OBD_VLD_LSH_UP_2" UWORD _CNV_S_2_RANGE__0___1_CM 1 100. 0. 1. DISPLAY_IDENTIFIER LV_ERR_MEM_OBD_VLD_LSH_UP_2 ECU_ADDRESS 0xd0009892 BIT_MASK 0x8 /end MEASUREMENT
/begin MEASUREMENT fmy_stat_obd_vld_lsh_up_2.err_info_stat.lv_ready "readiness status of the diagnosis instance OBD_VLD_LSH_UP_2" UWORD _CNV_S_2_RANGE__0___1_CM 1 100. 0. 1. DISPLAY_IDENTIFIER LV_READY_OBD_VLD_LSH_UP_2 ECU_ADDRESS 0xd0009892 BIT_MASK 0x10 /end MEASUREMENT
/begin MEASUREMENT fmy_stat_obd_vld_lsh_up_2.err_info_stat.lv_end_diag "end of diagnosis of the diagnosis instance OBD_VLD_LSH_UP_2" UWORD _CNV_S_2_RANGE__0___1_CM 1 100. 0. 1. DISPLAY_IDENTIFIER LV_END_DIAG_OBD_VLD_LSH_UP_2 ECU_ADDRESS 0xd0009892 BIT_MASK 0x20 /end MEASUREMENT
/begin MEASUREMENT fmy_stat_obd_vld_lsh_up_2.err_info_stat.lv_cdn_diag "diagnosis condition of the diagnosis instance OBD_VLD_LSH_UP_2" UWORD _CNV_S_2_RANGE__0___1_CM 1 100. 0. 1. DISPLAY_IDENTIFIER LV_CDN_DIAG_OBD_VLD_LSH_UP_2 ECU_ADDRESS 0xd0009892 BIT_MASK 0x40 /end MEASUREMENT
/begin MEASUREMENT fmy_stat_obd_vld_lsh_up_2.err_info_stat.err_sym "symptoms of the diagnosis instance OBD_VLD_LSH_UP_2" UWORD _CNV_S_16_RANGE_ERR__349_CM 1 100. 0. 15. DISPLAY_IDENTIFIER ERR_SYM_OBD_VLD_LSH_UP_2 ECU_ADDRESS 0xd0009892 BIT_MASK 0x780 /end MEASUREMENT
/begin MEASUREMENT fmy_stat_chk_ls_down_2.ctr_abc "anti bounce counter for diagnosis instance CHK_LS_DOWN_2" UBYTE _CNV_A_R_LINEAR_____0_CM 1 100. 0. 255. DISPLAY_IDENTIFIER CTR_ABC_CHK_LS_DOWN_2 ECU_ADDRESS 0xd00094a4 FORMAT "%3.0" /end MEASUREMENT
/begin MEASUREMENT fmy_stat_chk_ls_down_2.ctr_end_diag "counter for end of diagnosis for diagnosis instance CHK_LS_DOWN_2" UBYTE _CNV_A_R_LINEAR_____0_CM 1 100. 0. 255. DISPLAY_IDENTIFIER CTR_ABC_END_DIAG_CHK_LS_DOWN_2 ECU_ADDRESS 0xd00094a5 FORMAT "%3.0" /end MEASUREMENT
/begin MEASUREMENT fmy_stat_chk_ls_down_2.err_info_stat.lv_err_mem "storage in dynamic failure memory of the diagnosis instance CHK_LS_DOWN_2" UWORD _CNV_S_2_RANGE__0___1_CM 1 100. 0. 1. DISPLAY_IDENTIFIER LV_ERR_MEM_CHK_LS_DOWN_2 ECU_ADDRESS 0xd00094a6 BIT_MASK 0x8 /end MEASUREMENT
/begin MEASUREMENT fmy_stat_chk_ls_down_2.err_info_stat.lv_ready "readiness status of the diagnosis instance CHK_LS_DOWN_2" UWORD _CNV_S_2_RANGE__0___1_CM 1 100. 0. 1. DISPLAY_IDENTIFIER LV_READY_CHK_LS_DOWN_2 ECU_ADDRESS 0xd00094a6 BIT_MASK 0x10 /end MEASUREMENT
/begin MEASUREMENT fmy_stat_chk_ls_down_2.err_info_stat.lv_end_diag "end of diagnosis of the diagnosis instance CHK_LS_DOWN_2" UWORD _CNV_S_2_RANGE__0___1_CM 1 100. 0. 1. DISPLAY_IDENTIFIER LV_END_DIAG_CHK_LS_DOWN_2 ECU_ADDRESS 0xd00094a6 BIT_MASK 0x20 /end MEASUREMENT
/begin MEASUREMENT fmy_stat_chk_ls_down_2.err_info_stat.lv_cdn_diag "diagnosis condition of the diagnosis instance CHK_LS_DOWN_2" UWORD _CNV_S_2_RANGE__0___1_CM 1 100. 0. 1. DISPLAY_IDENTIFIER LV_CDN_DIAG_CHK_LS_DOWN_2 ECU_ADDRESS 0xd00094a6 BIT_MASK 0x40 /end MEASUREMENT
/begin MEASUREMENT fmy_stat_chk_ls_down_2.err_info_stat.err_sym "symptoms of the diagnosis instance CHK_LS_DOWN_2" UWORD _CNV_S_16_RANGE_ERR__349_CM 1 100. 0. 15. DISPLAY_IDENTIFIER ERR_SYM_CHK_LS_DOWN_2 ECU_ADDRESS 0xd00094a6 BIT_MASK 0x780 /end MEASUREMENT
/begin MEASUREMENT fmy_stat_shift_afl_lsl_up_2.ctr_abc "anti bounce counter for diagnosis instance SHIFT_AFL_LSL_UP_2" UBYTE _CNV_A_R_LINEAR_____0_CM 1 100. 0. 255. DISPLAY_IDENTIFIER CTR_ABC_SHIFT_AFL_LSL_UP_2 ECU_ADDRESS 0xd0009988 FORMAT "%3.0" /end MEASUREMENT
/begin MEASUREMENT fmy_stat_shift_afl_lsl_up_2.ctr_end_diag "counter for end of diagnosis for diagnosis instance SHIFT_AFL_LSL_UP_2" UBYTE _CNV_A_R_LINEAR_____0_CM 1 100. 0. 255. DISPLAY_IDENTIFIER CTR_ABC_END_DIAG_SHIFT_AFL_LSL_UP_2 ECU_ADDRESS 0xd0009989 FORMAT "%3.0" /end MEASUREMENT
/begin MEASUREMENT fmy_stat_shift_afl_lsl_up_2.err_info_stat.lv_err_mem "storage in dynamic failure memory of the diagnosis instance SHIFT_AFL_LSL_UP_2" UWORD _CNV_S_2_RANGE__0___1_CM 1 100. 0. 1. DISPLAY_IDENTIFIER LV_ERR_MEM_SHIFT_AFL_LSL_UP_2 ECU_ADDRESS 0xd000998a BIT_MASK 0x8 /end MEASUREMENT
/begin MEASUREMENT fmy_stat_shift_afl_lsl_up_2.err_info_stat.lv_ready "readiness status of the diagnosis instance SHIFT_AFL_LSL_UP_2" UWORD _CNV_S_2_RANGE__0___1_CM 1 100. 0. 1. DISPLAY_IDENTIFIER LV_READY_SHIFT_AFL_LSL_UP_2 ECU_ADDRESS 0xd000998a BIT_MASK 0x10 /end MEASUREMENT
/begin MEASUREMENT fmy_stat_shift_afl_lsl_up_2.err_info_stat.lv_end_diag "end of diagnosis of the diagnosis instance SHIFT_AFL_LSL_UP_2" UWORD _CNV_S_2_RANGE__0___1_CM 1 100. 0. 1. DISPLAY_IDENTIFIER LV_END_DIAG_SHIFT_AFL_LSL_UP_2 ECU_ADDRESS 0xd000998a BIT_MASK 0x20 /end MEASUREMENT
/begin MEASUREMENT fmy_stat_shift_afl_lsl_up_2.err_info_stat.lv_cdn_diag "diagnosis condition of the diagnosis instance SHIFT_AFL_LSL_UP_2" UWORD _CNV_S_2_RANGE__0___1_CM 1 100. 0. 1. DISPLAY_IDENTIFIER LV_CDN_DIAG_SHIFT_AFL_LSL_UP_2 ECU_ADDRESS 0xd000998a BIT_MASK 0x40 /end MEASUREMENT
/begin MEASUREMENT fmy_stat_shift_afl_lsl_up_2.err_info_stat.err_sym "symptoms of the diagnosis instance SHIFT_AFL_LSL_UP_2" UWORD _CNV_S_16_RANGE_ERR__349_CM 1 100. 0. 15. DISPLAY_IDENTIFIER ERR_SYM_SHIFT_AFL_LSL_UP_2 ECU_ADDRESS 0xd000998a BIT_MASK 0x780 /end MEASUREMENT
/begin MEASUREMENT fmy_stat_shift_afr_lsl_up_2.ctr_abc "anti bounce counter for diagnosis instance SHIFT_AFR_LSL_UP_2" UBYTE _CNV_A_R_LINEAR_____0_CM 1 100. 0. 255. DISPLAY_IDENTIFIER CTR_ABC_SHIFT_AFR_LSL_UP_2 ECU_ADDRESS 0xd0009990 FORMAT "%3.0" /end MEASUREMENT
/begin MEASUREMENT fmy_stat_shift_afr_lsl_up_2.ctr_end_diag "counter for end of diagnosis for diagnosis instance SHIFT_AFR_LSL_UP_2" UBYTE _CNV_A_R_LINEAR_____0_CM 1 100. 0. 255. DISPLAY_IDENTIFIER CTR_ABC_END_DIAG_SHIFT_AFR_LSL_UP_2 ECU_ADDRESS 0xd0009991 FORMAT "%3.0" /end MEASUREMENT
/begin MEASUREMENT fmy_stat_shift_afr_lsl_up_2.err_info_stat.lv_err_mem "storage in dynamic failure memory of the diagnosis instance SHIFT_AFR_LSL_UP_2" UWORD _CNV_S_2_RANGE__0___1_CM 1 100. 0. 1. DISPLAY_IDENTIFIER LV_ERR_MEM_SHIFT_AFR_LSL_UP_2 ECU_ADDRESS 0xd0009992 BIT_MASK 0x8 /end MEASUREMENT
/begin MEASUREMENT fmy_stat_shift_afr_lsl_up_2.err_info_stat.lv_ready "readiness status of the diagnosis instance SHIFT_AFR_LSL_UP_2" UWORD _CNV_S_2_RANGE__0___1_CM 1 100. 0. 1. DISPLAY_IDENTIFIER LV_READY_SHIFT_AFR_LSL_UP_2 ECU_ADDRESS 0xd0009992 BIT_MASK 0x10 /end MEASUREMENT
/begin MEASUREMENT fmy_stat_shift_afr_lsl_up_2.err_info_stat.lv_end_diag "end of diagnosis of the diagnosis instance SHIFT_AFR_LSL_UP_2" UWORD _CNV_S_2_RANGE__0___1_CM 1 100. 0. 1. DISPLAY_IDENTIFIER LV_END_DIAG_SHIFT_AFR_LSL_UP_2 ECU_ADDRESS 0xd0009992 BIT_MASK 0x20 /end MEASUREMENT
/begin MEASUREMENT fmy_stat_shift_afr_lsl_up_2.err_info_stat.lv_cdn_diag "diagnosis condition of the diagnosis instance SHIFT_AFR_LSL_UP_2" UWORD _CNV_S_2_RANGE__0___1_CM 1 100. 0. 1. DISPLAY_IDENTIFIER LV_CDN_DIAG_SHIFT_AFR_LSL_UP_2 ECU_ADDRESS 0xd0009992 BIT_MASK 0x40 /end MEASUREMENT
/begin MEASUREMENT fmy_stat_shift_afr_lsl_up_2.err_info_stat.err_sym "symptoms of the diagnosis instance SHIFT_AFR_LSL_UP_2" UWORD _CNV_S_16_RANGE_ERR__349_CM 1 100. 0. 15. DISPLAY_IDENTIFIER ERR_SYM_SHIFT_AFR_LSL_UP_2 ECU_ADDRESS 0xd0009992 BIT_MASK 0x780 /end MEASUREMENT
/begin MEASUREMENT fmy_stat_oc_lsl_up_2.ctr_abc "anti bounce counter for diagnosis instance OC_LSL_UP_2" UBYTE _CNV_A_R_LINEAR_____0_CM 1 100. 0. 255. DISPLAY_IDENTIFIER CTR_ABC_OC_LSL_UP_2 ECU_ADDRESS 0xd00098a0 FORMAT "%3.0" /end MEASUREMENT
/begin MEASUREMENT fmy_stat_oc_lsl_up_2.ctr_end_diag "counter for end of diagnosis for diagnosis instance OC_LSL_UP_2" UBYTE _CNV_A_R_LINEAR_____0_CM 1 100. 0. 255. DISPLAY_IDENTIFIER CTR_ABC_END_DIAG_OC_LSL_UP_2 ECU_ADDRESS 0xd00098a1 FORMAT "%3.0" /end MEASUREMENT
/begin MEASUREMENT fmy_stat_oc_lsl_up_2.err_info_stat.lv_err_mem "storage in dynamic failure memory of the diagnosis instance OC_LSL_UP_2" UWORD _CNV_S_2_RANGE__0___1_CM 1 100. 0. 1. DISPLAY_IDENTIFIER LV_ERR_MEM_OC_LSL_UP_2 ECU_ADDRESS 0xd00098a2 BIT_MASK 0x8 /end MEASUREMENT
/begin MEASUREMENT fmy_stat_oc_lsl_up_2.err_info_stat.lv_ready "readiness status of the diagnosis instance OC_LSL_UP_2" UWORD _CNV_S_2_RANGE__0___1_CM 1 100. 0. 1. DISPLAY_IDENTIFIER LV_READY_OC_LSL_UP_2 ECU_ADDRESS 0xd00098a2 BIT_MASK 0x10 /end MEASUREMENT
/begin MEASUREMENT fmy_stat_oc_lsl_up_2.err_info_stat.lv_end_diag "end of diagnosis of the diagnosis instance OC_LSL_UP_2" UWORD _CNV_S_2_RANGE__0___1_CM 1 100. 0. 1. DISPLAY_IDENTIFIER LV_END_DIAG_OC_LSL_UP_2 ECU_ADDRESS 0xd00098a2 BIT_MASK 0x20 /end MEASUREMENT
/begin MEASUREMENT fmy_stat_oc_lsl_up_2.err_info_stat.lv_cdn_diag "diagnosis condition of the diagnosis instance OC_LSL_UP_2" UWORD _CNV_S_2_RANGE__0___1_CM 1 100. 0. 1. DISPLAY_IDENTIFIER LV_CDN_DIAG_OC_LSL_UP_2 ECU_ADDRESS 0xd00098a2 BIT_MASK 0x40 /end MEASUREMENT
/begin MEASUREMENT fmy_stat_oc_lsl_up_2.err_info_stat.err_sym "symptoms of the diagnosis instance OC_LSL_UP_2" UWORD _CNV_S_16_RANGE_ERR__349_CM 1 100. 0. 15. DISPLAY_IDENTIFIER ERR_SYM_OC_LSL_UP_2 ECU_ADDRESS 0xd00098a2 BIT_MASK 0x780 /end MEASUREMENT
/begin MEASUREMENT fmy_stat_delta_i_lam_2.ctr_abc "anti bounce counter for diagnosis instance DELTA_I_LAM_2" UBYTE _CNV_A_R_LINEAR_____0_CM 1 100. 0. 255. DISPLAY_IDENTIFIER CTR_ABC_DELTA_I_LAM_2 ECU_ADDRESS 0xd00095ec FORMAT "%3.0" /end MEASUREMENT
/begin MEASUREMENT fmy_stat_delta_i_lam_2.ctr_end_diag "counter for end of diagnosis for diagnosis instance DELTA_I_LAM_2" UBYTE _CNV_A_R_LINEAR_____0_CM 1 100. 0. 255. DISPLAY_IDENTIFIER CTR_ABC_END_DIAG_DELTA_I_LAM_2 ECU_ADDRESS 0xd00095ed FORMAT "%3.0" /end MEASUREMENT
/begin MEASUREMENT fmy_stat_delta_i_lam_2.err_info_stat.lv_err_mem "storage in dynamic failure memory of the diagnosis instance DELTA_I_LAM_2" UWORD _CNV_S_2_RANGE__0___1_CM 1 100. 0. 1. DISPLAY_IDENTIFIER LV_ERR_MEM_DELTA_I_LAM_2 ECU_ADDRESS 0xd00095ee BIT_MASK 0x8 /end MEASUREMENT
/begin MEASUREMENT fmy_stat_delta_i_lam_2.err_info_stat.lv_ready "readiness status of the diagnosis instance DELTA_I_LAM_2" UWORD _CNV_S_2_RANGE__0___1_CM 1 100. 0. 1. DISPLAY_IDENTIFIER LV_READY_DELTA_I_LAM_2 ECU_ADDRESS 0xd00095ee BIT_MASK 0x10 /end MEASUREMENT
/begin MEASUREMENT fmy_stat_delta_i_lam_2.err_info_stat.lv_end_diag "end of diagnosis of the diagnosis instance DELTA_I_LAM_2" UWORD _CNV_S_2_RANGE__0___1_CM 1 100. 0. 1. DISPLAY_IDENTIFIER LV_END_DIAG_DELTA_I_LAM_2 ECU_ADDRESS 0xd00095ee BIT_MASK 0x20 /end MEASUREMENT
/begin MEASUREMENT fmy_stat_delta_i_lam_2.err_info_stat.lv_cdn_diag "diagnosis condition of the diagnosis instance DELTA_I_LAM_2" UWORD _CNV_S_2_RANGE__0___1_CM 1 100. 0. 1. DISPLAY_IDENTIFIER LV_CDN_DIAG_DELTA_I_LAM_2 ECU_ADDRESS 0xd00095ee BIT_MASK 0x40 /end MEASUREMENT
/begin MEASUREMENT fmy_stat_delta_i_lam_2.err_info_stat.err_sym "symptoms of the diagnosis instance DELTA_I_LAM_2" UWORD _CNV_S_16_RANGE_ERR__349_CM 1 100. 0. 15. DISPLAY_IDENTIFIER ERR_SYM_DELTA_I_LAM_2 ECU_ADDRESS 0xd00095ee BIT_MASK 0x780 /end MEASUREMENT
/begin MEASUREMENT fmy_stat_ofs_lsl_up_2.ctr_abc "anti bounce counter for diagnosis instance OFS_LSL_UP_2" UBYTE _CNV_A_R_LINEAR_____0_CM 1 100. 0. 255. DISPLAY_IDENTIFIER CTR_ABC_OFS_LSL_UP_2 ECU_ADDRESS 0xd00098a8 FORMAT "%3.0" /end MEASUREMENT
/begin MEASUREMENT fmy_stat_ofs_lsl_up_2.ctr_end_diag "counter for end of diagnosis for diagnosis instance OFS_LSL_UP_2" UBYTE _CNV_A_R_LINEAR_____0_CM 1 100. 0. 255. DISPLAY_IDENTIFIER CTR_ABC_END_DIAG_OFS_LSL_UP_2 ECU_ADDRESS 0xd00098a9 FORMAT "%3.0" /end MEASUREMENT
/begin MEASUREMENT fmy_stat_ofs_lsl_up_2.err_info_stat.lv_err_mem "storage in dynamic failure memory of the diagnosis instance OFS_LSL_UP_2" UWORD _CNV_S_2_RANGE__0___1_CM 1 100. 0. 1. DISPLAY_IDENTIFIER LV_ERR_MEM_OFS_LSL_UP_2 ECU_ADDRESS 0xd00098aa BIT_MASK 0x8 /end MEASUREMENT
/begin MEASUREMENT fmy_stat_ofs_lsl_up_2.err_info_stat.lv_ready "readiness status of the diagnosis instance OFS_LSL_UP_2" UWORD _CNV_S_2_RANGE__0___1_CM 1 100. 0. 1. DISPLAY_IDENTIFIER LV_READY_OFS_LSL_UP_2 ECU_ADDRESS 0xd00098aa BIT_MASK 0x10 /end MEASUREMENT
/begin MEASUREMENT fmy_stat_ofs_lsl_up_2.err_info_stat.lv_end_diag "end of diagnosis of the diagnosis instance OFS_LSL_UP_2" UWORD _CNV_S_2_RANGE__0___1_CM 1 100. 0. 1. DISPLAY_IDENTIFIER LV_END_DIAG_OFS_LSL_UP_2 ECU_ADDRESS 0xd00098aa BIT_MASK 0x20 /end MEASUREMENT
/begin MEASUREMENT fmy_stat_ofs_lsl_up_2.err_info_stat.lv_cdn_diag "diagnosis condition of the diagnosis instance OFS_LSL_UP_2" UWORD _CNV_S_2_RANGE__0___1_CM 1 100. 0. 1. DISPLAY_IDENTIFIER LV_CDN_DIAG_OFS_LSL_UP_2 ECU_ADDRESS 0xd00098aa BIT_MASK 0x40 /end MEASUREMENT
/begin MEASUREMENT fmy_stat_ofs_lsl_up_2.err_info_stat.err_sym "symptoms of the diagnosis instance OFS_LSL_UP_2" UWORD _CNV_S_16_RANGE_ERR__349_CM 1 100. 0. 15. DISPLAY_IDENTIFIER ERR_SYM_OFS_LSL_UP_2 ECU_ADDRESS 0xd00098aa BIT_MASK 0x780 /end MEASUREMENT
/begin MEASUREMENT fmy_stat_ttip_mes_lsh_up_2.ctr_abc "anti bounce counter for diagnosis instance TTIP_MES_LSH_UP_2" UBYTE _CNV_A_R_LINEAR_____0_CM 1 100. 0. 255. DISPLAY_IDENTIFIER CTR_ABC_TTIP_MES_LSH_UP_2 ECU_ADDRESS 0xd0009ad8 FORMAT "%3.0" /end MEASUREMENT
/begin MEASUREMENT fmy_stat_ttip_mes_lsh_up_2.ctr_end_diag "counter for end of diagnosis for diagnosis instance TTIP_MES_LSH_UP_2" UBYTE _CNV_A_R_LINEAR_____0_CM 1 100. 0. 255. DISPLAY_IDENTIFIER CTR_ABC_END_DIAG_TTIP_MES_LSH_UP_2 ECU_ADDRESS 0xd0009ad9 FORMAT "%3.0" /end MEASUREMENT
/begin MEASUREMENT fmy_stat_ttip_mes_lsh_up_2.err_info_stat.lv_err_mem "storage in dynamic failure memory of the diagnosis instance TTIP_MES_LSH_UP_2" UWORD _CNV_S_2_RANGE__0___1_CM 1 100. 0. 1. DISPLAY_IDENTIFIER LV_ERR_MEM_TTIP_MES_LSH_UP_2 ECU_ADDRESS 0xd0009ada BIT_MASK 0x8 /end MEASUREMENT
/begin MEASUREMENT fmy_stat_ttip_mes_lsh_up_2.err_info_stat.lv_ready "readiness status of the diagnosis instance TTIP_MES_LSH_UP_2" UWORD _CNV_S_2_RANGE__0___1_CM 1 100. 0. 1. DISPLAY_IDENTIFIER LV_READY_TTIP_MES_LSH_UP_2 ECU_ADDRESS 0xd0009ada BIT_MASK 0x10 /end MEASUREMENT
/begin MEASUREMENT fmy_stat_ttip_mes_lsh_up_2.err_info_stat.lv_end_diag "end of diagnosis of the diagnosis instance TTIP_MES_LSH_UP_2" UWORD _CNV_S_2_RANGE__0___1_CM 1 100. 0. 1. DISPLAY_IDENTIFIER LV_END_DIAG_TTIP_MES_LSH_UP_2 ECU_ADDRESS 0xd0009ada BIT_MASK 0x20 /end MEASUREMENT
/begin MEASUREMENT fmy_stat_ttip_mes_lsh_up_2.err_info_stat.lv_cdn_diag "diagnosis condition of the diagnosis instance TTIP_MES_LSH_UP_2" UWORD _CNV_S_2_RANGE__0___1_CM 1 100. 0. 1. DISPLAY_IDENTIFIER LV_CDN_DIAG_TTIP_MES_LSH_UP_2 ECU_ADDRESS 0xd0009ada BIT_MASK 0x40 /end MEASUREMENT
/begin MEASUREMENT fmy_stat_ttip_mes_lsh_up_2.err_info_stat.err_sym "symptoms of the diagnosis instance TTIP_MES_LSH_UP_2" UWORD _CNV_S_16_RANGE_ERR__349_CM 1 100. 0. 15. DISPLAY_IDENTIFIER ERR_SYM_TTIP_MES_LSH_UP_2 ECU_ADDRESS 0xd0009ada BIT_MASK 0x780 /end MEASUREMENT
/begin MEASUREMENT fmy_stat_ctl_lsl_up_2.ctr_abc "anti bounce counter for diagnosis instance CTL_LSL_UP_2" UBYTE _CNV_A_R_LINEAR_____0_CM 1 100. 0. 255. DISPLAY_IDENTIFIER CTR_ABC_CTL_LSL_UP_2 ECU_ADDRESS 0xd0009588 FORMAT "%3.0" /end MEASUREMENT
/begin MEASUREMENT fmy_stat_ctl_lsl_up_2.ctr_end_diag "counter for end of diagnosis for diagnosis instance CTL_LSL_UP_2" UBYTE _CNV_A_R_LINEAR_____0_CM 1 100. 0. 255. DISPLAY_IDENTIFIER CTR_ABC_END_DIAG_CTL_LSL_UP_2 ECU_ADDRESS 0xd0009589 FORMAT "%3.0" /end MEASUREMENT
/begin MEASUREMENT fmy_stat_ctl_lsl_up_2.err_info_stat.lv_err_mem "storage in dynamic failure memory of the diagnosis instance CTL_LSL_UP_2" UWORD _CNV_S_2_RANGE__0___1_CM 1 100. 0. 1. DISPLAY_IDENTIFIER LV_ERR_MEM_CTL_LSL_UP_2 ECU_ADDRESS 0xd000958a BIT_MASK 0x8 /end MEASUREMENT
/begin MEASUREMENT fmy_stat_ctl_lsl_up_2.err_info_stat.lv_ready "readiness status of the diagnosis instance CTL_LSL_UP_2" UWORD _CNV_S_2_RANGE__0___1_CM 1 100. 0. 1. DISPLAY_IDENTIFIER LV_READY_CTL_LSL_UP_2 ECU_ADDRESS 0xd000958a BIT_MASK 0x10 /end MEASUREMENT
/begin MEASUREMENT fmy_stat_ctl_lsl_up_2.err_info_stat.lv_end_diag "end of diagnosis of the diagnosis instance CTL_LSL_UP_2" UWORD _CNV_S_2_RANGE__0___1_CM 1 100. 0. 1. DISPLAY_IDENTIFIER LV_END_DIAG_CTL_LSL_UP_2 ECU_ADDRESS 0xd000958a BIT_MASK 0x20 /end MEASUREMENT
/begin MEASUREMENT fmy_stat_ctl_lsl_up_2.err_info_stat.lv_cdn_diag "diagnosis condition of the diagnosis instance CTL_LSL_UP_2" UWORD _CNV_S_2_RANGE__0___1_CM 1 100. 0. 1. DISPLAY_IDENTIFIER LV_CDN_DIAG_CTL_LSL_UP_2 ECU_ADDRESS 0xd000958a BIT_MASK 0x40 /end MEASUREMENT
/begin MEASUREMENT fmy_stat_ctl_lsl_up_2.err_info_stat.err_sym "symptoms of the diagnosis instance CTL_LSL_UP_2" UWORD _CNV_S_16_RANGE_ERR__349_CM 1 100. 0. 15. DISPLAY_IDENTIFIER ERR_SYM_CTL_LSL_UP_2 ECU_ADDRESS 0xd000958a BIT_MASK 0x780 /end MEASUREMENT
/begin MEASUREMENT fmy_stat_chg_ls_up.ctr_abc "anti bounce counter for diagnosis instance CHG_LS_UP" UBYTE _CNV_A_R_LINEAR_____0_CM 1 100. 0. 255. DISPLAY_IDENTIFIER CTR_ABC_CHG_LS_UP ECU_ADDRESS 0xd0009498 FORMAT "%3.0" /end MEASUREMENT
/begin MEASUREMENT fmy_stat_chg_ls_up.ctr_end_diag "counter for end of diagnosis for diagnosis instance CHG_LS_UP" UBYTE _CNV_A_R_LINEAR_____0_CM 1 100. 0. 255. DISPLAY_IDENTIFIER CTR_ABC_END_DIAG_CHG_LS_UP ECU_ADDRESS 0xd0009499 FORMAT "%3.0" /end MEASUREMENT
/begin MEASUREMENT fmy_stat_chg_ls_up.err_info_stat.lv_err_mem "storage in dynamic failure memory of the diagnosis instance CHG_LS_UP" UWORD _CNV_S_2_RANGE__0___1_CM 1 100. 0. 1. DISPLAY_IDENTIFIER LV_ERR_MEM_CHG_LS_UP ECU_ADDRESS 0xd000949a BIT_MASK 0x8 /end MEASUREMENT
/begin MEASUREMENT fmy_stat_chg_ls_up.err_info_stat.lv_ready "readiness status of the diagnosis instance CHG_LS_UP" UWORD _CNV_S_2_RANGE__0___1_CM 1 100. 0. 1. DISPLAY_IDENTIFIER LV_READY_CHG_LS_UP ECU_ADDRESS 0xd000949a BIT_MASK 0x10 /end MEASUREMENT
/begin MEASUREMENT fmy_stat_chg_ls_up.err_info_stat.lv_end_diag "end of diagnosis of the diagnosis instance CHG_LS_UP" UWORD _CNV_S_2_RANGE__0___1_CM 1 100. 0. 1. DISPLAY_IDENTIFIER LV_END_DIAG_CHG_LS_UP ECU_ADDRESS 0xd000949a BIT_MASK 0x20 /end MEASUREMENT
/begin MEASUREMENT fmy_stat_chg_ls_up.err_info_stat.lv_cdn_diag "diagnosis condition of the diagnosis instance CHG_LS_UP" UWORD _CNV_S_2_RANGE__0___1_CM 1 100. 0. 1. DISPLAY_IDENTIFIER LV_CDN_DIAG_CHG_LS_UP ECU_ADDRESS 0xd000949a BIT_MASK 0x40 /end MEASUREMENT
/begin MEASUREMENT fmy_stat_chg_ls_up.err_info_stat.err_sym "symptoms of the diagnosis instance CHG_LS_UP" UWORD _CNV_S_16_RANGE_ERR__349_CM 1 100. 0. 15. DISPLAY_IDENTIFIER ERR_SYM_CHG_LS_UP ECU_ADDRESS 0xd000949a BIT_MASK 0x780 /end MEASUREMENT
/begin MEASUREMENT fmy_stat_alter_com.err_info_stat.lv_err_mem "storage in dynamic failure memory of the diagnosis instance ALTER_COM" UWORD _CNV_S_2_RANGE__0___1_CM 1 100. 0. 1. DISPLAY_IDENTIFIER LV_ERR_MEM_ALTER_COM ECU_ADDRESS 0xd00093da BIT_MASK 0x8 /end MEASUREMENT
/begin MEASUREMENT fmy_stat_alter_com.err_info_stat.lv_ready "readiness status of the diagnosis instance ALTER_COM" UWORD _CNV_S_2_RANGE__0___1_CM 1 100. 0. 1. DISPLAY_IDENTIFIER LV_READY_ALTER_COM ECU_ADDRESS 0xd00093da BIT_MASK 0x10 /end MEASUREMENT
/begin MEASUREMENT fmy_stat_alter_com.err_info_stat.lv_end_diag "end of diagnosis of the diagnosis instance ALTER_COM" UWORD _CNV_S_2_RANGE__0___1_CM 1 100. 0. 1. DISPLAY_IDENTIFIER LV_END_DIAG_ALTER_COM ECU_ADDRESS 0xd00093da BIT_MASK 0x20 /end MEASUREMENT
/begin MEASUREMENT fmy_stat_alter_com.err_info_stat.lv_cdn_diag "diagnosis condition of the diagnosis instance ALTER_COM" UWORD _CNV_S_2_RANGE__0___1_CM 1 100. 0. 1. DISPLAY_IDENTIFIER LV_CDN_DIAG_ALTER_COM ECU_ADDRESS 0xd00093da BIT_MASK 0x40 /end MEASUREMENT
/begin MEASUREMENT fmy_stat_alter_com.err_info_stat.err_sym "symptoms of the diagnosis instance ALTER_COM" UWORD _CNV_S_16_RANGE_ERR__349_CM 1 100. 0. 15. DISPLAY_IDENTIFIER ERR_SYM_ALTER_COM ECU_ADDRESS 0xd00093da BIT_MASK 0x780 /end MEASUREMENT
/begin MEASUREMENT fmy_stat_cwp_com.err_info_stat.lv_err_mem "storage in dynamic failure memory of the diagnosis instance CWP_COM" UWORD _CNV_S_2_RANGE__0___1_CM 1 100. 0. 1. DISPLAY_IDENTIFIER LV_ERR_MEM_CWP_COM ECU_ADDRESS 0xd0009592 BIT_MASK 0x8 /end MEASUREMENT
/begin MEASUREMENT fmy_stat_cwp_com.err_info_stat.lv_ready "readiness status of the diagnosis instance CWP_COM" UWORD _CNV_S_2_RANGE__0___1_CM 1 100. 0. 1. DISPLAY_IDENTIFIER LV_READY_CWP_COM ECU_ADDRESS 0xd0009592 BIT_MASK 0x10 /end MEASUREMENT
/begin MEASUREMENT fmy_stat_cwp_com.err_info_stat.lv_end_diag "end of diagnosis of the diagnosis instance CWP_COM" UWORD _CNV_S_2_RANGE__0___1_CM 1 100. 0. 1. DISPLAY_IDENTIFIER LV_END_DIAG_CWP_COM ECU_ADDRESS 0xd0009592 BIT_MASK 0x20 /end MEASUREMENT
/begin MEASUREMENT fmy_stat_cwp_com.err_info_stat.lv_cdn_diag "diagnosis condition of the diagnosis instance CWP_COM" UWORD _CNV_S_2_RANGE__0___1_CM 1 100. 0. 1. DISPLAY_IDENTIFIER LV_CDN_DIAG_CWP_COM ECU_ADDRESS 0xd0009592 BIT_MASK 0x40 /end MEASUREMENT
/begin MEASUREMENT fmy_stat_cwp_com.err_info_stat.err_sym "symptoms of the diagnosis instance CWP_COM" UWORD _CNV_S_16_RANGE_ERR__349_CM 1 100. 0. 15. DISPLAY_IDENTIFIER ERR_SYM_CWP_COM ECU_ADDRESS 0xd0009592 BIT_MASK 0x780 /end MEASUREMENT
/begin MEASUREMENT fmy_stat_qoil_com.err_info_stat.lv_err_mem "storage in dynamic failure memory of the diagnosis instance QOIL_COM" UWORD _CNV_S_2_RANGE__0___1_CM 1 100. 0. 1. DISPLAY_IDENTIFIER LV_ERR_MEM_QOIL_COM ECU_ADDRESS 0xd000992a BIT_MASK 0x8 /end MEASUREMENT
/begin MEASUREMENT fmy_stat_qoil_com.err_info_stat.lv_ready "readiness status of the diagnosis instance QOIL_COM" UWORD _CNV_S_2_RANGE__0___1_CM 1 100. 0. 1. DISPLAY_IDENTIFIER LV_READY_QOIL_COM ECU_ADDRESS 0xd000992a BIT_MASK 0x10 /end MEASUREMENT
/begin MEASUREMENT fmy_stat_qoil_com.err_info_stat.lv_end_diag "end of diagnosis of the diagnosis instance QOIL_COM" UWORD _CNV_S_2_RANGE__0___1_CM 1 100. 0. 1. DISPLAY_IDENTIFIER LV_END_DIAG_QOIL_COM ECU_ADDRESS 0xd000992a BIT_MASK 0x20 /end MEASUREMENT
/begin MEASUREMENT fmy_stat_qoil_com.err_info_stat.lv_cdn_diag "diagnosis condition of the diagnosis instance QOIL_COM" UWORD _CNV_S_2_RANGE__0___1_CM 1 100. 0. 1. DISPLAY_IDENTIFIER LV_CDN_DIAG_QOIL_COM ECU_ADDRESS 0xd000992a BIT_MASK 0x40 /end MEASUREMENT
/begin MEASUREMENT fmy_stat_qoil_com.err_info_stat.err_sym "symptoms of the diagnosis instance QOIL_COM" UWORD _CNV_S_16_RANGE_ERR__349_CM 1 100. 0. 15. DISPLAY_IDENTIFIER ERR_SYM_QOIL_COM ECU_ADDRESS 0xd000992a BIT_MASK 0x780 /end MEASUREMENT
/begin MEASUREMENT fmy_stat_sens_bat_smt_com.err_info_stat.lv_err_mem "storage in dynamic failure memory of the diagnosis instance SENS_BAT_SMT_COM" UWORD _CNV_S_2_RANGE__0___1_CM 1 100. 0. 1. DISPLAY_IDENTIFIER LV_ERR_MEM_SENS_BAT_SMT_COM ECU_ADDRESS 0xd000997e BIT_MASK 0x8 /end MEASUREMENT
/begin MEASUREMENT fmy_stat_sens_bat_smt_com.err_info_stat.lv_ready "readiness status of the diagnosis instance SENS_BAT_SMT_COM" UWORD _CNV_S_2_RANGE__0___1_CM 1 100. 0. 1. DISPLAY_IDENTIFIER LV_READY_SENS_BAT_SMT_COM ECU_ADDRESS 0xd000997e BIT_MASK 0x10 /end MEASUREMENT
/begin MEASUREMENT fmy_stat_sens_bat_smt_com.err_info_stat.lv_end_diag "end of diagnosis of the diagnosis instance SENS_BAT_SMT_COM" UWORD _CNV_S_2_RANGE__0___1_CM 1 100. 0. 1. DISPLAY_IDENTIFIER LV_END_DIAG_SENS_BAT_SMT_COM ECU_ADDRESS 0xd000997e BIT_MASK 0x20 /end MEASUREMENT
/begin MEASUREMENT fmy_stat_sens_bat_smt_com.err_info_stat.lv_cdn_diag "diagnosis condition of the diagnosis instance SENS_BAT_SMT_COM" UWORD _CNV_S_2_RANGE__0___1_CM 1 100. 0. 1. DISPLAY_IDENTIFIER LV_CDN_DIAG_SENS_BAT_SMT_COM ECU_ADDRESS 0xd000997e BIT_MASK 0x40 /end MEASUREMENT
/begin MEASUREMENT fmy_stat_sens_bat_smt_com.err_info_stat.err_sym "symptoms of the diagnosis instance SENS_BAT_SMT_COM" UWORD _CNV_S_16_RANGE_ERR__349_CM 1 100. 0. 15. DISPLAY_IDENTIFIER ERR_SYM_SENS_BAT_SMT_COM ECU_ADDRESS 0xd000997e BIT_MASK 0x780 /end MEASUREMENT
/begin MEASUREMENT fmy_stat_ecraspwm_fb.ctr_abc "anti bounce counter for diagnosis instance ECRASPWM_FB" UBYTE _CNV_A_R_LINEAR_____0_CM 1 100. 0. 255. DISPLAY_IDENTIFIER CTR_ABC_ECRASPWM_FB ECU_ADDRESS 0xd0009638 FORMAT "%3.0" /end MEASUREMENT
/begin MEASUREMENT fmy_stat_ecraspwm_fb.ctr_end_diag "counter for end of diagnosis for diagnosis instance ECRASPWM_FB" UBYTE _CNV_A_R_LINEAR_____0_CM 1 100. 0. 255. DISPLAY_IDENTIFIER CTR_ABC_END_DIAG_ECRASPWM_FB ECU_ADDRESS 0xd0009639 FORMAT "%3.0" /end MEASUREMENT
/begin MEASUREMENT fmy_stat_ecraspwm_fb.err_info_stat.lv_err_mem "storage in dynamic failure memory of the diagnosis instance ECRASPWM_FB" UWORD _CNV_S_2_RANGE__0___1_CM 1 100. 0. 1. DISPLAY_IDENTIFIER LV_ERR_MEM_ECRASPWM_FB ECU_ADDRESS 0xd000963a BIT_MASK 0x8 /end MEASUREMENT
/begin MEASUREMENT fmy_stat_ecraspwm_fb.err_info_stat.lv_ready "readiness status of the diagnosis instance ECRASPWM_FB" UWORD _CNV_S_2_RANGE__0___1_CM 1 100. 0. 1. DISPLAY_IDENTIFIER LV_READY_ECRASPWM_FB ECU_ADDRESS 0xd000963a BIT_MASK 0x10 /end MEASUREMENT
/begin MEASUREMENT fmy_stat_ecraspwm_fb.err_info_stat.lv_end_diag "end of diagnosis of the diagnosis instance ECRASPWM_FB" UWORD _CNV_S_2_RANGE__0___1_CM 1 100. 0. 1. DISPLAY_IDENTIFIER LV_END_DIAG_ECRASPWM_FB ECU_ADDRESS 0xd000963a BIT_MASK 0x20 /end MEASUREMENT
/begin MEASUREMENT fmy_stat_ecraspwm_fb.err_info_stat.lv_cdn_diag "diagnosis condition of the diagnosis instance ECRASPWM_FB" UWORD _CNV_S_2_RANGE__0___1_CM 1 100. 0. 1. DISPLAY_IDENTIFIER LV_CDN_DIAG_ECRASPWM_FB ECU_ADDRESS 0xd000963a BIT_MASK 0x40 /end MEASUREMENT
/begin MEASUREMENT fmy_stat_ecraspwm_fb.err_info_stat.err_sym "symptoms of the diagnosis instance ECRASPWM_FB" UWORD _CNV_S_16_RANGE_ERR__349_CM 1 100. 0. 15. DISPLAY_IDENTIFIER ERR_SYM_ECRASPWM_FB ECU_ADDRESS 0xd000963a BIT_MASK 0x780 /end MEASUREMENT
/begin MEASUREMENT fmy_stat_ecras_el.ctr_abc "anti bounce counter for diagnosis instance ECRAS_EL" UBYTE _CNV_A_R_LINEAR_____0_CM 1 100. 0. 255. DISPLAY_IDENTIFIER CTR_ABC_ECRAS_EL ECU_ADDRESS 0xd0009630 FORMAT "%3.0" /end MEASUREMENT
/begin MEASUREMENT fmy_stat_ecras_el.ctr_end_diag "counter for end of diagnosis for diagnosis instance ECRAS_EL" UBYTE _CNV_A_R_LINEAR_____0_CM 1 100. 0. 255. DISPLAY_IDENTIFIER CTR_ABC_END_DIAG_ECRAS_EL ECU_ADDRESS 0xd0009631 FORMAT "%3.0" /end MEASUREMENT
/begin MEASUREMENT fmy_stat_ecras_el.err_info_stat.lv_err_mem "storage in dynamic failure memory of the diagnosis instance ECRAS_EL" UWORD _CNV_S_2_RANGE__0___1_CM 1 100. 0. 1. DISPLAY_IDENTIFIER LV_ERR_MEM_ECRAS_EL ECU_ADDRESS 0xd0009632 BIT_MASK 0x8 /end MEASUREMENT
/begin MEASUREMENT fmy_stat_ecras_el.err_info_stat.lv_ready "readiness status of the diagnosis instance ECRAS_EL" UWORD _CNV_S_2_RANGE__0___1_CM 1 100. 0. 1. DISPLAY_IDENTIFIER LV_READY_ECRAS_EL ECU_ADDRESS 0xd0009632 BIT_MASK 0x10 /end MEASUREMENT
/begin MEASUREMENT fmy_stat_ecras_el.err_info_stat.lv_end_diag "end of diagnosis of the diagnosis instance ECRAS_EL" UWORD _CNV_S_2_RANGE__0___1_CM 1 100. 0. 1. DISPLAY_IDENTIFIER LV_END_DIAG_ECRAS_EL ECU_ADDRESS 0xd0009632 BIT_MASK 0x20 /end MEASUREMENT
/begin MEASUREMENT fmy_stat_ecras_el.err_info_stat.lv_cdn_diag "diagnosis condition of the diagnosis instance ECRAS_EL" UWORD _CNV_S_2_RANGE__0___1_CM 1 100. 0. 1. DISPLAY_IDENTIFIER LV_CDN_DIAG_ECRAS_EL ECU_ADDRESS 0xd0009632 BIT_MASK 0x40 /end MEASUREMENT
/begin MEASUREMENT fmy_stat_ecras_el.err_info_stat.err_sym "symptoms of the diagnosis instance ECRAS_EL" UWORD _CNV_S_16_RANGE_ERR__349_CM 1 100. 0. 15. DISPLAY_IDENTIFIER ERR_SYM_ECRAS_EL ECU_ADDRESS 0xd0009632 BIT_MASK 0x780 /end MEASUREMENT
/begin MEASUREMENT fmy_stat_ecras_up_fb.ctr_abc "anti bounce counter for diagnosis instance ECRAS_UP_FB" UBYTE _CNV_A_R_LINEAR_____0_CM 1 100. 0. 255. DISPLAY_IDENTIFIER CTR_ABC_ECRAS_UP_FB ECU_ADDRESS 0xd0009634 FORMAT "%3.0" /end MEASUREMENT
/begin MEASUREMENT fmy_stat_ecras_up_fb.ctr_end_diag "counter for end of diagnosis for diagnosis instance ECRAS_UP_FB" UBYTE _CNV_A_R_LINEAR_____0_CM 1 100. 0. 255. DISPLAY_IDENTIFIER CTR_ABC_END_DIAG_ECRAS_UP_FB ECU_ADDRESS 0xd0009635 FORMAT "%3.0" /end MEASUREMENT
/begin MEASUREMENT fmy_stat_ecras_up_fb.err_info_stat.lv_err_mem "storage in dynamic failure memory of the diagnosis instance ECRAS_UP_FB" UWORD _CNV_S_2_RANGE__0___1_CM 1 100. 0. 1. DISPLAY_IDENTIFIER LV_ERR_MEM_ECRAS_UP_FB ECU_ADDRESS 0xd0009636 BIT_MASK 0x8 /end MEASUREMENT
/begin MEASUREMENT fmy_stat_ecras_up_fb.err_info_stat.lv_ready "readiness status of the diagnosis instance ECRAS_UP_FB" UWORD _CNV_S_2_RANGE__0___1_CM 1 100. 0. 1. DISPLAY_IDENTIFIER LV_READY_ECRAS_UP_FB ECU_ADDRESS 0xd0009636 BIT_MASK 0x10 /end MEASUREMENT
/begin MEASUREMENT fmy_stat_ecras_up_fb.err_info_stat.lv_end_diag "end of diagnosis of the diagnosis instance ECRAS_UP_FB" UWORD _CNV_S_2_RANGE__0___1_CM 1 100. 0. 1. DISPLAY_IDENTIFIER LV_END_DIAG_ECRAS_UP_FB ECU_ADDRESS 0xd0009636 BIT_MASK 0x20 /end MEASUREMENT
/begin MEASUREMENT fmy_stat_ecras_up_fb.err_info_stat.lv_cdn_diag "diagnosis condition of the diagnosis instance ECRAS_UP_FB" UWORD _CNV_S_2_RANGE__0___1_CM 1 100. 0. 1. DISPLAY_IDENTIFIER LV_CDN_DIAG_ECRAS_UP_FB ECU_ADDRESS 0xd0009636 BIT_MASK 0x40 /end MEASUREMENT
/begin MEASUREMENT fmy_stat_ecras_up_fb.err_info_stat.err_sym "symptoms of the diagnosis instance ECRAS_UP_FB" UWORD _CNV_S_16_RANGE_ERR__349_CM 1 100. 0. 15. DISPLAY_IDENTIFIER ERR_SYM_ECRAS_UP_FB ECU_ADDRESS 0xd0009636 BIT_MASK 0x780 /end MEASUREMENT
/begin MEASUREMENT fmy_stat_ecras_down_fb.ctr_abc "anti bounce counter for diagnosis instance ECRAS_DOWN_FB" UBYTE _CNV_A_R_LINEAR_____0_CM 1 100. 0. 255. DISPLAY_IDENTIFIER CTR_ABC_ECRAS_DOWN_FB ECU_ADDRESS 0xd000962c FORMAT "%3.0" /end MEASUREMENT
/begin MEASUREMENT fmy_stat_ecras_down_fb.ctr_end_diag "counter for end of diagnosis for diagnosis instance ECRAS_DOWN_FB" UBYTE _CNV_A_R_LINEAR_____0_CM 1 100. 0. 255. DISPLAY_IDENTIFIER CTR_ABC_END_DIAG_ECRAS_DOWN_FB ECU_ADDRESS 0xd000962d FORMAT "%3.0" /end MEASUREMENT
/begin MEASUREMENT fmy_stat_ecras_down_fb.err_info_stat.lv_err_mem "storage in dynamic failure memory of the diagnosis instance ECRAS_DOWN_FB" UWORD _CNV_S_2_RANGE__0___1_CM 1 100. 0. 1. DISPLAY_IDENTIFIER LV_ERR_MEM_ECRAS_DOWN_FB ECU_ADDRESS 0xd000962e BIT_MASK 0x8 /end MEASUREMENT
/begin MEASUREMENT fmy_stat_ecras_down_fb.err_info_stat.lv_ready "readiness status of the diagnosis instance ECRAS_DOWN_FB" UWORD _CNV_S_2_RANGE__0___1_CM 1 100. 0. 1. DISPLAY_IDENTIFIER LV_READY_ECRAS_DOWN_FB ECU_ADDRESS 0xd000962e BIT_MASK 0x10 /end MEASUREMENT
/begin MEASUREMENT fmy_stat_ecras_down_fb.err_info_stat.lv_end_diag "end of diagnosis of the diagnosis instance ECRAS_DOWN_FB" UWORD _CNV_S_2_RANGE__0___1_CM 1 100. 0. 1. DISPLAY_IDENTIFIER LV_END_DIAG_ECRAS_DOWN_FB ECU_ADDRESS 0xd000962e BIT_MASK 0x20 /end MEASUREMENT
/begin MEASUREMENT fmy_stat_ecras_down_fb.err_info_stat.lv_cdn_diag "diagnosis condition of the diagnosis instance ECRAS_DOWN_FB" UWORD _CNV_S_2_RANGE__0___1_CM 1 100. 0. 1. DISPLAY_IDENTIFIER LV_CDN_DIAG_ECRAS_DOWN_FB ECU_ADDRESS 0xd000962e BIT_MASK 0x40 /end MEASUREMENT
/begin MEASUREMENT fmy_stat_ecras_down_fb.err_info_stat.err_sym "symptoms of the diagnosis instance ECRAS_DOWN_FB" UWORD _CNV_S_16_RANGE_ERR__349_CM 1 100. 0. 15. DISPLAY_IDENTIFIER ERR_SYM_ECRAS_DOWN_FB ECU_ADDRESS 0xd000962e BIT_MASK 0x780 /end MEASUREMENT
/begin MEASUREMENT fmy_stat_warm_rst.ctr_abc "anti bounce counter for diagnosis instance WARM_RST" UBYTE _CNV_A_R_LINEAR_____0_CM 1 100. 0. 255. DISPLAY_IDENTIFIER CTR_ABC_WARM_RST ECU_ADDRESS 0xd0009b08 FORMAT "%3.0" /end MEASUREMENT
/begin MEASUREMENT fmy_stat_warm_rst.ctr_end_diag "counter for end of diagnosis for diagnosis instance WARM_RST" UBYTE _CNV_A_R_LINEAR_____0_CM 1 100. 0. 255. DISPLAY_IDENTIFIER CTR_ABC_END_DIAG_WARM_RST ECU_ADDRESS 0xd0009b09 FORMAT "%3.0" /end MEASUREMENT
/begin MEASUREMENT fmy_stat_warm_rst.err_info_stat.lv_err_mem "storage in dynamic failure memory of the diagnosis instance WARM_RST" UWORD _CNV_S_2_RANGE__0___1_CM 1 100. 0. 1. DISPLAY_IDENTIFIER LV_ERR_MEM_WARM_RST ECU_ADDRESS 0xd0009b0a BIT_MASK 0x8 /end MEASUREMENT
/begin MEASUREMENT fmy_stat_warm_rst.err_info_stat.lv_ready "readiness status of the diagnosis instance WARM_RST" UWORD _CNV_S_2_RANGE__0___1_CM 1 100. 0. 1. DISPLAY_IDENTIFIER LV_READY_WARM_RST ECU_ADDRESS 0xd0009b0a BIT_MASK 0x10 /end MEASUREMENT
/begin MEASUREMENT fmy_stat_warm_rst.err_info_stat.lv_end_diag "end of diagnosis of the diagnosis instance WARM_RST" UWORD _CNV_S_2_RANGE__0___1_CM 1 100. 0. 1. DISPLAY_IDENTIFIER LV_END_DIAG_WARM_RST ECU_ADDRESS 0xd0009b0a BIT_MASK 0x20 /end MEASUREMENT
/begin MEASUREMENT fmy_stat_warm_rst.err_info_stat.lv_cdn_diag "diagnosis condition of the diagnosis instance WARM_RST" UWORD _CNV_S_2_RANGE__0___1_CM 1 100. 0. 1. DISPLAY_IDENTIFIER LV_CDN_DIAG_WARM_RST ECU_ADDRESS 0xd0009b0a BIT_MASK 0x40 /end MEASUREMENT
/begin MEASUREMENT fmy_stat_warm_rst.err_info_stat.err_sym "symptoms of the diagnosis instance WARM_RST" UWORD _CNV_S_16_RANGE_ERR__349_CM 1 100. 0. 15. DISPLAY_IDENTIFIER ERR_SYM_WARM_RST ECU_ADDRESS 0xd0009b0a BIT_MASK 0x780 /end MEASUREMENT
/begin MEASUREMENT fmy_stat_acr_ad.ctr_abc "anti bounce counter for diagnosis instance ACR_AD" UBYTE _CNV_A_R_LINEAR_____0_CM 1 100. 0. 255. DISPLAY_IDENTIFIER CTR_ABC_ACR_AD ECU_ADDRESS 0xd00093b8 FORMAT "%3.0" /end MEASUREMENT
/begin MEASUREMENT fmy_stat_acr_ad.ctr_end_diag "counter for end of diagnosis for diagnosis instance ACR_AD" UBYTE _CNV_A_R_LINEAR_____0_CM 1 100. 0. 255. DISPLAY_IDENTIFIER CTR_ABC_END_DIAG_ACR_AD ECU_ADDRESS 0xd00093b9 FORMAT "%3.0" /end MEASUREMENT
/begin MEASUREMENT fmy_stat_acr_ad.err_info_stat.lv_err_mem "storage in dynamic failure memory of the diagnosis instance ACR_AD" UWORD _CNV_S_2_RANGE__0___1_CM 1 100. 0. 1. DISPLAY_IDENTIFIER LV_ERR_MEM_ACR_AD ECU_ADDRESS 0xd00093ba BIT_MASK 0x8 /end MEASUREMENT
/begin MEASUREMENT fmy_stat_acr_ad.err_info_stat.lv_ready "readiness status of the diagnosis instance ACR_AD" UWORD _CNV_S_2_RANGE__0___1_CM 1 100. 0. 1. DISPLAY_IDENTIFIER LV_READY_ACR_AD ECU_ADDRESS 0xd00093ba BIT_MASK 0x10 /end MEASUREMENT
/begin MEASUREMENT fmy_stat_acr_ad.err_info_stat.lv_end_diag "end of diagnosis of the diagnosis instance ACR_AD" UWORD _CNV_S_2_RANGE__0___1_CM 1 100. 0. 1. DISPLAY_IDENTIFIER LV_END_DIAG_ACR_AD ECU_ADDRESS 0xd00093ba BIT_MASK 0x20 /end MEASUREMENT
/begin MEASUREMENT fmy_stat_acr_ad.err_info_stat.lv_cdn_diag "diagnosis condition of the diagnosis instance ACR_AD" UWORD _CNV_S_2_RANGE__0___1_CM 1 100. 0. 1. DISPLAY_IDENTIFIER LV_CDN_DIAG_ACR_AD ECU_ADDRESS 0xd00093ba BIT_MASK 0x40 /end MEASUREMENT
/begin MEASUREMENT fmy_stat_acr_ad.err_info_stat.err_sym "symptoms of the diagnosis instance ACR_AD" UWORD _CNV_S_16_RANGE_ERR__349_CM 1 100. 0. 15. DISPLAY_IDENTIFIER ERR_SYM_ACR_AD ECU_ADDRESS 0xd00093ba BIT_MASK 0x780 /end MEASUREMENT
/begin MEASUREMENT fmy_stat_sens_acr.ctr_abc "anti bounce counter for diagnosis instance SENS_ACR" UBYTE _CNV_A_R_LINEAR_____0_CM 1 100. 0. 255. DISPLAY_IDENTIFIER CTR_ABC_SENS_ACR ECU_ADDRESS 0xd0009978 FORMAT "%3.0" /end MEASUREMENT
/begin MEASUREMENT fmy_stat_sens_acr.ctr_end_diag "counter for end of diagnosis for diagnosis instance SENS_ACR" UBYTE _CNV_A_R_LINEAR_____0_CM 1 100. 0. 255. DISPLAY_IDENTIFIER CTR_ABC_END_DIAG_SENS_ACR ECU_ADDRESS 0xd0009979 FORMAT "%3.0" /end MEASUREMENT
/begin MEASUREMENT fmy_stat_sens_acr.err_info_stat.lv_err_mem "storage in dynamic failure memory of the diagnosis instance SENS_ACR" UWORD _CNV_S_2_RANGE__0___1_CM 1 100. 0. 1. DISPLAY_IDENTIFIER LV_ERR_MEM_SENS_ACR ECU_ADDRESS 0xd000997a BIT_MASK 0x8 /end MEASUREMENT
/begin MEASUREMENT fmy_stat_sens_acr.err_info_stat.lv_ready "readiness status of the diagnosis instance SENS_ACR" UWORD _CNV_S_2_RANGE__0___1_CM 1 100. 0. 1. DISPLAY_IDENTIFIER LV_READY_SENS_ACR ECU_ADDRESS 0xd000997a BIT_MASK 0x10 /end MEASUREMENT
/begin MEASUREMENT fmy_stat_sens_acr.err_info_stat.lv_end_diag "end of diagnosis of the diagnosis instance SENS_ACR" UWORD _CNV_S_2_RANGE__0___1_CM 1 100. 0. 1. DISPLAY_IDENTIFIER LV_END_DIAG_SENS_ACR ECU_ADDRESS 0xd000997a BIT_MASK 0x20 /end MEASUREMENT
/begin MEASUREMENT fmy_stat_sens_acr.err_info_stat.lv_cdn_diag "diagnosis condition of the diagnosis instance SENS_ACR" UWORD _CNV_S_2_RANGE__0___1_CM 1 100. 0. 1. DISPLAY_IDENTIFIER LV_CDN_DIAG_SENS_ACR ECU_ADDRESS 0xd000997a BIT_MASK 0x40 /end MEASUREMENT
/begin MEASUREMENT fmy_stat_sens_acr.err_info_stat.err_sym "symptoms of the diagnosis instance SENS_ACR" UWORD _CNV_S_16_RANGE_ERR__349_CM 1 100. 0. 15. DISPLAY_IDENTIFIER ERR_SYM_SENS_ACR ECU_ADDRESS 0xd000997a BIT_MASK 0x780 /end MEASUREMENT
/begin MEASUREMENT fmy_stat_acr_ctl.ctr_abc "anti bounce counter for diagnosis instance ACR_CTL" UBYTE _CNV_A_R_LINEAR_____0_CM 1 100. 0. 255. DISPLAY_IDENTIFIER CTR_ABC_ACR_CTL ECU_ADDRESS 0xd00093bc FORMAT "%3.0" /end MEASUREMENT
/begin MEASUREMENT fmy_stat_acr_ctl.ctr_end_diag "counter for end of diagnosis for diagnosis instance ACR_CTL" UBYTE _CNV_A_R_LINEAR_____0_CM 1 100. 0. 255. DISPLAY_IDENTIFIER CTR_ABC_END_DIAG_ACR_CTL ECU_ADDRESS 0xd00093bd FORMAT "%3.0" /end MEASUREMENT
/begin MEASUREMENT fmy_stat_acr_ctl.err_info_stat.lv_err_mem "storage in dynamic failure memory of the diagnosis instance ACR_CTL" UWORD _CNV_S_2_RANGE__0___1_CM 1 100. 0. 1. DISPLAY_IDENTIFIER LV_ERR_MEM_ACR_CTL ECU_ADDRESS 0xd00093be BIT_MASK 0x8 /end MEASUREMENT
/begin MEASUREMENT fmy_stat_acr_ctl.err_info_stat.lv_ready "readiness status of the diagnosis instance ACR_CTL" UWORD _CNV_S_2_RANGE__0___1_CM 1 100. 0. 1. DISPLAY_IDENTIFIER LV_READY_ACR_CTL ECU_ADDRESS 0xd00093be BIT_MASK 0x10 /end MEASUREMENT
/begin MEASUREMENT fmy_stat_acr_ctl.err_info_stat.lv_end_diag "end of diagnosis of the diagnosis instance ACR_CTL" UWORD _CNV_S_2_RANGE__0___1_CM 1 100. 0. 1. DISPLAY_IDENTIFIER LV_END_DIAG_ACR_CTL ECU_ADDRESS 0xd00093be BIT_MASK 0x20 /end MEASUREMENT
/begin MEASUREMENT fmy_stat_acr_ctl.err_info_stat.lv_cdn_diag "diagnosis condition of the diagnosis instance ACR_CTL" UWORD _CNV_S_2_RANGE__0___1_CM 1 100. 0. 1. DISPLAY_IDENTIFIER LV_CDN_DIAG_ACR_CTL ECU_ADDRESS 0xd00093be BIT_MASK 0x40 /end MEASUREMENT
/begin MEASUREMENT fmy_stat_acr_ctl.err_info_stat.err_sym "symptoms of the diagnosis instance ACR_CTL" UWORD _CNV_S_16_RANGE_ERR__349_CM 1 100. 0. 15. DISPLAY_IDENTIFIER ERR_SYM_ACR_CTL ECU_ADDRESS 0xd00093be BIT_MASK 0x780 /end MEASUREMENT
/begin COMPU_METHOD _CNV_A_R_LINEAR_____0_CM "" RAT_FUNC "%6.3" "-" COEFFS 0 1. 0. 0 0 1 /end COMPU_METHOD
/begin COMPU_METHOD _CNV_S_2_RANGE__0___1_CM "" TAB_VERB "%6.3" "-" COMPU_TAB_REF _CNV_S_2_RANGE__0___1 /end COMPU_METHOD
/begin COMPU_VTAB _CNV_S_2_RANGE__0___1 "" TAB_VERB 2 0 "0" 1 "1" /end COMPU_VTAB
/begin COMPU_METHOD _CNV_S_16_RANGE_ERR__349_CM "" TAB_VERB "%6.3" "-" COMPU_TAB_REF _CNV_S_16_RANGE_ERR__349 /end COMPU_METHOD
/begin COMPU_VTAB _CNV_S_16_RANGE_ERR__349 "" TAB_VERB 16 0 "NO_SYM" 1 "SYM_0" 2 "SYM_1" 3 "SYM_0, SYM_1" 4 "SYM_2" 5 "SYM_0, SYM_2" 6 "SYM_1, SYM_2" 7 "SYM_0, SYM_1, SYM_2" 8 "SYM_3" 9 "SYM_0, SYM_3" 10 "SYM_1, SYM_3" 11 "SYM_0, SYM_1,SYM_3" 12 "SYM_2, SYM_3" 13 "SYM_0, SYM_2, SYM_3" 14 "SYM_1, SYM_2, SYM_3" 15 "SYM_0, SYM_1, SYM_2, SYM_3" /end COMPU_VTAB
/begin FUNCTION ERRM_Table_of_Failures "Table_of_Failures"
 /begin OUT_MEASUREMENT fmy_stat_tout_nox_sens_2.err_info_stat.lv_ready fmy_stat_tout_nox_sens_2.err_info_stat.lv_end_diag fmy_stat_tout_nox_sens_2.err_info_stat.lv_cdn_diag fmy_stat_tout_nox_sens_2.err_info_stat.err_sym fmy_stat_vvl_rot.ctr_abc fmy_stat_vvl_rot.ctr_end_diag fmy_stat_vvl_rot.err_info_stat.lv_err_mem fmy_stat_vvl_rot.err_info_stat.lv_ready fmy_stat_vvl_rot.err_info_stat.lv_end_diag fmy_stat_vvl_rot.err_info_stat.lv_cdn_diag fmy_stat_vvl_rot.err_info_stat.err_sym fmy_stat_rly_vvl.ctr_abc fmy_stat_rly_vvl.ctr_end_diag fmy_stat_rly_vvl.err_info_stat.lv_err_mem fmy_stat_rly_vvl.err_info_stat.lv_ready fmy_stat_rly_vvl.err_info_stat.lv_end_diag fmy_stat_rly_vvl.err_info_stat.lv_cdn_diag fmy_stat_rly_vvl.err_info_stat.err_sym fmy_stat_nox_sens_1.ctr_abc fmy_stat_nox_sens_1.ctr_end_diag fmy_stat_nox_sens_1.err_info_stat.lv_err_mem fmy_stat_nox_sens_1.err_info_stat.lv_ready fmy_stat_nox_sens_1.err_info_stat.lv_end_diag fmy_stat_nox_sens_1.err_info_stat.lv_cdn_diag fmy_stat_nox_sens_1.err_info_stat.err_sym fmy_stat_ns_obd_1_1.ctr_abc fmy_stat_ns_obd_1_1.ctr_end_diag fmy_stat_ns_obd_1_1.err_info_stat.lv_err_mem fmy_stat_ns_obd_1_1.err_info_stat.lv_ready fmy_stat_ns_obd_1_1.err_info_stat.lv_end_diag fmy_stat_ns_obd_1_1.err_info_stat.lv_cdn_diag fmy_stat_ns_obd_1_1.err_info_stat.err_sym fmy_stat_ns_obd_1_2.ctr_abc fmy_stat_ns_obd_1_2.ctr_end_diag fmy_stat_ns_obd_1_2.err_info_stat.lv_err_mem fmy_stat_ns_obd_1_2.err_info_stat.lv_ready fmy_stat_ns_obd_1_2.err_info_stat.lv_end_diag fmy_stat_ns_obd_1_2.err_info_stat.lv_cdn_diag fmy_stat_ns_obd_1_2.err_info_stat.err_sym fmy_stat_ovl_ecu_vvl.ctr_abc fmy_stat_ovl_ecu_vvl.ctr_end_diag fmy_stat_ovl_ecu_vvl.err_info_stat.lv_err_mem fmy_stat_ovl_ecu_vvl.err_info_stat.lv_ready fmy_stat_ovl_ecu_vvl.err_info_stat.lv_end_diag fmy_stat_ovl_ecu_vvl.err_info_stat.lv_cdn_diag fmy_stat_ovl_ecu_vvl.err_info_stat.err_sym fmy_stat_dr_sc_vvl.ctr_abc fmy_stat_dr_sc_vvl.ctr_end_diag fmy_stat_dr_sc_vvl.err_info_stat.lv_err_mem fmy_stat_dr_sc_vvl.err_info_stat.lv_ready fmy_stat_dr_sc_vvl.err_info_stat.lv_end_diag fmy_stat_dr_sc_vvl.err_info_stat.lv_cdn_diag fmy_stat_dr_sc_vvl.err_info_stat.err_sym fmy_stat_crit_ovl_ecu_vvl.ctr_abc fmy_stat_crit_ovl_ecu_vvl.ctr_end_diag fmy_stat_crit_ovl_ecu_vvl.err_info_stat.lv_err_mem fmy_stat_crit_ovl_ecu_vvl.err_info_stat.lv_ready fmy_stat_crit_ovl_ecu_vvl.err_info_stat.lv_end_diag fmy_stat_crit_ovl_ecu_vvl.err_info_stat.lv_cdn_diag fmy_stat_crit_ovl_ecu_vvl.err_info_stat.err_sym fmy_stat_nox_sens_2.ctr_abc fmy_stat_nox_sens_2.ctr_end_diag fmy_stat_nox_sens_2.err_info_stat.lv_err_mem fmy_stat_nox_sens_2.err_info_stat.lv_ready fmy_stat_nox_sens_2.err_info_stat.lv_end_diag fmy_stat_nox_sens_2.err_info_stat.lv_cdn_diag fmy_stat_nox_sens_2.err_info_stat.err_sym fmy_stat_cur_h_vvl.ctr_abc fmy_stat_cur_h_vvl.ctr_end_diag fmy_stat_cur_h_vvl.err_info_stat.lv_err_mem fmy_stat_cur_h_vvl.err_info_stat.lv_ready fmy_stat_cur_h_vvl.err_info_stat.lv_end_diag fmy_stat_cur_h_vvl.err_info_stat.lv_cdn_diag fmy_stat_cur_h_vvl.err_info_stat.err_sym fmy_stat_teg_pcat_down.ctr_abc fmy_stat_teg_pcat_down.ctr_end_diag fmy_stat_teg_pcat_down.err_info_stat.lv_err_mem fmy_stat_teg_pcat_down.err_info_stat.lv_ready fmy_stat_teg_pcat_down.err_info_stat.lv_end_diag fmy_stat_teg_pcat_down.err_info_stat.lv_cdn_diag fmy_stat_teg_pcat_down.err_info_stat.err_sym fmy_stat_t_seg_er.ctr_abc fmy_stat_t_seg_er.ctr_end_diag fmy_stat_t_seg_er.err_info_stat.lv_err_mem fmy_stat_t_seg_er.err_info_stat.lv_ready fmy_stat_t_seg_er.err_info_stat.lv_end_diag fmy_stat_t_seg_er.err_info_stat.lv_cdn_diag fmy_stat_t_seg_er.err_info_stat.err_sym fmy_stat_seg_ad_er.ctr_abc fmy_stat_seg_ad_er.ctr_end_diag fmy_stat_seg_ad_er.err_info_stat.lv_err_mem fmy_stat_seg_ad_er.err_info_stat.lv_ready fmy_stat_seg_ad_er.err_info_stat.lv_end_diag fmy_stat_seg_ad_er.err_info_stat.lv_cdn_diag fmy_stat_seg_ad_er.err_info_stat.err_sym fmy_stat_vs_plaus.ctr_abc fmy_stat_vs_plaus.ctr_end_diag fmy_stat_vs_plaus.err_info_stat.lv_err_mem fmy_stat_vs_plaus.err_info_stat.lv_ready fmy_stat_vs_plaus.err_info_stat.lv_end_diag fmy_stat_vs_plaus.err_info_stat.lv_cdn_diag fmy_stat_vs_plaus.err_info_stat.err_sym fmy_stat_ftl_obd.ctr_abc fmy_stat_ftl_obd.ctr_end_diag fmy_stat_ftl_obd.err_info_stat.lv_err_mem fmy_stat_ftl_obd.err_info_stat.lv_ready fmy_stat_ftl_obd.err_info_stat.lv_end_diag fmy_stat_ftl_obd.err_info_stat.lv_cdn_diag fmy_stat_ftl_obd.err_info_stat.err_sym fmy_stat_ftl_le_can.ctr_abc fmy_stat_ftl_le_can.ctr_end_diag fmy_stat_ftl_le_can.err_info_stat.lv_err_mem fmy_stat_ftl_le_can.err_info_stat.lv_ready fmy_stat_ftl_le_can.err_info_stat.lv_end_diag fmy_stat_ftl_le_can.err_info_stat.lv_cdn_diag fmy_stat_ftl_le_can.err_info_stat.err_sym fmy_stat_ftl_ri_can.ctr_abc fmy_stat_ftl_ri_can.ctr_end_diag fmy_stat_ftl_ri_can.err_info_stat.lv_err_mem fmy_stat_ftl_ri_can.err_info_stat.lv_ready fmy_stat_ftl_ri_can.err_info_stat.lv_end_diag fmy_stat_ftl_ri_can.err_info_stat.lv_cdn_diag fmy_stat_ftl_ri_can.err_info_stat.err_sym fmy_stat_tia_plaus.ctr_abc fmy_stat_tia_plaus.ctr_end_diag fmy_stat_tia_plaus.err_info_stat.lv_err_mem fmy_stat_tia_plaus.err_info_stat.lv_ready fmy_stat_tia_plaus.err_info_stat.lv_end_diag fmy_stat_tia_plaus.err_info_stat.lv_cdn_diag fmy_stat_tia_plaus.err_info_stat.err_sym fmy_stat_tam_can.ctr_abc fmy_stat_tam_can.ctr_end_diag fmy_stat_tam_can.err_info_stat.lv_err_mem fmy_stat_tam_can.err_info_stat.lv_ready fmy_stat_tam_can.err_info_stat.lv_end_diag fmy_stat_tam_can.err_info_stat.lv_cdn_diag fmy_stat_tam_can.err_info_stat.err_sym fmy_stat_tam_plaus.ctr_abc fmy_stat_tam_plaus.ctr_end_diag fmy_stat_tam_plaus.err_info_stat.lv_err_mem fmy_stat_tam_plaus.err_info_stat.lv_ready fmy_stat_tam_plaus.err_info_stat.lv_end_diag fmy_stat_tam_plaus.err_info_stat.lv_cdn_diag fmy_stat_tam_plaus.err_info_stat.err_sym fmy_stat_map_shift_1.ctr_abc fmy_stat_map_shift_1.ctr_end_diag fmy_stat_map_shift_1.err_info_stat.lv_err_mem fmy_stat_map_shift_1.err_info_stat.lv_ready fmy_stat_map_shift_1.err_info_stat.lv_end_diag fmy_stat_map_shift_1.err_info_stat.lv_cdn_diag fmy_stat_map_shift_1.err_info_stat.err_sym fmy_stat_map_shift_2.ctr_abc fmy_stat_map_shift_2.ctr_end_diag fmy_stat_map_shift_2.err_info_stat.lv_err_mem fmy_stat_map_shift_2.err_info_stat.lv_ready fmy_stat_map_shift_2.err_info_stat.lv_end_diag fmy_stat_map_shift_2.err_info_stat.lv_cdn_diag fmy_stat_map_shift_2.err_info_stat.err_sym fmy_stat_cat_diag_1.ctr_abc fmy_stat_cat_diag_1.ctr_end_diag fmy_stat_cat_diag_1.err_info_stat.lv_err_mem fmy_stat_cat_diag_1.err_info_stat.lv_ready fmy_stat_cat_diag_1.err_info_stat.lv_end_diag fmy_stat_cat_diag_1.err_info_stat.lv_cdn_diag fmy_stat_cat_diag_1.err_info_stat.err_sym fmy_stat_cat_diag_2.ctr_abc fmy_stat_cat_diag_2.ctr_end_diag fmy_stat_cat_diag_2.err_info_stat.lv_err_mem fmy_stat_cat_diag_2.err_info_stat.lv_ready fmy_stat_cat_diag_2.err_info_stat.lv_end_diag fmy_stat_cat_diag_2.err_info_stat.lv_cdn_diag fmy_stat_cat_diag_2.err_info_stat.err_sym fmy_stat_cat_diag_afl_1.ctr_abc fmy_stat_cat_diag_afl_1.ctr_end_diag fmy_stat_cat_diag_afl_1.err_info_stat.lv_err_mem fmy_stat_cat_diag_afl_1.err_info_stat.lv_ready fmy_stat_cat_diag_afl_1.err_info_stat.lv_end_diag fmy_stat_cat_diag_afl_1.err_info_stat.lv_cdn_diag fmy_stat_cat_diag_afl_1.err_info_stat.err_sym fmy_stat_cat_diag_afl_2.ctr_abc fmy_stat_cat_diag_afl_2.ctr_end_diag fmy_stat_cat_diag_afl_2.err_info_stat.lv_err_mem fmy_stat_cat_diag_afl_2.err_info_stat.lv_ready fmy_stat_cat_diag_afl_2.err_info_stat.lv_end_diag fmy_stat_cat_diag_afl_2.err_info_stat.lv_cdn_diag fmy_stat_cat_diag_afl_2.err_info_stat.err_sym fmy_stat_scg_ls_down_1.ctr_abc fmy_stat_scg_ls_down_1.ctr_end_diag fmy_stat_scg_ls_down_1.err_info_stat.lv_err_mem fmy_stat_scg_ls_down_1.err_info_stat.lv_ready fmy_stat_scg_ls_down_1.err_info_stat.lv_end_diag fmy_stat_scg_ls_down_1.err_info_stat.lv_cdn_diag fmy_stat_scg_ls_down_1.err_info_stat.err_sym fmy_stat_scp_ls_down_1.ctr_abc fmy_stat_scp_ls_down_1.ctr_end_diag fmy_stat_scp_ls_down_1.err_info_stat.lv_err_mem fmy_stat_scp_ls_down_1.err_info_stat.lv_ready fmy_stat_scp_ls_down_1.err_info_stat.lv_end_diag fmy_stat_scp_ls_down_1.err_info_stat.lv_cdn_diag fmy_stat_scp_ls_down_1.err_info_stat.err_sym fmy_stat_oc_ls_down_1.ctr_abc fmy_stat_oc_ls_down_1.ctr_end_diag fmy_stat_oc_ls_down_1.err_info_stat.lv_err_mem fmy_stat_oc_ls_down_1.err_info_stat.lv_ready fmy_stat_oc_ls_down_1.err_info_stat.lv_end_diag fmy_stat_oc_ls_down_1.err_info_stat.lv_cdn_diag fmy_stat_oc_ls_down_1.err_info_stat.err_sym fmy_stat_puc_ls_down_1.ctr_abc fmy_stat_puc_ls_down_1.ctr_end_diag fmy_stat_puc_ls_down_1.err_info_stat.lv_err_mem fmy_stat_puc_ls_down_1.err_info_stat.lv_ready fmy_stat_puc_ls_down_1.err_info_stat.lv_end_diag fmy_stat_puc_ls_down_1.err_info_stat.lv_cdn_diag fmy_stat_puc_ls_down_1.err_info_stat.err_sym fmy_stat_fl_ls_down_1.ctr_abc fmy_stat_fl_ls_down_1.ctr_end_diag fmy_stat_fl_ls_down_1.err_info_stat.lv_err_mem fmy_stat_fl_ls_down_1.err_info_stat.lv_ready fmy_stat_fl_ls_down_1.err_info_stat.lv_end_diag fmy_stat_fl_ls_down_1.err_info_stat.lv_cdn_diag fmy_stat_fl_ls_down_1.err_info_stat.err_sym fmy_stat_lsl_up_if_1.ctr_abc fmy_stat_lsl_up_if_1.ctr_end_diag fmy_stat_lsl_up_if_1.err_info_stat.lv_err_mem fmy_stat_lsl_up_if_1.err_info_stat.lv_ready fmy_stat_lsl_up_if_1.err_info_stat.lv_end_diag fmy_stat_lsl_up_if_1.err_info_stat.lv_cdn_diag fmy_stat_lsl_up_if_1.err_info_stat.err_sym fmy_stat_el_lsl_up_1.ctr_abc fmy_stat_el_lsl_up_1.ctr_end_diag fmy_stat_el_lsl_up_1.err_info_stat.lv_err_mem fmy_stat_el_lsl_up_1.err_info_stat.lv_ready fmy_stat_el_lsl_up_1.err_info_stat.lv_end_diag fmy_stat_el_lsl_up_1.err_info_stat.lv_cdn_diag fmy_stat_el_lsl_up_1.err_info_stat.err_sym fmy_stat_lsh_up_1.ctr_abc fmy_stat_lsh_up_1.ctr_end_diag fmy_stat_lsh_up_1.err_info_stat.lv_err_mem fmy_stat_lsh_up_1.err_info_stat.lv_ready fmy_stat_lsh_up_1.err_info_stat.lv_end_diag fmy_stat_lsh_up_1.err_info_stat.lv_cdn_diag fmy_stat_lsh_up_1.err_info_stat.err_sym fmy_stat_lsh_down_1.ctr_abc fmy_stat_lsh_down_1.ctr_end_diag fmy_stat_lsh_down_1.err_info_stat.lv_err_mem fmy_stat_lsh_down_1.err_info_stat.lv_ready fmy_stat_lsh_down_1.err_info_stat.lv_end_diag fmy_stat_lsh_down_1.err_info_stat.lv_cdn_diag fmy_stat_lsh_down_1.err_info_stat.err_sym fmy_stat_vls_down_dif_1.ctr_abc fmy_stat_vls_down_dif_1.ctr_end_diag fmy_stat_vls_down_dif_1.err_info_stat.lv_err_mem fmy_stat_vls_down_dif_1.err_info_stat.lv_ready fmy_stat_vls_down_dif_1.err_info_stat.lv_end_diag fmy_stat_vls_down_dif_1.err_info_stat.lv_cdn_diag fmy_stat_vls_down_dif_1.err_info_stat.err_sym fmy_stat_lsh_lsl_up_1.ctr_abc fmy_stat_lsh_lsl_up_1.ctr_end_diag fmy_stat_lsh_lsl_up_1.err_info_stat.lv_err_mem fmy_stat_lsh_lsl_up_1.err_info_stat.lv_ready fmy_stat_lsh_lsl_up_1.err_info_stat.lv_end_diag fmy_stat_lsh_lsl_up_1.err_info_stat.lv_cdn_diag fmy_stat_lsh_lsl_up_1.err_info_stat.err_sym fmy_stat_air_lsl_up_1.ctr_abc fmy_stat_air_lsl_up_1.ctr_end_diag fmy_stat_air_lsl_up_1.err_info_stat.lv_err_mem fmy_stat_air_lsl_up_1.err_info_stat.lv_ready fmy_stat_air_lsl_up_1.err_info_stat.lv_end_diag fmy_stat_air_lsl_up_1.err_info_stat.lv_cdn_diag fmy_stat_air_lsl_up_1.err_info_stat.err_sym fmy_stat_pue_ls_down_1.ctr_abc fmy_stat_pue_ls_down_1.ctr_end_diag fmy_stat_pue_ls_down_1.err_info_stat.lv_err_mem fmy_stat_pue_ls_down_1.err_info_stat.lv_ready fmy_stat_pue_ls_down_1.err_info_stat.lv_end_diag fmy_stat_pue_ls_down_1.err_info_stat.lv_cdn_diag fmy_stat_pue_ls_down_1.err_info_stat.err_sym fmy_stat_swt_ls_down_1.ctr_abc fmy_stat_swt_ls_down_1.ctr_end_diag fmy_stat_swt_ls_down_1.err_info_stat.lv_err_mem fmy_stat_swt_ls_down_1.err_info_stat.lv_ready fmy_stat_swt_ls_down_1.err_info_stat.lv_end_diag fmy_stat_swt_ls_down_1.err_info_stat.lv_cdn_diag fmy_stat_swt_ls_down_1.err_info_stat.err_sym fmy_stat_obd_lsh_down_1.ctr_abc fmy_stat_obd_lsh_down_1.ctr_end_diag fmy_stat_obd_lsh_down_1.err_info_stat.lv_err_mem fmy_stat_obd_lsh_down_1.err_info_stat.lv_ready fmy_stat_obd_lsh_down_1.err_info_stat.lv_end_diag fmy_stat_obd_lsh_down_1.err_info_stat.lv_cdn_diag fmy_stat_obd_lsh_down_1.err_info_stat.err_sym fmy_stat_dyn_vld_ls_up_1.ctr_abc fmy_stat_dyn_vld_ls_up_1.ctr_end_diag fmy_stat_dyn_vld_ls_up_1.err_info_stat.lv_err_mem fmy_stat_dyn_vld_ls_up_1.err_info_stat.lv_ready fmy_stat_dyn_vld_ls_up_1.err_info_stat.lv_end_diag fmy_stat_dyn_vld_ls_up_1.err_info_stat.lv_cdn_diag fmy_stat_dyn_vld_ls_up_1.err_info_stat.err_sym fmy_stat_puc_vld_ls_up_1.ctr_abc fmy_stat_puc_vld_ls_up_1.ctr_end_diag fmy_stat_puc_vld_ls_up_1.err_info_stat.lv_err_mem fmy_stat_puc_vld_ls_up_1.err_info_stat.lv_ready fmy_stat_puc_vld_ls_up_1.err_info_stat.lv_end_diag fmy_stat_puc_vld_ls_up_1.err_info_stat.lv_cdn_diag fmy_stat_puc_vld_ls_up_1.err_info_stat.err_sym fmy_stat_obd_vld_lsh_up_1.ctr_abc fmy_stat_obd_vld_lsh_up_1.ctr_end_diag fmy_stat_obd_vld_lsh_up_1.err_info_stat.lv_err_mem fmy_stat_obd_vld_lsh_up_1.err_info_stat.lv_ready fmy_stat_obd_vld_lsh_up_1.err_info_stat.lv_end_diag fmy_stat_obd_vld_lsh_up_1.err_info_stat.lv_cdn_diag fmy_stat_obd_vld_lsh_up_1.err_info_stat.err_sym fmy_stat_chk_ls_down_1.ctr_abc fmy_stat_chk_ls_down_1.ctr_end_diag fmy_stat_chk_ls_down_1.err_info_stat.lv_err_mem fmy_stat_chk_ls_down_1.err_info_stat.lv_ready fmy_stat_chk_ls_down_1.err_info_stat.lv_end_diag fmy_stat_chk_ls_down_1.err_info_stat.lv_cdn_diag fmy_stat_chk_ls_down_1.err_info_stat.err_sym fmy_stat_shift_afl_lsl_up_1.ctr_abc fmy_stat_shift_afl_lsl_up_1.ctr_end_diag fmy_stat_shift_afl_lsl_up_1.err_info_stat.lv_err_mem fmy_stat_shift_afl_lsl_up_1.err_info_stat.lv_ready fmy_stat_shift_afl_lsl_up_1.err_info_stat.lv_end_diag fmy_stat_shift_afl_lsl_up_1.err_info_stat.lv_cdn_diag fmy_stat_shift_afl_lsl_up_1.err_info_stat.err_sym fmy_stat_shift_afr_lsl_up_1.ctr_abc fmy_stat_shift_afr_lsl_up_1.ctr_end_diag fmy_stat_shift_afr_lsl_up_1.err_info_stat.lv_err_mem fmy_stat_shift_afr_lsl_up_1.err_info_stat.lv_ready fmy_stat_shift_afr_lsl_up_1.err_info_stat.lv_end_diag fmy_stat_shift_afr_lsl_up_1.err_info_stat.lv_cdn_diag fmy_stat_shift_afr_lsl_up_1.err_info_stat.err_sym fmy_stat_oc_lsl_up_1.ctr_abc fmy_stat_oc_lsl_up_1.ctr_end_diag fmy_stat_oc_lsl_up_1.err_info_stat.lv_err_mem fmy_stat_oc_lsl_up_1.err_info_stat.lv_ready fmy_stat_oc_lsl_up_1.err_info_stat.lv_end_diag fmy_stat_oc_lsl_up_1.err_info_stat.lv_cdn_diag fmy_stat_oc_lsl_up_1.err_info_stat.err_sym fmy_stat_delta_i_lam_1.ctr_abc fmy_stat_delta_i_lam_1.ctr_end_diag fmy_stat_delta_i_lam_1.err_info_stat.lv_err_mem fmy_stat_delta_i_lam_1.err_info_stat.lv_ready fmy_stat_delta_i_lam_1.err_info_stat.lv_end_diag fmy_stat_delta_i_lam_1.err_info_stat.lv_cdn_diag fmy_stat_delta_i_lam_1.err_info_stat.err_sym fmy_stat_ofs_lsl_up_1.ctr_abc fmy_stat_ofs_lsl_up_1.ctr_end_diag fmy_stat_ofs_lsl_up_1.err_info_stat.lv_err_mem fmy_stat_ofs_lsl_up_1.err_info_stat.lv_ready fmy_stat_ofs_lsl_up_1.err_info_stat.lv_end_diag fmy_stat_ofs_lsl_up_1.err_info_stat.lv_cdn_diag fmy_stat_ofs_lsl_up_1.err_info_stat.err_sym fmy_stat_ttip_mes_lsh_up_1.ctr_abc fmy_stat_ttip_mes_lsh_up_1.ctr_end_diag fmy_stat_ttip_mes_lsh_up_1.err_info_stat.lv_err_mem fmy_stat_ttip_mes_lsh_up_1.err_info_stat.lv_ready fmy_stat_ttip_mes_lsh_up_1.err_info_stat.lv_end_diag fmy_stat_ttip_mes_lsh_up_1.err_info_stat.lv_cdn_diag fmy_stat_ttip_mes_lsh_up_1.err_info_stat.err_sym fmy_stat_ctl_lsl_up_1.ctr_abc fmy_stat_ctl_lsl_up_1.ctr_end_diag fmy_stat_ctl_lsl_up_1.err_info_stat.lv_err_mem fmy_stat_ctl_lsl_up_1.err_info_stat.lv_ready fmy_stat_ctl_lsl_up_1.err_info_stat.lv_end_diag fmy_stat_ctl_lsl_up_1.err_info_stat.lv_cdn_diag fmy_stat_ctl_lsl_up_1.err_info_stat.err_sym fmy_stat_chg_ls_down.ctr_abc fmy_stat_chg_ls_down.ctr_end_diag fmy_stat_chg_ls_down.err_info_stat.lv_err_mem fmy_stat_chg_ls_down.err_info_stat.lv_ready fmy_stat_chg_ls_down.err_info_stat.lv_end_diag fmy_stat_chg_ls_down.err_info_stat.lv_cdn_diag fmy_stat_chg_ls_down.err_info_stat.err_sym fmy_stat_scg_ls_down_2.ctr_abc fmy_stat_scg_ls_down_2.ctr_end_diag fmy_stat_scg_ls_down_2.err_info_stat.lv_err_mem fmy_stat_scg_ls_down_2.err_info_stat.lv_ready fmy_stat_scg_ls_down_2.err_info_stat.lv_end_diag fmy_stat_scg_ls_down_2.err_info_stat.lv_cdn_diag fmy_stat_scg_ls_down_2.err_info_stat.err_sym fmy_stat_scp_ls_down_2.ctr_abc fmy_stat_scp_ls_down_2.ctr_end_diag fmy_stat_scp_ls_down_2.err_info_stat.lv_err_mem fmy_stat_scp_ls_down_2.err_info_stat.lv_ready fmy_stat_scp_ls_down_2.err_info_stat.lv_end_diag fmy_stat_scp_ls_down_2.err_info_stat.lv_cdn_diag fmy_stat_scp_ls_down_2.err_info_stat.err_sym fmy_stat_oc_ls_down_2.ctr_abc fmy_stat_oc_ls_down_2.ctr_end_diag fmy_stat_oc_ls_down_2.err_info_stat.lv_err_mem fmy_stat_oc_ls_down_2.err_info_stat.lv_ready fmy_stat_oc_ls_down_2.err_info_stat.lv_end_diag fmy_stat_oc_ls_down_2.err_info_stat.lv_cdn_diag fmy_stat_oc_ls_down_2.err_info_stat.err_sym fmy_stat_puc_ls_down_2.ctr_abc fmy_stat_puc_ls_down_2.ctr_end_diag fmy_stat_puc_ls_down_2.err_info_stat.lv_err_mem fmy_stat_puc_ls_down_2.err_info_stat.lv_ready fmy_stat_puc_ls_down_2.err_info_stat.lv_end_diag fmy_stat_puc_ls_down_2.err_info_stat.lv_cdn_diag fmy_stat_puc_ls_down_2.err_info_stat.err_sym fmy_stat_fl_ls_down_2.ctr_abc fmy_stat_fl_ls_down_2.ctr_end_diag fmy_stat_fl_ls_down_2.err_info_stat.lv_err_mem fmy_stat_fl_ls_down_2.err_info_stat.lv_ready fmy_stat_fl_ls_down_2.err_info_stat.lv_end_diag fmy_stat_fl_ls_down_2.err_info_stat.lv_cdn_diag fmy_stat_fl_ls_down_2.err_info_stat.err_sym fmy_stat_lsl_up_if_2.ctr_abc fmy_stat_lsl_up_if_2.ctr_end_diag fmy_stat_lsl_up_if_2.err_info_stat.lv_err_mem fmy_stat_lsl_up_if_2.err_info_stat.lv_ready fmy_stat_lsl_up_if_2.err_info_stat.lv_end_diag fmy_stat_lsl_up_if_2.err_info_stat.lv_cdn_diag fmy_stat_lsl_up_if_2.err_info_stat.err_sym fmy_stat_el_lsl_up_2.ctr_abc fmy_stat_el_lsl_up_2.ctr_end_diag fmy_stat_el_lsl_up_2.err_info_stat.lv_err_mem fmy_stat_el_lsl_up_2.err_info_stat.lv_ready fmy_stat_el_lsl_up_2.err_info_stat.lv_end_diag fmy_stat_el_lsl_up_2.err_info_stat.lv_cdn_diag fmy_stat_el_lsl_up_2.err_info_stat.err_sym fmy_stat_lsh_up_2.ctr_abc fmy_stat_lsh_up_2.ctr_end_diag fmy_stat_lsh_up_2.err_info_stat.lv_err_mem fmy_stat_lsh_up_2.err_info_stat.lv_ready fmy_stat_lsh_up_2.err_info_stat.lv_end_diag fmy_stat_lsh_up_2.err_info_stat.lv_cdn_diag fmy_stat_lsh_up_2.err_info_stat.err_sym fmy_stat_lsh_down_2.ctr_abc fmy_stat_lsh_down_2.ctr_end_diag fmy_stat_lsh_down_2.err_info_stat.lv_err_mem fmy_stat_lsh_down_2.err_info_stat.lv_ready fmy_stat_lsh_down_2.err_info_stat.lv_end_diag fmy_stat_lsh_down_2.err_info_stat.lv_cdn_diag fmy_stat_lsh_down_2.err_info_stat.err_sym fmy_stat_vls_down_dif_2.ctr_abc fmy_stat_vls_down_dif_2.ctr_end_diag fmy_stat_vls_down_dif_2.err_info_stat.lv_err_mem fmy_stat_vls_down_dif_2.err_info_stat.lv_ready fmy_stat_vls_down_dif_2.err_info_stat.lv_end_diag fmy_stat_vls_down_dif_2.err_info_stat.lv_cdn_diag fmy_stat_vls_down_dif_2.err_info_stat.err_sym fmy_stat_lsh_lsl_up_2.ctr_abc fmy_stat_lsh_lsl_up_2.ctr_end_diag fmy_stat_lsh_lsl_up_2.err_info_stat.lv_err_mem fmy_stat_lsh_lsl_up_2.err_info_stat.lv_ready fmy_stat_lsh_lsl_up_2.err_info_stat.lv_end_diag fmy_stat_lsh_lsl_up_2.err_info_stat.lv_cdn_diag fmy_stat_lsh_lsl_up_2.err_info_stat.err_sym fmy_stat_air_lsl_up_2.ctr_abc fmy_stat_air_lsl_up_2.ctr_end_diag fmy_stat_air_lsl_up_2.err_info_stat.lv_err_mem fmy_stat_air_lsl_up_2.err_info_stat.lv_ready fmy_stat_air_lsl_up_2.err_info_stat.lv_end_diag fmy_stat_air_lsl_up_2.err_info_stat.lv_cdn_diag fmy_stat_air_lsl_up_2.err_info_stat.err_sym fmy_stat_pue_ls_down_2.ctr_abc fmy_stat_pue_ls_down_2.ctr_end_diag fmy_stat_pue_ls_down_2.err_info_stat.lv_err_mem fmy_stat_pue_ls_down_2.err_info_stat.lv_ready fmy_stat_pue_ls_down_2.err_info_stat.lv_end_diag fmy_stat_pue_ls_down_2.err_info_stat.lv_cdn_diag fmy_stat_pue_ls_down_2.err_info_stat.err_sym fmy_stat_swt_ls_down_2.ctr_abc fmy_stat_swt_ls_down_2.ctr_end_diag fmy_stat_swt_ls_down_2.err_info_stat.lv_err_mem fmy_stat_swt_ls_down_2.err_info_stat.lv_ready fmy_stat_swt_ls_down_2.err_info_stat.lv_end_diag fmy_stat_swt_ls_down_2.err_info_stat.lv_cdn_diag fmy_stat_swt_ls_down_2.err_info_stat.err_sym fmy_stat_obd_lsh_down_2.ctr_abc fmy_stat_obd_lsh_down_2.ctr_end_diag fmy_stat_obd_lsh_down_2.err_info_stat.lv_err_mem fmy_stat_obd_lsh_down_2.err_info_stat.lv_ready fmy_stat_obd_lsh_down_2.err_info_stat.lv_end_diag fmy_stat_obd_lsh_down_2.err_info_stat.lv_cdn_diag fmy_stat_obd_lsh_down_2.err_info_stat.err_sym fmy_stat_dyn_vld_ls_up_2.ctr_abc fmy_stat_dyn_vld_ls_up_2.ctr_end_diag fmy_stat_dyn_vld_ls_up_2.err_info_stat.lv_err_mem fmy_stat_dyn_vld_ls_up_2.err_info_stat.lv_ready fmy_stat_dyn_vld_ls_up_2.err_info_stat.lv_end_diag fmy_stat_dyn_vld_ls_up_2.err_info_stat.lv_cdn_diag fmy_stat_dyn_vld_ls_up_2.err_info_stat.err_sym fmy_stat_puc_vld_ls_up_2.ctr_abc fmy_stat_puc_vld_ls_up_2.ctr_end_diag fmy_stat_puc_vld_ls_up_2.err_info_stat.lv_err_mem fmy_stat_puc_vld_ls_up_2.err_info_stat.lv_ready fmy_stat_puc_vld_ls_up_2.err_info_stat.lv_end_diag fmy_stat_puc_vld_ls_up_2.err_info_stat.lv_cdn_diag fmy_stat_puc_vld_ls_up_2.err_info_stat.err_sym fmy_stat_obd_vld_lsh_up_2.ctr_abc fmy_stat_obd_vld_lsh_up_2.ctr_end_diag fmy_stat_obd_vld_lsh_up_2.err_info_stat.lv_err_mem fmy_stat_obd_vld_lsh_up_2.err_info_stat.lv_ready fmy_stat_obd_vld_lsh_up_2.err_info_stat.lv_end_diag fmy_stat_obd_vld_lsh_up_2.err_info_stat.lv_cdn_diag fmy_stat_obd_vld_lsh_up_2.err_info_stat.err_sym fmy_stat_chk_ls_down_2.ctr_abc fmy_stat_chk_ls_down_2.ctr_end_diag fmy_stat_chk_ls_down_2.err_info_stat.lv_err_mem fmy_stat_chk_ls_down_2.err_info_stat.lv_ready fmy_stat_chk_ls_down_2.err_info_stat.lv_end_diag fmy_stat_chk_ls_down_2.err_info_stat.lv_cdn_diag fmy_stat_chk_ls_down_2.err_info_stat.err_sym fmy_stat_shift_afl_lsl_up_2.ctr_abc fmy_stat_shift_afl_lsl_up_2.ctr_end_diag fmy_stat_shift_afl_lsl_up_2.err_info_stat.lv_err_mem fmy_stat_shift_afl_lsl_up_2.err_info_stat.lv_ready fmy_stat_shift_afl_lsl_up_2.err_info_stat.lv_end_diag fmy_stat_shift_afl_lsl_up_2.err_info_stat.lv_cdn_diag fmy_stat_shift_afl_lsl_up_2.err_info_stat.err_sym fmy_stat_shift_afr_lsl_up_2.ctr_abc fmy_stat_shift_afr_lsl_up_2.ctr_end_diag fmy_stat_shift_afr_lsl_up_2.err_info_stat.lv_err_mem fmy_stat_shift_afr_lsl_up_2.err_info_stat.lv_ready fmy_stat_shift_afr_lsl_up_2.err_info_stat.lv_end_diag fmy_stat_shift_afr_lsl_up_2.err_info_stat.lv_cdn_diag fmy_stat_shift_afr_lsl_up_2.err_info_stat.err_sym fmy_stat_oc_lsl_up_2.ctr_abc fmy_stat_oc_lsl_up_2.ctr_end_diag fmy_stat_oc_lsl_up_2.err_info_stat.lv_err_mem fmy_stat_oc_lsl_up_2.err_info_stat.lv_ready fmy_stat_oc_lsl_up_2.err_info_stat.lv_end_diag fmy_stat_oc_lsl_up_2.err_info_stat.lv_cdn_diag fmy_stat_oc_lsl_up_2.err_info_stat.err_sym fmy_stat_delta_i_lam_2.ctr_abc fmy_stat_delta_i_lam_2.ctr_end_diag fmy_stat_delta_i_lam_2.err_info_stat.lv_err_mem fmy_stat_delta_i_lam_2.err_info_stat.lv_ready fmy_stat_delta_i_lam_2.err_info_stat.lv_end_diag fmy_stat_delta_i_lam_2.err_info_stat.lv_cdn_diag fmy_stat_delta_i_lam_2.err_info_stat.err_sym fmy_stat_ofs_lsl_up_2.ctr_abc fmy_stat_ofs_lsl_up_2.ctr_end_diag fmy_stat_ofs_lsl_up_2.err_info_stat.lv_err_mem fmy_stat_ofs_lsl_up_2.err_info_stat.lv_ready fmy_stat_ofs_lsl_up_2.err_info_stat.lv_end_diag fmy_stat_ofs_lsl_up_2.err_info_stat.lv_cdn_diag fmy_stat_ofs_lsl_up_2.err_info_stat.err_sym fmy_stat_ttip_mes_lsh_up_2.ctr_abc fmy_stat_ttip_mes_lsh_up_2.ctr_end_diag fmy_stat_ttip_mes_lsh_up_2.err_info_stat.lv_err_mem fmy_stat_ttip_mes_lsh_up_2.err_info_stat.lv_ready fmy_stat_ttip_mes_lsh_up_2.err_info_stat.lv_end_diag fmy_stat_ttip_mes_lsh_up_2.err_info_stat.lv_cdn_diag fmy_stat_ttip_mes_lsh_up_2.err_info_stat.err_sym fmy_stat_ctl_lsl_up_2.ctr_abc fmy_stat_ctl_lsl_up_2.ctr_end_diag fmy_stat_ctl_lsl_up_2.err_info_stat.lv_err_mem fmy_stat_ctl_lsl_up_2.err_info_stat.lv_ready fmy_stat_ctl_lsl_up_2.err_info_stat.lv_end_diag fmy_stat_ctl_lsl_up_2.err_info_stat.lv_cdn_diag fmy_stat_ctl_lsl_up_2.err_info_stat.err_sym fmy_stat_chg_ls_up.ctr_abc fmy_stat_chg_ls_up.ctr_end_diag fmy_stat_chg_ls_up.err_info_stat.lv_err_mem fmy_stat_chg_ls_up.err_info_stat.lv_ready fmy_stat_chg_ls_up.err_info_stat.lv_end_diag fmy_stat_chg_ls_up.err_info_stat.lv_cdn_diag fmy_stat_chg_ls_up.err_info_stat.err_sym fmy_stat_alter_com.err_info_stat.lv_err_mem fmy_stat_alter_com.err_info_stat.lv_ready fmy_stat_alter_com.err_info_stat.lv_end_diag fmy_stat_alter_com.err_info_stat.lv_cdn_diag fmy_stat_alter_com.err_info_stat.err_sym fmy_stat_cwp_com.err_info_stat.lv_err_mem fmy_stat_cwp_com.err_info_stat.lv_ready fmy_stat_cwp_com.err_info_stat.lv_end_diag fmy_stat_cwp_com.err_info_stat.lv_cdn_diag fmy_stat_cwp_com.err_info_stat.err_sym fmy_stat_qoil_com.err_info_stat.lv_err_mem fmy_stat_qoil_com.err_info_stat.lv_ready fmy_stat_qoil_com.err_info_stat.lv_end_diag fmy_stat_qoil_com.err_info_stat.lv_cdn_diag fmy_stat_qoil_com.err_info_stat.err_sym fmy_stat_sens_bat_smt_com.err_info_stat.lv_err_mem fmy_stat_sens_bat_smt_com.err_info_stat.lv_ready fmy_stat_sens_bat_smt_com.err_info_stat.lv_end_diag fmy_stat_sens_bat_smt_com.err_info_stat.lv_cdn_diag fmy_stat_sens_bat_smt_com.err_info_stat.err_sym fmy_stat_ecraspwm_fb.ctr_abc fmy_stat_ecraspwm_fb.ctr_end_diag fmy_stat_ecraspwm_fb.err_info_stat.lv_err_mem fmy_stat_ecraspwm_fb.err_info_stat.lv_ready fmy_stat_ecraspwm_fb.err_info_stat.lv_end_diag fmy_stat_ecraspwm_fb.err_info_stat.lv_cdn_diag fmy_stat_ecraspwm_fb.err_info_stat.err_sym fmy_stat_ecras_el.ctr_abc fmy_stat_ecras_el.ctr_end_diag fmy_stat_ecras_el.err_info_stat.lv_err_mem fmy_stat_ecras_el.err_info_stat.lv_ready fmy_stat_ecras_el.err_info_stat.lv_end_diag fmy_stat_ecras_el.err_info_stat.lv_cdn_diag fmy_stat_ecras_el.err_info_stat.err_sym fmy_stat_ecras_up_fb.ctr_abc fmy_stat_ecras_up_fb.ctr_end_diag fmy_stat_ecras_up_fb.err_info_stat.lv_err_mem fmy_stat_ecras_up_fb.err_info_stat.lv_ready fmy_stat_ecras_up_fb.err_info_stat.lv_end_diag fmy_stat_ecras_up_fb.err_info_stat.lv_cdn_diag fmy_stat_ecras_up_fb.err_info_stat.err_sym fmy_stat_ecras_down_fb.ctr_abc fmy_stat_ecras_down_fb.ctr_end_diag fmy_stat_ecras_down_fb.err_info_stat.lv_err_mem fmy_stat_ecras_down_fb.err_info_stat.lv_ready fmy_stat_ecras_down_fb.err_info_stat.lv_end_diag fmy_stat_ecras_down_fb.err_info_stat.lv_cdn_diag fmy_stat_ecras_down_fb.err_info_stat.err_sym fmy_stat_warm_rst.ctr_abc fmy_stat_warm_rst.ctr_end_diag fmy_stat_warm_rst.err_info_stat.lv_err_mem fmy_stat_warm_rst.err_info_stat.lv_ready fmy_stat_warm_rst.err_info_stat.lv_end_diag fmy_stat_warm_rst.err_info_stat.lv_cdn_diag fmy_stat_warm_rst.err_info_stat.err_sym fmy_stat_acr_ad.ctr_abc fmy_stat_acr_ad.ctr_end_diag fmy_stat_acr_ad.err_info_stat.lv_err_mem fmy_stat_acr_ad.err_info_stat.lv_ready fmy_stat_acr_ad.err_info_stat.lv_end_diag fmy_stat_acr_ad.err_info_stat.lv_cdn_diag fmy_stat_acr_ad.err_info_stat.err_sym fmy_stat_sens_acr.ctr_abc fmy_stat_sens_acr.ctr_end_diag fmy_stat_sens_acr.err_info_stat.lv_err_mem fmy_stat_sens_acr.err_info_stat.lv_ready fmy_stat_sens_acr.err_info_stat.lv_end_diag fmy_stat_sens_acr.err_info_stat.lv_cdn_diag fmy_stat_sens_acr.err_info_stat.err_sym fmy_stat_acr_ctl.ctr_abc fmy_stat_acr_ctl.ctr_end_diag fmy_stat_acr_ctl.err_info_stat.lv_err_mem fmy_stat_acr_ctl.err_info_stat.lv_ready fmy_stat_acr_ctl.err_info_stat.lv_end_diag fmy_stat_acr_ctl.err_info_stat.lv_cdn_diag fmy_stat_acr_ctl.err_info_stat.err_sym /end OUT_MEASUREMENT
/end FUNCTION
/end MODULE
/end PROJECT
