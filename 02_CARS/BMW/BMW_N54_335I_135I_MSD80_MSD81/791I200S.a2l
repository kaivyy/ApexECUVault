ASAP2_VERSION 1 41
/begin PROJECT MSD85 "Spray Guided DI-System with Piezo Injectors for 8-Cylinder"
/begin HEADER "_default_HeaderComment" PROJECT_NO _91 /end HEADER
/begin MODULE _default_ModuleName "_default_ModuleLongIdentifier"
/begin MOD_COMMON "_default_ModCommonComment" DEPOSIT ABSOLUTE BYTE_ORDER MSB_LAST ALIGNMENT_BYTE 1 ALIGNMENT_WORD 2 ALIGNMENT_LONG 2 ALIGNMENT_FLOAT32_IEEE 2 ALIGNMENT_FLOAT64_IEEE 4 /end MOD_COMMON
/begin MEASUREMENT Ba_ist "Istbetriebsart" UBYTE _CNV_S_5_Def_ba_gdi_565_CM 1 100. 0. 8. DISPLAY_IDENTIFIER BA_IST ECU_ADDRESS 0xd000d9d5 BIT_MASK 0xFF /end MEASUREMENT
/begin MEASUREMENT Ba_ist_sw "Ba_ist als signed word" SWORD _CNV_R_R_Def_dez_sl_551_CM 1 100. -32768. 32767. DISPLAY_IDENTIFIER BA_IST_SW ECU_ADDRESS 0xd000d9ea FORMAT "%5.0" /end MEASUREMENT
/begin MEASUREMENT Ba_prio "Priorisierte Betriebsart" UBYTE _CNV_S_5_Def_ba_gdi_565_CM 1 100. 0. 8. DISPLAY_IDENTIFIER BA_PRIO ECU_ADDRESS 0xd000da2a BIT_MASK 0xFF /end MEASUREMENT
/begin MEASUREMENT Ba_prio_sw "Ba_prio als signed word" SWORD _CNV_R_R_Def_dez_sl_551_CM 1 100. -32768. 32767. DISPLAY_IDENTIFIER BA_PRIO_SW ECU_ADDRESS 0xd000d9ec FORMAT "%5.0" /end MEASUREMENT
/begin MEASUREMENT Ba_prio_tra "aus zweiter Prio gewonnenes Priosignal" UBYTE _CNV_S_5_Def_ba_gdi_565_CM 1 100. 0. 8. DISPLAY_IDENTIFIER BA_PRIO_TRA ECU_ADDRESS 0xd000da2b BIT_MASK 0xFF /end MEASUREMENT
/begin MEASUREMENT Ba_soll "Sollbetriebsart" UBYTE _CNV_S_5_Def_ba_gdi_565_CM 1 100. 0. 8. DISPLAY_IDENTIFIER BA_SOLL ECU_ADDRESS 0xd000d9d8 BIT_MASK 0xFF /end MEASUREMENT
/begin MEASUREMENT Ba_soll_sw "Ba_soll als signed word" SWORD _CNV_R_R_Def_dez_sl_551_CM 1 100. -32768. 32767. DISPLAY_IDENTIFIER BA_SOLL_SW ECU_ADDRESS 0xd000d9ee FORMAT "%5.0" /end MEASUREMENT
/begin MEASUREMENT Ba_subist "Istbetriebsart" UBYTE _CNV_S_22_Def_ba_gdi_567_CM 1 100. 0. 21. DISPLAY_IDENTIFIER BA_SUBIST ECU_ADDRESS 0xd000d9d6 BIT_MASK 0xFF /end MEASUREMENT
/begin MEASUREMENT Ba_subist_sw "Ba_subist als signed word" SWORD _CNV_R_R_Def_dez_sl_551_CM 1 100. -32768. 32767. DISPLAY_IDENTIFIER BA_SUBIST_SW ECU_ADDRESS 0xd000da00 FORMAT "%5.0" /end MEASUREMENT
/begin MEASUREMENT Ba_subprio "Priorisierte Unterbetriebsart" UBYTE _CNV_S_22_Def_ba_gdi_567_CM 1 100. 0. 21. DISPLAY_IDENTIFIER BA_SUBPRIO ECU_ADDRESS 0xd000da2c BIT_MASK 0xFF /end MEASUREMENT
/begin MEASUREMENT Ba_subprio_sw "Ba_subprio als signed word" SWORD _CNV_R_R_Def_dez_sl_551_CM 1 100. -32768. 32767. DISPLAY_IDENTIFIER BA_SUBPRIO_SW ECU_ADDRESS 0xd000d9fe FORMAT "%5.0" /end MEASUREMENT
/begin MEASUREMENT Ba_subsoll "Sollbetriebsart" UBYTE _CNV_S_22_Def_ba_gdi_567_CM 1 100. 0. 21. DISPLAY_IDENTIFIER BA_SUBSOLL ECU_ADDRESS 0xd000d9d7 BIT_MASK 0xFF /end MEASUREMENT
/begin MEASUREMENT Ba_subsoll_sw "Ba_subsoll als signed word" SWORD _CNV_R_R_Def_dez_sl_551_CM 1 100. -32768. 32767. DISPLAY_IDENTIFIER BA_SUBSOLL_SW ECU_ADDRESS 0xd000da02 FORMAT "%5.0" /end MEASUREMENT
/begin MEASUREMENT Ba_vb_nl "Betriebsartverbot aus Notlaufmanager" UBYTE _CNV_S_7_Def_bvgdi_568_CM 1 100. 0. 6. DISPLAY_IDENTIFIER BA_VB_NL ECU_ADDRESS 0xd000e0bc BIT_MASK 0xFF /end MEASUREMENT
/begin MEASUREMENT Ba_wu_nl "Betriebsartwunsch aus Notlaufmanager" UWORD _CNV_R_R_Def_dez_sl_551_CM 1 100. 0. 65535. DISPLAY_IDENTIFIER BA_WU_NL ECU_ADDRESS 0xd000e0b6 FORMAT "%5.0" /end MEASUREMENT
/begin MEASUREMENT Baprio_HO "Anforderung von applikation" ULONG _CNV_R_R_Def_dez_sl_551_CM 1 100. 0. 4294967295. DISPLAY_IDENTIFIER BAPRIO_HO ECU_ADDRESS 0xd000da32 FORMAT "%7.0" /end MEASUREMENT
/begin MEASUREMENT Baprio_HSO "Anforderung von applikation" ULONG _CNV_R_R_Def_dez_sl_551_CM 1 100. 0. 4294967295. DISPLAY_IDENTIFIER BAPRIO_HSO ECU_ADDRESS 0xd000da36 FORMAT "%7.0" /end MEASUREMENT
/begin MEASUREMENT Baprio_SO "Anforderung von applikation" ULONG _CNV_R_R_Def_dez_sl_551_CM 1 100. 0. 4294967295. DISPLAY_IDENTIFIER BAPRIO_SO ECU_ADDRESS 0xd000da3a FORMAT "%7.0" /end MEASUREMENT
/begin MEASUREMENT Baprio_appl "Anforderung von applikation" ULONG _CNV_R_R_Def_dez_sl_551_CM 1 100. 0. 4294967295. DISPLAY_IDENTIFIER BAPRIO_APPL ECU_ADDRESS 0xd000da3e FORMAT "%7.0" /end MEASUREMENT
/begin MEASUREMENT Baprio_aussetzer "Anforderung von Verbrennungsregelung" ULONG _CNV_R_R_Def_dez_sl_551_CM 1 100. 0. 4294967295. DISPLAY_IDENTIFIER BAPRIO_AUSSETZER ECU_ADDRESS 0xd000da42 FORMAT "%7.0" /end MEASUREMENT
/begin MEASUREMENT Baprio_diagnose "Anforderrung von Katdiagnose" ULONG _CNV_R_R_Def_dez_sl_551_CM 1 100. 0. 4294967295. DISPLAY_IDENTIFIER BAPRIO_DIAGNOSE ECU_ADDRESS 0xd000da46 FORMAT "%7.0" /end MEASUREMENT
/begin MEASUREMENT Baprio_dinotl "Anforderrung von DI Notlauf" ULONG _CNV_R_R_Def_dez_sl_551_CM 1 100. 0. 4294967295. DISPLAY_IDENTIFIER BAPRIO_DINOTL ECU_ADDRESS 0xd000da4a FORMAT "%7.0" /end MEASUREMENT
/begin MEASUREMENT Baprio_entschw "Eingriff für Entschwefelung" ULONG _CNV_R_R_Def_dez_sl_551_CM 1 100. 0. 4294967295. DISPLAY_IDENTIFIER BAPRIO_ENTSCHW ECU_ADDRESS 0xd000da4e FORMAT "%7.0" /end MEASUREMENT
/begin MEASUREMENT Baprio_gl "Anforderung von Gleichstellung" ULONG _CNV_R_R_Def_dez_sl_551_CM 1 100. 0. 4294967295. DISPLAY_IDENTIFIER BAPRIO_GL ECU_ADDRESS 0xd000da52 FORMAT "%7.0" /end MEASUREMENT
/begin MEASUREMENT Baprio_haeums "Anforderung aus hängender Umschaltung" ULONG _CNV_R_R_Def_dez_sl_551_CM 1 100. 0. 4294967295. DISPLAY_IDENTIFIER BAPRIO_HAEUMS ECU_ADDRESS 0xd000da56 FORMAT "%7.0" /end MEASUREMENT
/begin MEASUREMENT Baprio_heiz "Anforderung von Heizleistungseingriff" ULONG _CNV_R_R_Def_dez_sl_551_CM 1 100. 0. 4294967295. DISPLAY_IDENTIFIER BAPRIO_HEIZ ECU_ADDRESS 0xd000da5a FORMAT "%7.0" /end MEASUREMENT
/begin MEASUREMENT Baprio_katman1 "Eingriff von Momentenüberwachung" ULONG _CNV_R_R_Def_dez_sl_551_CM 1 100. 0. 4294967295. DISPLAY_IDENTIFIER BAPRIO_KATMAN1 ECU_ADDRESS 0xd000da5e FORMAT "%7.0" /end MEASUREMENT
/begin MEASUREMENT Baprio_katman2 "Eingriff von Momentenüberwachung" ULONG _CNV_R_R_Def_dez_sl_551_CM 1 100. 0. 4294967295. DISPLAY_IDENTIFIER BAPRIO_KATMAN2 ECU_ADDRESS 0xd000da62 FORMAT "%7.0" /end MEASUREMENT
/begin MEASUREMENT Baprio_katreg "Anforderung von applikation" ULONG _CNV_R_R_Def_dez_sl_551_CM 1 100. 0. 4294967295. DISPLAY_IDENTIFIER BAPRIO_KATREG ECU_ADDRESS 0xd000da66 FORMAT "%7.0" /end MEASUREMENT
/begin MEASUREMENT Baprio_komfort "Priobetriebsart Komfort" ULONG _CNV_R_R_Def_dez_sl_551_CM 1 100. 0. 4294967295. DISPLAY_IDENTIFIER BAPRIO_KOMFORT ECU_ADDRESS 0xd000da6a FORMAT "%7.0" /end MEASUREMENT
/begin MEASUREMENT Baprio_mdi "Eingriff von Momentenüberwachung" ULONG _CNV_R_R_Def_dez_sl_551_CM 1 100. 0. 4294967295. DISPLAY_IDENTIFIER BAPRIO_MDI ECU_ADDRESS 0xd000da6e FORMAT "%7.0" /end MEASUREMENT
/begin MEASUREMENT Baprio_motorstopp "Anforderrung von Motorstop MSA" ULONG _CNV_R_R_Def_dez_sl_551_CM 1 100. 0. 4294967295. DISPLAY_IDENTIFIER BAPRIO_MOTORSTOPP ECU_ADDRESS 0xd000da72 FORMAT "%7.0" /end MEASUREMENT
/begin MEASUREMENT Baprio_pruef "Anforderung von Sensorpruefung" ULONG _CNV_R_R_Def_dez_sl_551_CM 1 100. 0. 4294967295. DISPLAY_IDENTIFIER BAPRIO_PRUEF ECU_ADDRESS 0xd000da76 FORMAT "%7.0" /end MEASUREMENT
/begin MEASUREMENT Baprio_siko "Anforderung von Sicherheitskonzept" ULONG _CNV_R_R_Def_dez_sl_551_CM 1 100. 0. 4294967295. DISPLAY_IDENTIFIER BAPRIO_SIKO ECU_ADDRESS 0xd000da7a FORMAT "%7.0" /end MEASUREMENT
/begin MEASUREMENT Baprio_stand "Standartanforderung" ULONG _CNV_R_R_Def_dez_sl_551_CM 1 100. 0. 4294967295. DISPLAY_IDENTIFIER BAPRIO_STAND ECU_ADDRESS 0xd000da7e FORMAT "%7.0" /end MEASUREMENT
/begin MEASUREMENT Baprio_start "Anforderung von Start" ULONG _CNV_R_R_Def_dez_sl_551_CM 1 100. 0. 4294967295. DISPLAY_IDENTIFIER BAPRIO_START ECU_ADDRESS 0xd000da82 FORMAT "%7.0" /end MEASUREMENT
/begin MEASUREMENT Baprio_tester "Anforderung von Tester" ULONG _CNV_R_R_Def_dez_sl_551_CM 1 100. 0. 4294967295. DISPLAY_IDENTIFIER BAPRIO_TESTER ECU_ADDRESS 0xd000da86 FORMAT "%7.0" /end MEASUREMENT
/begin MEASUREMENT Baprio_tev "Anforderung von Tankentlüftung" ULONG _CNV_R_R_Def_dez_sl_551_CM 1 100. 0. 4294967295. DISPLAY_IDENTIFIER BAPRIO_TEV ECU_ADDRESS 0xd000da8a FORMAT "%7.0" /end MEASUREMENT
/begin MEASUREMENT Baprio_ueh "Anforderderung von Bauteilschutz Uberhitzung" ULONG _CNV_R_R_Def_dez_sl_551_CM 1 100. 0. 4294967295. DISPLAY_IDENTIFIER BAPRIO_UEH ECU_ADDRESS 0xd000da8e FORMAT "%7.0" /end MEASUREMENT
/begin MEASUREMENT Baprio_uesp "Anforderung  von Überspülen" ULONG _CNV_R_R_Def_dez_sl_551_CM 1 100. 0. 4294967295. DISPLAY_IDENTIFIER BAPRIO_UESP ECU_ADDRESS 0xd000da92 FORMAT "%7.0" /end MEASUREMENT
/begin MEASUREMENT Baprio_vl "Anforderung von Volllast" ULONG _CNV_R_R_Def_dez_sl_551_CM 1 100. 0. 4294967295. DISPLAY_IDENTIFIER BAPRIO_VL ECU_ADDRESS 0xd000da96 FORMAT "%7.0" /end MEASUREMENT
/begin MEASUREMENT Baprio_zwgemad "Anforderung  von Zwangsgemischadaption" ULONG _CNV_R_R_Def_dez_sl_551_CM 1 100. 0. 4294967295. DISPLAY_IDENTIFIER BAPRIO_ZWGEMAD ECU_ADDRESS 0xd000da9a FORMAT "%7.0" /end MEASUREMENT
/begin MEASUREMENT Baums_moni "Monitoring der BA Umschaltung für Komfort" UBYTE _CNV_R_R_Def_dez_sl_551_CM 1 100. 0. 255. DISPLAY_IDENTIFIER BAUMS_MONI ECU_ADDRESS 0xd000db58 FORMAT "%3.0" /end MEASUREMENT
/begin MEASUREMENT Bav_appl "Verbot von Applikation" UBYTE _CNV_S_7_Def_bvgdi_568_CM 1 100. 0. 6. DISPLAY_IDENTIFIER BAV_APPL ECU_ADDRESS 0xd000db59 BIT_MASK 0xFF /end MEASUREMENT
/begin MEASUREMENT Bav_dinotl "Verbot von Notlauf DI" UBYTE _CNV_S_7_Def_bvgdi_568_CM 1 100. 0. 6. DISPLAY_IDENTIFIER BAV_DINOTL ECU_ADDRESS 0xd000db5a BIT_MASK 0xFF /end MEASUREMENT
/begin MEASUREMENT Bav_mdi "Verbot von Momentenüberwachung" UBYTE _CNV_S_7_Def_bvgdi_568_CM 1 100. 0. 6. DISPLAY_IDENTIFIER BAV_MDI ECU_ADDRESS 0xd000db5b BIT_MASK 0xFF /end MEASUREMENT
/begin MEASUREMENT Bav_prio "Priorisiertes Verbot" UBYTE _CNV_S_7_Def_bvgdi_568_CM 1 100. 0. 6. DISPLAY_IDENTIFIER BAV_PRIO ECU_ADDRESS 0xd000db5c BIT_MASK 0xFF /end MEASUREMENT
/begin MEASUREMENT Bav_prio_v "Priorisiertes Verbot Vorab" UBYTE _CNV_S_7_Def_bvgdi_568_CM 1 100. 0. 6. DISPLAY_IDENTIFIER BAV_PRIO_V ECU_ADDRESS 0xd000db5d BIT_MASK 0xFF /end MEASUREMENT
/begin MEASUREMENT Bav_ueh "Verbot von Bauteilschutz Überhitzung" UBYTE _CNV_S_7_Def_bvgdi_568_CM 1 100. 0. 6. DISPLAY_IDENTIFIER BAV_UEH ECU_ADDRESS 0xd000db5e BIT_MASK 0xFF /end MEASUREMENT
/begin MEASUREMENT Baw_appl "Gesamtwunsch aus Applikation" UWORD _CNV_R_R_Def_dez_sl_551_CM 1 100. 0. 65535. DISPLAY_IDENTIFIER BAW_APPL ECU_ADDRESS 0xd000db1e FORMAT "%5.0" /end MEASUREMENT
/begin MEASUREMENT Baw_aussetzer "Gesamtwunsch aus Verbrennungsregelung" UWORD _CNV_R_R_Def_dez_sl_551_CM 1 100. 0. 65535. DISPLAY_IDENTIFIER BAW_AUSSETZER ECU_ADDRESS 0xd000db20 FORMAT "%5.0" /end MEASUREMENT
/begin MEASUREMENT Baw_bronze "Betriebsartwunsch Bronze" ULONG _CNV_R_R_Def_dez_sl_551_CM 1 100. 0. 4294967295. DISPLAY_IDENTIFIER BAW_BRONZE ECU_ADDRESS 0xd000da9e FORMAT "%7.0" /end MEASUREMENT
/begin MEASUREMENT Baw_diagnose "Anforderung für Katdiagnose" UWORD _CNV_R_R_Def_dez_sl_551_CM 1 100. 0. 65535. DISPLAY_IDENTIFIER BAW_DIAGNOSE ECU_ADDRESS 0xd000db22 FORMAT "%5.0" /end MEASUREMENT
/begin MEASUREMENT Baw_dinotl "Gesamtwunsch von DI Notlauf" UWORD _CNV_R_R_Def_dez_sl_551_CM 1 100. 0. 65535. DISPLAY_IDENTIFIER BAW_DINOTL ECU_ADDRESS 0xd000db24 FORMAT "%5.0" /end MEASUREMENT
/begin MEASUREMENT Baw_entschw "Anforderung für Entschwefelung" UWORD _CNV_R_R_Def_dez_sl_551_CM 1 100. 0. 65535. DISPLAY_IDENTIFIER BAW_ENTSCHW ECU_ADDRESS 0xd000db26 FORMAT "%5.0" /end MEASUREMENT
/begin MEASUREMENT Baw_gesamt "Gesamtanforderung aus erster Priorisierung" ULONG _CNV_R_R_Def_dez_sl_551_CM 1 100. 0. 4294967295. DISPLAY_IDENTIFIER BAW_GESAMT ECU_ADDRESS 0xd000daa2 FORMAT "%7.0" /end MEASUREMENT
/begin MEASUREMENT Baw_gl "Gesamtwunsch aus Gleichstellung" UWORD _CNV_R_R_Def_dez_sl_551_CM 1 100. 0. 65535. DISPLAY_IDENTIFIER BAW_GL ECU_ADDRESS 0xd000db28 FORMAT "%5.0" /end MEASUREMENT
/begin MEASUREMENT Baw_gold "Betriebsartwunsch Gold" ULONG _CNV_R_R_Def_dez_sl_551_CM 1 100. 0. 4294967295. DISPLAY_IDENTIFIER BAW_GOLD ECU_ADDRESS 0xd000daa6 FORMAT "%7.0" /end MEASUREMENT
/begin MEASUREMENT Baw_haeums "Wunsch aus hängender Umschaltung" UWORD _CNV_R_R_Def_dez_sl_551_CM 1 100. 0. 65535. DISPLAY_IDENTIFIER BAW_HAEUMS ECU_ADDRESS 0xd000db2a FORMAT "%5.0" /end MEASUREMENT
/begin MEASUREMENT Baw_heiz "Gesamtwunsch aus Heizleistungseingriiff" UWORD _CNV_R_R_Def_dez_sl_551_CM 1 100. 0. 65535. DISPLAY_IDENTIFIER BAW_HEIZ ECU_ADDRESS 0xd000db2c FORMAT "%5.0" /end MEASUREMENT
/begin MEASUREMENT Baw_ist "" UWORD _CNV_R_R_Def_dez_sl_551_CM 1 100. 0. 65535. DISPLAY_IDENTIFIER BAW_IST ECU_ADDRESS 0xd000d9de FORMAT "%5.0" /end MEASUREMENT
/begin MEASUREMENT Baw_katreg "Gesamtwunsch aus Kat Regeration" UWORD _CNV_R_R_Def_dez_sl_551_CM 1 100. 0. 65535. DISPLAY_IDENTIFIER BAW_KATREG ECU_ADDRESS 0xd000db2e FORMAT "%5.0" /end MEASUREMENT
/begin MEASUREMENT Baw_komfort "Betriebsartwunsch Komfort" UWORD _CNV_R_R_Def_dez_sl_551_CM 1 100. 0. 65535. DISPLAY_IDENTIFIER BAW_KOMFORT ECU_ADDRESS 0xd000db30 FORMAT "%5.0" /end MEASUREMENT
/begin MEASUREMENT Baw_mdi "Gesamtwunsch aus Momentenüberwachung" UWORD _CNV_R_R_Def_dez_sl_551_CM 1 100. 0. 65535. DISPLAY_IDENTIFIER BAW_MDI ECU_ADDRESS 0xd000db32 FORMAT "%5.0" /end MEASUREMENT
/begin MEASUREMENT Baw_motorstopp "Anforderung für MSA Stop" UWORD _CNV_R_R_Def_dez_sl_551_CM 1 100. 0. 65535. DISPLAY_IDENTIFIER BAW_MOTORSTOPP ECU_ADDRESS 0xd000db34 FORMAT "%5.0" /end MEASUREMENT
/begin MEASUREMENT Baw_prio "Gesamte Anforderung aus Priorisierung" UWORD _CNV_R_R_Def_dez_sl_551_CM 1 100. 0. 65535. DISPLAY_IDENTIFIER BAW_PRIO ECU_ADDRESS 0xd000da28 FORMAT "%5.0" /end MEASUREMENT
/begin MEASUREMENT Baw_prionotl "Wunsch durch Notlauf" UWORD _CNV_R_R_Def_dez_sl_551_CM 1 100. 0. 65535. DISPLAY_IDENTIFIER BAW_PRIONOTL ECU_ADDRESS 0xd000db36 FORMAT "%5.0" /end MEASUREMENT
/begin MEASUREMENT Baw_pruef "Gesamtanforderung aus Sensorprüfung" UWORD _CNV_R_R_Def_dez_sl_551_CM 1 100. 0. 65535. DISPLAY_IDENTIFIER BAW_PRUEF ECU_ADDRESS 0xd000db38 FORMAT "%5.0" /end MEASUREMENT
/begin MEASUREMENT Baw_siko "Gesamtwunsch aus Sicherheitskonzept" UWORD _CNV_R_R_Def_dez_sl_551_CM 1 100. 0. 65535. DISPLAY_IDENTIFIER BAW_SIKO ECU_ADDRESS 0xd000db3a FORMAT "%5.0" /end MEASUREMENT
/begin MEASUREMENT Baw_silber "Betriebsartwunsch Silber" ULONG _CNV_R_R_Def_dez_sl_551_CM 1 100. 0. 4294967295. DISPLAY_IDENTIFIER BAW_SILBER ECU_ADDRESS 0xd000daaa FORMAT "%7.0" /end MEASUREMENT
/begin MEASUREMENT Baw_soll "" UWORD _CNV_R_R_Def_dez_sl_551_CM 1 100. 0. 65535. DISPLAY_IDENTIFIER BAW_SOLL ECU_ADDRESS 0xd000d9e0 FORMAT "%5.0" /end MEASUREMENT
/begin MEASUREMENT Baw_standard "Standartanforderung" UWORD _CNV_R_R_Def_dez_sl_551_CM 1 100. 0. 65535. DISPLAY_IDENTIFIER BAW_STANDARD ECU_ADDRESS 0xd000db3c FORMAT "%5.0" /end MEASUREMENT
/begin MEASUREMENT Baw_start "Gesamtwunsch aus Start" UWORD _CNV_R_R_Def_dez_sl_551_CM 1 100. 0. 65535. DISPLAY_IDENTIFIER BAW_START ECU_ADDRESS 0xd000db3e FORMAT "%5.0" /end MEASUREMENT
/begin MEASUREMENT Baw_te "Gesamtwunsch aus Tankentlüftung" UWORD _CNV_R_R_Def_dez_sl_551_CM 1 100. 0. 65535. DISPLAY_IDENTIFIER BAW_TE ECU_ADDRESS 0xd000db40 FORMAT "%5.0" /end MEASUREMENT
/begin MEASUREMENT Baw_ueh "Gesamtanforderung aus Bauteilschutz Überhitzung" UWORD _CNV_R_R_Def_dez_sl_551_CM 1 100. 0. 65535. DISPLAY_IDENTIFIER BAW_UEH ECU_ADDRESS 0xd000db42 FORMAT "%5.0" /end MEASUREMENT
/begin MEASUREMENT Baw_uesp "Gesamtwunsch aus Überspülen" UWORD _CNV_R_R_Def_dez_sl_551_CM 1 100. 0. 65535. DISPLAY_IDENTIFIER BAW_UESP ECU_ADDRESS 0xd000db44 FORMAT "%5.0" /end MEASUREMENT
/begin MEASUREMENT Baw_umsnotl "Wunsch aus Notlauf" UWORD _CNV_R_R_Def_dez_sl_551_CM 1 100. 0. 65535. DISPLAY_IDENTIFIER BAW_UMSNOTL ECU_ADDRESS 0xd000db46 FORMAT "%5.0" /end MEASUREMENT
/begin MEASUREMENT Baw_vl "Gesamtwunsch aus Volllastanforderung" UWORD _CNV_R_R_Def_dez_sl_551_CM 1 100. 0. 65535. DISPLAY_IDENTIFIER BAW_VL ECU_ADDRESS 0xd000db48 FORMAT "%5.0" /end MEASUREMENT
/begin MEASUREMENT Baw_zwgemad "Wunsch aus Zwangsgemischadaption" UWORD _CNV_R_R_Def_dez_sl_551_CM 1 100. 0. 65535. DISPLAY_IDENTIFIER BAW_ZWGEMAD ECU_ADDRESS 0xd000db4a FORMAT "%5.0" /end MEASUREMENT
/begin MEASUREMENT Dmd_min "Differenz Mdk_min_f - Mdk_min" SWORD _CNV_R_R_Def_m_sw_q_554_CM 1 100. -3276.8 3276.7 DISPLAY_IDENTIFIER DMD_MIN ECU_ADDRESS 0xd000dbe8 FORMAT "%7.2" /end MEASUREMENT
/begin MEASUREMENT Dmdkw_soll "Kurbelwellensollmoment Gradient" SWORD _CNV_R_R_Def_m_sw_q_554_CM 1 100. -3276.8 3276.7 DISPLAY_IDENTIFIER DMDKW_SOLL ECU_ADDRESS 0xd000e1e2 FORMAT "%7.2" /end MEASUREMENT
/begin MEASUREMENT Dps_diff "Delta Soll-Differenz-Druck" SWORD _CNV_R_R_Def_p_sw_q_576_CM 1 100. -1280. 1279.9609 DISPLAY_IDENTIFIER DPS_DIFF ECU_ADDRESS 0xd000db6a FORMAT "%7.2" /end MEASUREMENT
/begin MEASUREMENT Dzw_ist_quad "(Zw_opt-Zw_ist)²" SWORD _CNV_R_R_Def_eta_sw_606_CM 1 100. 0. 100. DISPLAY_IDENTIFIER DZW_IST_QUAD ECU_ADDRESS 0xd000e18e FORMAT "%8.3" /end MEASUREMENT
/begin MEASUREMENT Dzw_koeff "Parameter für Zündhaken" UWORD _CNV_R_R_Def_f_uw_b_559_CM 1 100. 0. 15.9997 DISPLAY_IDENTIFIER DZW_KOEFF ECU_ADDRESS 0xd000e18a FORMAT "%9.4" /end MEASUREMENT
/begin MEASUREMENT Dzw_ve_quad "(Zw_opt-Zw_bas)²" SWORD _CNV_R_R_Def_eta_sw_606_CM 1 100. 0. 100. DISPLAY_IDENTIFIER DZW_VE_QUAD ECU_ADDRESS 0xd000e18c FORMAT "%8.3" /end MEASUREMENT
/begin MEASUREMENT Err_notl "Notlauf wegen Fehlereinträgen" UWORD _CNV_R_R_Def_dez_sl_551_CM 1 100. 0. 65535. DISPLAY_IDENTIFIER ERR_NOTL ECU_ADDRESS 0xd000e0be FORMAT "%5.0" /end MEASUREMENT
/begin MEASUREMENT Eta_ges_ist "Wirkungsgrad" SWORD _CNV_R_R_Def_eta_sw_599_CM 1 100. -200. 199.9938 DISPLAY_IDENTIFIER ETA_GES_IST ECU_ADDRESS 0xd000dc1a FORMAT "%8.3" /end MEASUREMENT
/begin MEASUREMENT Eta_ist "Wirkungsgrad für Rk Ba abhängig" UWORD _CNV_R_R_Def_eta_uw_615_CM 1 100. 0. 199.9969 DISPLAY_IDENTIFIER ETA_IST ECU_ADDRESS 0xd000dc24 FORMAT "%8.3" /end MEASUREMENT
/begin MEASUREMENT Eta_rk_md "Wirkungsgrad der Lambdahaken einzustellen ist" SWORD _CNV_R_R_Def_eta_sw_599_CM 1 100. -200. 199.9938 DISPLAY_IDENTIFIER ETA_RK_MD ECU_ADDRESS 0xd000e090 FORMAT "%8.3" /end MEASUREMENT
/begin MEASUREMENT Eta_rk_mdmx "Wirkungsgrad aus La_md_soll" SWORD _CNV_R_R_Def_eta_sw_599_CM 1 100. -200. 199.9938 DISPLAY_IDENTIFIER ETA_RK_MDMX ECU_ADDRESS 0xd000e07a FORMAT "%8.3" /end MEASUREMENT
/begin MEASUREMENT Eta_zw_ist "Wirkungsgrad des aktuellen Zylinders vor Eingriff der Momentenstruktur" SWORD _CNV_R_R_Def_eta_sw_606_CM 1 100. 0. 100. DISPLAY_IDENTIFIER ETA_ZW_IST ECU_ADDRESS 0xd000e188 FORMAT "%8.3" /end MEASUREMENT
/begin MEASUREMENT Eta_zw_ist1 "Aktueller Zündwirkungsgrad Bank 1" SWORD _CNV_R_R_Def_eta_sw_606_CM 1 100. 0. 100. DISPLAY_IDENTIFIER ETA_ZW_IST1 ECU_ADDRESS 0xd000e180 FORMAT "%8.3" /end MEASUREMENT
/begin MEASUREMENT Eta_zw_ist2 "Aktueller Zündwirkungsgrad Bank 2" SWORD _CNV_R_R_Def_eta_sw_606_CM 1 100. 0. 100. DISPLAY_IDENTIFIER ETA_ZW_IST2 ECU_ADDRESS 0xd000e182 FORMAT "%8.3" /end MEASUREMENT
/begin MEASUREMENT Eta_zwist_m "Über alle Zylinder gemittelter Ist-Wirkungsgrad" SWORD _CNV_R_R_Def_eta_sw_606_CM 1 100. 0. 100. DISPLAY_IDENTIFIER ETA_ZWIST_M ECU_ADDRESS 0xd000e186 FORMAT "%8.3" /end MEASUREMENT
/begin MEASUREMENT Eta_zwve_m "Über alle Zylinder gemittelter Wirkungsgrad vor Eingriff der Momentenstruktur" SWORD _CNV_R_R_Def_eta_sw_606_CM 1 100. 0. 100. DISPLAY_IDENTIFIER ETA_ZWVE_M ECU_ADDRESS 0xd000e17e FORMAT "%8.3" /end MEASUREMENT
/begin MEASUREMENT F_atldyn_start "Faktor Überspülen" UBYTE _CNV_R_R_Def_f_ub_b_553_CM 1 100. 0. 0.996 DISPLAY_IDENTIFIER F_ATLDYN_START ECU_ADDRESS 0xd000da0c /end MEASUREMENT
/begin MEASUREMENT F_dps_ba "" UBYTE _CNV_R_R_Def_f_ub_b_553_CM 1 100. 0. 0.996 DISPLAY_IDENTIFIER F_DPS_BA ECU_ADDRESS 0xd000d9c7 /end MEASUREMENT
/begin MEASUREMENT F_evmod "Faktor Überblendung Mszyl" UBYTE _CNV_R_R_Def_f_ub_b_553_CM 1 100. 0. 0.996 DISPLAY_IDENTIFIER F_EVMOD ECU_ADDRESS 0xd000d9c6 /end MEASUREMENT
/begin MEASUREMENT F_la_zwmx "Max-Wert für F_lazw_md" UBYTE _CNV_R_R_Def_f_ub_b_553_CM 1 100. 0. 0.996 DISPLAY_IDENTIFIER F_LA_ZWMX ECU_ADDRESS 0xd000e080 /end MEASUREMENT
/begin MEASUREMENT F_lazw_md "Faktor Umschaltung schnelle/langsame Momentenumsetzung über Lambda" UBYTE _CNV_R_R_Def_f_ub_b_553_CM 1 100. 0. 0.996 DISPLAY_IDENTIFIER F_LAZW_MD ECU_ADDRESS 0xd000e078 /end MEASUREMENT
/begin MEASUREMENT F_llr_ba "Faktor Umschaltung Leerlaufregler" UBYTE _CNV_R_R_Def_f_ub_b_553_CM 1 100. 0. 0.996 DISPLAY_IDENTIFIER F_LLR_BA ECU_ADDRESS 0xd000d9f1 /end MEASUREMENT
/begin MEASUREMENT F_mdi_ba "" UBYTE _CNV_R_R_Def_f_ub_b_553_CM 1 100. 0. 0.996 DISPLAY_IDENTIFIER F_MDI_BA ECU_ADDRESS 0xd000d9c9 /end MEASUREMENT
/begin MEASUREMENT F_mdiop_ba "" UBYTE _CNV_R_R_Def_f_ub_b_553_CM 1 100. 0. 0.996 DISPLAY_IDENTIFIER F_MDIOP_BA ECU_ADDRESS 0xd000d9c8 /end MEASUREMENT
/begin MEASUREMENT F_mdres_rgn "-" UWORD _CNV_R_R_Def_f_uw_b_571_CM 1 100. 0. 0.9999 DISPLAY_IDENTIFIER F_MDRES_RGN ECU_ADDRESS 0xd000d9d2 FORMAT "%14.5" /end MEASUREMENT
/begin MEASUREMENT F_ml_ba "" UBYTE _CNV_R_R_Def_f_ub_b_553_CM 1 100. 0. 0.996 DISPLAY_IDENTIFIER F_ML_BA ECU_ADDRESS 0xd000d9ca /end MEASUREMENT
/begin MEASUREMENT F_n_nstat "Faktor Nkw/Nstat" UWORD _CNV_R_R_Def_f_sw_b_616_CM 1 100. 0. 3.9999 DISPLAY_IDENTIFIER F_N_NSTAT ECU_ADDRESS 0xd000dbea FORMAT "%14.5" /end MEASUREMENT
/begin MEASUREMENT F_nst_ba "Faktor Überblendung Nachstart" UBYTE _CNV_R_R_Def_f_ub_b_553_CM 1 100. 0. 0.996 DISPLAY_IDENTIFIER F_NST_BA ECU_ADDRESS 0xd000d9f3 /end MEASUREMENT
/begin MEASUREMENT F_reib_ba "Faktor Überblendung Verlustmomente" UBYTE _CNV_R_R_Def_f_ub_b_553_CM 1 100. 0. 0.996 DISPLAY_IDENTIFIER F_REIB_BA ECU_ADDRESS 0xd000d9f2 /end MEASUREMENT
/begin MEASUREMENT F_sicher_zw "Überblendfaktor aus Verbrennungsregelung für Zündwinkel" UBYTE _CNV_R_R_Def_f_ub_b_553_CM 1 100. 0. 0.996 DISPLAY_IDENTIFIER F_SICHER_ZW ECU_ADDRESS 0xd000e0bd /end MEASUREMENT
/begin MEASUREMENT F_spr_ba "Faktor Umschaltung Spreizung" UBYTE _CNV_R_R_Def_f_ub_b_553_CM 1 100. 0. 0.996 DISPLAY_IDENTIFIER F_SPR_BA ECU_ADDRESS 0xd000d9f6 /end MEASUREMENT
/begin MEASUREMENT F_spr_baw "Faktor Umschaltung Spreizung" UBYTE _CNV_R_R_Def_f_ub_b_553_CM 1 100. 0. 0.996 DISPLAY_IDENTIFIER F_SPR_BAW ECU_ADDRESS 0xd000d9f7 /end MEASUREMENT
/begin MEASUREMENT F_st_ba "Faktor Überblendung Start" UBYTE _CNV_R_R_Def_f_ub_b_553_CM 1 100. 0. 0.996 DISPLAY_IDENTIFIER F_ST_BA ECU_ADDRESS 0xd000d9f0 /end MEASUREMENT
/begin MEASUREMENT F_uesp_aus "Faktor Überspülen" UBYTE _CNV_R_R_Def_f_ub_b_553_CM 1 100. 0. 0.996 DISPLAY_IDENTIFIER F_UESP_AUS ECU_ADDRESS 0xd000d9cc /end MEASUREMENT
/begin MEASUREMENT F_vwi_ba "Faktor Umschaltung Vorlagerungwinkel" UBYTE _CNV_R_R_Def_f_ub_b_553_CM 1 100. 0. 0.996 DISPLAY_IDENTIFIER F_VWI_BA ECU_ADDRESS 0xd000d9cb /end MEASUREMENT
/begin MEASUREMENT F_wl_ba "Faktor Überblendung Nachstart" UBYTE _CNV_R_R_Def_f_ub_b_553_CM 1 100. 0. 0.996 DISPLAY_IDENTIFIER F_WL_BA ECU_ADDRESS 0xd000d9f4 /end MEASUREMENT
/begin MEASUREMENT F_wnwkh "" UBYTE _CNV_R_R_Def_f_ub_b_553_CM 1 100. 0. 0.996 DISPLAY_IDENTIFIER F_WNWKH ECU_ADDRESS 0xc0007b56 /end MEASUREMENT
/begin MEASUREMENT F_wnwkhk "" UBYTE _CNV_R_R_Def_f_ub_b_553_CM 1 100. 0. 0.996 DISPLAY_IDENTIFIER F_WNWKHK ECU_ADDRESS 0xc0007b54 /end MEASUREMENT
/begin MEASUREMENT F_wnwkhk_2 "" UBYTE _CNV_R_R_Def_f_ub_b_553_CM 1 100. 0. 0.996 DISPLAY_IDENTIFIER F_WNWKHK_2 ECU_ADDRESS 0xc0007b55 /end MEASUREMENT
/begin MEASUREMENT F_zw_ba "Faktor Umschaltung BA Zündwinkel" UBYTE _CNV_R_R_Def_f_ub_b_553_CM 1 100. 0. 0.996 DISPLAY_IDENTIFIER F_ZW_BA ECU_ADDRESS 0xd000d9f5 /end MEASUREMENT
/begin MEASUREMENT F_zw_baw "Überblendfaktor Zündung" UBYTE _CNV_R_R_Def_f_ub_b_553_CM 1 100. 0. 0.996 DISPLAY_IDENTIFIER F_ZW_BAW ECU_ADDRESS 0xd000d9cd /end MEASUREMENT
/begin MEASUREMENT F_zw_hsplit "Überblendfaktor Aufteilung Einspritzung" UBYTE _CNV_R_R_Def_f_ub_b_553_CM 1 100. 0. 0.996 DISPLAY_IDENTIFIER F_ZW_HSPLIT ECU_ADDRESS 0xd000d9ce /end MEASUREMENT
/begin MEASUREMENT Frkbgdyn_hs "Faktor Verschiebung Brenngrenzen Homogen Schicht" UWORD _CNV_R_R_Def_f_uw_b_571_CM 1 100. 0. 0.9999 DISPLAY_IDENTIFIER FRKBGDYN_HS ECU_ADDRESS 0xd000da06 FORMAT "%14.5" /end MEASUREMENT
/begin MEASUREMENT Frkbgdyn_s "Faktor Verschiebung Brenngrenzen Schicht" UWORD _CNV_R_R_Def_f_uw_b_571_CM 1 100. 0. 0.9999 DISPLAY_IDENTIFIER FRKBGDYN_S ECU_ADDRESS 0xd000da04 FORMAT "%14.5" /end MEASUREMENT
/begin MEASUREMENT I_eff "effektive Übersetzung" UWORD _CNV_R_R_Def_f_uw_b_617_CM 1 100. 0. 63.999 DISPLAY_IDENTIFIER I_EFF ECU_ADDRESS 0xd000dc0c FORMAT "%9.4" /end MEASUREMENT
/begin MEASUREMENT I_fw_ber "Übersetzung zur Berechnung des Fahrerwunsches" UWORD _CNV_R_R_Def_f_uw_b_617_CM 1 100. 0. 63.999 DISPLAY_IDENTIFIER I_FW_BER ECU_ADDRESS 0xd000dc04 FORMAT "%9.4" /end MEASUREMENT
/begin MEASUREMENT I_ges "Gesamtübersetzung" UWORD _CNV_R_R_Def_f_uw_b_617_CM 1 100. 0. 63.999 DISPLAY_IDENTIFIER I_GES ECU_ADDRESS 0xd000dc00 FORMAT "%9.4" /end MEASUREMENT
/begin MEASUREMENT I_ges_at "Gesamtübersetzung für AT" UWORD _CNV_R_R_Def_f_uw_b_617_CM 1 100. 0. 63.999 DISPLAY_IDENTIFIER I_GES_AT ECU_ADDRESS 0xd000dc10 FORMAT "%9.4" /end MEASUREMENT
/begin MEASUREMENT I_ges_hs "Gesamtübersetzung für HS" UWORD _CNV_R_R_Def_f_uw_b_617_CM 1 100. 0. 63.999 DISPLAY_IDENTIFIER I_GES_HS ECU_ADDRESS 0xd000dc0e FORMAT "%9.4" /end MEASUREMENT
/begin MEASUREMENT I_ha "Übersetzung Hinterachse" UWORD _CNV_R_R_Def_f_uw_b_617_CM 1 100. 0. 63.999 DISPLAY_IDENTIFIER I_HA ECU_ADDRESS 0xd000dc02 FORMAT "%9.4" /end MEASUREMENT
/begin MEASUREMENT I_opt "opt. Übersetzung" UWORD _CNV_R_R_Def_f_uw_b_617_CM 1 100. 0. 63.999 DISPLAY_IDENTIFIER I_OPT ECU_ADDRESS 0xd000dc0a FORMAT "%9.4" /end MEASUREMENT
/begin MEASUREMENT La_md "Lambda um gewünschtes Moment einzustellen" UWORD _CNV_R_R_Def_f_uw_b_559_CM 1 100. 0. 15.9997 DISPLAY_IDENTIFIER LA_MD ECU_ADDRESS 0xd000e08a FORMAT "%9.4" /end MEASUREMENT
/begin MEASUREMENT La_soll_md "Lambdavorgabe aus Momentenstruktur" UWORD _CNV_R_R_Def_f_uw_b_559_CM 1 100. 0. 15.9997 DISPLAY_IDENTIFIER LA_SOLL_MD ECU_ADDRESS 0xd000e07c FORMAT "%9.4" /end MEASUREMENT
/begin MEASUREMENT La_soll_notl1 "Lambda-Sollwert 1 aus Notlaufmanager" UWORD _CNV_R_R_Def_f_uw_b_559_CM 1 100. 0. 15.9997 DISPLAY_IDENTIFIER LA_SOLL_NOTL1 ECU_ADDRESS 0xd000e0b8 FORMAT "%9.4" /end MEASUREMENT
/begin MEASUREMENT La_soll_notl2 "Lambda-Sollwert aus Notlaufmanager" UWORD _CNV_R_R_Def_f_uw_b_559_CM 1 100. 0. 15.9997 DISPLAY_IDENTIFIER LA_SOLL_NOTL2 ECU_ADDRESS 0xd000e0ba FORMAT "%9.4" /end MEASUREMENT
/begin MEASUREMENT Md_la_mx "Momenten das nicht über Lambda eingestellt werden konnte" SWORD _CNV_R_R_Def_m_sw_q_554_CM 1 100. -3276.8 3276.7 DISPLAY_IDENTIFIER MD_LA_MX ECU_ADDRESS 0xd000e07e FORMAT "%7.2" /end MEASUREMENT
/begin MEASUREMENT Md_na_ramp "Fallende Nebenaggregatelast abgerampt" SWORD _CNV_R_R_Def_m_sw_q_554_CM 1 100. -3276.8 3276.7 DISPLAY_IDENTIFIER MD_NA_RAMP ECU_ADDRESS 0xd000dbec FORMAT "%7.2" /end MEASUREMENT
/begin MEASUREMENT Md_rad_istlm "Ist-Radmoment aus Luftmasse ohne externe Eingriffe" SLONG _CNV_R_R_Def_m_sw_q_554_CM 1 100. -214748364.8 214748364.7 DISPLAY_IDENTIFIER MD_RAD_ISTLM ECU_ADDRESS 0xd000dc06 FORMAT "%9.2" /end MEASUREMENT
/begin MEASUREMENT Md_res_diff "" SWORD _CNV_R_R_Def_m_sw_q_554_CM 1 100. -3276.8 3276.7 DISPLAY_IDENTIFIER MD_RES_DIFF ECU_ADDRESS 0xd000dba2 FORMAT "%7.2" /end MEASUREMENT
/begin MEASUREMENT Md_res_diffint "" SWORD _CNV_R_R_Def_m_sw_q_554_CM 1 100. -3276.8 3276.7 DISPLAY_IDENTIFIER MD_RES_DIFFINT ECU_ADDRESS 0xd000db8e FORMAT "%7.2" /end MEASUREMENT
/begin MEASUREMENT Md_res_khint "" SWORD _CNV_R_R_Def_m_sw_q_554_CM 1 100. -3276.8 3276.7 DISPLAY_IDENTIFIER MD_RES_KHINT ECU_ADDRESS 0xd000db90 FORMAT "%7.2" /end MEASUREMENT
/begin MEASUREMENT Md_res_khmn "" SWORD _CNV_R_R_Def_m_sw_q_554_CM 1 100. -3276.8 3276.7 DISPLAY_IDENTIFIER MD_RES_KHMN ECU_ADDRESS 0xd000dba0 FORMAT "%7.2" /end MEASUREMENT
/begin MEASUREMENT Md_soll_delta "" SWORD _CNV_R_R_Def_m_sw_q_554_CM 1 100. -3276.8 3276.7 DISPLAY_IDENTIFIER MD_SOLL_DELTA ECU_ADDRESS 0xd000db94 FORMAT "%7.2" /end MEASUREMENT
/begin MEASUREMENT Mdi_arll "Schneller Momenteneingrif des LL-Reglers und der AR über die Zündung" SWORD _CNV_R_R_Def_m_sw_q_554_CM 1 100. -3276.8 3276.7 DISPLAY_IDENTIFIER MDI_ARLL ECU_ADDRESS 0xd000db98 FORMAT "%7.2" /end MEASUREMENT
/begin MEASUREMENT Mdi_arll_la "Schneller Momenteneingrif des LL-Reglers und der AR über Lambda" SWORD _CNV_R_R_Def_m_sw_q_554_CM 1 100. -3276.8 3276.7 DISPLAY_IDENTIFIER MDI_ARLL_LA ECU_ADDRESS 0xd000db9a FORMAT "%7.2" /end MEASUREMENT
/begin MEASUREMENT Mdi_arll_zw "Schneller Momenteneingrif des LL-Reglers und der AR über die Zündung" SWORD _CNV_R_R_Def_m_sw_q_554_CM 1 100. -3276.8 3276.7 DISPLAY_IDENTIFIER MDI_ARLL_ZW ECU_ADDRESS 0xd000db96 FORMAT "%7.2" /end MEASUREMENT
/begin MEASUREMENT Mdi_bas "Optimales inneres Moment mit Lambdawirkungsgrad und mittlerem Wirkungsgrad vor Eingriff korrigiert" SWORD _CNV_R_R_Def_m_sw_q_554_CM 1 100. -3276.8 3276.7 DISPLAY_IDENTIFIER MDI_BAS ECU_ADDRESS 0xd000e17c FORMAT "%7.2" /end MEASUREMENT
/begin MEASUREMENT Mdi_bas_ba "Basismoment aus Mdi_bas/_hs oder /_s" SWORD _CNV_R_R_Def_m_sw_q_554_CM 1 100. -3276.8 3276.7 DISPLAY_IDENTIFIER MDI_BAS_BA ECU_ADDRESS 0xd000db86 FORMAT "%7.2" /end MEASUREMENT
/begin MEASUREMENT Mdi_bas_korr "Basismoment aus KF_MDIOP_x und Eta_zwve_m um Wirkungsgrad Momentenres korrigiert" SWORD _CNV_R_R_Def_m_sw_q_554_CM 1 100. -3276.8 3276.7 DISPLAY_IDENTIFIER MDI_BAS_KORR ECU_ADDRESS 0xd000db84 FORMAT "%7.2" /end MEASUREMENT
/begin MEASUREMENT Mdi_fzdyn_res "inneres Moment nach Fahrdynamikfilterung mit Momentenreserve" SWORD _CNV_R_R_Def_m_sw_q_554_CM 1 100. -3276.8 3276.7 DISPLAY_IDENTIFIER MDI_FZDYN_RES ECU_ADDRESS 0xd000dbc2 FORMAT "%7.2" /end MEASUREMENT
/begin MEASUREMENT Mdi_ist_h "Ist-Moment im Homogenbetrieb" SWORD _CNV_R_R_Def_m_sw_q_554_CM 1 100. -3276.8 3276.7 DISPLAY_IDENTIFIER MDI_IST_H ECU_ADDRESS 0xd000dc1c FORMAT "%7.2" /end MEASUREMENT
/begin MEASUREMENT Mdi_la_soll "Momenten das über Lambda eingestellt werden soll" SWORD _CNV_R_R_Def_m_sw_q_554_CM 1 100. -3276.8 3276.7 DISPLAY_IDENTIFIER MDI_LA_SOLL ECU_ADDRESS 0xd000db74 FORMAT "%7.2" /end MEASUREMENT
/begin MEASUREMENT Mdi_la_sollbg "Momenten das über Lambda eingestellt werden soll begrenzt" SWORD _CNV_R_R_Def_m_sw_q_554_CM 1 100. -3276.8 3276.7 DISPLAY_IDENTIFIER MDI_LA_SOLLBG ECU_ADDRESS 0xd000e08e FORMAT "%7.2" /end MEASUREMENT
/begin MEASUREMENT Mdi_max_notl "Maximales inneres Moment Notlauf" SWORD _CNV_R_R_Def_m_sw_q_554_CM 1 100. -3276.8 3276.7 DISPLAY_IDENTIFIER MDI_MAX_NOTL ECU_ADDRESS 0xd000e0ac FORMAT "%7.2" /end MEASUREMENT
/begin MEASUREMENT Mdi_ml_soll "inneres Sollmoment-über die Luft einzustellen " SWORD _CNV_R_R_Def_m_sw_q_554_CM 1 100. -3276.8 3276.7 DISPLAY_IDENTIFIER MDI_ML_SOLL ECU_ADDRESS 0xd000db7c FORMAT "%7.2" /end MEASUREMENT
/begin MEASUREMENT Mdi_ml_sollvb "Soll-Momenten Luftpfad vor Sicherheitsbegrenzung" SWORD _CNV_R_R_Def_m_sw_q_554_CM 1 100. -3276.8 3276.7 DISPLAY_IDENTIFIER MDI_ML_SOLLVB ECU_ADDRESS 0xd000db72 FORMAT "%7.2" /end MEASUREMENT
/begin MEASUREMENT Mdi_mxnl_min "mindest Maximales Inneresmoment Notlauf" SWORD _CNV_R_R_Def_m_sw_q_554_CM 1 100. -3276.8 3276.7 DISPLAY_IDENTIFIER MDI_MXNL_MIN ECU_ADDRESS 0xd000e0ae FORMAT "%7.2" /end MEASUREMENT
/begin MEASUREMENT Mdi_opt "optimales inneres Motormoment" SWORD _CNV_R_R_Def_m_sw_q_554_CM 1 100. -3276.8 3276.7 DISPLAY_IDENTIFIER MDI_OPT ECU_ADDRESS 0xd000e08c FORMAT "%7.2" /end MEASUREMENT
/begin MEASUREMENT Mdi_opt_1 "optimales inneres Motormoment" SWORD _CNV_R_R_Def_m_sw_q_554_CM 1 100. -3276.8 3276.7 DISPLAY_IDENTIFIER MDI_OPT_1 ECU_ADDRESS 0xd000dc1e FORMAT "%7.2" /end MEASUREMENT
/begin MEASUREMENT Mdi_opt_2 "optimales inneres Motormoment" SWORD _CNV_R_R_Def_m_sw_q_554_CM 1 100. -3276.8 3276.7 DISPLAY_IDENTIFIER MDI_OPT_2 ECU_ADDRESS 0xd000dc20 FORMAT "%7.2" /end MEASUREMENT
/begin MEASUREMENT Mdi_opt_h "optimales inneres Motormoment homogen" SWORD _CNV_R_R_Def_m_sw_q_554_CM 1 100. -3276.8 3276.7 DISPLAY_IDENTIFIER MDI_OPT_H ECU_ADDRESS 0xd000dc22 FORMAT "%7.2" /end MEASUREMENT
/begin MEASUREMENT Mdi_opt_l1 "optimales inneres Motormoment" SWORD _CNV_R_R_Def_m_sw_q_554_CM 1 100. -3276.8 3276.7 DISPLAY_IDENTIFIER MDI_OPT_L1 ECU_ADDRESS 0xd000dc14 FORMAT "%7.2" /end MEASUREMENT
/begin MEASUREMENT Mdi_opt_lam "Optimales inneres Moment mit Lambdawirkungsgrad korrigiert" SWORD _CNV_R_R_Def_m_sw_q_554_CM 1 100. -3276.8 3276.7 DISPLAY_IDENTIFIER MDI_OPT_LAM ECU_ADDRESS 0xd000e184 FORMAT "%7.2" /end MEASUREMENT
/begin MEASUREMENT Mdi_opt_s "optimales inneres Motormoment im Schichtbetrieb" SWORD _CNV_R_R_Def_m_sw_q_554_CM 1 100. -3276.8 3276.7 DISPLAY_IDENTIFIER MDI_OPT_S ECU_ADDRESS 0xd000dc16 FORMAT "%7.2" /end MEASUREMENT
/begin MEASUREMENT Mdi_res_gdi "Momentenreserve für Sprung Homgen und Schicht" SWORD _CNV_R_R_Def_m_sw_q_554_CM 1 100. -3276.8 3276.7 DISPLAY_IDENTIFIER MDI_RES_GDI ECU_ADDRESS 0xd000d9d0 FORMAT "%7.2" /end MEASUREMENT
/begin MEASUREMENT Mdi_rk_soll "Momenten das über Lambda eingestellt werden soll" SWORD _CNV_R_R_Def_m_sw_q_554_CM 1 100. -3276.8 3276.7 DISPLAY_IDENTIFIER MDI_RK_SOLL ECU_ADDRESS 0xd000db6e FORMAT "%7.2" /end MEASUREMENT
/begin MEASUREMENT Mdi_s_istm "inneres Ist-Motormoment im Schichtbetrieb" SWORD _CNV_R_R_Def_m_sw_q_554_CM 1 100. -3276.8 3276.7 DISPLAY_IDENTIFIER MDI_S_ISTM ECU_ADDRESS 0xd000dc18 FORMAT "%7.2" /end MEASUREMENT
/begin MEASUREMENT Mdi_soll "inneres Sollmoment" SWORD _CNV_R_R_Def_m_sw_q_554_CM 1 100. -3276.8 3276.7 DISPLAY_IDENTIFIER MDI_SOLL ECU_ADDRESS 0xd000db7e FORMAT "%7.2" /end MEASUREMENT
/begin MEASUREMENT Mdi_soll_1 " " SWORD _CNV_R_R_Def_m_sw_q_554_CM 1 100. -3276.8 3276.7 DISPLAY_IDENTIFIER MDI_SOLL_1 ECU_ADDRESS 0xd000db76 FORMAT "%7.2" /end MEASUREMENT
/begin MEASUREMENT Mdi_soll_arll "inneres Moment Zündpfad mit LL und Antiruckel" SWORD _CNV_R_R_Def_m_sw_q_554_CM 1 100. -3276.8 3276.7 DISPLAY_IDENTIFIER MDI_SOLL_ARLL ECU_ADDRESS 0xd000db9e FORMAT "%7.2" /end MEASUREMENT
/begin MEASUREMENT Mdi_soll_can "Soll-Moment ohne Getriebeeingriff für den CAN-Bus" SWORD _CNV_R_R_Def_m_sw_q_554_CM 1 100. -3276.8 3276.7 DISPLAY_IDENTIFIER MDI_SOLL_CAN ECU_ADDRESS 0xd000db6c FORMAT "%7.2" /end MEASUREMENT
/begin MEASUREMENT Mdi_soll_canarll "inneres Moment Zündpfad mit LL und Antiruckel" SWORD _CNV_R_R_Def_m_sw_q_554_CM 1 100. -3276.8 3276.7 DISPLAY_IDENTIFIER MDI_SOLL_CANARLL ECU_ADDRESS 0xd000db9c FORMAT "%7.2" /end MEASUREMENT
/begin MEASUREMENT Mdi_soll_k "" SWORD _CNV_R_R_Def_m_sw_q_554_CM 1 100. -3276.8 3276.7 DISPLAY_IDENTIFIER MDI_SOLL_K ECU_ADDRESS 0xd000dbc0 FORMAT "%7.2" /end MEASUREMENT
/begin MEASUREMENT Mdi_soll_l "inneres Moment fuer den Luftpfad" SWORD _CNV_R_R_Def_m_sw_q_554_CM 1 100. -3276.8 3276.7 DISPLAY_IDENTIFIER MDI_SOLL_L ECU_ADDRESS 0xd000db82 FORMAT "%7.2" /end MEASUREMENT
/begin MEASUREMENT Mdi_soll_lk "inneres Soll-Moment langsamer Pfad ohne Sicherheitseingriff" SWORD _CNV_R_R_Def_m_sw_q_554_CM 1 100. -3276.8 3276.7 DISPLAY_IDENTIFIER MDI_SOLL_LK ECU_ADDRESS 0xd000e1dc FORMAT "%7.2" /end MEASUREMENT
/begin MEASUREMENT Mdi_soll_lkdyn "inneres Soll-Moment langsamer Pfad ohne Sicherheitseingriff" SWORD _CNV_R_R_Def_m_sw_q_554_CM 1 100. -3276.8 3276.7 DISPLAY_IDENTIFIER MDI_SOLL_LKDYN ECU_ADDRESS 0xd000e1de FORMAT "%7.2" /end MEASUREMENT
/begin MEASUREMENT Mdi_soll_min3 "aus Mdk_s2 für Layer" SWORD _CNV_R_R_Def_m_sw_q_554_CM 1 100. -3276.8 3276.7 DISPLAY_IDENTIFIER MDI_SOLL_MIN3 ECU_ADDRESS 0xd000dbbe FORMAT "%7.2" /end MEASUREMENT
/begin MEASUREMENT Mdi_sollvb "inneres Sollmoment" SWORD _CNV_R_R_Def_m_sw_q_554_CM 1 100. -3276.8 3276.7 DISPLAY_IDENTIFIER MDI_SOLLVB ECU_ADDRESS 0xd000db80 FORMAT "%7.2" /end MEASUREMENT
/begin MEASUREMENT Mdi_wunsch "Inneres Fahrerwunschmoment mit Begrenzung ohne Eingriffe" SWORD _CNV_R_R_Def_m_sw_q_554_CM 1 100. -3276.8 3276.7 DISPLAY_IDENTIFIER MDI_WUNSCH ECU_ADDRESS 0xd000dbc4 FORMAT "%7.2" /end MEASUREMENT
/begin MEASUREMENT Mdi_zw_rampe "" SWORD _CNV_R_R_Def_m_sw_q_554_CM 1 100. -3276.8 3276.7 DISPLAY_IDENTIFIER MDI_ZW_RAMPE ECU_ADDRESS 0xd000db92 FORMAT "%7.2" /end MEASUREMENT
/begin MEASUREMENT Mdi_zw_soll "inneres Sollmoment-über den Zw einzustellen " SWORD _CNV_R_R_Def_m_sw_q_554_CM 1 100. -3276.8 3276.7 DISPLAY_IDENTIFIER MDI_ZW_SOLL ECU_ADDRESS 0xd000db78 FORMAT "%7.2" /end MEASUREMENT
/begin MEASUREMENT Mdi_zw_sollcan "inneres Sollmoment-über den Zw einzustellen " SWORD _CNV_R_R_Def_m_sw_q_554_CM 1 100. -3276.8 3276.7 DISPLAY_IDENTIFIER MDI_ZW_SOLLCAN ECU_ADDRESS 0xd000db7a FORMAT "%7.2" /end MEASUREMENT
/begin MEASUREMENT Mdi_zw_sollvb "Soll-Momenten Zündpfad vor Sicherheitsbegrenzung" SWORD _CNV_R_R_Def_m_sw_q_554_CM 1 100. -3276.8 3276.7 DISPLAY_IDENTIFIER MDI_ZW_SOLLVB ECU_ADDRESS 0xd000db70 FORMAT "%7.2" /end MEASUREMENT
/begin MEASUREMENT Mdk_ext_min "Reduktion Gesamtmoment" SWORD _CNV_R_R_Def_m_sw_q_554_CM 1 100. -3276.8 3276.7 DISPLAY_IDENTIFIER MDK_EXT_MIN ECU_ADDRESS 0xd000dbd4 FORMAT "%7.2" /end MEASUREMENT
/begin MEASUREMENT Mdk_ext_plus1 "max. Auswahl externe Eingriffe auf dem schnellen Pfad" SWORD _CNV_R_R_Def_m_sw_q_554_CM 1 100. -3276.8 3276.7 DISPLAY_IDENTIFIER MDK_EXT_PLUS1 ECU_ADDRESS 0xd000dbb8 FORMAT "%7.2" /end MEASUREMENT
/begin MEASUREMENT Mdk_fw "Wunschkupplungsmoment Fahrer/FGR" SWORD _CNV_R_R_Def_m_sw_q_554_CM 1 100. -3276.8 3276.7 DISPLAY_IDENTIFIER MDK_FW ECU_ADDRESS 0xd000dbe2 FORMAT "%7.2" /end MEASUREMENT
/begin MEASUREMENT Mdk_l1 "Momentenbegrenzung Luftpfad Externer Anforderer  (Plus)" SWORD _CNV_R_R_Def_m_sw_q_554_CM 1 100. -3276.8 3276.7 DISPLAY_IDENTIFIER MDK_L1 ECU_ADDRESS 0xd000dbd0 FORMAT "%7.2" /end MEASUREMENT
/begin MEASUREMENT Mdk_l2 "Momentenbegrenzung Luftpfad Externer Anforderer  (Minus)" SWORD _CNV_R_R_Def_m_sw_q_554_CM 1 100. -3276.8 3276.7 DISPLAY_IDENTIFIER MDK_L2 ECU_ADDRESS 0xd000dbd2 FORMAT "%7.2" /end MEASUREMENT
/begin MEASUREMENT Mdk_min_f "minimales Moment gefiltert" SWORD _CNV_R_R_Def_m_sw_q_554_CM 1 100. -3276.8 3276.7 DISPLAY_IDENTIFIER MDK_MIN_F ECU_ADDRESS 0xd000dbe0 FORMAT "%7.2" /end MEASUREMENT
/begin MEASUREMENT Mdk_min_res "min Moment mit ASR" SWORD _CNV_R_R_Def_m_sw_q_554_CM 1 100. -3276.8 3276.7 DISPLAY_IDENTIFIER MDK_MIN_RES ECU_ADDRESS 0xd000dbd6 FORMAT "%7.2" /end MEASUREMENT
/begin MEASUREMENT Mdk_s1 "Momentenbegrenzung Zündung Externer Anforderer  (Minus)" SWORD _CNV_R_R_Def_m_sw_q_554_CM 1 100. -3276.8 3276.7 DISPLAY_IDENTIFIER MDK_S1 ECU_ADDRESS 0xd000dbcc FORMAT "%7.2" /end MEASUREMENT
/begin MEASUREMENT Mdk_s2 "Momentenbegrenzung Zündung incl. Externer Anforderer" SWORD _CNV_R_R_Def_m_sw_q_554_CM 1 100. -3276.8 3276.7 DISPLAY_IDENTIFIER MDK_S2 ECU_ADDRESS 0xd000dbce FORMAT "%7.2" /end MEASUREMENT
/begin MEASUREMENT Mdk_soll "Kupplungssollmoment schnell" SWORD _CNV_R_R_Def_m_sw_q_554_CM 1 100. -3276.8 3276.7 DISPLAY_IDENTIFIER MDK_SOLL ECU_ADDRESS 0xd000dbba FORMAT "%7.2" /end MEASUREMENT
/begin MEASUREMENT Mdk_soll_l "Kupplungssollmoment langsam" SWORD _CNV_R_R_Def_m_sw_q_554_CM 1 100. -3276.8 3276.7 DISPLAY_IDENTIFIER MDK_SOLL_L ECU_ADDRESS 0xd000dbbc FORMAT "%7.2" /end MEASUREMENT
/begin MEASUREMENT Mdk_soll_min1 "Momentenbegrenzung Zündung Externer Anforderer (Plus / z.B. Nmax)" SWORD _CNV_R_R_Def_m_sw_q_554_CM 1 100. -3276.8 3276.7 DISPLAY_IDENTIFIER MDK_SOLL_MIN1 ECU_ADDRESS 0xd000dbca FORMAT "%7.2" /end MEASUREMENT
/begin MEASUREMENT Mdk_soll_plus "Momentenanforderung Zündung incl. Externer Anforderer (Plus)" SWORD _CNV_R_R_Def_m_sw_q_554_CM 1 100. -3276.8 3276.7 DISPLAY_IDENTIFIER MDK_SOLL_PLUS ECU_ADDRESS 0xd000dbc8 FORMAT "%7.2" /end MEASUREMENT
/begin MEASUREMENT Mdk_soll_plusgs "Erhöhendes Moment ohne Getriebeeingriff" SWORD _CNV_R_R_Def_m_sw_q_554_CM 1 100. -3276.8 3276.7 DISPLAY_IDENTIFIER MDK_SOLL_PLUSGS ECU_ADDRESS 0xd000db8c FORMAT "%7.2" /end MEASUREMENT
/begin MEASUREMENT Mdk_ul_mx "Momentenbegrenzung bei Variantenfehler" SWORD _CNV_R_R_Def_m_sw_q_554_CM 1 100. -3276.8 3276.7 DISPLAY_IDENTIFIER MDK_UL_MX ECU_ADDRESS 0xd000dbd8 FORMAT "%7.2" /end MEASUREMENT
/begin MEASUREMENT Mdk_wunsch "Wunschkupplungsmoment vor Fahrdynamikfilterung" SWORD _CNV_R_R_Def_m_sw_q_554_CM 1 100. -3276.8 3276.7 DISPLAY_IDENTIFIER MDK_WUNSCH ECU_ADDRESS 0xd000dbe4 FORMAT "%7.2" /end MEASUREMENT
/begin MEASUREMENT Mdk_wunsch_grad "Delta Mdk_wunsch im 10ms_Raster über 40ms gerechnet" SWORD _CNV_R_R_Def_dm_sw__650_CM 1 100. -3276.8 3276.7 DISPLAY_IDENTIFIER MDK_WUNSCH_GRAD ECU_ADDRESS 0xd000dbe6 FORMAT "%7.2" /end MEASUREMENT
/begin MEASUREMENT Mdk_wunsch_vb "Wunschkupplungsmoment vor Begrenzung" SWORD _CNV_R_R_Def_m_sw_q_554_CM 1 100. -3276.8 3276.7 DISPLAY_IDENTIFIER MDK_WUNSCH_VB ECU_ADDRESS 0xd000dbee FORMAT "%7.2" /end MEASUREMENT
/begin MEASUREMENT Mdkw_soll "Kurbelwellensollmoment schnell" SWORD _CNV_R_R_Def_m_sw_q_554_CM 1 100. -3276.8 3276.7 DISPLAY_IDENTIFIER MDKW_SOLL ECU_ADDRESS 0xd000e1e0 FORMAT "%7.2" /end MEASUREMENT
/begin MEASUREMENT Mdkw_soll_l "Kurbelwellensollmoment langsam" SWORD _CNV_R_R_Def_m_sw_q_554_CM 1 100. -3276.8 3276.7 DISPLAY_IDENTIFIER MDKW_SOLL_L ECU_ADDRESS 0xd000e1e4 FORMAT "%7.2" /end MEASUREMENT
/begin MEASUREMENT N_ab "Abtriebsdrehzahl" SWORD _CNV_R_R_Def_n_sw_q_595_CM 1 100. -32768. 32767. DISPLAY_IDENTIFIER N_AB ECU_ADDRESS 0xd000dbfc FORMAT "%5.0" /end MEASUREMENT
/begin MEASUREMENT Nkw_opt "Motordrehzahl die zu opt. Übersetzung führt" SWORD _CNV_R_R_Def_n_sw_q_595_CM 1 100. -32768. 32767. DISPLAY_IDENTIFIER NKW_OPT ECU_ADDRESS 0xd000dbfe FORMAT "%5.0" /end MEASUREMENT
/begin MEASUREMENT Nmax_ba "Maximale Drehzahl der Betriebsart" SWORD _CNV_R_R_Def_n_sw_q_595_CM 1 100. -32768. 32767. DISPLAY_IDENTIFIER NMAX_BA ECU_ADDRESS 0xd000d9e6 FORMAT "%5.0" /end MEASUREMENT
/begin MEASUREMENT Nmax_notl "Maximale Drehzahl der Betriebsart aus Notlaufmanager" SWORD _CNV_R_R_Def_n_sw_q_595_CM 1 100. -32768. 32767. DISPLAY_IDENTIFIER NMAX_NOTL ECU_ADDRESS 0xd000e0b0 FORMAT "%5.0" /end MEASUREMENT
/begin MEASUREMENT Notl_wahl "Auswahl des Notlaufes" UBYTE _CNV_R_R_Def_dez_sl_551_CM 1 100. 0. 255. DISPLAY_IDENTIFIER NOTL_WAHL ECU_ADDRESS 0xd000e0c0 FORMAT "%3.0" /end MEASUREMENT
/begin MEASUREMENT Prio_sieg "Priorität der ausgewählten BA als Text" UWORD _CNV_S_29_Def_ba_anf_681_CM 1 100. 0. 28. DISPLAY_IDENTIFIER PRIO_SIEG ECU_ADDRESS 0xd000db4c BIT_MASK 0xFF /end MEASUREMENT
/begin MEASUREMENT Prio_sieg_zahl "Priorität der ausgewählten BA als Zahl" UWORD _CNV_R_R_Def_dez_sl_551_CM 1 100. 0. 255. DISPLAY_IDENTIFIER PRIO_SIEG_ZAHL ECU_ADDRESS 0xd000db4e FORMAT "%5.0" /end MEASUREMENT
/begin MEASUREMENT Prozkh_md_res "" UBYTE _CNV_R_R_Def_f_ub_b_553_CM 1 100. 0. 0.996 DISPLAY_IDENTIFIER PROZKH_MD_RES ECU_ADDRESS 0xd000db89 /end MEASUREMENT
/begin MEASUREMENT Rf_egr_hs "" SWORD _CNV_R_R_Def_rf_sw__598_CM 1 100. -327.68 327.67 DISPLAY_IDENTIFIER RF_EGR_HS ECU_ADDRESS 0xd000d9e4 FORMAT "%9.4" /end MEASUREMENT
/begin MEASUREMENT Rf_tev_hs "" SWORD _CNV_R_R_Def_rf_sw__598_CM 1 100. -327.68 327.67 DISPLAY_IDENTIFIER RF_TEV_HS ECU_ADDRESS 0xd000d9e2 FORMAT "%9.4" /end MEASUREMENT
/begin MEASUREMENT Rk_opt_ist "" SWORD _CNV_R_R_Def_rk_sw__600_CM 1 100. -1600. 1599.9511 DISPLAY_IDENTIFIER RK_OPT_IST ECU_ADDRESS 0xd000dc26 FORMAT "%8.3" /end MEASUREMENT
/begin MEASUREMENT Rk_soll_kr "" SWORD _CNV_R_R_Def_rk_sw__600_CM 1 100. -1600. 1599.9511 DISPLAY_IDENTIFIER RK_SOLL_KR ECU_ADDRESS 0xd000d9e8 FORMAT "%8.3" /end MEASUREMENT
/begin MEASUREMENT Rt_bastat_h "Relative Zeit Homogen-Betrieb aktueller Motorlauf" UWORD _CNV_R_R_Def_f_uw_b_555_CM 1 100. 0. 99.9984 DISPLAY_IDENTIFIER RT_BASTAT_H ECU_ADDRESS 0xc0000dd0 FORMAT "%8.3" /end MEASUREMENT
/begin MEASUREMENT Rt_bastat_hs "Relative Zeit Homogen-Schicht- Betrieb aktueller Motorlauf" UWORD _CNV_R_R_Def_f_uw_b_555_CM 1 100. 0. 99.9984 DISPLAY_IDENTIFIER RT_BASTAT_HS ECU_ADDRESS 0xc0000dd2 FORMAT "%8.3" /end MEASUREMENT
/begin MEASUREMENT Rt_bastat_s "Relative Zeit Schicht-Betrieb aktueller Motorlauf" UWORD _CNV_R_R_Def_f_uw_b_555_CM 1 100. 0. 99.9984 DISPLAY_IDENTIFIER RT_BASTAT_S ECU_ADDRESS 0xc0000dd4 FORMAT "%8.3" /end MEASUREMENT
/begin MEASUREMENT Rt_bastat_sa "Relative Zeit Homogen-Betrieb aktueller Motorlauf" UWORD _CNV_R_R_Def_f_uw_b_555_CM 1 100. 0. 99.9984 DISPLAY_IDENTIFIER RT_BASTAT_SA ECU_ADDRESS 0xc0000dd6 FORMAT "%8.3" /end MEASUREMENT
/begin MEASUREMENT Rt_bastatg_h "Relative Zeit Homogen-Betrieb gesamter Motorlauf" UWORD _CNV_R_R_Def_f_uw_b_555_CM 1 100. 0. 99.9984 DISPLAY_IDENTIFIER RT_BASTATG_H ECU_ADDRESS 0xc0000dc8 FORMAT "%8.3" /end MEASUREMENT
/begin MEASUREMENT Rt_bastatg_hs "Relative Zeit Homogen-Schicht-Betrieb gesamter Motorlauf" UWORD _CNV_R_R_Def_f_uw_b_555_CM 1 100. 0. 99.9984 DISPLAY_IDENTIFIER RT_BASTATG_HS ECU_ADDRESS 0xc0000dca FORMAT "%8.3" /end MEASUREMENT
/begin MEASUREMENT Rt_bastatg_s "Relative Zeit Schicht-Betrieb gesamter Motorlauf" UWORD _CNV_R_R_Def_f_uw_b_555_CM 1 100. 0. 99.9984 DISPLAY_IDENTIFIER RT_BASTATG_S ECU_ADDRESS 0xc0000dcc FORMAT "%8.3" /end MEASUREMENT
/begin MEASUREMENT Rt_bastatg_sa "Relative Zeit Homogen-Betrieb gesamter Motorlauf" UWORD _CNV_R_R_Def_f_uw_b_555_CM 1 100. 0. 99.9984 DISPLAY_IDENTIFIER RT_BASTATG_SA ECU_ADDRESS 0xc0000dce FORMAT "%8.3" /end MEASUREMENT
/begin MEASUREMENT St_ba_agf "Statuswort fuer Umschaltung" UBYTE _CNV_R_R_Def_dez_sl_551_CM 1 100. 0. 255. DISPLAY_IDENTIFIER ST_BA_AGF ECU_ADDRESS 0xd000d9c5 FORMAT "%3.0" /end MEASUREMENT
/begin MEASUREMENT St_ba_agf.B_hstoech "Bedingung stoecheometrisches Verhaeltnis" UBYTE _CNV_S_2_Def_bit_ub_563_CM 1 100. 0. 1. DISPLAY_IDENTIFIER B_HSTOECH ECU_ADDRESS 0xd000d9c5 BIT_MASK 0x1 /end MEASUREMENT
/begin MEASUREMENT St_ba_agf.B_khmdoe_anf "Statuswort fuer Umschaltung" UBYTE _CNV_S_2_Def_bit_ub_563_CM 1 100. 0. 1. DISPLAY_IDENTIFIER B_KHMDOE_ANF ECU_ADDRESS 0xd000d9c5 BIT_MASK 0x2 /end MEASUREMENT
/begin MEASUREMENT St_bano "Verbote BA für Verbrennungsregelung" UBYTE _CNV_S_17_Def_brenn__704_CM 1 100. 0. 68. DISPLAY_IDENTIFIER ST_BANO ECU_ADDRESS 0xd000da2d BIT_MASK 0xFF /end MEASUREMENT
/begin MEASUREMENT St_bano_alt "Statuswort Betriebsartverbot alt" UBYTE _CNV_S_17_Def_brenn__704_CM 1 100. 0. 68. DISPLAY_IDENTIFIER ST_BANO_ALT ECU_ADDRESS 0xd000db5f BIT_MASK 0xFF /end MEASUREMENT
/begin MEASUREMENT St_bano_halt "Statuswort Betriebsartverbot gespeichert" UBYTE _CNV_S_17_Def_brenn__704_CM 1 100. 0. 68. DISPLAY_IDENTIFIER ST_BANO_HALT ECU_ADDRESS 0xd000db60 BIT_MASK 0xFF /end MEASUREMENT
/begin MEASUREMENT St_bano_neu "Statuswort Betriebsartverbot neu" UBYTE _CNV_S_17_Def_brenn__704_CM 1 100. 0. 68. DISPLAY_IDENTIFIER ST_BANO_NEU ECU_ADDRESS 0xd000db61 BIT_MASK 0xFF /end MEASUREMENT
/begin MEASUREMENT St_bano_prio "Statuswort Betriebsartenverbot Prio" UBYTE _CNV_S_17_Def_brenn__704_CM 1 100. 0. 68. DISPLAY_IDENTIFIER ST_BANO_PRIO ECU_ADDRESS 0xd000db62 BIT_MASK 0xFF /end MEASUREMENT
/begin MEASUREMENT St_baums "" UWORD _CNV_R_R_Def_dez_sl_551_CM 1 100. 0. 65535. DISPLAY_IDENTIFIER ST_BAUMS ECU_ADDRESS 0xd000da08 FORMAT "%5.0" /end MEASUREMENT
/begin MEASUREMENT St_baumsch "Statuswort" UBYTE _CNV_R_R_Def_dez_sl_551_CM 1 100. 0. 255. DISPLAY_IDENTIFIER ST_BAUMSCH ECU_ADDRESS 0xd000da20 FORMAT "%3.0" /end MEASUREMENT
/begin MEASUREMENT St_baumsch.B_ba_toggle "Anzeige Zustand Togglefunktion BA" UBYTE _CNV_S_2_Def_bit_ub_563_CM 1 100. 0. 1. DISPLAY_IDENTIFIER B_BA_TOGGLE ECU_ADDRESS 0xd000da20 BIT_MASK 0x4 /end MEASUREMENT
/begin MEASUREMENT St_baumsch.B_ba_toggletime "Anzeige Zustand Togglefunktion BA" UBYTE _CNV_S_2_Def_bit_ub_563_CM 1 100. 0. 1. DISPLAY_IDENTIFIER B_BA_TOGGLETIME ECU_ADDRESS 0xd000da20 BIT_MASK 0x8 /end MEASUREMENT
/begin MEASUREMENT St_baumsch.B_babr "Abbruchbedingung" UBYTE _CNV_S_2_Def_bit_ub_563_CM 1 100. 0. 1. DISPLAY_IDENTIFIER B_BABR ECU_ADDRESS 0xd000da20 BIT_MASK 0x1 /end MEASUREMENT
/begin MEASUREMENT St_baumsch.B_mdres_glll "Momentenreserve Gleichstellung Leerlauf" UBYTE _CNV_S_2_Def_bit_ub_563_CM 1 100. 0. 1. DISPLAY_IDENTIFIER B_MDRES_GLLL ECU_ADDRESS 0xd000da20 BIT_MASK 0x10 /end MEASUREMENT
/begin MEASUREMENT St_bawu "Statuswort BAWU" UBYTE _CNV_S_17_Def_brenn__704_CM 1 100. 0. 68. DISPLAY_IDENTIFIER ST_BAWU ECU_ADDRESS 0xd000d9dc BIT_MASK 0xFF /end MEASUREMENT
/begin MEASUREMENT St_bvist "Statuswort BVIST" UBYTE _CNV_S_17_Def_brenn__704_CM 1 100. 0. 68. DISPLAY_IDENTIFIER ST_BVIST ECU_ADDRESS 0xd000d9d9 BIT_MASK 0xFF /end MEASUREMENT
/begin MEASUREMENT St_bvso "Statuswort BVIST" UBYTE _CNV_S_17_Def_brenn__704_CM 1 100. 0. 68. DISPLAY_IDENTIFIER ST_BVSO ECU_ADDRESS 0xd000d9da BIT_MASK 0xFF /end MEASUREMENT
/begin MEASUREMENT St_bvums "Statuswort BVUMS" UBYTE _CNV_S_17_Def_brenn__704_CM 1 100. 0. 68. DISPLAY_IDENTIFIER ST_BVUMS ECU_ADDRESS 0xd000d9db BIT_MASK 0xFF /end MEASUREMENT
/begin MEASUREMENT St_disa_bmw "Statuswort fuer DISA" UBYTE _CNV_R_R_Def_dez_sl_551_CM 1 100. 0. 255. DISPLAY_IDENTIFIER ST_DISA_BMW ECU_ADDRESS 0xd000d9c1 FORMAT "%3.0" /end MEASUREMENT
/begin MEASUREMENT St_disa_bmw.B_disa_stopp "Bedingung DISA abschalten" UBYTE _CNV_S_2_Def_bit_ub_563_CM 1 100. 0. 1. DISPLAY_IDENTIFIER B_DISA_STOPP ECU_ADDRESS 0xd000d9c1 BIT_MASK 0x1 /end MEASUREMENT
/begin MEASUREMENT St_dknot "Statuswort DK-Notlauf" UBYTE _CNV_R_R_Def_dez_sl_551_CM 1 100. 0. 255. DISPLAY_IDENTIFIER ST_DKNOT ECU_ADDRESS 0xd000d9d4 FORMAT "%3.0" /end MEASUREMENT
/begin MEASUREMENT St_dknot.B_vvt_dknotl "Statuswort DK-Notlauf" UBYTE _CNV_S_2_Def_bit_ub_563_CM 1 100. 0. 1. DISPLAY_IDENTIFIER B_VVT_DKNOTL ECU_ADDRESS 0xd000d9d4 BIT_MASK 0x1 /end MEASUREMENT
/begin MEASUREMENT St_dps "Statuswort" UBYTE _CNV_R_R_Def_dez_sl_551_CM 1 100. 0. 255. DISPLAY_IDENTIFIER ST_DPS ECU_ADDRESS 0xd000da21 FORMAT "%3.0" /end MEASUREMENT
/begin MEASUREMENT St_dps.B_dpsadp "Bedingung Druckadaption freigegeben" UBYTE _CNV_S_2_Def_bit_ub_563_CM 1 100. 0. 1. DISPLAY_IDENTIFIER B_DPSADP ECU_ADDRESS 0xd000da21 BIT_MASK 0x8 /end MEASUREMENT
/begin MEASUREMENT St_dps.B_gd "Bedingung gedrosselt" UBYTE _CNV_S_2_Def_bit_ub_563_CM 1 100. 0. 1. DISPLAY_IDENTIFIER B_GD ECU_ADDRESS 0xd000da21 BIT_MASK 0x2 /end MEASUREMENT
/begin MEASUREMENT St_dps.B_gdst "Bedingung gedrosselterStart" UBYTE _CNV_S_2_Def_bit_ub_563_CM 1 100. 0. 1. DISPLAY_IDENTIFIER B_GDST ECU_ADDRESS 0xd000da21 BIT_MASK 0x1 /end MEASUREMENT
/begin MEASUREMENT St_dps.B_gdvhub "Bedingung gedrosselt Vollhub" UBYTE _CNV_S_2_Def_bit_ub_563_CM 1 100. 0. 1. DISPLAY_IDENTIFIER B_GDVHUB ECU_ADDRESS 0xd000da21 BIT_MASK 0x4 /end MEASUREMENT
/begin MEASUREMENT St_fw "Status Momentenreserve" UBYTE _CNV_R_R_Def_dez_sl_551_CM 1 100. 0. 255. DISPLAY_IDENTIFIER ST_FW ECU_ADDRESS 0xd000dbdc FORMAT "%3.0" /end MEASUREMENT
/begin MEASUREMENT St_fw.B_hschalt_komb "Status Momentenreserve" UBYTE _CNV_S_2_Def_bit_ub_563_CM 1 100. 0. 1. DISPLAY_IDENTIFIER B_HSCHALT_KOMB ECU_ADDRESS 0xd000dbdc BIT_MASK 0x20 /end MEASUREMENT
/begin MEASUREMENT St_fw.B_kupp_extalt "Status Momentenreserve" UBYTE _CNV_S_2_Def_bit_ub_563_CM 1 100. 0. 1. DISPLAY_IDENTIFIER B_KUPP_EXTALT ECU_ADDRESS 0xd000dbdc BIT_MASK 0x4 /end MEASUREMENT
/begin MEASUREMENT St_fw.B_ldm_akt04 "Status Momentenreserve" UBYTE _CNV_S_2_Def_bit_ub_563_CM 1 100. 0. 1. DISPLAY_IDENTIFIER B_LDM_AKT04 ECU_ADDRESS 0xd000dbdc BIT_MASK 0x1 /end MEASUREMENT
/begin MEASUREMENT St_fw.B_ldm_off "Status Momentenreserve" UBYTE _CNV_S_2_Def_bit_ub_563_CM 1 100. 0. 1. DISPLAY_IDENTIFIER B_LDM_OFF ECU_ADDRESS 0xd000dbdc BIT_MASK 0x8 /end MEASUREMENT
/begin MEASUREMENT St_fw.B_ldm_offhs "Status Momentenreserve" UBYTE _CNV_S_2_Def_bit_ub_563_CM 1 100. 0. 1. DISPLAY_IDENTIFIER B_LDM_OFFHS ECU_ADDRESS 0xd000dbdc BIT_MASK 0x80 /end MEASUREMENT
/begin MEASUREMENT St_fw.B_ldm_offreg "Status Momentenreserve" UBYTE _CNV_S_2_Def_bit_ub_563_CM 1 100. 0. 1. DISPLAY_IDENTIFIER B_LDM_OFFREG ECU_ADDRESS 0xd000dbdc BIT_MASK 0x2 /end MEASUREMENT
/begin MEASUREMENT St_fw.B_ldm_offrs "Status Momentenreserve" UBYTE _CNV_S_2_Def_bit_ub_563_CM 1 100. 0. 1. DISPLAY_IDENTIFIER B_LDM_OFFRS ECU_ADDRESS 0xd000dbdc BIT_MASK 0x40 /end MEASUREMENT
/begin MEASUREMENT St_fw.B_rschalt_komb "Status Momentenreserve" UBYTE _CNV_S_2_Def_bit_ub_563_CM 1 100. 0. 1. DISPLAY_IDENTIFIER B_RSCHALT_KOMB ECU_ADDRESS 0xd000dbdc BIT_MASK 0x10 /end MEASUREMENT
/begin MEASUREMENT St_fw1 "Status Momentenreserve" UBYTE _CNV_R_R_Def_dez_sl_551_CM 1 100. 0. 255. DISPLAY_IDENTIFIER ST_FW1 ECU_ADDRESS 0xd000dbdd FORMAT "%3.0" /end MEASUREMENT
/begin MEASUREMENT St_fw1.B_nschalt_akt "Status Momentenreserve" UBYTE _CNV_S_2_Def_bit_ub_563_CM 1 100. 0. 1. DISPLAY_IDENTIFIER B_NSCHALT_AKT ECU_ADDRESS 0xd000dbdd BIT_MASK 0x1 /end MEASUREMENT
/begin MEASUREMENT St_fw1.B_nschalt_aktalt "Status Momentenreserve" UBYTE _CNV_S_2_Def_bit_ub_563_CM 1 100. 0. 1. DISPLAY_IDENTIFIER B_NSCHALT_AKTALT ECU_ADDRESS 0xd000dbdd BIT_MASK 0x2 /end MEASUREMENT
/begin MEASUREMENT St_kath_ena "Statuswort" UBYTE _CNV_R_R_Def_dez_sl_551_CM 1 100. 0. 255. DISPLAY_IDENTIFIER ST_KATH_ENA ECU_ADDRESS 0xd000da22 FORMAT "%3.0" /end MEASUREMENT
/begin MEASUREMENT St_kath_ena.B_hsplit_ena "Bedingung Homogensplit möglich" UBYTE _CNV_S_2_Def_bit_ub_563_CM 1 100. 0. 1. DISPLAY_IDENTIFIER B_HSPLIT_ENA ECU_ADDRESS 0xd000da22 BIT_MASK 0x8 /end MEASUREMENT
/begin MEASUREMENT St_kath_ena.B_nesps_ena "Bedingung Nacheinspritzung Schicht möglich" UBYTE _CNV_S_2_Def_bit_ub_563_CM 1 100. 0. 1. DISPLAY_IDENTIFIER B_NESPS_ENA ECU_ADDRESS 0xd000da22 BIT_MASK 0x2 /end MEASUREMENT
/begin MEASUREMENT St_kath_ena.B_verb_h "Bedingung Verbot  Homogen" UBYTE _CNV_S_2_Def_bit_ub_563_CM 1 100. 0. 1. DISPLAY_IDENTIFIER B_VERB_H ECU_ADDRESS 0xd000da22 BIT_MASK 0x4 /end MEASUREMENT
/begin MEASUREMENT St_kath_ena.B_verb_s "Bedingung Verbot  Schicht" UBYTE _CNV_S_2_Def_bit_ub_563_CM 1 100. 0. 1. DISPLAY_IDENTIFIER B_VERB_S ECU_ADDRESS 0xd000da22 BIT_MASK 0x1 /end MEASUREMENT
/begin MEASUREMENT St_khaktiv "Statuswort" UBYTE _CNV_R_R_Def_dez_sl_551_CM 1 100. 0. 255. DISPLAY_IDENTIFIER ST_KHAKTIV ECU_ADDRESS 0xd000da23 FORMAT "%3.0" /end MEASUREMENT
/begin MEASUREMENT St_khaktiv.B_khaktiv_h "Bedingung Katheizen Homogen" UBYTE _CNV_S_2_Def_bit_ub_563_CM 1 100. 0. 1. DISPLAY_IDENTIFIER B_KHAKTIV_H ECU_ADDRESS 0xd000da23 BIT_MASK 0x1 /end MEASUREMENT
/begin MEASUREMENT St_khaktiv.B_khaktiv_s "Bedingung Katheizen Homogen" UBYTE _CNV_S_2_Def_bit_ub_563_CM 1 100. 0. 1. DISPLAY_IDENTIFIER B_KHAKTIV_S ECU_ADDRESS 0xd000da23 BIT_MASK 0x2 /end MEASUREMENT
/begin MEASUREMENT St_ldm_chk "" UBYTE _CNV_R_R_Def_dez_sl_551_CM 1 100. 0. 255. DISPLAY_IDENTIFIER ST_LDM_CHK ECU_ADDRESS 0xd000dbaf FORMAT "%3.0" /end MEASUREMENT
/begin MEASUREMENT St_ldm_init "" UBYTE _CNV_R_R_Def_dez_sl_551_CM 1 100. 0. 255. DISPLAY_IDENTIFIER ST_LDM_INIT ECU_ADDRESS 0xd000dbb1 FORMAT "%3.0" /end MEASUREMENT
/begin MEASUREMENT St_ldm_off "" UBYTE _CNV_R_R_Def_dez_sl_551_CM 1 100. 0. 255. DISPLAY_IDENTIFIER ST_LDM_OFF ECU_ADDRESS 0xd000dbb0 FORMAT "%3.0" /end MEASUREMENT
/begin MEASUREMENT St_mdba_msa "Statuswort" UBYTE _CNV_R_R_Def_dez_sl_551_CM 1 100. 0. 255. DISPLAY_IDENTIFIER ST_MDBA_MSA ECU_ADDRESS 0xd000da24 FORMAT "%3.0" /end MEASUREMENT
/begin MEASUREMENT St_mdba_msa.B_msav_gl "Bit MSA Verbot bei Gleichstellung" UBYTE _CNV_S_2_Def_bit_ub_563_CM 1 100. 0. 1. DISPLAY_IDENTIFIER B_MSAV_GL ECU_ADDRESS 0xd000da24 BIT_MASK 0x1 /end MEASUREMENT
/begin MEASUREMENT St_mdbafak "Statuswort MDBAFAK" UBYTE _CNV_R_R_Def_dez_sl_551_CM 1 100. 0. 255. DISPLAY_IDENTIFIER ST_MDBAFAK ECU_ADDRESS 0xd000d9c2 FORMAT "%3.0" /end MEASUREMENT
/begin MEASUREMENT St_mdbafak.B_hmm_akt "Bedingung homogen mager aktiv" UBYTE _CNV_S_2_Def_bit_ub_563_CM 1 100. 0. 1. DISPLAY_IDENTIFIER B_HMM_AKT ECU_ADDRESS 0xd000d9c2 BIT_MASK 0x40 /end MEASUREMENT
/begin MEASUREMENT St_mdbafak.B_hom_akt "Bedingung Berechnung Homogen aktiv" UBYTE _CNV_S_2_Def_bit_ub_563_CM 1 100. 0. 1. DISPLAY_IDENTIFIER B_HOM_AKT ECU_ADDRESS 0xd000d9c2 BIT_MASK 0x2 /end MEASUREMENT
/begin MEASUREMENT St_mdbafak.B_hschicht "Statuswort MDBAFAK" UBYTE _CNV_S_2_Def_bit_ub_563_CM 1 100. 0. 1. DISPLAY_IDENTIFIER B_HSCHICHT ECU_ADDRESS 0xd000d9c2 BIT_MASK 0x80 /end MEASUREMENT
/begin MEASUREMENT St_mdbafak.B_la_stopp "Bedingung Lambdaregler ausschalten" UBYTE _CNV_S_2_Def_bit_ub_563_CM 1 100. 0. 1. DISPLAY_IDENTIFIER B_LA_STOPP ECU_ADDRESS 0xd000d9c2 BIT_MASK 0x10 /end MEASUREMENT
/begin MEASUREMENT St_mdbafak.B_la_stopp1 "Bedingung Lambdaregler  Bank1 ausschalten" UBYTE _CNV_S_2_Def_bit_ub_563_CM 1 100. 0. 1. DISPLAY_IDENTIFIER B_LA_STOPP1 ECU_ADDRESS 0xd000d9c2 BIT_MASK 0x8 /end MEASUREMENT
/begin MEASUREMENT St_mdbafak.B_la_stopp2 "Bedingung Lambdaregler Bank2 ausschalten" UBYTE _CNV_S_2_Def_bit_ub_563_CM 1 100. 0. 1. DISPLAY_IDENTIFIER B_LA_STOPP2 ECU_ADDRESS 0xd000d9c2 BIT_MASK 0x20 /end MEASUREMENT
/begin MEASUREMENT St_mdbafak.B_sch_akt "Bedingung Berechnung Schicht aktiv" UBYTE _CNV_S_2_Def_bit_ub_563_CM 1 100. 0. 1. DISPLAY_IDENTIFIER B_SCH_AKT ECU_ADDRESS 0xd000d9c2 BIT_MASK 0x4 /end MEASUREMENT
/begin MEASUREMENT St_mdbafak.B_schicht "Bedingung Schichtbetrieb aktiv" UBYTE _CNV_S_2_Def_bit_ub_563_CM 1 100. 0. 1. DISPLAY_IDENTIFIER B_SCHICHT ECU_ADDRESS 0xd000d9c2 BIT_MASK 0x1 /end MEASUREMENT
/begin MEASUREMENT St_mdbafak2 "Statuswort MDBAFAK2" UBYTE _CNV_R_R_Def_dez_sl_551_CM 1 100. 0. 255. DISPLAY_IDENTIFIER ST_MDBAFAK2 ECU_ADDRESS 0xd000d9c3 FORMAT "%3.0" /end MEASUREMENT
/begin MEASUREMENT St_mdbafak2.B_ba_um "Bedingung BA-Umschaltung" UBYTE _CNV_S_2_Def_bit_ub_563_CM 1 100. 0. 1. DISPLAY_IDENTIFIER B_BA_UM ECU_ADDRESS 0xd000d9c3 BIT_MASK 0x8 /end MEASUREMENT
/begin MEASUREMENT St_mdbafak2.B_mdres_rgn "-" UBYTE _CNV_S_2_Def_bit_ub_563_CM 1 100. 0. 1. DISPLAY_IDENTIFIER B_MDRES_RGN ECU_ADDRESS 0xd000d9c3 BIT_MASK 0x80 /end MEASUREMENT
/begin MEASUREMENT St_mdbafak2.B_tev_quitt "Bedingung Quittung TEV" UBYTE _CNV_S_2_Def_bit_ub_563_CM 1 100. 0. 1. DISPLAY_IDENTIFIER B_TEV_QUITT ECU_ADDRESS 0xd000d9c3 BIT_MASK 0x1 /end MEASUREMENT
/begin MEASUREMENT St_mdbafak2.B_tev_stopp "Bedingung schliessen TEV angefordert" UBYTE _CNV_S_2_Def_bit_ub_563_CM 1 100. 0. 1. DISPLAY_IDENTIFIER B_TEV_STOPP ECU_ADDRESS 0xd000d9c3 BIT_MASK 0x20 /end MEASUREMENT
/begin MEASUREMENT St_mdbafak2.B_zwbaw "Zündwinkelfreigabe durch Betriebsartenwechsel" UBYTE _CNV_S_2_Def_bit_ub_563_CM 1 100. 0. 1. DISPLAY_IDENTIFIER B_ZWBAW ECU_ADDRESS 0xd000d9c3 BIT_MASK 0x40 /end MEASUREMENT
/begin MEASUREMENT St_mdbafak3 "Statuswort MDBAFAK3" UBYTE _CNV_R_R_Def_dez_sl_551_CM 1 100. 0. 255. DISPLAY_IDENTIFIER ST_MDBAFAK3 ECU_ADDRESS 0xd000d9c4 FORMAT "%3.0" /end MEASUREMENT
/begin MEASUREMENT St_mdbafak3.B_baums_akt "Statuswort MDBAFAK3" UBYTE _CNV_S_2_Def_bit_ub_563_CM 1 100. 0. 1. DISPLAY_IDENTIFIER B_BAUMS_AKT ECU_ADDRESS 0xd000d9c4 BIT_MASK 0x10 /end MEASUREMENT
/begin MEASUREMENT St_mdbafak3.B_quit_baw "Quittung aus Ist-Betriebsart" UBYTE _CNV_S_2_Def_bit_ub_563_CM 1 100. 0. 1. DISPLAY_IDENTIFIER B_QUIT_BAW ECU_ADDRESS 0xd000d9c4 BIT_MASK 0x1 /end MEASUREMENT
/begin MEASUREMENT St_mdbafak3.B_sbaums_akt "Subbetriebsartenumschatlung aktiv" UBYTE _CNV_S_2_Def_bit_ub_563_CM 1 100. 0. 1. DISPLAY_IDENTIFIER B_SBAUMS_AKT ECU_ADDRESS 0xd000d9c4 BIT_MASK 0x2 /end MEASUREMENT
/begin MEASUREMENT St_mdbafak3.B_sbaums_ea "Statuswort MDBAFAK3" UBYTE _CNV_S_2_Def_bit_ub_563_CM 1 100. 0. 1. DISPLAY_IDENTIFIER B_SBAUMS_EA ECU_ADDRESS 0xd000d9c4 BIT_MASK 0x4 /end MEASUREMENT
/begin MEASUREMENT St_mdbafak3.B_sbaums_fail "Statuswort MDBAFAK3" UBYTE _CNV_S_2_Def_bit_ub_563_CM 1 100. 0. 1. DISPLAY_IDENTIFIER B_SBAUMS_FAIL ECU_ADDRESS 0xd000d9c4 BIT_MASK 0x8 /end MEASUREMENT
/begin MEASUREMENT St_mdbafast "Statuswort" UBYTE _CNV_R_R_Def_dez_sl_551_CM 1 100. 0. 255. DISPLAY_IDENTIFIER ST_MDBAFAST ECU_ADDRESS 0xd000da25 FORMAT "%3.0" /end MEASUREMENT
/begin MEASUREMENT St_mdbafast.B_beopt_aus "Bedingung verbrauchsoptimierte Umschaltung aus" UBYTE _CNV_S_2_Def_bit_ub_563_CM 1 100. 0. 1. DISPLAY_IDENTIFIER B_BEOPT_AUS ECU_ADDRESS 0xd000da25 BIT_MASK 0x2 /end MEASUREMENT
/begin MEASUREMENT St_mdbafast.B_priov_haeng "Bedingung Prio hängt durch Verbot" UBYTE _CNV_S_2_Def_bit_ub_563_CM 1 100. 0. 1. DISPLAY_IDENTIFIER B_PRIOV_HAENG ECU_ADDRESS 0xd000da25 BIT_MASK 0x4 /end MEASUREMENT
/begin MEASUREMENT St_mdbafast.B_ums_fast "Bedingung beschleunigte Umschaltung angefordert" UBYTE _CNV_S_2_Def_bit_ub_563_CM 1 100. 0. 1. DISPLAY_IDENTIFIER B_UMS_FAST ECU_ADDRESS 0xd000da25 BIT_MASK 0x1 /end MEASUREMENT
/begin MEASUREMENT St_mdbanl "Statuswort" UBYTE _CNV_R_R_Def_dez_sl_551_CM 1 100. 0. 255. DISPLAY_IDENTIFIER ST_MDBANL ECU_ADDRESS 0xd000e0a8 FORMAT "%3.0" /end MEASUREMENT
/begin MEASUREMENT St_mdbanl.B_agrzu_nl "Bedingung AGR schliessen aus Notlaufmanager" UBYTE _CNV_S_2_Def_bit_ub_563_CM 1 100. 0. 1. DISPLAY_IDENTIFIER B_AGRZU_NL ECU_ADDRESS 0xd000e0a8 BIT_MASK 0x10 /end MEASUREMENT
/begin MEASUREMENT St_mdbanl.B_disa_nl "Bedingung DISA schliessen aus Notlaufmanager" UBYTE _CNV_S_2_Def_bit_ub_563_CM 1 100. 0. 1. DISPLAY_IDENTIFIER B_DISA_NL ECU_ADDRESS 0xd000e0a8 BIT_MASK 0x20 /end MEASUREMENT
/begin MEASUREMENT St_mdbanl.B_evvt_vsa_nl "Bedinung Notlauf Vanos Auslassventil" UBYTE _CNV_S_2_Def_bit_ub_563_CM 1 100. 0. 1. DISPLAY_IDENTIFIER B_EVVT_VSA_NL ECU_ADDRESS 0xd000e0a8 BIT_MASK 0x2 /end MEASUREMENT
/begin MEASUREMENT St_mdbanl.B_evvt_vse_nl "Bedingung Vanos Notlauf Einlassventil" UBYTE _CNV_S_2_Def_bit_ub_563_CM 1 100. 0. 1. DISPLAY_IDENTIFIER B_EVVT_VSE_NL ECU_ADDRESS 0xd000e0a8 BIT_MASK 0x1 /end MEASUREMENT
/begin MEASUREMENT St_mdbanl.B_lastopp_nl "edingung Stopp Lambdaregler aus Notlaufmanager" UBYTE _CNV_S_2_Def_bit_ub_563_CM 1 100. 0. 1. DISPLAY_IDENTIFIER B_LASTOPP_NL ECU_ADDRESS 0xd000e0a8 BIT_MASK 0x4 /end MEASUREMENT
/begin MEASUREMENT St_mdbanl.B_tevzu_nl "Bedingung TEV schliessen aus Notlaufmanager" UBYTE _CNV_S_2_Def_bit_ub_563_CM 1 100. 0. 1. DISPLAY_IDENTIFIER B_TEVZU_NL ECU_ADDRESS 0xd000e0a8 BIT_MASK 0x8 /end MEASUREMENT
/begin MEASUREMENT St_mdbanl.B_wesb1h_nl "Bedingung Winkeleinspritzbeginn 1 Einspritzung homogen aus Notlaufmanager" UBYTE _CNV_S_2_Def_bit_ub_563_CM 1 100. 0. 1. DISPLAY_IDENTIFIER B_WESB1H_NL ECU_ADDRESS 0xd000e0a8 BIT_MASK 0x80 /end MEASUREMENT
/begin MEASUREMENT St_mdbanl.B_zw_nl "Bedingung Zündwinkel aus Notlaufmanager" UBYTE _CNV_S_2_Def_bit_ub_563_CM 1 100. 0. 1. DISPLAY_IDENTIFIER B_ZW_NL ECU_ADDRESS 0xd000e0a8 BIT_MASK 0x40 /end MEASUREMENT
/begin MEASUREMENT St_mdbanl2 "Statuswort" UBYTE _CNV_R_R_Def_dez_sl_551_CM 1 100. 0. 255. DISPLAY_IDENTIFIER ST_MDBANL2 ECU_ADDRESS 0xd000e0a9 FORMAT "%3.0" /end MEASUREMENT
/begin MEASUREMENT St_mdbanl2.B_gl_ernl "Bedingung" UBYTE _CNV_S_2_Def_bit_ub_563_CM 1 100. 0. 1. DISPLAY_IDENTIFIER B_GL_ERNL ECU_ADDRESS 0xd000e0a9 BIT_MASK 0x2 /end MEASUREMENT
/begin MEASUREMENT St_mdbanl2.B_gl_lanl "Bedingung" UBYTE _CNV_S_2_Def_bit_ub_563_CM 1 100. 0. 1. DISPLAY_IDENTIFIER B_GL_LANL ECU_ADDRESS 0xd000e0a9 BIT_MASK 0x8 /end MEASUREMENT
/begin MEASUREMENT St_mdbanl2.B_gl_zilnl "Bedingung " UBYTE _CNV_S_2_Def_bit_ub_563_CM 1 100. 0. 1. DISPLAY_IDENTIFIER B_GL_ZILNL ECU_ADDRESS 0xd000e0a9 BIT_MASK 0x4 /end MEASUREMENT
/begin MEASUREMENT St_mdbanl2.B_prail_nl "Bedingung Notlauf Raildruck" UBYTE _CNV_S_2_Def_bit_ub_563_CM 1 100. 0. 1. DISPLAY_IDENTIFIER B_PRAIL_NL ECU_ADDRESS 0xd000e0a9 BIT_MASK 0x10 /end MEASUREMENT
/begin MEASUREMENT St_mdbanl2.B_vdoe_nl "Bedingung Verbot Doppeleinspritzung aus Notlaufmanager" UBYTE _CNV_S_2_Def_bit_ub_563_CM 1 100. 0. 1. DISPLAY_IDENTIFIER B_VDOE_NL ECU_ADDRESS 0xd000e0a9 BIT_MASK 0x1 /end MEASUREMENT
/begin MEASUREMENT St_mdbanl3 "Statuswort" UBYTE _CNV_R_R_Def_dez_sl_551_CM 1 100. 0. 255. DISPLAY_IDENTIFIER ST_MDBANL3 ECU_ADDRESS 0xd000e0aa FORMAT "%3.0" /end MEASUREMENT
/begin MEASUREMENT St_mdbanl3.B_evdiag_b1 "Einlassventildiagnosefehler Bank1" UBYTE _CNV_S_2_Def_bit_ub_563_CM 1 100. 0. 1. DISPLAY_IDENTIFIER B_EVDIAG_B1 ECU_ADDRESS 0xd000e0aa BIT_MASK 0x1 /end MEASUREMENT
/begin MEASUREMENT St_mdbanl3.B_evdiag_b2 "Einlassventildiagnosefehler Bank2" UBYTE _CNV_S_2_Def_bit_ub_563_CM 1 100. 0. 1. DISPLAY_IDENTIFIER B_EVDIAG_B2 ECU_ADDRESS 0xd000e0aa BIT_MASK 0x2 /end MEASUREMENT
/begin MEASUREMENT St_mdbanl3.B_evvt_vsa "Bedingung Notlauf Vanos Auslassventil" UBYTE _CNV_S_2_Def_bit_ub_563_CM 1 100. 0. 1. DISPLAY_IDENTIFIER B_EVVT_VSA ECU_ADDRESS 0xd000e0aa BIT_MASK 0x4 /end MEASUREMENT
/begin MEASUREMENT St_mdbanl3.B_evvt_vse "Bedingung Notlauf Vanos Einlassventil" UBYTE _CNV_S_2_Def_bit_ub_563_CM 1 100. 0. 1. DISPLAY_IDENTIFIER B_EVVT_VSE ECU_ADDRESS 0xd000e0aa BIT_MASK 0x8 /end MEASUREMENT
/begin MEASUREMENT St_mdbanl3.B_fi_agr "Bedingung Fehlerindices AGR" UBYTE _CNV_S_2_Def_bit_ub_563_CM 1 100. 0. 1. DISPLAY_IDENTIFIER B_FI_AGR ECU_ADDRESS 0xd000e0aa BIT_MASK 0x10 /end MEASUREMENT
/begin MEASUREMENT St_mdbanl3.B_fi_agrfs "Bedingung Fehlerspeicherabfrage AGR" UBYTE _CNV_S_2_Def_bit_ub_563_CM 1 100. 0. 1. DISPLAY_IDENTIFIER B_FI_AGRFS ECU_ADDRESS 0xd000e0aa BIT_MASK 0x20 /end MEASUREMENT
/begin MEASUREMENT St_mdbanl3.B_fi_agrsens "Bedingung Fehlerspeicherabfrage AGR" UBYTE _CNV_S_2_Def_bit_ub_563_CM 1 100. 0. 1. DISPLAY_IDENTIFIER B_FI_AGRSENS ECU_ADDRESS 0xd000e0aa BIT_MASK 0x40 /end MEASUREMENT
/begin MEASUREMENT St_mdbanl3.B_mdmax_notl "Bedinung Maximales Moment Notlauf" UBYTE _CNV_S_2_Def_bit_ub_563_CM 1 100. 0. 1. DISPLAY_IDENTIFIER B_MDMAX_NOTL ECU_ADDRESS 0xd000e0aa BIT_MASK 0x80 /end MEASUREMENT
/begin MEASUREMENT St_mdbanl4 "Statuswort" UBYTE _CNV_R_R_Def_dez_sl_551_CM 1 100. 0. 255. DISPLAY_IDENTIFIER ST_MDBANL4 ECU_ADDRESS 0xd000e0ab FORMAT "%3.0" /end MEASUREMENT
/begin MEASUREMENT St_mdbanl4.B_nkw_prail "Bedingung Drehzahl Raildruck" UBYTE _CNV_S_2_Def_bit_ub_563_CM 1 100. 0. 1. DISPLAY_IDENTIFIER B_NKW_PRAIL ECU_ADDRESS 0xd000e0ab BIT_MASK 0x1 /end MEASUREMENT
/begin MEASUREMENT St_mdbanl4.B_nl10_agrauf "Bedingung Notlauf Agrauf" UBYTE _CNV_S_2_Def_bit_ub_563_CM 1 100. 0. 1. DISPLAY_IDENTIFIER B_NL10_AGRAUF ECU_ADDRESS 0xd000e0ab BIT_MASK 0x2 /end MEASUREMENT
/begin MEASUREMENT St_mdbanl4.B_nl11_agrzu "Bedingung Notlauf Agrzu" UBYTE _CNV_S_2_Def_bit_ub_563_CM 1 100. 0. 1. DISPLAY_IDENTIFIER B_NL11_AGRZU ECU_ADDRESS 0xd000e0ab BIT_MASK 0x4 /end MEASUREMENT
/begin MEASUREMENT St_mdbanl4.B_nl9_tev "Bedingung Notlauf TEV" UBYTE _CNV_S_2_Def_bit_ub_563_CM 1 100. 0. 1. DISPLAY_IDENTIFIER B_NL9_TEV ECU_ADDRESS 0xd000e0ab BIT_MASK 0x80 /end MEASUREMENT
/begin MEASUREMENT St_mdbanl4.B_nldgh "Bedingung Notlauf" UBYTE _CNV_S_2_Def_bit_ub_563_CM 1 100. 0. 1. DISPLAY_IDENTIFIER B_NLDGH ECU_ADDRESS 0xd000e0ab BIT_MASK 0x8 /end MEASUREMENT
/begin MEASUREMENT St_mdbanl4.B_nmax_mager "Bedingung Maximale Drehzahlbergrenzung bei Magerbetrieb" UBYTE _CNV_S_2_Def_bit_ub_563_CM 1 100. 0. 1. DISPLAY_IDENTIFIER B_NMAX_MAGER ECU_ADDRESS 0xd000e0ab BIT_MASK 0x10 /end MEASUREMENT
/begin MEASUREMENT St_mdbanl4.B_notl3 "Bedingung Notlauf 3" UBYTE _CNV_S_2_Def_bit_ub_563_CM 1 100. 0. 1. DISPLAY_IDENTIFIER B_NOTL3 ECU_ADDRESS 0xd000e0ab BIT_MASK 0x20 /end MEASUREMENT
/begin MEASUREMENT St_mdbanl4.B_pos_agrzu "Bedingung AGR zu" UBYTE _CNV_S_2_Def_bit_ub_563_CM 1 100. 0. 1. DISPLAY_IDENTIFIER B_POS_AGRZU ECU_ADDRESS 0xd000e0ab BIT_MASK 0x40 /end MEASUREMENT
/begin MEASUREMENT St_mdbaprio "Statuswort" UBYTE _CNV_R_R_Def_dez_sl_551_CM 1 100. 0. 255. DISPLAY_IDENTIFIER ST_MDBAPRIO ECU_ADDRESS 0xd000da26 FORMAT "%3.0" /end MEASUREMENT
/begin MEASUREMENT St_mdbaprio.B_anfll_komf "Bit Anforderung Leerlaufkomfort" UBYTE _CNV_S_2_Def_bit_ub_563_CM 1 100. 0. 1. DISPLAY_IDENTIFIER B_ANFLL_KOMF ECU_ADDRESS 0xd000da26 BIT_MASK 0x20 /end MEASUREMENT
/begin MEASUREMENT St_mdbaprio.B_bastat_gee "Betriebsartstatistik Gesamtmotorlauf aktiviert" UBYTE _CNV_S_2_Def_bit_ub_563_CM 1 100. 0. 1. DISPLAY_IDENTIFIER B_BASTAT_GEE ECU_ADDRESS 0xd000da26 BIT_MASK 0x2 /end MEASUREMENT
/begin MEASUREMENT St_mdbaprio.B_bastat_mle "Betriebsartstatistik aktueller Motorlauf aktiviert" UBYTE _CNV_S_2_Def_bit_ub_563_CM 1 100. 0. 1. DISPLAY_IDENTIFIER B_BASTAT_MLE ECU_ADDRESS 0xd000da26 BIT_MASK 0x1 /end MEASUREMENT
/begin MEASUREMENT St_mdbaprio.B_dghaeumsrst "Reset Diagnose hängende Umschaltung" UBYTE _CNV_S_2_Def_bit_ub_563_CM 1 100. 0. 1. DISPLAY_IDENTIFIER B_DGHAEUMSRST ECU_ADDRESS 0xd000da26 BIT_MASK 0x40 /end MEASUREMENT
/begin MEASUREMENT St_mdbaprio.B_katreganf "Katregeneration angefordert" UBYTE _CNV_S_2_Def_bit_ub_563_CM 1 100. 0. 1. DISPLAY_IDENTIFIER B_KATREGANF ECU_ADDRESS 0xd000da26 BIT_MASK 0x4 /end MEASUREMENT
/begin MEASUREMENT St_mdbaprio.B_mhauf_anf "Bit Anforderung Motorhaube auf" UBYTE _CNV_S_2_Def_bit_ub_563_CM 1 100. 0. 1. DISPLAY_IDENTIFIER B_MHAUF_ANF ECU_ADDRESS 0xd000da26 BIT_MASK 0x10 /end MEASUREMENT
/begin MEASUREMENT St_mdbaprio.B_mhauf_plaus "Bedingung Motorhaube auf plausibel" UBYTE _CNV_S_2_Def_bit_ub_563_CM 1 100. 0. 1. DISPLAY_IDENTIFIER B_MHAUF_PLAUS ECU_ADDRESS 0xd000da26 BIT_MASK 0x8 /end MEASUREMENT
/begin MEASUREMENT St_mdbaschalt "Status" UBYTE _CNV_R_R_Def_dez_sl_551_CM 1 100. 0. 255. DISPLAY_IDENTIFIER ST_MDBASCHALT ECU_ADDRESS 0xd000db68 FORMAT "%3.0" /end MEASUREMENT
/begin MEASUREMENT St_mdbaschalt.B_mdibaskor "Basismoment wird über Momentenreserve korrigiert" UBYTE _CNV_S_2_Def_bit_ub_563_CM 1 100. 0. 1. DISPLAY_IDENTIFIER B_MDIBASKOR ECU_ADDRESS 0xd000db68 BIT_MASK 0x80 /end MEASUREMENT
/begin MEASUREMENT St_mdbaschalt.B_mdzw_1 "Md_soll_delta unterhalb Hysterese bei kein Leerlauf" UBYTE _CNV_S_2_Def_bit_ub_563_CM 1 100. 0. 1. DISPLAY_IDENTIFIER B_MDZW_1 ECU_ADDRESS 0xd000db68 BIT_MASK 0x1 /end MEASUREMENT
/begin MEASUREMENT St_mdbaschalt.B_mdzw_2 "Md_soll_delta oberhalb Hysterese bei kein Leerlauf" UBYTE _CNV_S_2_Def_bit_ub_563_CM 1 100. 0. 1. DISPLAY_IDENTIFIER B_MDZW_2 ECU_ADDRESS 0xd000db68 BIT_MASK 0x2 /end MEASUREMENT
/begin MEASUREMENT St_mdbaschalt.B_mdzw_3 "Md_soll_delta unterhalb Hysterese bei Leerlauf" UBYTE _CNV_S_2_Def_bit_ub_563_CM 1 100. 0. 1. DISPLAY_IDENTIFIER B_MDZW_3 ECU_ADDRESS 0xd000db68 BIT_MASK 0x4 /end MEASUREMENT
/begin MEASUREMENT St_mdbaschalt.B_mdzw_4 "Md_soll_delta oberhalb Hysterese bei Leerlauf" UBYTE _CNV_S_2_Def_bit_ub_563_CM 1 100. 0. 1. DISPLAY_IDENTIFIER B_MDZW_4 ECU_ADDRESS 0xd000db68 BIT_MASK 0x8 /end MEASUREMENT
/begin MEASUREMENT St_mdbaschalt.B_mdzw_5 "Md_soll_delta ausserhalb Hysterese" UBYTE _CNV_S_2_Def_bit_ub_563_CM 1 100. 0. 1. DISPLAY_IDENTIFIER B_MDZW_5 ECU_ADDRESS 0xd000db68 BIT_MASK 0x10 /end MEASUREMENT
/begin MEASUREMENT St_mdbaschalt.B_mdzw_hd "Status" UBYTE _CNV_S_2_Def_bit_ub_563_CM 1 100. 0. 1. DISPLAY_IDENTIFIER B_MDZW_HD ECU_ADDRESS 0xd000db68 BIT_MASK 0x20 /end MEASUREMENT
/begin MEASUREMENT St_mdbaschalt.B_mdzwhysoff "Status" UBYTE _CNV_S_2_Def_bit_ub_563_CM 1 100. 0. 1. DISPLAY_IDENTIFIER B_MDZWHYSOFF ECU_ADDRESS 0xd000db68 BIT_MASK 0x40 /end MEASUREMENT
/begin MEASUREMENT St_mdbaschalt1 "Status" UBYTE _CNV_R_R_Def_dez_sl_551_CM 1 100. 0. 255. DISPLAY_IDENTIFIER ST_MDBASCHALT1 ECU_ADDRESS 0xd000db88 FORMAT "%3.0" /end MEASUREMENT
/begin MEASUREMENT St_mdbaschalt1.B_mdkh_rbmcpl "Status" UBYTE _CNV_S_2_Def_bit_ub_563_CM 1 100. 0. 1. DISPLAY_IDENTIFIER B_MDKH_RBMCPL ECU_ADDRESS 0xd000db88 BIT_MASK 0x8 /end MEASUREMENT
/begin MEASUREMENT St_mdbaschalt1.B_mdkh_rbmsc "Status" UBYTE _CNV_S_2_Def_bit_ub_563_CM 1 100. 0. 1. DISPLAY_IDENTIFIER B_MDKH_RBMSC ECU_ADDRESS 0xd000db88 BIT_MASK 0x10 /end MEASUREMENT
/begin MEASUREMENT St_mdbaschalt1.B_zw_khdiag "Status" UBYTE _CNV_S_2_Def_bit_ub_563_CM 1 100. 0. 1. DISPLAY_IDENTIFIER B_ZW_KHDIAG ECU_ADDRESS 0xd000db88 BIT_MASK 0x4 /end MEASUREMENT
/begin MEASUREMENT St_mdbaschalt1.B_zw_khdiagon "Status" UBYTE _CNV_S_2_Def_bit_ub_563_CM 1 100. 0. 1. DISPLAY_IDENTIFIER B_ZW_KHDIAGON ECU_ADDRESS 0xd000db88 BIT_MASK 0x2 /end MEASUREMENT
/begin MEASUREMENT St_mdbaschalt1.B_zw_khproz "Status" UBYTE _CNV_S_2_Def_bit_ub_563_CM 1 100. 0. 1. DISPLAY_IDENTIFIER B_ZW_KHPROZ ECU_ADDRESS 0xd000db88 BIT_MASK 0x1 /end MEASUREMENT
/begin MEASUREMENT St_mdbaschalt1.B_zwkh_red "Status" UBYTE _CNV_S_2_Def_bit_ub_563_CM 1 100. 0. 1. DISPLAY_IDENTIFIER B_ZWKH_RED ECU_ADDRESS 0xd000db88 BIT_MASK 0x20 /end MEASUREMENT
/begin MEASUREMENT St_mdinfo_ges "St_mdinfo" UBYTE _CNV_S_8_Def_st_mdi_705_CM 1 100. 0. 7. DISPLAY_IDENTIFIER ST_MDINFO_GES ECU_ADDRESS 0xd000dbae BIT_MASK 0xFF /end MEASUREMENT
/begin MEASUREMENT St_mdinfo_l "St_mdinfow" UWORD _CNV_S_17_Def_st_mdi_706_CM 1 100. 0. 32768. DISPLAY_IDENTIFIER ST_MDINFO_L ECU_ADDRESS 0xd000dbb4 BIT_MASK 0xFFFF /end MEASUREMENT
/begin MEASUREMENT St_mdinfo_s "St_mdinfow" UWORD _CNV_S_17_Def_st_mdi_706_CM 1 100. 0. 32768. DISPLAY_IDENTIFIER ST_MDINFO_S ECU_ADDRESS 0xd000dbb6 BIT_MASK 0xFFFF /end MEASUREMENT
/begin MEASUREMENT St_mdk "Status Momentenkoordination" UBYTE _CNV_R_R_Def_dez_sl_551_CM 1 100. 0. 255. DISPLAY_IDENTIFIER ST_MDK ECU_ADDRESS 0xd000dbad FORMAT "%3.0" /end MEASUREMENT
/begin MEASUREMENT St_mdk.B_asr_akt "Bedingung ASR aktiv" UBYTE _CNV_S_2_Def_bit_ub_563_CM 1 100. 0. 1. DISPLAY_IDENTIFIER B_ASR_AKT ECU_ADDRESS 0xd000dbad BIT_MASK 0x2 /end MEASUREMENT
/begin MEASUREMENT St_mdk.B_getr_plus "Bedingung B_getr_plus" UBYTE _CNV_S_2_Def_bit_ub_563_CM 1 100. 0. 1. DISPLAY_IDENTIFIER B_GETR_PLUS ECU_ADDRESS 0xd000dbad BIT_MASK 0x40 /end MEASUREMENT
/begin MEASUREMENT St_mdk.B_md_dynman "Bedingung Dynamik" UBYTE _CNV_S_2_Def_bit_ub_563_CM 1 100. 0. 1. DISPLAY_IDENTIFIER B_MD_DYNMAN ECU_ADDRESS 0xd000dbad BIT_MASK 0x4 /end MEASUREMENT
/begin MEASUREMENT St_mdk.B_mdk_plus "Bedingung Momentenerhöhung auf langsamen Pfad" UBYTE _CNV_S_2_Def_bit_ub_563_CM 1 100. 0. 1. DISPLAY_IDENTIFIER B_MDK_PLUS ECU_ADDRESS 0xd000dbad BIT_MASK 0x1 /end MEASUREMENT
/begin MEASUREMENT St_mdk.B_msr_aktiv "Bedingung MSR" UBYTE _CNV_S_2_Def_bit_ub_563_CM 1 100. 0. 1. DISPLAY_IDENTIFIER B_MSR_AKTIV ECU_ADDRESS 0xd000dbad BIT_MASK 0x10 /end MEASUREMENT
/begin MEASUREMENT St_mdk.B_san "Bedingung SA verboten" UBYTE _CNV_S_2_Def_bit_ub_563_CM 1 100. 0. 1. DISPLAY_IDENTIFIER B_SAN ECU_ADDRESS 0xd000dbad BIT_MASK 0x80 /end MEASUREMENT
/begin MEASUREMENT St_mdk.B_siko_akt "Bedingung Sicherheitseingriff aktiv" UBYTE _CNV_S_2_Def_bit_ub_563_CM 1 100. 0. 1. DISPLAY_IDENTIFIER B_SIKO_AKT ECU_ADDRESS 0xd000dbad BIT_MASK 0x20 /end MEASUREMENT
/begin MEASUREMENT St_mdk.B_zw_dynman "Bedingung Dynamik" UBYTE _CNV_S_2_Def_bit_ub_563_CM 1 100. 0. 1. DISPLAY_IDENTIFIER B_ZW_DYNMAN ECU_ADDRESS 0xd000dbad BIT_MASK 0x8 /end MEASUREMENT
/begin MEASUREMENT St_mdk1 "Status Momentenkoordination" UWORD _CNV_R_R_Def_dez_sl_551_CM 1 100. 0. 65535. DISPLAY_IDENTIFIER ST_MDK1 ECU_ADDRESS 0xd000dbc6 FORMAT "%5.0" /end MEASUREMENT
/begin MEASUREMENT St_mdk1.B_md_dynman1 "B_md_dynman vor Einreichnung B_mdzw_hd" UWORD _CNV_S_2_Def_bit_ub_563_CM 1 100. 0. 1. DISPLAY_IDENTIFIER B_MD_DYNMAN1 ECU_ADDRESS 0xd000dbc6 BIT_MASK 0x1000 /end MEASUREMENT
/begin MEASUREMENT St_mdk1.B_mdzw_min1 "Status Momentenkoordination" UWORD _CNV_S_2_Def_bit_ub_563_CM 1 100. 0. 1. DISPLAY_IDENTIFIER B_MDZW_MIN1 ECU_ADDRESS 0xd000dbc6 BIT_MASK 0x2 /end MEASUREMENT
/begin MEASUREMENT St_mdk1.B_mdzw_min2 "Status Momentenkoordination" UWORD _CNV_S_2_Def_bit_ub_563_CM 1 100. 0. 1. DISPLAY_IDENTIFIER B_MDZW_MIN2 ECU_ADDRESS 0xd000dbc6 BIT_MASK 0x4 /end MEASUREMENT
/begin MEASUREMENT St_mdk1.B_mdzw_plus "Status Momentenkoordination" UWORD _CNV_S_2_Def_bit_ub_563_CM 1 100. 0. 1. DISPLAY_IDENTIFIER B_MDZW_PLUS ECU_ADDRESS 0xd000dbc6 BIT_MASK 0x1 /end MEASUREMENT
/begin MEASUREMENT St_mdk1.B_zwe_ar "Status Momentenkoordination" UWORD _CNV_S_2_Def_bit_ub_563_CM 1 100. 0. 1. DISPLAY_IDENTIFIER B_ZWE_AR ECU_ADDRESS 0xd000dbc6 BIT_MASK 0x100 /end MEASUREMENT
/begin MEASUREMENT St_mdk1.B_zwe_fzdyn "Status Momentenkoordination" UWORD _CNV_S_2_Def_bit_ub_563_CM 1 100. 0. 1. DISPLAY_IDENTIFIER B_ZWE_FZDYN ECU_ADDRESS 0xd000dbc6 BIT_MASK 0x20 /end MEASUREMENT
/begin MEASUREMENT St_mdk1.B_zwe_kh "Status Momentenkoordination" UWORD _CNV_S_2_Def_bit_ub_563_CM 1 100. 0. 1. DISPLAY_IDENTIFIER B_ZWE_KH ECU_ADDRESS 0xd000dbc6 BIT_MASK 0x8 /end MEASUREMENT
/begin MEASUREMENT St_mdk1.B_zwe_kupp "Status Momentenkoordination" UWORD _CNV_S_2_Def_bit_ub_563_CM 1 100. 0. 1. DISPLAY_IDENTIFIER B_ZWE_KUPP ECU_ADDRESS 0xd000dbc6 BIT_MASK 0x80 /end MEASUREMENT
/begin MEASUREMENT St_mdk1.B_zwe_llr "Status Momentenkoordination" UWORD _CNV_S_2_Def_bit_ub_563_CM 1 100. 0. 1. DISPLAY_IDENTIFIER B_ZWE_LLR ECU_ADDRESS 0xd000dbc6 BIT_MASK 0x40 /end MEASUREMENT
/begin MEASUREMENT St_mdk1.B_zwe_res "Status Momentenkoordination" UWORD _CNV_S_2_Def_bit_ub_563_CM 1 100. 0. 1. DISPLAY_IDENTIFIER B_ZWE_RES ECU_ADDRESS 0xd000dbc6 BIT_MASK 0x10 /end MEASUREMENT
/begin MEASUREMENT St_mdk1.B_zwe_resa "Status Momentenkoordination" UWORD _CNV_S_2_Def_bit_ub_563_CM 1 100. 0. 1. DISPLAY_IDENTIFIER B_ZWE_RESA ECU_ADDRESS 0xd000dbc6 BIT_MASK 0x800 /end MEASUREMENT
/begin MEASUREMENT St_mdk1.B_zwe_sa "Status Momentenkoordination" UWORD _CNV_S_2_Def_bit_ub_563_CM 1 100. 0. 1. DISPLAY_IDENTIFIER B_ZWE_SA ECU_ADDRESS 0xd000dbc6 BIT_MASK 0x400 /end MEASUREMENT
/begin MEASUREMENT St_mdk1.B_zwe_start "Status Momentenkoordination" UWORD _CNV_S_2_Def_bit_ub_563_CM 1 100. 0. 1. DISPLAY_IDENTIFIER B_ZWE_START ECU_ADDRESS 0xd000dbc6 BIT_MASK 0x200 /end MEASUREMENT
/begin MEASUREMENT St_mdk2 "Status Momentenkoordination" UWORD _CNV_R_R_Def_dez_sl_551_CM 1 100. 0. 65535. DISPLAY_IDENTIFIER ST_MDK2 ECU_ADDRESS 0xd000dbb2 FORMAT "%5.0" /end MEASUREMENT
/begin MEASUREMENT St_mdk2.B_accl_plus "Status Momentenkoordination" UWORD _CNV_S_2_Def_bit_ub_563_CM 1 100. 0. 1. DISPLAY_IDENTIFIER B_ACCL_PLUS ECU_ADDRESS 0xd000dbb2 BIT_MASK 0x40 /end MEASUREMENT
/begin MEASUREMENT St_mdk2.B_accs_plus "Status Momentenkoordination" UWORD _CNV_S_2_Def_bit_ub_563_CM 1 100. 0. 1. DISPLAY_IDENTIFIER B_ACCS_PLUS ECU_ADDRESS 0xd000dbb2 BIT_MASK 0x2000 /end MEASUREMENT
/begin MEASUREMENT St_mdk2.B_asr_l "Status Momentenkoordination" UWORD _CNV_S_2_Def_bit_ub_563_CM 1 100. 0. 1. DISPLAY_IDENTIFIER B_ASR_L ECU_ADDRESS 0xd000dbb2 BIT_MASK 0x1 /end MEASUREMENT
/begin MEASUREMENT St_mdk2.B_asr_s "Status Momentenkoordination" UWORD _CNV_S_2_Def_bit_ub_563_CM 1 100. 0. 1. DISPLAY_IDENTIFIER B_ASR_S ECU_ADDRESS 0xd000dbb2 BIT_MASK 0x80 /end MEASUREMENT
/begin MEASUREMENT St_mdk2.B_gsl_minus "Status Momentenkoordination" UWORD _CNV_S_2_Def_bit_ub_563_CM 1 100. 0. 1. DISPLAY_IDENTIFIER B_GSL_MINUS ECU_ADDRESS 0xd000dbb2 BIT_MASK 0x2 /end MEASUREMENT
/begin MEASUREMENT St_mdk2.B_gsl_plus "Status Momentenkoordination" UWORD _CNV_S_2_Def_bit_ub_563_CM 1 100. 0. 1. DISPLAY_IDENTIFIER B_GSL_PLUS ECU_ADDRESS 0xd000dbb2 BIT_MASK 0x8 /end MEASUREMENT
/begin MEASUREMENT St_mdk2.B_gss_minus "Status Momentenkoordination" UWORD _CNV_S_2_Def_bit_ub_563_CM 1 100. 0. 1. DISPLAY_IDENTIFIER B_GSS_MINUS ECU_ADDRESS 0xd000dbb2 BIT_MASK 0x100 /end MEASUREMENT
/begin MEASUREMENT St_mdk2.B_gss_plus "Status Momentenkoordination" UWORD _CNV_S_2_Def_bit_ub_563_CM 1 100. 0. 1. DISPLAY_IDENTIFIER B_GSS_PLUS ECU_ADDRESS 0xd000dbb2 BIT_MASK 0x400 /end MEASUREMENT
/begin MEASUREMENT St_mdk2.B_mdres_wm "Status Momentenkoordination" UWORD _CNV_S_2_Def_bit_ub_563_CM 1 100. 0. 1. DISPLAY_IDENTIFIER B_MDRES_WM ECU_ADDRESS 0xd000dbb2 BIT_MASK 0x4000 /end MEASUREMENT
/begin MEASUREMENT St_mdk2.B_msr_l "Status Momentenkoordination" UWORD _CNV_S_2_Def_bit_ub_563_CM 1 100. 0. 1. DISPLAY_IDENTIFIER B_MSR_L ECU_ADDRESS 0xd000dbb2 BIT_MASK 0x20 /end MEASUREMENT
/begin MEASUREMENT St_mdk2.B_msr_s "Status Momentenkoordination" UWORD _CNV_S_2_Def_bit_ub_563_CM 1 100. 0. 1. DISPLAY_IDENTIFIER B_MSR_S ECU_ADDRESS 0xd000dbb2 BIT_MASK 0x1000 /end MEASUREMENT
/begin MEASUREMENT St_mdk2.B_smgl_minus "Status Momentenkoordination" UWORD _CNV_S_2_Def_bit_ub_563_CM 1 100. 0. 1. DISPLAY_IDENTIFIER B_SMGL_MINUS ECU_ADDRESS 0xd000dbb2 BIT_MASK 0x4 /end MEASUREMENT
/begin MEASUREMENT St_mdk2.B_smgl_plus "Status Momentenkoordination" UWORD _CNV_S_2_Def_bit_ub_563_CM 1 100. 0. 1. DISPLAY_IDENTIFIER B_SMGL_PLUS ECU_ADDRESS 0xd000dbb2 BIT_MASK 0x10 /end MEASUREMENT
/begin MEASUREMENT St_mdk2.B_smgs_minus "Status Momentenkoordination" UWORD _CNV_S_2_Def_bit_ub_563_CM 1 100. 0. 1. DISPLAY_IDENTIFIER B_SMGS_MINUS ECU_ADDRESS 0xd000dbb2 BIT_MASK 0x200 /end MEASUREMENT
/begin MEASUREMENT St_mdk2.B_smgs_plus "Status Momentenkoordination" UWORD _CNV_S_2_Def_bit_ub_563_CM 1 100. 0. 1. DISPLAY_IDENTIFIER B_SMGS_PLUS ECU_ADDRESS 0xd000dbb2 BIT_MASK 0x800 /end MEASUREMENT
/begin MEASUREMENT St_mdk3 "Status Momentenkoordination" UBYTE _CNV_R_R_Def_dez_sl_551_CM 1 100. 0. 255. DISPLAY_IDENTIFIER ST_MDK3 ECU_ADDRESS 0xd000dbac FORMAT "%3.0" /end MEASUREMENT
/begin MEASUREMENT St_mdk3.B_dynmnrf "Status Momentenkoordination" UBYTE _CNV_S_2_Def_bit_ub_563_CM 1 100. 0. 1. DISPLAY_IDENTIFIER B_DYNMNRF ECU_ADDRESS 0xd000dbac BIT_MASK 0x8 /end MEASUREMENT
/begin MEASUREMENT St_mdk3.B_hd "Status Momentenkoordination" UBYTE _CNV_S_2_Def_bit_ub_563_CM 1 100. 0. 1. DISPLAY_IDENTIFIER B_HD ECU_ADDRESS 0xd000dbac BIT_MASK 0x4 /end MEASUREMENT
/begin MEASUREMENT St_mdk3.B_nwehd "Status Momentenkoordination" UBYTE _CNV_S_2_Def_bit_ub_563_CM 1 100. 0. 1. DISPLAY_IDENTIFIER B_NWEHD ECU_ADDRESS 0xd000dbac BIT_MASK 0x1 /end MEASUREMENT
/begin MEASUREMENT St_mdk3.B_vhd "Status Momentenkoordination" UBYTE _CNV_S_2_Def_bit_ub_563_CM 1 100. 0. 1. DISPLAY_IDENTIFIER B_VHD ECU_ADDRESS 0xd000dbac BIT_MASK 0x2 /end MEASUREMENT
/begin MEASUREMENT St_priodiag "Statuswort" UBYTE _CNV_R_R_Def_dez_sl_551_CM 1 100. 0. 255. DISPLAY_IDENTIFIER ST_PRIODIAG ECU_ADDRESS 0xd000da27 FORMAT "%3.0" /end MEASUREMENT
/begin MEASUREMENT St_priodiag.B_badif_bv "Umschaltung aktiv" UBYTE _CNV_S_2_Def_bit_ub_563_CM 1 100. 0. 1. DISPLAY_IDENTIFIER B_BADIF_BV ECU_ADDRESS 0xd000da27 BIT_MASK 0x2 /end MEASUREMENT
/begin MEASUREMENT St_priodiag.B_badif_prio "Setzen Ba_soll aktiv" UBYTE _CNV_S_2_Def_bit_ub_563_CM 1 100. 0. 1. DISPLAY_IDENTIFIER B_BADIF_PRIO ECU_ADDRESS 0xd000da27 BIT_MASK 0x1 /end MEASUREMENT
/begin MEASUREMENT St_priodiag.B_bv_haeng "Umschaltung hängt" UBYTE _CNV_S_2_Def_bit_ub_563_CM 1 100. 0. 1. DISPLAY_IDENTIFIER B_BV_HAENG ECU_ADDRESS 0xd000da27 BIT_MASK 0x8 /end MEASUREMENT
/begin MEASUREMENT St_priodiag.B_prio_haeng "Priorisierung hängt in Setzen vom Sollwert" UBYTE _CNV_S_2_Def_bit_ub_563_CM 1 100. 0. 1. DISPLAY_IDENTIFIER B_PRIO_HAENG ECU_ADDRESS 0xd000da27 BIT_MASK 0x4 /end MEASUREMENT
/begin MEASUREMENT St_priodiag.B_prio_not "Notfallmassnahme wegen Zeitdauer Quittungen" UBYTE _CNV_S_2_Def_bit_ub_563_CM 1 100. 0. 1. DISPLAY_IDENTIFIER B_PRIO_NOT ECU_ADDRESS 0xd000da27 BIT_MASK 0x10 /end MEASUREMENT
/begin MEASUREMENT St_priodiag.B_quit_notl "Übergehen der Quittungen durch Notlauf" UBYTE _CNV_S_2_Def_bit_ub_563_CM 1 100. 0. 1. DISPLAY_IDENTIFIER B_QUIT_NOTL ECU_ADDRESS 0xd000da27 BIT_MASK 0x40 /end MEASUREMENT
/begin MEASUREMENT St_priodiag.B_ums_not "Auswahl Notfallmassnahme" UBYTE _CNV_S_2_Def_bit_ub_563_CM 1 100. 0. 1. DISPLAY_IDENTIFIER B_UMS_NOT ECU_ADDRESS 0xd000da27 BIT_MASK 0x20 /end MEASUREMENT
/begin MEASUREMENT St_priodiag.B_ums_notl "Notfall Umschaltung sofort" UBYTE _CNV_S_2_Def_bit_ub_563_CM 1 100. 0. 1. DISPLAY_IDENTIFIER B_UMS_NOTL ECU_ADDRESS 0xd000da27 BIT_MASK 0x80 /end MEASUREMENT
/begin MEASUREMENT St_quitt "Statuswort für Quittungen" UBYTE _CNV_S_8_Def_stquit_707_CM 1 100. 0. 7. DISPLAY_IDENTIFIER ST_QUITT ECU_ADDRESS 0xd000d9dd BIT_MASK 0xFF /end MEASUREMENT
/begin MEASUREMENT St_rf1 "Status" UBYTE _CNV_R_R_Def_dez_sl_551_CM 1 100. 0. 255. DISPLAY_IDENTIFIER ST_RF1 ECU_ADDRESS 0xd000e079 FORMAT "%3.0" /end MEASUREMENT
/begin MEASUREMENT St_rf1.B_dps_lamd "Status" UBYTE _CNV_S_2_Def_bit_ub_563_CM 1 100. 0. 1. DISPLAY_IDENTIFIER B_DPS_LAMD ECU_ADDRESS 0xd000e079 BIT_MASK 0x4 /end MEASUREMENT
/begin MEASUREMENT St_rf1.B_la_md "Bedingung Lavorgabe aus Momentenstruktur" UBYTE _CNV_S_2_Def_bit_ub_563_CM 1 100. 0. 1. DISPLAY_IDENTIFIER B_LA_MD ECU_ADDRESS 0xd000e079 BIT_MASK 0x1 /end MEASUREMENT
/begin MEASUREMENT St_rf1.B_la_zwmd "Status" UBYTE _CNV_S_2_Def_bit_ub_563_CM 1 100. 0. 1. DISPLAY_IDENTIFIER B_LA_ZWMD ECU_ADDRESS 0xd000e079 BIT_MASK 0x2 /end MEASUREMENT
/begin MEASUREMENT St_rf1.B_v_lamd "Status" UBYTE _CNV_S_2_Def_bit_ub_563_CM 1 100. 0. 1. DISPLAY_IDENTIFIER B_V_LAMD ECU_ADDRESS 0xd000e079 BIT_MASK 0x8 /end MEASUREMENT
/begin MEASUREMENT St_subziel "Sub Betriebsart" UBYTE _CNV_S_22_Def_ba_gdi_567_CM 1 100. 0. 21. DISPLAY_IDENTIFIER ST_SUBZIEL ECU_ADDRESS 0xd000d9f8 BIT_MASK 0xFF /end MEASUREMENT
/begin MEASUREMENT St_tevfi_status "Status Fehlerort FI_TEVE" UWORD _CNV_R_R_Def_dez_sl_551_CM 1 100. 0. 65535. DISPLAY_IDENTIFIER ST_TEVFI_STATUS ECU_ADDRESS 0xc0000dfc FORMAT "%5.0" /end MEASUREMENT
/begin MEASUREMENT St_tiausgang "" UBYTE _CNV_R_R_Def_dez_sl_551_CM 1 100. 0. 255. DISPLAY_IDENTIFIER ST_TIAUSGANG ECU_ADDRESS 0xd000d9c0 FORMAT "%3.0" /end MEASUREMENT
/begin MEASUREMENT St_tiausgang.B_esp_h1 "Bedingung Einspritzung homogen - Bank 1" UBYTE _CNV_S_2_Def_bit_ub_563_CM 1 100. 0. 1. DISPLAY_IDENTIFIER B_ESP_H1 ECU_ADDRESS 0xd000d9c0 BIT_MASK 0x1 /end MEASUREMENT
/begin MEASUREMENT St_tiausgang.B_esp_h2 "Bedingung Einspritzung homogen - Bank 2" UBYTE _CNV_S_2_Def_bit_ub_563_CM 1 100. 0. 1. DISPLAY_IDENTIFIER B_ESP_H2 ECU_ADDRESS 0xd000d9c0 BIT_MASK 0x2 /end MEASUREMENT
/begin MEASUREMENT St_tiausgang.B_esp_hs1 "Bedingung Einspritzung Homogenschicht - Bank 1" UBYTE _CNV_S_2_Def_bit_ub_563_CM 1 100. 0. 1. DISPLAY_IDENTIFIER B_ESP_HS1 ECU_ADDRESS 0xd000d9c0 BIT_MASK 0x4 /end MEASUREMENT
/begin MEASUREMENT St_tiausgang.B_esp_hs2 "Bedingung Einspritzung Homogenschicht - Bank 2" UBYTE _CNV_S_2_Def_bit_ub_563_CM 1 100. 0. 1. DISPLAY_IDENTIFIER B_ESP_HS2 ECU_ADDRESS 0xd000d9c0 BIT_MASK 0x8 /end MEASUREMENT
/begin MEASUREMENT St_umsvorg "" UBYTE _CNV_R_R_Def_dez_sl_551_CM 1 100. 0. 255. DISPLAY_IDENTIFIER ST_UMSVORG ECU_ADDRESS 0xd000da0a FORMAT "%3.0" /end MEASUREMENT
/begin MEASUREMENT Subprio_bronze "Subbetriebsart Bronze" UBYTE _CNV_S_22_Def_ba_gdi_567_CM 1 100. 0. 21. DISPLAY_IDENTIFIER SUBPRIO_BRONZE ECU_ADDRESS 0xd000da2e BIT_MASK 0xFF /end MEASUREMENT
/begin MEASUREMENT Subprio_gold "Subbetriebs Gold" UBYTE _CNV_S_22_Def_ba_gdi_567_CM 1 100. 0. 21. DISPLAY_IDENTIFIER SUBPRIO_GOLD ECU_ADDRESS 0xd000da2f BIT_MASK 0xFF /end MEASUREMENT
/begin MEASUREMENT Subprio_sieg "Subbetriebsart die gewonnen hat" UBYTE _CNV_S_22_Def_ba_gdi_567_CM 1 100. 0. 21. DISPLAY_IDENTIFIER SUBPRIO_SIEG ECU_ADDRESS 0xd000db63 BIT_MASK 0xFF /end MEASUREMENT
/begin MEASUREMENT Subprio_silber "Subbetriebsart silber" UBYTE _CNV_S_22_Def_ba_gdi_567_CM 1 100. 0. 21. DISPLAY_IDENTIFIER SUBPRIO_SILBER ECU_ADDRESS 0xd000da30 BIT_MASK 0xFF /end MEASUREMENT
/begin MEASUREMENT Subprio_sort "Array für Sortierung Subbetriebsartenanforderungen" ULONG _CNV_R_R_Def_dez_sl_551_CM 1 100. 0. 4294967295. DISPLAY_IDENTIFIER SUBPRIO_SORT ECU_ADDRESS 0xd000dab0 FORMAT "%7.0" ARRAY_SIZE 27 MATRIX_DIM 27 1 1 /end MEASUREMENT
/begin MEASUREMENT T_babr "Fehlerzähler " UBYTE _CNV_R_R_Def_dez_sl_551_CM 1 100. 0. 255. DISPLAY_IDENTIFIER T_BABR ECU_ADDRESS 0xd000db64 FORMAT "%3.0" /end MEASUREMENT
/begin MEASUREMENT T_minshs "minimale Zeit " SWORD _CNV_R_R_Def_t_sw_q_579_CM 1 100. -327.68 327.67 DISPLAY_IDENTIFIER T_MINSHS ECU_ADDRESS 0xd000db1c FORMAT "%7.2" /end MEASUREMENT
/begin MEASUREMENT T_quit "Zeitdauer hängende Quittierungen" UWORD _CNV_R_R_Def_td_uw__673_CM 1 100. 0. 655.35 DISPLAY_IDENTIFIER T_QUIT ECU_ADDRESS 0xd000db50 FORMAT "%7.2" /end MEASUREMENT
/begin MEASUREMENT T_tevzu "Wartezeit für TEV geschlossen nach BA Wechsel" UWORD _CNV_R_R_Def_td_uw__673_CM 1 100. 0. 655.35 DISPLAY_IDENTIFIER T_TEVZU ECU_ADDRESS 0xd000d9fc FORMAT "%7.2" /end MEASUREMENT
/begin MEASUREMENT T_umsch "Zeitdauer hängende Umschaltung" UWORD _CNV_R_R_Def_td_uw__673_CM 1 100. 0. 655.35 DISPLAY_IDENTIFIER T_UMSCH ECU_ADDRESS 0xd000db52 FORMAT "%7.2" /end MEASUREMENT
/begin MEASUREMENT Td_bastat_h "Zeit Homogen-Betrieb aktueller Motorlauf" UWORD _CNV_R_R_Def_td_ub__574_CM 1 100. 0. 6553.5 DISPLAY_IDENTIFIER TD_BASTAT_H ECU_ADDRESS 0xc0000dd8 FORMAT "%6.1" /end MEASUREMENT
/begin MEASUREMENT Td_bastat_hs "Zeit Homogen-Schicht-Betrieb aktueller Motorlauf" UWORD _CNV_R_R_Def_td_ub__574_CM 1 100. 0. 6553.5 DISPLAY_IDENTIFIER TD_BASTAT_HS ECU_ADDRESS 0xc0000dda FORMAT "%6.1" /end MEASUREMENT
/begin MEASUREMENT Td_bastat_s "Zeit Schicht-Betrieb aktueller Motorlauf" UWORD _CNV_R_R_Def_td_ub__574_CM 1 100. 0. 6553.5 DISPLAY_IDENTIFIER TD_BASTAT_S ECU_ADDRESS 0xc0000ddc FORMAT "%6.1" /end MEASUREMENT
/begin MEASUREMENT Td_bastat_sa "Zeit Schubabschalt-Betrieb aktueller Motorlauf" UWORD _CNV_R_R_Def_td_ub__574_CM 1 100. 0. 6553.5 DISPLAY_IDENTIFIER TD_BASTAT_SA ECU_ADDRESS 0xc0000dde FORMAT "%6.1" /end MEASUREMENT
/begin MEASUREMENT Td_bastatg_h "Zeit Homogen-Betrieb gesamter Motorlauf" FLOAT32_IEEE _CNV_R_R_Def_dez_sl_551_CM 1 100. -3.e+038 3.e+038 DISPLAY_IDENTIFIER TD_BASTATG_H ECU_ADDRESS 0xc0004798 FORMAT "%14.7" /end MEASUREMENT
/begin MEASUREMENT Td_bastatg_sa "Zeit Schubabschalt-Betrieb gesamter Motorlauf" FLOAT32_IEEE _CNV_R_R_Def_dez_sl_551_CM 1 100. -3.e+038 3.e+038 DISPLAY_IDENTIFIER TD_BASTATG_SA ECU_ADDRESS 0xc000479c FORMAT "%14.7" /end MEASUREMENT
/begin MEASUREMENT Td_baststg_hs "Zeit Homogen-Schicht-Betrieb gesamter Motorlauf" FLOAT32_IEEE _CNV_R_R_Def_dez_sl_551_CM 1 100. -3.e+038 3.e+038 DISPLAY_IDENTIFIER TD_BASTSTG_HS ECU_ADDRESS 0xc00047a0 FORMAT "%14.7" /end MEASUREMENT
/begin MEASUREMENT Td_baststg_s "Zeit Schicht-Betrieb gesamter Motorlauf" FLOAT32_IEEE _CNV_R_R_Def_dez_sl_551_CM 1 100. -3.e+038 3.e+038 DISPLAY_IDENTIFIER TD_BASTSTG_S ECU_ADDRESS 0xc00047a4 FORMAT "%14.7" /end MEASUREMENT
/begin MEASUREMENT Tddpslamd "Verzögerungszeit" UWORD _CNV_R_R_Def_td_uw__673_CM 1 100. 0. 655.35 DISPLAY_IDENTIFIER TDDPSLAMD ECU_ADDRESS 0xd000e086 FORMAT "%7.2" /end MEASUREMENT
/begin MEASUREMENT Tdlamdaus "Verzögerungszeit" UWORD _CNV_R_R_Def_td_uw__673_CM 1 100. 0. 655.35 DISPLAY_IDENTIFIER TDLAMDAUS ECU_ADDRESS 0xd000e082 FORMAT "%7.2" /end MEASUREMENT
/begin MEASUREMENT Tdlamdein "Verzögerungszeit" UWORD _CNV_R_R_Def_td_uw__673_CM 1 100. 0. 655.35 DISPLAY_IDENTIFIER TDLAMDEIN ECU_ADDRESS 0xd000e088 FORMAT "%7.2" /end MEASUREMENT
/begin MEASUREMENT Tdlamdein2 "Verzögerungszeit" UWORD _CNV_R_R_Def_td_uw__673_CM 1 100. 0. 655.35 DISPLAY_IDENTIFIER TDLAMDEIN2 ECU_ADDRESS 0xd000e084 FORMAT "%7.2" /end MEASUREMENT
/begin MEASUREMENT Tdmax_bawbeopt "Maximale Wartezeit für verbrauchsoptimalen BA-Wechsel" UWORD _CNV_R_R_Def_td_uw__673_CM 1 100. 0. 655.35 DISPLAY_IDENTIFIER TDMAX_BAWBEOPT ECU_ADDRESS 0xd000d9fa FORMAT "%7.2" /end MEASUREMENT
/begin MEASUREMENT Tums_moni "Zeitmessung für BAUMS Verbot  Leerlaufkomfort" UWORD _CNV_R_R_Def_td_uw__673_CM 1 100. 0. 655.35 DISPLAY_IDENTIFIER TUMS_MONI ECU_ADDRESS 0xd000db54 FORMAT "%7.2" /end MEASUREMENT
/begin MEASUREMENT Z_priohaeng "Zähler hängende Umschaltung wegen Prio" UBYTE _CNV_R_R_Def_dez_sl_551_CM 1 100. 0. 255. DISPLAY_IDENTIFIER Z_PRIOHAENG ECU_ADDRESS 0xc00047a8 FORMAT "%3.0" /end MEASUREMENT
/begin MEASUREMENT Z_sbaums_fail "" UBYTE _CNV_R_R_Def_dez_sl_551_CM 1 100. 0. 255. DISPLAY_IDENTIFIER Z_SBAUMS_FAIL ECU_ADDRESS 0xc0004794 FORMAT "%3.0" /end MEASUREMENT
/begin MEASUREMENT Z_umshaeng "Zähler hängende Umschaltung wegen fehlender Quittung" UBYTE _CNV_R_R_Def_dez_sl_551_CM 1 100. 0. 255. DISPLAY_IDENTIFIER Z_UMSHAENG ECU_ADDRESS 0xc00047a9 FORMAT "%3.0" /end MEASUREMENT
/begin MEASUREMENT Z_wart "" UBYTE _CNV_R_R_Def_dez_sl_551_CM 1 100. 0. 255. DISPLAY_IDENTIFIER Z_WART ECU_ADDRESS 0xd000da0b FORMAT "%3.0" /end MEASUREMENT
/begin MEASUREMENT Zaehl_bano_verz "Verzögerungszähler für Statuswort Betriebsartverbot" UWORD _CNV_R_R_Def_dez_sl_551_CM 1 100. 0. 65535. DISPLAY_IDENTIFIER ZAEHL_BANO_VERZ ECU_ADDRESS 0xd000db56 FORMAT "%5.0" /end MEASUREMENT
/begin MEASUREMENT Zk_mdk_min "Zeitkonstante Filterung Mdk_min" UBYTE _CNV_R_R_Def_f_ub_b_586_CM 1 100. 0. 99.60930000000001 DISPLAY_IDENTIFIER ZK_MDK_MIN ECU_ADDRESS 0xd000dbde FORMAT "%5.2" /end MEASUREMENT
/begin MEASUREMENT Zr_khdiag "Zaehlerfreigabe Katheizfehlereintrag" UBYTE _CNV_R_R_Def_dez_sl_551_CM 1 100. 0. 255. DISPLAY_IDENTIFIER ZR_KHDIAG ECU_ADDRESS 0xd000db8a FORMAT "%3.0" /end MEASUREMENT
/begin MEASUREMENT Zw_grund_nl "Grundzündwinkel, Notlauf" SWORD _CNV_R_R_Def_zw_sw__604_CM 1 100. -3276.8 3276.7 DISPLAY_IDENTIFIER ZW_GRUND_NL ECU_ADDRESS 0xd000e0b2 FORMAT "%6.1" /end MEASUREMENT
/begin MEASUREMENT Zw_opt_nl "Optimalzündwinkel, Notlauf" SWORD _CNV_R_R_Def_zw_sw__604_CM 1 100. -3276.8 3276.7 DISPLAY_IDENTIFIER ZW_OPT_NL ECU_ADDRESS 0xd000e0b4 FORMAT "%6.1" /end MEASUREMENT
/begin CHARACTERISTIC CW_BANOAPPL "Umschalten aus Applikationsswert für St_bano" VALUE 0xa08264e0 _REC_VAL_20_u1 1. _CNV_R_R_Def_dez_sl_551_CM 0. 1. FORMAT "%3.0" /end CHARACTERISTIC
/begin CHARACTERISTIC CW_BAWLL "Schalter um LL in BA Koordination zu Simulieren" VALUE 0xa08264e1 _REC_VAL_20_u1 1. _CNV_R_R_Def_dez_sl_551_CM 0. 1. FORMAT "%3.0" /end CHARACTERISTIC
/begin CHARACTERISTIC CW_BAWVL "Schalter um LL in BA Koordination zu Simulieren" VALUE 0xa08264e2 _REC_VAL_20_u1 1. _CNV_R_R_Def_dez_sl_551_CM 0. 1. FORMAT "%3.0" /end CHARACTERISTIC
/begin CHARACTERISTIC CW_DYNMAN "Codewort Dynamikmanager" VALUE 0xa08266a6 _REC_VAL_20_u2 0. _CNV_R_R_Def_dez_sl_551_CM 0. 65535. FORMAT "%5.0" /end CHARACTERISTIC
/begin CHARACTERISTIC CW_GLAKTIV "Codewort Glelichstellung Aktiv" VALUE 0xa08264b0 _REC_VAL_20_u1 99.45 _CNV_R_R_Def_dez_sl_551_CM 0. 255. FORMAT "%3.0" /end CHARACTERISTIC
/begin CHARACTERISTIC CW_LLBA "Leerlauf in Schicht oder Homogen" VALUE 0xa08264e3 _REC_VAL_20_u1 1. _CNV_R_R_Def_dez_sl_551_CM 0. 1. FORMAT "%3.0" /end CHARACTERISTIC
/begin CHARACTERISTIC CW_MDISTOPP "Codeword: Abstellmoment (Bit0:KL15; Bit1:MSA)" VALUE 0xa0826649 _REC_VAL_20_u1 99.45 _CNV_R_R_Def_dez_sl_551_CM 0. 255. FORMAT "%3.0" /end CHARACTERISTIC
/begin CHARACTERISTIC CW_MDLA_VAR "variantenabhängige Freischaltung magerer Ll" VALUE 0xa082b500 _REC_VAL_20_u1 99.45 _CNV_R_R_Def_dez_sl_551_CM 0. 255. FORMAT "%3.0" /end CHARACTERISTIC
/begin CHARACTERISTIC CW_MDZWHYS "Codewort MomentenzuendwinkelHyst." VALUE 0xa082664e _REC_VAL_20_u2 0. _CNV_R_R_Def_dez_sl_551_CM 0. 65535. FORMAT "%5.0" /end CHARACTERISTIC
/begin CHARACTERISTIC CW_MSAV_GL "Codewort Berechung MSA Verbot durch Gleichstellung" VALUE 0xa08264e4 _REC_VAL_20_u1 99.45 _CNV_R_R_Def_dez_sl_551_CM 0. 255. FORMAT "%3.0" /end CHARACTERISTIC
/begin CHARACTERISTIC CW_NOTLAUF "Codewort Notlauf" VALUE 0xa082b8f2 _REC_VAL_20_u2 0. _CNV_R_R_Def_dez_sl_551_CM 0. 65535. FORMAT "%5.0" /end CHARACTERISTIC
/begin CHARACTERISTIC CW_RGN "Codewort Kat Regeneration" VALUE 0xa08264e5 _REC_VAL_20_u1 7. _CNV_R_R_Def_dez_sl_551_CM 0. 7. FORMAT "%3.0" /end CHARACTERISTIC
/begin CHARACTERISTIC CW_UMS_FAST "Codewort zum Freischalten beschleunigte Umschaltungen" VALUE 0xa08264e6 _REC_VAL_20_u1 99.45 _CNV_R_R_Def_dez_sl_551_CM 0. 255. FORMAT "%3.0" /end CHARACTERISTIC
/begin CHARACTERISTIC CW_VAKTIV "Codewort zur Aktivierung Verbotsmatrix 1" VALUE 0xa08264b4 _REC_VAL_20_u4 0. _CNV_R_R_Def_dez_sl_551_CM 0. 4294967295. FORMAT "%7.0" /end CHARACTERISTIC
/begin CHARACTERISTIC CW_VAKTIV2 "Codewort zur Aktivierung Verbotsmatrix 2" VALUE 0xa08264b8 _REC_VAL_20_u4 0. _CNV_R_R_Def_dez_sl_551_CM 0. 4294967295. FORMAT "%7.0" /end CHARACTERISTIC
/begin CHARACTERISTIC CW_ZWMIN_EXT "Codewort B_zwmin_ext" VALUE 0xa0826650 _REC_VAL_20_u2 0. _CNV_R_R_Def_dez_sl_551_CM 0. 65535. FORMAT "%5.0" /end CHARACTERISTIC
/begin CHARACTERISTIC KF_BAUMS "" MAP 0xa0825ca0 _REC_MAP_52_u1_s2_s2 99.45 _CNV_R_R_Def_dez_sl_551_CM 0. 255. FORMAT "%3.0"
 /begin AXIS_DESCR STD_AXIS Ba_ist_sw _CNV_R_R_Def_dez_sl_551_CM 3 -32768. 32767. FORMAT "%5.0" /end AXIS_DESCR
 /begin AXIS_DESCR STD_AXIS Ba_prio_sw _CNV_R_R_Def_dez_sl_551_CM 3 -32768. 32767. FORMAT "%5.0" /end AXIS_DESCR
/end CHARACTERISTIC
/begin CHARACTERISTIC KF_DZW_KOEFF "" MAP 0xa082c110 _REC_MAP_52_UBYTE_u2_s2_s2 15.9997 _CNV_R_R_Def_f_uw_b_559_CM 0. 15.9997 FORMAT "%7.4"
 /begin AXIS_DESCR STD_AXIS Nkw _CNV_R_R_Def_n_sw_q_595_CM 8 -32768. 32767. FORMAT "%5.0" /end AXIS_DESCR
 /begin AXIS_DESCR STD_AXIS Rf _CNV_R_R_Def_rf_sw__598_CM 8 -327.68 327.67 FORMAT "%7.4" /end AXIS_DESCR
/end CHARACTERISTIC
/begin CHARACTERISTIC KF_FMDRES_RGN "Faktor Momentenreserve während einer Regeneration" MAP 0xa082642c _REC_MAP_52_UBYTE_u2_s2_s2 1. _CNV_R_R_Def_f_uw_b_622_CM 0. 1. FORMAT "%7.4"
 /begin AXIS_DESCR STD_AXIS Nkw _CNV_R_R_Def_n_sw_q_595_CM 6 -32768. 32767. FORMAT "%5.0" /end AXIS_DESCR
 /begin AXIS_DESCR STD_AXIS Mdi_zw_soll _CNV_R_R_Def_m_sw_q_554_CM 8 -3276.8 3276.7 FORMAT "%5.2" /end AXIS_DESCR
/end CHARACTERISTIC
/begin CHARACTERISTIC KF_FRKBGDYN_HS "Faktor Verschiebung Brenngrenzen Homogen Schicht" MAP 0xa08263c8 _REC_MAP_52_UBYTE_u2_s2_s2 1. _CNV_R_R_Def_f_uw_b_622_CM 0. 1. FORMAT "%7.4"
 /begin AXIS_DESCR STD_AXIS Nkw _CNV_R_R_Def_n_sw_q_595_CM 6 -32768. 32767. FORMAT "%5.0" /end AXIS_DESCR
 /begin AXIS_DESCR STD_AXIS Drk_soll _CNV_R_R_Def_rk_sw__600_CM 6 -1600. 1599.9511 /end AXIS_DESCR
/end CHARACTERISTIC
/begin CHARACTERISTIC KF_FRKBGDYN_S "Faktor Verschiebung Brenngrenzen Schicht" MAP 0xa0826364 _REC_MAP_52_UBYTE_u2_s2_s2 1. _CNV_R_R_Def_f_uw_b_622_CM 0. 1. FORMAT "%7.4"
 /begin AXIS_DESCR STD_AXIS Nkw _CNV_R_R_Def_n_sw_q_595_CM 6 -32768. 32767. FORMAT "%5.0" /end AXIS_DESCR
 /begin AXIS_DESCR STD_AXIS Drk_soll _CNV_R_R_Def_rk_sw__600_CM 6 -1600. 1599.9511 /end AXIS_DESCR
/end CHARACTERISTIC
/begin CHARACTERISTIC KF_FSPR_BA "Kennfeld für BA Umschaltung Spreizungen" MAP 0xa0825cb8 _REC_MAP_52_u1_u1_u1 0.996 _CNV_R_R_Def_f_ub_b_553_CM 0. 0.996 /begin AXIS_DESCR STD_AXIS Ba_ist _CNV_S_5_Def_ba_gdi_565_CM 3 0. 8. /end AXIS_DESCR /begin AXIS_DESCR STD_AXIS Ba_soll _CNV_S_5_Def_ba_gdi_565_CM 3 0. 8. /end AXIS_DESCR /end CHARACTERISTIC
/begin CHARACTERISTIC KF_FSPR_BAW "Kennfeld für BA Umschaltung Spreizungen" MAP 0xa0825ccc _REC_MAP_52_u1_u1_u1 0.996 _CNV_R_R_Def_f_ub_b_553_CM 0. 0.996 /begin AXIS_DESCR STD_AXIS Ba_subist _CNV_S_22_Def_ba_gdi_567_CM 15 0. 21. /end AXIS_DESCR /begin AXIS_DESCR STD_AXIS Ba_subsoll _CNV_S_22_Def_ba_gdi_567_CM 15 0. 21. /end AXIS_DESCR /end CHARACTERISTIC
/begin CHARACTERISTIC KF_LA_MDMX "" MAP 0xa082b564 _REC_MAP_52_UBYTE_u2_s2_s2 15.9997 _CNV_R_R_Def_f_uw_b_559_CM 0. 15.9997 FORMAT "%7.4"
 /begin AXIS_DESCR STD_AXIS Rfv_soll _CNV_R_R_Def_rf_sw__598_CM 6 -327.68 327.67 FORMAT "%7.4" /end AXIS_DESCR
 /begin AXIS_DESCR STD_AXIS Md_res_anf _CNV_R_R_Def_m_sw_q_554_CM 6 -3276.8 3276.7 FORMAT "%5.2" /end AXIS_DESCR
/end CHARACTERISTIC
/begin CHARACTERISTIC KF_LA_NLEV "Soll Lambda Einlassventilnotlauf" MAP 0xa082bb64 _REC_MAP_52_UBYTE_u2_s2_s2 15.9997 _CNV_R_R_Def_f_uw_b_559_CM 0. 15.9997 FORMAT "%7.4"
 /begin AXIS_DESCR STD_AXIS Rf _CNV_R_R_Def_rf_sw__598_CM 6 -327.68 327.67 FORMAT "%7.4" /end AXIS_DESCR
 /begin AXIS_DESCR STD_AXIS Nkw _CNV_R_R_Def_n_sw_q_595_CM 6 -32768. 32767. FORMAT "%5.0" /end AXIS_DESCR
/end CHARACTERISTIC
/begin CHARACTERISTIC KF_LA_NLKR "Soll Lambda Klopfregelungsnotlauf" MAP 0xa082bbc8 _REC_MAP_52_UBYTE_u2_s2_s2 15.9997 _CNV_R_R_Def_f_uw_b_559_CM 0. 15.9997 FORMAT "%7.4"
 /begin AXIS_DESCR STD_AXIS Rf _CNV_R_R_Def_rf_sw__598_CM 6 -327.68 327.67 FORMAT "%7.4" /end AXIS_DESCR
 /begin AXIS_DESCR STD_AXIS Nkw _CNV_R_R_Def_n_sw_q_595_CM 6 -32768. 32767. FORMAT "%5.0" /end AXIS_DESCR
/end CHARACTERISTIC
/begin CHARACTERISTIC KF_MDKMIN_FIL "Schaltwahrscheinlichkeit" MAP 0xa0826704 _REC_MAP_52_u1_u2_s2 99.60930000000001 _CNV_R_R_Def_f_ub_b_586_CM 0. 99.60930000000001 FORMAT "%5.2"
 /begin AXIS_DESCR STD_AXIS F_n_nstat _CNV_R_R_Def_f_sw_b_616_CM 6 0. 3.9999 FORMAT "%14.5" /end AXIS_DESCR
 /begin AXIS_DESCR STD_AXIS Dmd_min _CNV_R_R_Def_m_sw_q_554_CM 6 -3276.8 3276.7 FORMAT "%5.2" /end AXIS_DESCR
/end CHARACTERISTIC
/begin CHARACTERISTIC KF_PRIO_NOTL "Notfall Betriebsart bei fehlenden Quittungen" MAP 0xa0826600 _REC_MAP_52_UBYTE_u2_s2_s2 0. _CNV_R_R_Def_dez_sl_551_CM 0. 65535. FORMAT "%5.0" /begin AXIS_DESCR STD_AXIS Ba_soll_sw _CNV_S_5_Def_ba_gdi_565_CM 3 0. 8. /end AXIS_DESCR /begin AXIS_DESCR STD_AXIS Ba_prio_sw _CNV_S_5_Def_ba_gdi_565_CM 3 0. 8. /end AXIS_DESCR /end CHARACTERISTIC
/begin CHARACTERISTIC KF_QUIT_BAW "Kennfeld für Quittungen auf Ba_ist" MAP 0xa0825dd0 _REC_MAP_52_u1_s2_s2 1. _CNV_R_R_Def_dez_sl_551_CM 0. 1. FORMAT "%3.0"
 /begin AXIS_DESCR STD_AXIS Ba_ist_sw _CNV_R_R_Def_dez_sl_551_CM 3 -32768. 32767. FORMAT "%5.0" /end AXIS_DESCR
 /begin AXIS_DESCR STD_AXIS Ba_subist_sw _CNV_R_R_Def_dez_sl_551_CM 15 -32768. 32767. FORMAT "%5.0" /end AXIS_DESCR
/end CHARACTERISTIC
/begin CHARACTERISTIC KF_SBAUMS_H "Umschaltkennfeld SubBA Homogen" MAP 0xa0825f40 _REC_MAP_52_UBYTE_u2_s2_s2 0. _CNV_R_R_Def_dez_sl_551_CM 0. 65535. FORMAT "%5.0"
 /begin AXIS_DESCR STD_AXIS Ba_subist_sw _CNV_R_R_Def_dez_sl_551_CM 22 -32768. 32767. FORMAT "%5.0" /end AXIS_DESCR
 /begin AXIS_DESCR STD_AXIS Ba_subsoll_sw _CNV_R_R_Def_dez_sl_551_CM 22 -32768. 32767. FORMAT "%5.0" /end AXIS_DESCR
/end CHARACTERISTIC
/begin CHARACTERISTIC KF_SBAUMS_HS "Umschaltkennfeld SubBA Homogenschicht" MAP 0xa0825e78 _REC_MAP_52_UBYTE_u2_s2_s2 0. _CNV_R_R_Def_dez_sl_551_CM 0. 65535. FORMAT "%5.0"
 /begin AXIS_DESCR STD_AXIS Ba_subist_sw _CNV_R_R_Def_dez_sl_551_CM 6 -32768. 32767. FORMAT "%5.0" /end AXIS_DESCR
 /begin AXIS_DESCR STD_AXIS Ba_subsoll_sw _CNV_R_R_Def_dez_sl_551_CM 6 -32768. 32767. FORMAT "%5.0" /end AXIS_DESCR
/end CHARACTERISTIC
/begin CHARACTERISTIC KF_SBAUMS_S "Umschaltkennfeld SubBA Schicht" MAP 0xa0825edc _REC_MAP_52_UBYTE_u2_s2_s2 0. _CNV_R_R_Def_dez_sl_551_CM 0. 65535. FORMAT "%5.0"
 /begin AXIS_DESCR STD_AXIS Ba_subist_sw _CNV_R_R_Def_dez_sl_551_CM 6 -32768. 32767. FORMAT "%5.0" /end AXIS_DESCR
 /begin AXIS_DESCR STD_AXIS Ba_subsoll_sw _CNV_R_R_Def_dez_sl_551_CM 6 -32768. 32767. FORMAT "%5.0" /end AXIS_DESCR
/end CHARACTERISTIC
/begin CHARACTERISTIC KF_SUBSOLL "Kennfeld mit Soll Subbetriebsart" MAP 0xa0825e24 _REC_MAP_52_u1_s2_s2 14. _CNV_R_R_Def_dez_sl_551_CM 1. 15. FORMAT "%3.0"
 /begin AXIS_DESCR STD_AXIS Ba_prio_sw _CNV_R_R_Def_dez_sl_551_CM 3 -32768. 32767. FORMAT "%5.0" /end AXIS_DESCR
 /begin AXIS_DESCR STD_AXIS Ba_subprio_sw _CNV_R_R_Def_dez_sl_551_CM 15 -32768. 32767. FORMAT "%5.0" /end AXIS_DESCR
/end CHARACTERISTIC
/begin CHARACTERISTIC KF_UMS_NOTL "Notfall Betriebsart bei höngender Umschaltung" MAP 0xa0826620 _REC_MAP_52_UBYTE_u2_s2_s2 0. _CNV_R_R_Def_dez_sl_551_CM 0. 65535. FORMAT "%5.0" /begin AXIS_DESCR STD_AXIS Ba_ist_sw _CNV_S_5_Def_ba_gdi_565_CM 3 0. 8. /end AXIS_DESCR /begin AXIS_DESCR STD_AXIS Ba_soll_sw _CNV_S_5_Def_ba_gdi_565_CM 3 0. 8. /end AXIS_DESCR /end CHARACTERISTIC
/begin CHARACTERISTIC KF_ZWOPT_NOTL "Optimalzündwinkel Notlauf" MAP 0xa082bac0 _REC_MAP_52_UBYTE_s2_s2_s2 131.07 _CNV_R_R_Def_zw_sw__604_CM -3276.8 3276.7 FORMAT "%4.1"
 /begin AXIS_DESCR STD_AXIS Nkw _CNV_R_R_Def_n_sw_q_595_CM 8 -32768. 32767. FORMAT "%5.0" /end AXIS_DESCR
 /begin AXIS_DESCR STD_AXIS Rf _CNV_R_R_Def_rf_sw__598_CM 8 -327.68 327.67 FORMAT "%7.4" /end AXIS_DESCR
/end CHARACTERISTIC
/begin CHARACTERISTIC KF_ZW_NOTL "Zündwinkel Notlauf" MAP 0xa082ba1c _REC_MAP_52_UBYTE_s2_s2_s2 131.07 _CNV_R_R_Def_zw_sw__604_CM -3276.8 3276.7 FORMAT "%4.1"
 /begin AXIS_DESCR STD_AXIS Nkw _CNV_R_R_Def_n_sw_q_595_CM 8 -32768. 32767. FORMAT "%5.0" /end AXIS_DESCR
 /begin AXIS_DESCR STD_AXIS Rf _CNV_R_R_Def_rf_sw__598_CM 8 -327.68 327.67 FORMAT "%7.4" /end AXIS_DESCR
/end CHARACTERISTIC
/begin CHARACTERISTIC KL_ETA_LA "Lambdahaken" CURVE 0xa082b520 _REC_CUR_TKL_UW_VV__u2_s2 15.9997 _CNV_R_R_Def_f_uw_b_559_CM 0. 15.9997 FORMAT "%7.4"
 /begin AXIS_DESCR STD_AXIS Eta_rk_md _CNV_R_R_Def_eta_sw_599_CM 16 -200. 199.9938 /end AXIS_DESCR
/end CHARACTERISTIC
/begin CHARACTERISTIC KL_FMDRES_KH "" CURVE 0xa082667c _REC_CUR_TKL_UW_VV__s2_s2 1.9999 _CNV_R_R_Def_f_uw_b_590_CM -1. 0.9999 FORMAT "%14.5"
 /begin AXIS_DESCR STD_AXIS Mdi_res_kh _CNV_R_R_Def_m_sw_q_554_CM 4 -3276.8 3276.7 FORMAT "%5.2" /end AXIS_DESCR
/end CHARACTERISTIC
/begin CHARACTERISTIC KL_FTMDRES_RGN "Korrektur Md_res_katreg über Nox Kat-Temperatur" CURVE 0xa0825c6c _REC_CUR_TKL_UW_VV__u2_s2 0.9999 _CNV_R_R_Def_f_uw_b_571_CM 0. 0.9999 FORMAT "%14.5"
 /begin AXIS_DESCR STD_AXIS Tabg_nokmin _CNV_R_R_Def_t_sw_q_578_CM 8 -3276.8 3276.7 FORMAT "%4.1" /end AXIS_DESCR
/end CHARACTERISTIC
/begin CHARACTERISTIC KL_FUESPAUS_INKR "Inkrement für Faktor" CURVE 0xa0825c90 _REC_CUR_TKL_UW_VV__u1_s2 0.996 _CNV_R_R_Def_f_ub_b_553_CM 0. 0.996
 /begin AXIS_DESCR STD_AXIS Nkw _CNV_R_R_Def_n_sw_q_595_CM 4 -32768. 32767. FORMAT "%5.0" /end AXIS_DESCR
/end CHARACTERISTIC
/begin CHARACTERISTIC KL_FWNWKHK2_INI "" CURVE 0xa0825c48 _REC_CUR_TKL_UW_VV__u1_u1 99.45 _CNV_R_R_Def_dez_sl_551_CM 0. 255. FORMAT "%3.0"
 /begin AXIS_DESCR STD_AXIS NO_INPUT_QUANTITY _CNV_S_22_Def_ba_gdi_567_CM 16 0. 21. /end AXIS_DESCR
/end CHARACTERISTIC
/begin CHARACTERISTIC KL_FWNWKHK_INI "" CURVE 0xa0825c24 _REC_CUR_TKL_UW_VV__u1_u1 99.45 _CNV_R_R_Def_dez_sl_551_CM 0. 255. FORMAT "%3.0"
 /begin AXIS_DESCR STD_AXIS NO_INPUT_QUANTITY _CNV_S_22_Def_ba_gdi_567_CM 16 0. 21. /end AXIS_DESCR
/end CHARACTERISTIC
/begin CHARACTERISTIC KL_FWNWKH_INI "" CURVE 0xa0825c00 _REC_CUR_TKL_UW_VV__u1_u1 99.45 _CNV_R_R_Def_dez_sl_551_CM 0. 255. FORMAT "%3.0"
 /begin AXIS_DESCR STD_AXIS NO_INPUT_QUANTITY _CNV_S_22_Def_ba_gdi_567_CM 16 0. 21. /end AXIS_DESCR
/end CHARACTERISTIC
/begin CHARACTERISTIC KL_MDIRGN_MX "Kennlinie inneres Moment Regeneration Maximum" CURVE 0xa082656c _REC_CUR_TKL_UW_VV__s2_s2 131.07 _CNV_R_R_Def_m_sw_q_554_CM -3276.8 3276.7 FORMAT "%5.2"
 /begin AXIS_DESCR STD_AXIS Nkw _CNV_R_R_Def_n_sw_q_595_CM 8 -32768. 32767. FORMAT "%5.0" /end AXIS_DESCR
/end CHARACTERISTIC
/begin CHARACTERISTIC KL_MDKMAXUL "" CURVE 0xa08266d4 _REC_CUR_TKL_UW_VV__s2_s2 131.07 _CNV_R_R_Def_m_sw_q_554_CM -3276.8 3276.7 FORMAT "%5.2"
 /begin AXIS_DESCR STD_AXIS Nkw _CNV_R_R_Def_n_sw_q_595_CM 4 -32768. 32767. FORMAT "%5.0" /end AXIS_DESCR
/end CHARACTERISTIC
/begin CHARACTERISTIC KL_MDKMINASR "" CURVE 0xa08266b0 _REC_CUR_TKL_UW_VV__s2_s2 131.07 _CNV_R_R_Def_m_sw_q_554_CM -3276.8 3276.7 FORMAT "%5.2"
 /begin AXIS_DESCR STD_AXIS Nkw _CNV_R_R_Def_n_sw_q_595_CM 8 -32768. 32767. FORMAT "%5.0" /end AXIS_DESCR
/end CHARACTERISTIC
/begin CHARACTERISTIC KL_MDKMIN_NA "mindest Mdkmin-Filterung bei Änderung der Nebenaggregatelast" CURVE 0xa08266f0 _REC_CUR_TKL_UW_VV__u1_s2 99.60930000000001 _CNV_R_R_Def_f_ub_b_586_CM 0. 99.60930000000001 FORMAT "%5.2"
 /begin AXIS_DESCR STD_AXIS Md_na_ramp _CNV_R_R_Def_m_sw_q_554_CM 6 -3276.8 3276.7 FORMAT "%5.2" /end AXIS_DESCR
/end CHARACTERISTIC
/begin CHARACTERISTIC KL_MDMAXNL_1 "Kennlinie 1 Maximale Drehzahl Notlauf" CURVE 0xa082b9f8 _REC_CUR_TKL_UW_VV__s2_s2 131.07 _CNV_R_R_Def_m_sw_q_554_CM -3276.8 3276.7 FORMAT "%5.2"
 /begin AXIS_DESCR STD_AXIS Nkw _CNV_R_R_Def_n_sw_q_595_CM 8 -32768. 32767. FORMAT "%5.0" /end AXIS_DESCR
/end CHARACTERISTIC
/begin CHARACTERISTIC KL_MDMAXNL_2 "Kennlinie 2 Maximales Moment Notlauf" CURVE 0xa082b9d4 _REC_CUR_TKL_UW_VV__s2_s2 131.07 _CNV_R_R_Def_m_sw_q_554_CM -3276.8 3276.7 FORMAT "%5.2"
 /begin AXIS_DESCR STD_AXIS Nkw _CNV_R_R_Def_n_sw_q_595_CM 8 -32768. 32767. FORMAT "%5.0" /end AXIS_DESCR
/end CHARACTERISTIC
/begin CHARACTERISTIC KL_PRIO_BA "Kennlinie Priorisierung der Betriebsarten" CURVE 0xa0826590 _REC_CUR_TKL_UW_VV__u2_u2 99.45 _CNV_R_R_Def_dez_sl_551_CM 0. 255. FORMAT "%5.0"
 /begin AXIS_DESCR STD_AXIS NO_INPUT_QUANTITY _CNV_S_29_Def_ba_anf_681_CM 27 0. 28. /end AXIS_DESCR
/end CHARACTERISTIC
/begin CHARACTERISTIC KL_TMAX_HOM "Kennlinie maximale Zeit Hom" CURVE 0xa0826550 _REC_CUR_TKL_UW_VV__u2_s2 98.30250000000001 _CNV_R_R_Def_td_uw__673_CM 0. 655.35 FORMAT "%5.2"
 /begin AXIS_DESCR STD_AXIS Tmot_start _CNV_R_R_Def_t_sw_q_579_CM 6 -327.68 327.67 FORMAT "%5.2" /end AXIS_DESCR
/end CHARACTERISTIC
/begin CHARACTERISTIC KL_TMIN_SHS "Kennlinie minimale Zeit SHS" CURVE 0xa0826518 _REC_CUR_TKL_UW_VV__s2_s2 98.30250000000001 _CNV_R_R_Def_t_sw_q_579_CM -327.68 327.67 FORMAT "%5.2"
 /begin AXIS_DESCR STD_AXIS Tmot_start _CNV_R_R_Def_t_sw_q_579_CM 6 -327.68 327.67 FORMAT "%5.2" /end AXIS_DESCR
/end CHARACTERISTIC
/begin CHARACTERISTIC KL_ZAEHLVERZ "Kennlinie Umschaltverzögerungszähler" CURVE 0xa0826534 _REC_CUR_TKL_UW_VV__u2_u2 0. _CNV_R_R_Def_dez_sl_551_CM 0. 65535. FORMAT "%5.0"
 /begin AXIS_DESCR STD_AXIS V _CNV_R_R_Def_v_uw_q_726_CM 6 0. 360. FORMAT "%5.0" /end AXIS_DESCR
/end CHARACTERISTIC
/begin CHARACTERISTIC K_ALLVERBOT "Verbotsmatrix, wenn alles verboten" VALUE 0xa08264e7 _REC_VAL_20_u1 2.34 _CNV_S_7_Def_bvgdi_568_CM 0. 6. BIT_MASK 0xFF /end CHARACTERISTIC
/begin CHARACTERISTIC K_BANOAPPL "Applikationswert St_bano" VALUE 0xa08264e8 _REC_VAL_20_u1 99.45 _CNV_R_R_Def_dez_sl_551_CM 0. 255. FORMAT "%3.0" /end CHARACTERISTIC
/begin CHARACTERISTIC K_BANO_VERZ "Konstante Verzögerung für Statuswort St_bano" VALUE 0xa08264c4 _REC_VAL_20_u2 0. _CNV_R_R_Def_dez_sl_551_CM 0. 65535. FORMAT "%5.0" /end CHARACTERISTIC
/begin CHARACTERISTIC K_BASTART "Betriebsart im Start bis Drehzahlschwelle" VALUE 0xa08264e9 _REC_VAL_20_u1 3.12 _CNV_S_5_Def_ba_gdi_565_CM 0. 8. BIT_MASK 0xFF /end CHARACTERISTIC
/begin CHARACTERISTIC K_BAWKALT "Ba wunsch Standart bei kaltem Motor" VALUE 0xa08264c6 _REC_VAL_20_u2 0. _CNV_R_R_Def_dez_sl_551_CM 0. 65535. FORMAT "%5.0" /end CHARACTERISTIC
/begin CHARACTERISTIC K_BAWSCHALT "Bei Umschalten von 0 auf 1 Übernahme Applikationswerte" VALUE 0xa08264ea _REC_VAL_20_u1 1. _CNV_R_R_Def_dez_sl_551_CM 0. 1. FORMAT "%3.0" /end CHARACTERISTIC
/begin CHARACTERISTIC K_BAWU_NL1 "Betriebsartwunsch 1 Notlauf" VALUE 0xa082b8f4 _REC_VAL_20_u2 0. _CNV_R_R_Def_dez_sl_551_CM 0. 65535. FORMAT "%5.0" /end CHARACTERISTIC
/begin CHARACTERISTIC K_BAWU_NL2 "Betriebsartwunsch 2 Notlauf" VALUE 0xa082b8f6 _REC_VAL_20_u2 0. _CNV_R_R_Def_dez_sl_551_CM 0. 65535. FORMAT "%5.0" /end CHARACTERISTIC
/begin CHARACTERISTIC K_BAWU_NL3 "Betriebsartwunsch 3 Notlauf" VALUE 0xa082b8f8 _REC_VAL_20_u2 0. _CNV_R_R_Def_dez_sl_551_CM 0. 65535. FORMAT "%5.0" /end CHARACTERISTIC
/begin CHARACTERISTIC K_BAW_APPL "Ba aus Appl" VALUE 0xa08264eb _REC_VAL_20_u1 8. _CNV_S_5_Def_ba_gdi_565_CM 0. 8. BIT_MASK 0xFF /end CHARACTERISTIC
/begin CHARACTERISTIC K_BAW_APPSUB "SubBa aus Appl" VALUE 0xa08264ec _REC_VAL_20_u1 8.19 _CNV_S_22_Def_ba_gdi_567_CM 0. 21. BIT_MASK 0xFF /end CHARACTERISTIC
/begin CHARACTERISTIC K_BAW_HOMRGN "-" VALUE 0xa0825bda _REC_VAL_20_u2 0. _CNV_R_R_Def_dez_sl_551_CM 0. 65535. FORMAT "%5.0" /end CHARACTERISTIC
/begin CHARACTERISTIC K_BAW_MOTSTOPP "Anforderung Motorstopp" VALUE 0xa08264c8 _REC_VAL_20_u2 0. _CNV_R_R_Def_dez_sl_551_CM 0. 65535. FORMAT "%5.0" /end CHARACTERISTIC
/begin CHARACTERISTIC K_BA_AUSSETZ "Betriebsartenwunsch aus Verbrennungsregelung" VALUE 0xa08264ed _REC_VAL_20_u1 3.12 _CNV_S_5_Def_ba_gdi_565_CM 0. 8. BIT_MASK 0xFF /end CHARACTERISTIC
/begin CHARACTERISTIC K_BA_LAMD "Ba bei der magerer LL zugelassen wird" VALUE 0xa082b501 _REC_VAL_20_u1 8. _CNV_S_7_Def_ba_757_CM 0. 8. BIT_MASK 0xFF /end CHARACTERISTIC
/begin CHARACTERISTIC K_BA_TE "Betriebsartenwunsch Tankentlüftung" VALUE 0xa08264ee _REC_VAL_20_u1 3.12 _CNV_S_5_Def_ba_gdi_565_CM 0. 8. BIT_MASK 0xFF /end CHARACTERISTIC
/begin CHARACTERISTIC K_BA_TOGGLE1 "Hauptbetriebsart Togglefunktion 1" VALUE 0xa08264ef _REC_VAL_20_u1 8. _CNV_S_5_Def_ba_gdi_565_CM 0. 8. BIT_MASK 0xFF /end CHARACTERISTIC
/begin CHARACTERISTIC K_BA_TOGGLE2 "Hauptbetriebsart Togglefunktion 2" VALUE 0xa08264f0 _REC_VAL_20_u1 3.12 _CNV_S_5_Def_ba_gdi_565_CM 0. 8. BIT_MASK 0xFF /end CHARACTERISTIC
/begin CHARACTERISTIC K_BA_TOGSUB1 "Subbetriebsart Togglefunktion 1" VALUE 0xa08264f1 _REC_VAL_20_u1 8.19 _CNV_S_22_Def_ba_gdi_567_CM 0. 21. BIT_MASK 0xFF /end CHARACTERISTIC
/begin CHARACTERISTIC K_BA_TOGSUB2 "Subbetriebsart Togglefunktion 1" VALUE 0xa08264f2 _REC_VAL_20_u1 8.19 _CNV_S_22_Def_ba_gdi_567_CM 0. 21. BIT_MASK 0xFF /end CHARACTERISTIC
/begin CHARACTERISTIC K_BA_ZWGEMAD "Hauptbetriebsart Zwangsgemischadaption" VALUE 0xa08264f3 _REC_VAL_20_u1 8. _CNV_S_5_Def_ba_gdi_565_CM 0. 8. BIT_MASK 0xFF /end CHARACTERISTIC
/begin CHARACTERISTIC K_DMDIBAS_MN "Grenze Basismomentenänderung zur Freigabe ZW-Eingriff" VALUE 0xa0826676 _REC_VAL_20_s2 131.07 _CNV_R_R_Def_m_sw_q_554_CM -3276.8 3276.7 FORMAT "%5.2" /end CHARACTERISTIC
/begin CHARACTERISTIC K_DMDIBAS_MX "Grenze Basismomentenänderung zur Freigabe ZW-Eingriff" VALUE 0xa0826678 _REC_VAL_20_s2 131.07 _CNV_R_R_Def_m_sw_q_554_CM -3276.8 3276.7 FORMAT "%5.2" /end CHARACTERISTIC
/begin CHARACTERISTIC K_DMDZWO "" VALUE 0xa0826672 _REC_VAL_20_s2 131.07 _CNV_R_R_Def_m_sw_q_554_CM -3276.8 3276.7 FORMAT "%5.2" /end CHARACTERISTIC
/begin CHARACTERISTIC K_DMDZWOHYS "" VALUE 0xa0826674 _REC_VAL_20_s2 131.07 _CNV_R_R_Def_m_sw_q_554_CM -3276.8 3276.7 FORMAT "%5.2" /end CHARACTERISTIC
/begin CHARACTERISTIC K_DMDZWOLL "" VALUE 0xa082666e _REC_VAL_20_s2 131.07 _CNV_R_R_Def_m_sw_q_554_CM -3276.8 3276.7 FORMAT "%5.2" /end CHARACTERISTIC
/begin CHARACTERISTIC K_DMDZWOLLHYS "" VALUE 0xa0826670 _REC_VAL_20_s2 131.07 _CNV_R_R_Def_m_sw_q_554_CM -3276.8 3276.7 FORMAT "%5.2" /end CHARACTERISTIC
/begin CHARACTERISTIC K_DMDZWU "" VALUE 0xa0826666 _REC_VAL_20_s2 131.07 _CNV_R_R_Def_m_sw_q_554_CM -3276.8 3276.7 FORMAT "%5.2" /end CHARACTERISTIC
/begin CHARACTERISTIC K_DMDZWUHYS "" VALUE 0xa0826668 _REC_VAL_20_s2 131.07 _CNV_R_R_Def_m_sw_q_554_CM -3276.8 3276.7 FORMAT "%5.2" /end CHARACTERISTIC
/begin CHARACTERISTIC K_DMDZWULL "" VALUE 0xa082666a _REC_VAL_20_s2 131.07 _CNV_R_R_Def_m_sw_q_554_CM -3276.8 3276.7 FORMAT "%5.2" /end CHARACTERISTIC
/begin CHARACTERISTIC K_DMDZWULLHYS "" VALUE 0xa082666c _REC_VAL_20_s2 131.07 _CNV_R_R_Def_m_sw_q_554_CM -3276.8 3276.7 FORMAT "%5.2" /end CHARACTERISTIC
/begin CHARACTERISTIC K_DPOS_AGRZU "Hysteresis Agrpos zu" VALUE 0xa082b8fa _REC_VAL_20_u2 99.9984 _CNV_R_R_Def_f_uw_b_555_CM 0. 99.9984 /end CHARACTERISTIC
/begin CHARACTERISTIC K_DPSVER_LAMD "" VALUE 0xa082b510 _REC_VAL_20_u2 98.30250000000001 _CNV_R_R_Def_td_uw__673_CM 0. 655.35 FORMAT "%5.2" /end CHARACTERISTIC
/begin CHARACTERISTIC K_DPS_LAMD "" VALUE 0xa082b508 _REC_VAL_20_s2 102.398436 _CNV_R_R_Def_p_sw_q_576_CM -1280. 1279.9609 FORMAT "%5.2" /end CHARACTERISTIC
/begin CHARACTERISTIC K_DTMINSHS "Konstante Zeitdifferenz" VALUE 0xa08264bc _REC_VAL_20_s2 98.30250000000001 _CNV_R_R_Def_t_sw_q_579_CM -327.68 327.67 FORMAT "%5.2" /end CHARACTERISTIC
/begin CHARACTERISTIC K_DYNMAN_DELTARF "Offset Relative-Soll-Fuellung" VALUE 0xa08266ac _REC_VAL_20_s2 98.30250000000001 _CNV_R_R_Def_rf_sw__598_CM -327.68 327.67 FORMAT "%7.4" /end CHARACTERISTIC
/begin CHARACTERISTIC K_FRKBG_HS "Faktor Verschiebung Brenngrenzen Homogen Schicht" VALUE 0xa0825bec _REC_VAL_20_u2 1. _CNV_R_R_Def_f_uw_b_622_CM 0. 1. FORMAT "%7.4" /end CHARACTERISTIC
/begin CHARACTERISTIC K_FRKBG_S "Faktor Verschiebung Brenngrenzen Schicht" VALUE 0xa0825bea _REC_VAL_20_u2 1. _CNV_R_R_Def_f_uw_b_622_CM 0. 1. FORMAT "%7.4" /end CHARACTERISTIC
/begin CHARACTERISTIC K_HOMBTS "Ba aus Bauteilschutz" VALUE 0xa08264f4 _REC_VAL_20_u1 8. _CNV_S_5_Def_ba_gdi_565_CM 0. 8. BIT_MASK 0xFF /end CHARACTERISTIC
/begin CHARACTERISTIC K_HOMBTSSUB "SubBa aus Bauteilschutz" VALUE 0xa08264f5 _REC_VAL_20_u1 8.19 _CNV_S_22_Def_ba_gdi_567_CM 0. 21. BIT_MASK 0xFF /end CHARACTERISTIC
/begin CHARACTERISTIC K_HOMHEIZ "Ba wunsch Lambda 1" VALUE 0xa08264f6 _REC_VAL_20_u1 8. _CNV_S_5_Def_ba_gdi_565_CM 0. 8. BIT_MASK 0xFF /end CHARACTERISTIC
/begin CHARACTERISTIC K_HOMHEIZSUB "SubBa wunsch Lambda 1" VALUE 0xa08264f7 _REC_VAL_20_u1 8.19 _CNV_S_22_Def_ba_gdi_567_CM 0. 21. BIT_MASK 0xFF /end CHARACTERISTIC
/begin CHARACTERISTIC K_HOMLA1 "Ba wunsch Lambda 1" VALUE 0xa08264b1 _REC_VAL_20_u1 8. _CNV_S_5_Def_ba_gdi_565_CM 0. 8. BIT_MASK 0xFF /end CHARACTERISTIC
/begin CHARACTERISTIC K_HOMLA1SUB "SubBa wunsch Lambda 1" VALUE 0xa08264b2 _REC_VAL_20_u1 8.19 _CNV_S_22_Def_ba_gdi_567_CM 0. 21. BIT_MASK 0xFF /end CHARACTERISTIC
/begin CHARACTERISTIC K_HOMOPT "" VALUE 0xa0825bfe _REC_VAL_20_u2 0. _CNV_R_R_Def_dez_sl_551_CM 0. 65535. FORMAT "%5.0" /end CHARACTERISTIC
/begin CHARACTERISTIC K_HOMTO2 "Ba wunsch O2 Test" VALUE 0xa08264f8 _REC_VAL_20_u1 8. _CNV_S_5_Def_ba_gdi_565_CM 0. 8. BIT_MASK 0xFF /end CHARACTERISTIC
/begin CHARACTERISTIC K_HOMTO2SUB "SubBa wunsch O2 Test" VALUE 0xa08264f9 _REC_VAL_20_u1 8.19 _CNV_S_22_Def_ba_gdi_567_CM 0. 21. BIT_MASK 0xFF /end CHARACTERISTIC
/begin CHARACTERISTIC K_H_STANDARD "Homogen Standartwunsch" VALUE 0xa08264fa _REC_VAL_20_u1 99.45 _CNV_R_R_Def_dez_sl_551_CM 0. 255. FORMAT "%3.0" /end CHARACTERISTIC
/begin CHARACTERISTIC K_IEFF_FAK "Faktor Sicherheitsabstand I_ges_hs zu I_ges_at" VALUE 0xa0826747 _REC_VAL_20_u1 0.996 _CNV_R_R_Def_f_ub_b_553_CM 0. 0.996 /end CHARACTERISTIC
/begin CHARACTERISTIC K_IEFF_GSMN "min. Triebstrangverstärkung" VALUE 0xa0826766 _REC_VAL_20_u2 102.39684 _CNV_R_R_Def_strv_u_636_CM 7.900000000000001e-003 511.9921 FORMAT "%5.2" /end CHARACTERISTIC
/begin CHARACTERISTIC K_IEFF_GSMX "max. Triebstrangverstärkung" VALUE 0xa0826764 _REC_VAL_20_u2 102.39684 _CNV_R_R_Def_strv_u_636_CM 7.900000000000001e-003 511.9921 FORMAT "%5.2" /end CHARACTERISTIC
/begin CHARACTERISTIC K_I_1GANG "Übersetzng erster Gang" VALUE 0xa082674e _REC_VAL_20_u2 5.999 _CNV_R_R_Def_f_uw_b_617_CM 1.e-003 6. FORMAT "%7.4" /end CHARACTERISTIC
/begin CHARACTERISTIC K_I_1GANGAT "Übersetzng erster Gang AT" VALUE 0xa0826756 _REC_VAL_20_u2 5.999 _CNV_R_R_Def_f_uw_b_617_CM 1.e-003 6. FORMAT "%7.4" /end CHARACTERISTIC
/begin CHARACTERISTIC K_I_1GANGDKG "Übersetzng erster Gang DKG" VALUE 0xa0826750 _REC_VAL_20_u2 5.999 _CNV_R_R_Def_f_uw_b_617_CM 1.e-003 6. FORMAT "%7.4" /end CHARACTERISTIC
/begin CHARACTERISTIC K_I_2GANGAT "Übersetzng 2. Gang AT" VALUE 0xa082674a _REC_VAL_20_u2 5.999 _CNV_R_R_Def_f_uw_b_617_CM 1.e-003 6. FORMAT "%7.4" /end CHARACTERISTIC
/begin CHARACTERISTIC K_I_2GANGDKG "Übersetzng 2. Gang DKG" VALUE 0xa082674c _REC_VAL_20_u2 5.999 _CNV_R_R_Def_f_uw_b_617_CM 1.e-003 6. FORMAT "%7.4" /end CHARACTERISTIC
/begin CHARACTERISTIC K_I_HA "Hinterachsenübersetzung" VALUE 0xa0826758 _REC_VAL_20_u2 5.999 _CNV_R_R_Def_f_uw_b_617_CM 1.e-003 6. FORMAT "%7.4" /end CHARACTERISTIC
/begin CHARACTERISTIC K_I_HAAT "Hinterachsenübersetzung für AT" VALUE 0xa082675a _REC_VAL_20_u2 5.999 _CNV_R_R_Def_f_uw_b_617_CM 1.e-003 6. FORMAT "%7.4" /end CHARACTERISTIC
/begin CHARACTERISTIC K_I_HADKG "Hinterachsenübersetzung für DKG" VALUE 0xa082675c _REC_VAL_20_u2 5.999 _CNV_R_R_Def_f_uw_b_617_CM 1.e-003 6. FORMAT "%7.4" /end CHARACTERISTIC
/begin CHARACTERISTIC K_I_LGANG "Übersetzng längster Gang" VALUE 0xa0826748 _REC_VAL_20_u2 5.999 _CNV_R_R_Def_f_uw_b_617_CM 1.e-003 6. FORMAT "%7.4" /end CHARACTERISTIC
/begin CHARACTERISTIC K_I_LGANGAT "Übersetzng längster Gang AT" VALUE 0xa0826752 _REC_VAL_20_u2 5.999 _CNV_R_R_Def_f_uw_b_617_CM 1.e-003 6. FORMAT "%7.4" /end CHARACTERISTIC
/begin CHARACTERISTIC K_I_LGANGDKG "Übersetzng längster Gang DKG" VALUE 0xa0826754 _REC_VAL_20_u2 5.999 _CNV_R_R_Def_f_uw_b_617_CM 1.e-003 6. FORMAT "%7.4" /end CHARACTERISTIC
/begin CHARACTERISTIC K_KATREG "BA aus Kat Regeneration" VALUE 0xa08264fb _REC_VAL_20_u1 8. _CNV_S_5_Def_ba_gdi_565_CM 0. 8. BIT_MASK 0xFF /end CHARACTERISTIC
/begin CHARACTERISTIC K_KATREGSUB "SubBa aus Kat Regeneration" VALUE 0xa08264fc _REC_VAL_20_u1 8.19 _CNV_S_22_Def_ba_gdi_567_CM 0. 21. BIT_MASK 0xFF /end CHARACTERISTIC
/begin CHARACTERISTIC K_KEINE_BA "Keine Ba gewünscht" VALUE 0xa08264fd _REC_VAL_20_u1 3.12 _CNV_S_5_Def_ba_gdi_565_CM 0. 8. BIT_MASK 0xFF /end CHARACTERISTIC
/begin CHARACTERISTIC K_KHDIAG_FAK "Faktor" VALUE 0xa0826652 _REC_VAL_20_u2 0.9999 _CNV_R_R_Def_f_uw_b_571_CM 0. 0.9999 FORMAT "%14.5" /end CHARACTERISTIC
/begin CHARACTERISTIC K_KHDIAG_FKH "Schwelle Katheizdiagnose" VALUE 0xa0826642 _REC_VAL_20_u1 0.996 _CNV_R_R_Def_f_ub_b_553_CM 0. 0.996 /end CHARACTERISTIC
/begin CHARACTERISTIC K_KHDIAG_NKWMX "Schwelle Katheizdiagnose" VALUE 0xa0826656 _REC_VAL_20_s2 0. _CNV_R_R_Def_n_sw_q_595_CM -32768. 32767. FORMAT "%5.0" /end CHARACTERISTIC
/begin CHARACTERISTIC K_KHMDOE_WART "Wartezeit für Umschaltung DOE bzw EE" VALUE 0xa0825be4 _REC_VAL_20_u2 98.30250000000001 _CNV_R_R_Def_td_uw__673_CM 0. 655.35 FORMAT "%5.2" /end CHARACTERISTIC
/begin CHARACTERISTIC K_KMDZW_DASH "" VALUE 0xa082664a _REC_VAL_20_u1 1.9921 _CNV_R_R_Def_f_ub_b_613_CM 0. 1.9921 /end CHARACTERISTIC
/begin CHARACTERISTIC K_LAMDFAK "Verbesserung des Momentes bei opt Lambda" VALUE 0xa082b505 _REC_VAL_20_u1 1.9921 _CNV_R_R_Def_f_ub_b_613_CM 0. 1.9921 /end CHARACTERISTIC
/begin CHARACTERISTIC K_LAZW_MINUS "" VALUE 0xa082b507 _REC_VAL_20_u1 0.996 _CNV_R_R_Def_f_ub_b_553_CM 0. 0.996 /end CHARACTERISTIC
/begin CHARACTERISTIC K_LAZW_PLUS "" VALUE 0xa082b506 _REC_VAL_20_u1 0.996 _CNV_R_R_Def_f_ub_b_553_CM 0. 0.996 /end CHARACTERISTIC
/begin CHARACTERISTIC K_LA_FIX "Festes Lambda" VALUE 0xa082b8fc _REC_VAL_20_u2 15.9997 _CNV_R_R_Def_f_uw_b_559_CM 0. 15.9997 FORMAT "%7.4" /end CHARACTERISTIC
/begin CHARACTERISTIC K_LA_MDMN "untere Begrenzung Lambda" VALUE 0xa082b51c _REC_VAL_20_u2 15.9997 _CNV_R_R_Def_f_uw_b_559_CM 0. 15.9997 FORMAT "%7.4" /end CHARACTERISTIC
/begin CHARACTERISTIC K_LA_OPT "Lambda für max Leistung" VALUE 0xa082b518 _REC_VAL_20_u2 15.9997 _CNV_R_R_Def_f_uw_b_559_CM 0. 15.9997 FORMAT "%7.4" /end CHARACTERISTIC
/begin CHARACTERISTIC K_LLSTAND "Standartanforderung bei Leerlauf" VALUE 0xa08264fe _REC_VAL_20_u1 8. _CNV_S_5_Def_ba_gdi_565_CM 0. 8. BIT_MASK 0xFF /end CHARACTERISTIC
/begin CHARACTERISTIC K_LLSTANDSUB "Subbetriebsartanforderung  bei LL " VALUE 0xa08264ff _REC_VAL_20_u1 8.19 _CNV_S_22_Def_ba_gdi_567_CM 0. 21. BIT_MASK 0xFF /end CHARACTERISTIC
/begin CHARACTERISTIC K_LLSTANDSUB_1 "Subbetriebsartanforderung bei LL 1" VALUE 0xa0826500 _REC_VAL_20_u1 8.19 _CNV_S_22_Def_ba_gdi_567_CM 0. 21. BIT_MASK 0xFF /end CHARACTERISTIC
/begin CHARACTERISTIC K_LLSTAND_1 "Standartanforderung bei Leerlauf 1" VALUE 0xa0826501 _REC_VAL_20_u1 8. _CNV_S_5_Def_ba_gdi_565_CM 0. 8. BIT_MASK 0xFF /end CHARACTERISTIC
/begin CHARACTERISTIC K_MAT_MDIOP "Zuordnung Eingang Ba-Umschaltung zu Betriebsart" VAL_BLK 0xa082676c _REC_VAL_2_u1 99.45 _CNV_R_R_Def_dez_sl_551_CM 0. 255. FORMAT "%3.0" NUMBER 8 /end CHARACTERISTIC
/begin CHARACTERISTIC K_MA_BAWUNL "Eingang Auswahl, Ba_wu_nl" VAL_BLK 0xa082b918 _REC_VAL_2_u1 99.45 _CNV_R_R_Def_dez_sl_551_CM 0. 255. FORMAT "%3.0" NUMBER 20 /end CHARACTERISTIC
/begin CHARACTERISTIC K_MA_LANL1 "Eingang Auswahl, La_soll_notl" VAL_BLK 0xa082b92c _REC_VAL_2_u1 99.45 _CNV_R_R_Def_dez_sl_551_CM 0. 255. FORMAT "%3.0" NUMBER 20 /end CHARACTERISTIC
/begin CHARACTERISTIC K_MA_LANL2 "Eingang Auswahl, La_soll_notl" VAL_BLK 0xa082b940 _REC_VAL_2_u1 99.45 _CNV_R_R_Def_dez_sl_551_CM 0. 255. FORMAT "%3.0" NUMBER 20 /end CHARACTERISTIC
/begin CHARACTERISTIC K_MA_NMAXNL "Eingang Auswahl, Nmax_notl" VAL_BLK 0xa082b954 _REC_VAL_2_u1 99.45 _CNV_R_R_Def_dez_sl_551_CM 0. 255. FORMAT "%3.0" NUMBER 20 /end CHARACTERISTIC
/begin CHARACTERISTIC K_MA_VBNL "Eingang Auswahl, Ba_vb_nl" VAL_BLK 0xa082b968 _REC_VAL_2_u1 99.45 _CNV_R_R_Def_dez_sl_551_CM 0. 255. FORMAT "%3.0" NUMBER 20 /end CHARACTERISTIC
/begin CHARACTERISTIC K_MA_ZWNL "Eingang Auswahl, Zw_grund_nl, Zw_opt_nl" VAL_BLK 0xa082b97c _REC_VAL_2_u1 99.45 _CNV_R_R_Def_dez_sl_551_CM 0. 255. FORMAT "%3.0" NUMBER 20 /end CHARACTERISTIC
/begin CHARACTERISTIC K_MDBANL_CFG "Auswahl Statuswort 1 Notlauf" VAL_BLK 0xa082b9a4 _REC_VAL_2_u1 99.45 _CNV_R_R_Def_dez_sl_551_CM 0. 255. FORMAT "%3.0" NUMBER 20 /end CHARACTERISTIC
/begin CHARACTERISTIC K_MDBANL_CFG2 "Auswahl Statuswort 2 Notlauf" VAL_BLK 0xa082b990 _REC_VAL_2_u1 99.45 _CNV_R_R_Def_dez_sl_551_CM 0. 255. FORMAT "%3.0" NUMBER 20 /end CHARACTERISTIC
/begin CHARACTERISTIC K_MDIMXNL_ARR "Maximales inneres Moment Auswahl Berechnung" VAL_BLK 0xa082b9b8 _REC_VAL_2_u1 99.45 _CNV_R_R_Def_dez_sl_551_CM 0. 255. FORMAT "%3.0" NUMBER 20 /end CHARACTERISTIC
/begin CHARACTERISTIC K_MDIPM_HYS "Hysterese bei Übertreten durch IPM" VALUE 0xa08266ea _REC_VAL_20_s2 131.07 _CNV_R_R_Def_m_sw_q_554_CM -3276.8 3276.7 FORMAT "%5.2" /end CHARACTERISTIC
/begin CHARACTERISTIC K_MDIRGN_HYS "Konstante inneres Moment Regeneration Hysterese" VALUE 0xa08264be _REC_VAL_20_s2 131.07 _CNV_R_R_Def_m_sw_q_554_CM -3276.8 3276.7 FORMAT "%5.2" /end CHARACTERISTIC
/begin CHARACTERISTIC K_MDISIKOHYST "Hysterese Sicherheitskonzept" VALUE 0xa0826662 _REC_VAL_20_s2 131.07 _CNV_R_R_Def_m_sw_q_554_CM -3276.8 3276.7 FORMAT "%5.2" /end CHARACTERISTIC
/begin CHARACTERISTIC K_MDI_RESOFF "Schwelle Momentenreserve Katheizen aus" VALUE 0xa08266aa _REC_VAL_20_s2 131.07 _CNV_R_R_Def_m_sw_q_554_CM -3276.8 3276.7 FORMAT "%5.2" /end CHARACTERISTIC
/begin CHARACTERISTIC K_MDI_RESON "Schwelle Momentenreserve Katheizen an" VALUE 0xa08266a8 _REC_VAL_20_s2 131.07 _CNV_R_R_Def_m_sw_q_554_CM -3276.8 3276.7 FORMAT "%5.2" /end CHARACTERISTIC
/begin CHARACTERISTIC K_MDI_ZWHAND "Mdi_zw_soll aus Applkonst" VALUE 0xa0826664 _REC_VAL_20_s2 131.07 _CNV_R_R_Def_m_sw_q_554_CM -3276.8 3276.7 FORMAT "%5.2" /end CHARACTERISTIC
/begin CHARACTERISTIC K_MDMAX_ENA "Aktivierung Berechnung Maximales Moment " VAL_BLK 0xa082b9cc _REC_VAL_2_u1 1. _CNV_R_R_Def_dez_sl_551_CM 0. 1. FORMAT "%3.0" NUMBER 8 /end CHARACTERISTIC
/begin CHARACTERISTIC K_MDNARAMP "Inkrementierung der Rampe der fallenden Nebenaggregatelast" VALUE 0xa08266ec _REC_VAL_20_s2 131.07 _CNV_R_R_Def_m_sw_q_554_CM -3276.8 3276.7 FORMAT "%5.2" /end CHARACTERISTIC
/begin CHARACTERISTIC K_MDNOTL_NEG "Dekrement Moment Notlauf (negative Rampe)" VALUE 0xa082b8e4 _REC_VAL_20_s2 98.30250000000001 _CNV_R_R_Def_m_sw_q_649_CM -327.68 327.67 FORMAT "%5.2" /end CHARACTERISTIC
/begin CHARACTERISTIC K_MDNOTL_POS "Inkrement Rampe Notlauf Moment (positive Rampe)" VALUE 0xa082b8e6 _REC_VAL_20_s2 98.30250000000001 _CNV_R_R_Def_m_sw_q_649_CM -327.68 327.67 FORMAT "%5.2" /end CHARACTERISTIC
/begin CHARACTERISTIC K_MDRESKH_MN "" VALUE 0xa082665a _REC_VAL_20_s2 131.07 _CNV_R_R_Def_m_sw_q_554_CM -3276.8 3276.7 FORMAT "%5.2" /end CHARACTERISTIC
/begin CHARACTERISTIC K_MDRES_DIAGON "Schwelle integrierte Soll-Momentenreserve" VALUE 0xa0826654 _REC_VAL_20_s2 131.07 _CNV_R_R_Def_m_sw_q_554_CM -3276.8 3276.7 FORMAT "%5.2" /end CHARACTERISTIC
/begin CHARACTERISTIC K_MDZWPLUS_HYS "Hysterese B_mdzw_plus" VALUE 0xa0826698 _REC_VAL_20_s2 131.07 _CNV_R_R_Def_m_sw_q_554_CM -3276.8 3276.7 FORMAT "%5.2" /end CHARACTERISTIC
/begin CHARACTERISTIC K_MDZW_LSD "" VALUE 0xa082664b _REC_VAL_20_u1 1.9921 _CNV_R_R_Def_f_ub_b_613_CM 0. 1.9921 /end CHARACTERISTIC
/begin CHARACTERISTIC K_MD_RESMXLA "max Momentenreserve die über Lambda vernichtet werden soll" VALUE 0xa082b516 _REC_VAL_20_s2 131.07 _CNV_R_R_Def_m_sw_q_554_CM -3276.8 3276.7 FORMAT "%5.2" /end CHARACTERISTIC
/begin CHARACTERISTIC K_NAB_MN "min mögliche Abtriebsdrehzahl" VALUE 0xa0826762 _REC_VAL_20_s2 0. _CNV_R_R_Def_n_sw_q_595_CM 1. 32767. FORMAT "%5.0" /end CHARACTERISTIC
/begin CHARACTERISTIC K_NBAWNOTMX "Max Drehzahl ehemalige Anforderung Notlauf" VALUE 0xa08264ac _REC_VAL_20_s2 0. _CNV_R_R_Def_n_sw_q_595_CM -32768. 32767. FORMAT "%5.0" /end CHARACTERISTIC
/begin CHARACTERISTIC K_NKWMX_HOS "Maximale Drehzahl HOS aus MDBANL" VALUE 0xa082b8e8 _REC_VAL_20_s2 0. _CNV_R_R_Def_n_sw_q_595_CM -32768. 32767. FORMAT "%5.0" /end CHARACTERISTIC
/begin CHARACTERISTIC K_NKWMX_SCH "Maximal erlaubte Drehzahl für Schicht" VALUE 0xa082b8ea _REC_VAL_20_s2 0. _CNV_R_R_Def_n_sw_q_595_CM -32768. 32767. FORMAT "%5.0" /end CHARACTERISTIC
/begin CHARACTERISTIC K_NKW_KOM_MN "Minimale Schwelle Drehzahl für Leerlaufkomfort" VALUE 0xa08264c0 _REC_VAL_20_s2 0. _CNV_R_R_Def_n_sw_q_595_CM -32768. 32767. FORMAT "%5.0" /end CHARACTERISTIC
/begin CHARACTERISTIC K_NKW_PEMAX "Drehzahl bei der der Motor sein Leistungsmax hat" VALUE 0xa0826760 _REC_VAL_20_s2 0. _CNV_R_R_Def_n_sw_q_595_CM -32768. 32767. FORMAT "%5.0" /end CHARACTERISTIC
/begin CHARACTERISTIC K_NLWAHL_MAN "Notlaufwahl manuell" VALUE 0xa082b902 _REC_VAL_20_u1 99.45 _CNV_R_R_Def_dez_sl_551_CM 0. 255. FORMAT "%3.0" /end CHARACTERISTIC
/begin CHARACTERISTIC K_NLWAHL_NMAXMAG "Eingang Auswahl, Nmax_notl" VALUE 0xa082b903 _REC_VAL_20_u1 99.45 _CNV_R_R_Def_dez_sl_551_CM 0. 255. FORMAT "%3.0" /end CHARACTERISTIC
/begin CHARACTERISTIC K_NMAXBA "-" VALUE 0xa0825bdc _REC_VAL_20_s2 0. _CNV_R_R_Def_n_sw_q_595_CM -32768. 32767. FORMAT "%5.0" /end CHARACTERISTIC
/begin CHARACTERISTIC K_NMAX_NL1 "Notlaufdrehzahl 1" VALUE 0xa082b8ec _REC_VAL_20_s2 0. _CNV_R_R_Def_n_sw_q_595_CM -32768. 32767. FORMAT "%5.0" /end CHARACTERISTIC
/begin CHARACTERISTIC K_NMAX_NL2 "Notlaufdrehzahl 2" VALUE 0xa082b8ee _REC_VAL_20_s2 0. _CNV_R_R_Def_n_sw_q_595_CM -32768. 32767. FORMAT "%5.0" /end CHARACTERISTIC
/begin CHARACTERISTIC K_NMAX_NL3 "Notlauf Drehzahl 3" VALUE 0xa082b8f0 _REC_VAL_20_s2 0. _CNV_R_R_Def_n_sw_q_595_CM -32768. 32767. FORMAT "%5.0" /end CHARACTERISTIC
/begin CHARACTERISTIC K_NOTLW_AGRAUF "Notlaufwahl AGR-Ventil auf" VALUE 0xa082b904 _REC_VAL_20_u1 99.45 _CNV_R_R_Def_dez_sl_551_CM 0. 255. FORMAT "%3.0" /end CHARACTERISTIC
/begin CHARACTERISTIC K_NOTLW_AGRZU "Notlaufwahl AGR-Ventil Zu" VALUE 0xa082b905 _REC_VAL_20_u1 99.45 _CNV_R_R_Def_dez_sl_551_CM 0. 255. FORMAT "%3.0" /end CHARACTERISTIC
/begin CHARACTERISTIC K_NOTLW_ASEABGAS "Notlaufwahl Aussetzererkennung Abgas" VALUE 0xa082b906 _REC_VAL_20_u1 99.45 _CNV_R_R_Def_dez_sl_551_CM 0. 255. FORMAT "%3.0" /end CHARACTERISTIC
/begin CHARACTERISTIC K_NOTLW_ASEKAT "Notlaufwahl Aussetzererkennung Kat" VALUE 0xa082b907 _REC_VAL_20_u1 99.45 _CNV_R_R_Def_dez_sl_551_CM 0. 255. FORMAT "%3.0" /end CHARACTERISTIC
/begin CHARACTERISTIC K_NOTLW_DKRATIO "Notlaufwahl Drosselklappenratio" VALUE 0xa082b908 _REC_VAL_20_u1 99.45 _CNV_R_R_Def_dez_sl_551_CM 0. 255. FORMAT "%3.0" /end CHARACTERISTIC
/begin CHARACTERISTIC K_NOTLW_EVDIAG "Notlaufwahl Einlassventildiagnose Bank 1 und 2" VALUE 0xa082b909 _REC_VAL_20_u1 99.45 _CNV_R_R_Def_dez_sl_551_CM 0. 255. FORMAT "%3.0" /end CHARACTERISTIC
/begin CHARACTERISTIC K_NOTLW_EVDIAG1 "Notlaufwahl Einlassventildiagnose Bank1" VALUE 0xa082b90a _REC_VAL_20_u1 99.45 _CNV_R_R_Def_dez_sl_551_CM 0. 255. FORMAT "%3.0" /end CHARACTERISTIC
/begin CHARACTERISTIC K_NOTLW_EVDIAG2 "Notlaufwahl Einlassventildiagnose Bank2" VALUE 0xa082b90b _REC_VAL_20_u1 99.45 _CNV_R_R_Def_dez_sl_551_CM 0. 255. FORMAT "%3.0" /end CHARACTERISTIC
/begin CHARACTERISTIC K_NOTLW_KRDWS "Notlaufwahl Klopfregelung" VALUE 0xa082b90c _REC_VAL_20_u1 99.45 _CNV_R_R_Def_dez_sl_551_CM 0. 255. FORMAT "%3.0" /end CHARACTERISTIC
/begin CHARACTERISTIC K_NOTLW_NOTL3 "Notlaufwahl Notlauf3" VALUE 0xa082b90d _REC_VAL_20_u1 99.45 _CNV_R_R_Def_dez_sl_551_CM 0. 255. FORMAT "%3.0" /end CHARACTERISTIC
/begin CHARACTERISTIC K_NOTLW_PRAIL "Notlaufwahl Raildruck" VALUE 0xa082b90e _REC_VAL_20_u1 99.45 _CNV_R_R_Def_dez_sl_551_CM 0. 255. FORMAT "%3.0" /end CHARACTERISTIC
/begin CHARACTERISTIC K_NOTLW_PRAILVCV "Notlaufwahl Raildruck Mengensteuerventil" VALUE 0xa082b90f _REC_VAL_20_u1 99.45 _CNV_R_R_Def_dez_sl_551_CM 0. 255. FORMAT "%3.0" /end CHARACTERISTIC
/begin CHARACTERISTIC K_NOTLW_PRAILVFD "Notlaufwahl Raildruck Vorförderdruck" VALUE 0xa082b910 _REC_VAL_20_u1 99.45 _CNV_R_R_Def_dez_sl_551_CM 0. 255. FORMAT "%3.0" /end CHARACTERISTIC
/begin CHARACTERISTIC K_NOTLW_TEV "Notlaufwahl TEV" VALUE 0xa082b911 _REC_VAL_20_u1 99.45 _CNV_R_R_Def_dez_sl_551_CM 0. 255. FORMAT "%3.0" /end CHARACTERISTIC
/begin CHARACTERISTIC K_NOTLW_UBAT "Notlaufwahl bei zu geringer Bordnetzspannung" VALUE 0xa082b912 _REC_VAL_20_u1 99.45 _CNV_R_R_Def_dez_sl_551_CM 0. 255. FORMAT "%3.0" /end CHARACTERISTIC
/begin CHARACTERISTIC K_NWEHYS "Hysterese Nwe zur Freischaltung B_md_dynman" VALUE 0xa08266a0 _REC_VAL_20_s2 0. _CNV_R_R_Def_n_sw_q_595_CM -32768. 32767. FORMAT "%5.0" /end CHARACTERISTIC
/begin CHARACTERISTIC K_POS_AGRZU "Schwelle Agrpos zu" VALUE 0xa082b8fe _REC_VAL_20_u2 99.9984 _CNV_R_R_Def_f_uw_b_555_CM 0. 99.9984 /end CHARACTERISTIC
/begin CHARACTERISTIC K_PRIORESET "Zeit, nach der ein automatischer Reset des Prionotlaufs stattfindet" VALUE 0xa08264ca _REC_VAL_20_u2 98.30250000000001 _CNV_R_R_Def_td_uw__673_CM 0. 655.35 FORMAT "%5.2" /end CHARACTERISTIC
/begin CHARACTERISTIC K_PRIORESETK "Zeit, nach der ein automatischer Reset des Prionotlaufs stattfindet" VALUE 0xa08264cc _REC_VAL_20_u2 98.30250000000001 _CNV_R_R_Def_td_uw__673_CM 0. 655.35 FORMAT "%5.2" /end CHARACTERISTIC
/begin CHARACTERISTIC K_PRMX_PRNOT "Priorisierungsschwelle für Notfallmassnahme" VALUE 0xa0826502 _REC_VAL_20_u1 99.45 _CNV_R_R_Def_dez_sl_551_CM 0. 255. FORMAT "%3.0" /end CHARACTERISTIC
/begin CHARACTERISTIC K_PRMX_UMNOT "Priorisierungsschwelle für Notfallmassnahme" VALUE 0xa0826503 _REC_VAL_20_u1 99.45 _CNV_R_R_Def_dez_sl_551_CM 0. 255. FORMAT "%3.0" /end CHARACTERISTIC
/begin CHARACTERISTIC K_PROZKH_MX "Schwelle Verhältnis integrierte Differenz Ist-Momentenreserve/Soll-Momentenreserve" VALUE 0xa082664c _REC_VAL_20_u1 0.996 _CNV_R_R_Def_f_ub_b_553_CM 0. 0.996 /end CHARACTERISTIC
/begin CHARACTERISTIC K_PSPVDK_GDV "Schaltschwelle B_gdvhub" VALUE 0xa0825bde _REC_VAL_20_u2 0.9999 _CNV_R_R_Def_f_uw_b_571_CM 0. 0.9999 FORMAT "%14.5" /end CHARACTERISTIC
/begin CHARACTERISTIC K_PWG_KOM_MN "Minimale Schwelle Fahrpedal für Leerlaufkomfort" VALUE 0xa08264c2 _REC_VAL_20_s2 95.99852999999999 _CNV_R_R_Def_wdk_sw_683_CM -800. 799.9755 FORMAT "%5.2" /end CHARACTERISTIC
/begin CHARACTERISTIC K_RFMIN_OFS "Offset Rf für Umschaltung bei Zw_min" VALUE 0xa0825be8 _REC_VAL_20_s2 98.30250000000001 _CNV_R_R_Def_rf_sw__598_CM -327.68 327.67 FORMAT "%7.4" /end CHARACTERISTIC
/begin CHARACTERISTIC K_RFRESMAX_HYS "Hysterese für Setzen B_rk_resmax" VALUE 0xa0825be6 _REC_VAL_20_s2 98.30250000000001 _CNV_R_R_Def_rf_sw__598_CM -327.68 327.67 FORMAT "%7.4" /end CHARACTERISTIC
/begin CHARACTERISTIC K_R_DYN "" VALUE 0xa0826768 _REC_VAL_20_u2 0.9998 _CNV_R_R_Def_f_uw_b_571_CM 1.e-004 0.9999 FORMAT "%14.5" /end CHARACTERISTIC
/begin CHARACTERISTIC K_R_DYNLDM "" VALUE 0xa082676a _REC_VAL_20_u2 0.9998 _CNV_R_R_Def_f_uw_b_571_CM 1.e-004 0.9999 FORMAT "%14.5" /end CHARACTERISTIC
/begin CHARACTERISTIC K_SEGBANK "Zuordnung Eingang Ba-Umschaltung zu Betriebsart" VAL_BLK 0xa082c108 _REC_VAL_2_u1 99.45 _CNV_R_R_Def_dez_sl_551_CM 0. 255. FORMAT "%3.0" NUMBER 8 /end CHARACTERISTIC
/begin CHARACTERISTIC K_ST_LDMCHK "" VALUE 0xa0826691 _REC_VAL_20_u1 99.45 _CNV_R_R_Def_dez_sl_551_CM 0. 255. FORMAT "%3.0" /end CHARACTERISTIC
/begin CHARACTERISTIC K_ST_LDMINIT "" VALUE 0xa0826693 _REC_VAL_20_u1 99.45 _CNV_R_R_Def_dez_sl_551_CM 0. 255. FORMAT "%3.0" /end CHARACTERISTIC
/begin CHARACTERISTIC K_ST_LDMKUPP "" VALUE 0xa0826690 _REC_VAL_20_u1 99.45 _CNV_R_R_Def_dez_sl_551_CM 0. 255. FORMAT "%3.0" /end CHARACTERISTIC
/begin CHARACTERISTIC K_ST_LDMOFF "" VALUE 0xa0826692 _REC_VAL_20_u1 99.45 _CNV_R_R_Def_dez_sl_551_CM 0. 255. FORMAT "%3.0" /end CHARACTERISTIC
/begin CHARACTERISTIC K_ST_MDINFOGES "" VALUE 0xa0826694 _REC_VAL_20_u1 99.45 _CNV_R_R_Def_dez_sl_551_CM 0. 255. FORMAT "%3.0" /end CHARACTERISTIC
/begin CHARACTERISTIC K_ST_MDINFOL "" VALUE 0xa0826695 _REC_VAL_20_u1 99.45 _CNV_R_R_Def_dez_sl_551_CM 0. 255. FORMAT "%3.0" /end CHARACTERISTIC
/begin CHARACTERISTIC K_ST_MDINFOS "" VALUE 0xa0826696 _REC_VAL_20_u1 99.45 _CNV_R_R_Def_dez_sl_551_CM 0. 255. FORMAT "%3.0" /end CHARACTERISTIC
/begin CHARACTERISTIC K_SUBBA_ZWGEMAD "Subbetriebsart Zwangsgemischadaption" VALUE 0xa0826504 _REC_VAL_20_u1 8.19 _CNV_S_22_Def_ba_gdi_567_CM 0. 21. BIT_MASK 0xFF /end CHARACTERISTIC
/begin CHARACTERISTIC K_TBA_TOGGLE "Zeitdauer Togglefunktion" VALUE 0xa08264ce _REC_VAL_20_u2 98.30250000000001 _CNV_R_R_Def_td_uw__673_CM 0. 655.35 FORMAT "%5.2" /end CHARACTERISTIC
/begin CHARACTERISTIC K_TDLAMD_AUS "" VALUE 0xa082b514 _REC_VAL_20_u2 98.30250000000001 _CNV_R_R_Def_td_uw__673_CM 0. 655.35 FORMAT "%5.2" /end CHARACTERISTIC
/begin CHARACTERISTIC K_TDLAMD_EIN "" VALUE 0xa082b50e _REC_VAL_20_u2 98.30250000000001 _CNV_R_R_Def_td_uw__673_CM 0. 655.35 FORMAT "%5.2" /end CHARACTERISTIC
/begin CHARACTERISTIC K_TDLAMD_EIN2 "" VALUE 0xa082b512 _REC_VAL_20_u2 98.30250000000001 _CNV_R_R_Def_td_uw__673_CM 0. 655.35 FORMAT "%5.2" /end CHARACTERISTIC
/begin CHARACTERISTIC K_TDMAX_BAWBEOPT "Maximale Wartezeit für verbrauchsoptimalen BA-Wechsel" VALUE 0xa0825be0 _REC_VAL_20_u2 98.30250000000001 _CNV_R_R_Def_td_uw__673_CM 0. 655.35 FORMAT "%5.2" /end CHARACTERISTIC
/begin CHARACTERISTIC K_TDTEVZU "Wartezeit für TEV geschlossen nach BA-Wechsel" VALUE 0xa0825be2 _REC_VAL_20_u2 98.30250000000001 _CNV_R_R_Def_td_uw__673_CM 0. 655.35 FORMAT "%5.2" /end CHARACTERISTIC
/begin CHARACTERISTIC K_TDZWBAW_OFF "" VALUE 0xa0825bf4 _REC_VAL_20_u1 2.55 _CNV_R_R_Def_td_uw__673_CM 0. 2.55 FORMAT "%5.2" /end CHARACTERISTIC
/begin CHARACTERISTIC K_TEBGLLA_OFF "" VALUE 0xa082b50a _REC_VAL_20_s2 99.83843999999999 _CNV_R_R_Def_f_sw_b_623_CM -64. 63.998 /end CHARACTERISTIC
/begin CHARACTERISTIC K_TMAX_QUIT "Maximale Dauer für Quittungen" VALUE 0xa08264d0 _REC_VAL_20_u2 98.30250000000001 _CNV_R_R_Def_td_uw__673_CM 0. 655.35 FORMAT "%5.2" /end CHARACTERISTIC
/begin CHARACTERISTIC K_TMAX_UMS "Maximale Dauer für Umschaltung" VALUE 0xa08264d2 _REC_VAL_20_u2 98.30250000000001 _CNV_R_R_Def_td_uw__673_CM 0. 655.35 FORMAT "%5.2" /end CHARACTERISTIC
/begin CHARACTERISTIC K_TMINHOMSTA "Kennwert für Zeit zum Festsetzen auf Homogen nach Startende" VALUE 0xa08264d4 _REC_VAL_20_u2 98.30250000000001 _CNV_R_R_Def_td_uw__673_CM 0. 655.35 FORMAT "%5.2" /end CHARACTERISTIC
/begin CHARACTERISTIC K_TMOTMAX_ZSK "Temperaturschwelle zur Erkennung Kalte Gleichstellung nicht erfolgt" VALUE 0xa08264ae _REC_VAL_20_s2 98.30250000000001 _CNV_R_R_Def_t_sw_q_579_CM -327.68 327.67 FORMAT "%5.2" /end CHARACTERISTIC
/begin CHARACTERISTIC K_TMXBASTART "Konstante maximale Zeit Betriebsart Start" VALUE 0xa08264d6 _REC_VAL_20_u2 98.30250000000001 _CNV_R_R_Def_td_uw__673_CM 0. 655.35 FORMAT "%5.2" /end CHARACTERISTIC
/begin CHARACTERISTIC K_TUMS_MONIMX "Maximale Zeit Umschaltungsverbot" VALUE 0xa08264d8 _REC_VAL_20_u2 98.30250000000001 _CNV_R_R_Def_td_uw__673_CM 0. 655.35 FORMAT "%5.2" /end CHARACTERISTIC
/begin CHARACTERISTIC K_TWARTEND "Zähler für Abbruch Subba Umschaltung" VALUE 0xa0825bef _REC_VAL_20_u1 99.45 _CNV_R_R_Def_dez_sl_551_CM 0. 255. FORMAT "%3.0" /end CHARACTERISTIC
/begin CHARACTERISTIC K_T_LAMD "Tmot-Schwelle für Rampe F_lazw_md" VALUE 0xa082b51a _REC_VAL_20_s2 98.30250000000001 _CNV_R_R_Def_t_sw_q_579_CM -327.68 327.67 FORMAT "%5.2" /end CHARACTERISTIC
/begin CHARACTERISTIC K_UBMIN_NOTL "Notlauf bei zu geringer Bordnetzspannung" VALUE 0xa082b900 _REC_VAL_20_u2 123.46794 _CNV_R_R_Def_u_sb_q_583_CM 0. 6173.397 FORMAT "%4.1" /end CHARACTERISTIC
/begin CHARACTERISTIC K_V2NAB "Umrechnungsfaktor V in N_ab" VALUE 0xa082675e _REC_VAL_20_u2 63.99900000000001 _CNV_R_R_Def_f_uw_b_617_CM 0. 63.999 FORMAT "%7.4" /end CHARACTERISTIC
/begin CHARACTERISTIC K_VB_APPL "Verbot aus Applikation" VALUE 0xa0826505 _REC_VAL_20_u1 2.34 _CNV_S_7_Def_bvgdi_568_CM 0. 6. BIT_MASK 0xFF /end CHARACTERISTIC
/begin CHARACTERISTIC K_VLLZWHD "V-Schwelle zum setzen von B_md_dynman" VALUE 0xa08266a2 _REC_VAL_20_u2 100.8 _CNV_R_R_Def_v_uw_q_726_CM 0. 360. FORMAT "%5.0" /end CHARACTERISTIC
/begin CHARACTERISTIC K_VLLZWHD_HYS "V-Schwelle zum zurücksetzen von B_md_dynman" VALUE 0xa08266a4 _REC_VAL_20_u2 100.8 _CNV_R_R_Def_v_uw_q_726_CM 0. 360. FORMAT "%5.0" /end CHARACTERISTIC
/begin CHARACTERISTIC K_VLSTAND "Standartanforderung bei Volllast" VALUE 0xa0826506 _REC_VAL_20_u1 8. _CNV_S_5_Def_ba_gdi_565_CM 0. 8. BIT_MASK 0xFF /end CHARACTERISTIC
/begin CHARACTERISTIC K_VLSTANDSUB "Sunbetriebsartanforderung bei Volllast" VALUE 0xa0826507 _REC_VAL_20_u1 8.19 _CNV_S_22_Def_ba_gdi_567_CM 0. 21. BIT_MASK 0xFF /end CHARACTERISTIC
/begin CHARACTERISTIC K_VMAX_MHAUF "Geschwindigkeitsschwelle Haubenschalter aus" VALUE 0xa08264da _REC_VAL_20_u2 0. _CNV_R_R_Def_v_uw_q_726_CM 0. 65535. FORMAT "%5.0" /end CHARACTERISTIC
/begin CHARACTERISTIC K_VMAX_MHPLAUS "Geschwindigkeitsschwelle Plausibilisierung Haubenschalter" VALUE 0xa08264dc _REC_VAL_20_u2 0. _CNV_R_R_Def_v_uw_q_726_CM 0. 65535. FORMAT "%5.0" /end CHARACTERISTIC
/begin CHARACTERISTIC K_V_KOM_MN "Minimale Schwelle Geschwindigkeit für Leerlaufkomfort" VALUE 0xa08264de _REC_VAL_20_u2 0. _CNV_R_R_Def_v_uw_q_726_CM 0. 65535. FORMAT "%5.0" /end CHARACTERISTIC
/begin CHARACTERISTIC K_V_LAMD "Fz-Geschwindigkeit" VALUE 0xa082b50c _REC_VAL_20_u2 100.8 _CNV_R_R_Def_v_uw_q_726_CM 0. 360. FORMAT "%5.0" /end CHARACTERISTIC
/begin CHARACTERISTIC K_WNWKH01 "" VALUE 0xa0825bf2 _REC_VAL_20_u1 0.996 _CNV_R_R_Def_f_ub_b_553_CM 0. 0.996 /end CHARACTERISTIC
/begin CHARACTERISTIC K_WNWKH10 "" VALUE 0xa0825bf3 _REC_VAL_20_u1 0.996 _CNV_R_R_Def_f_ub_b_553_CM 0. 0.996 /end CHARACTERISTIC
/begin CHARACTERISTIC K_WNWKHK_COPY "Filterkonstante Übergang" VALUE 0xa0825bf7 _REC_VAL_20_u1 0.996 _CNV_R_R_Def_f_ub_b_553_CM 0. 0.996 /end CHARACTERISTIC
/begin CHARACTERISTIC K_WNWKHK_DOE2EE_EM "Filterkonstante Übergang" VALUE 0xa0825bf9 _REC_VAL_20_u1 0.996 _CNV_R_R_Def_f_ub_b_553_CM 0. 0.996 /end CHARACTERISTIC
/begin CHARACTERISTIC K_WNWKHK_DOE2EE_LR "Filterkonstante Übergang" VALUE 0xa0825bf8 _REC_VAL_20_u1 0.996 _CNV_R_R_Def_f_ub_b_553_CM 0. 0.996 /end CHARACTERISTIC
/begin CHARACTERISTIC K_WNWKHK_EE2DOE_EM "Filterkonstante Übergang" VALUE 0xa0825bfb _REC_VAL_20_u1 0.996 _CNV_R_R_Def_f_ub_b_553_CM 0. 0.996 /end CHARACTERISTIC
/begin CHARACTERISTIC K_WNWKHK_EE2DOE_LR "Filterkonstante Übergang" VALUE 0xa0825bfa _REC_VAL_20_u1 0.996 _CNV_R_R_Def_f_ub_b_553_CM 0. 0.996 /end CHARACTERISTIC
/begin CHARACTERISTIC K_WNWKHK_EM2LR "Filterkonstante Übergang" VALUE 0xa0825bf6 _REC_VAL_20_u1 0.996 _CNV_R_R_Def_f_ub_b_553_CM 0. 0.996 /end CHARACTERISTIC
/begin CHARACTERISTIC K_WNWKHK_LR2EM "Filterkonstante Übergang" VALUE 0xa0825bf5 _REC_VAL_20_u1 0.996 _CNV_R_R_Def_f_ub_b_553_CM 0. 0.996 /end CHARACTERISTIC
/begin CHARACTERISTIC K_ZR_KHDIAG "Zaehlerfreigabe Katheizfehlereintrag Schwelle" VALUE 0xa0826641 _REC_VAL_20_u1 99.45 _CNV_R_R_Def_dez_sl_551_CM 0. 255. FORMAT "%3.0" /end CHARACTERISTIC
/begin CHARACTERISTIC K_ZWRAMP_MDMAX "max Rampensteigung" VALUE 0xa082665e _REC_VAL_20_s2 131.07 _CNV_R_R_Def_m_sw_q_554_CM -3276.8 3276.7 FORMAT "%5.2" /end CHARACTERISTIC
/begin CHARACTERISTIC K_ZWRAMP_MIN "min Rampensteigung" VALUE 0xa0826660 _REC_VAL_20_s2 131.07 _CNV_R_R_Def_m_sw_q_554_CM -3276.8 3276.7 FORMAT "%5.2" /end CHARACTERISTIC
/begin CHARACTERISTIC K_ZWRAMP_NMX "" VALUE 0xa0826658 _REC_VAL_20_s2 0. _CNV_R_R_Def_n_sw_q_595_CM -32768. 32767. FORMAT "%5.0" /end CHARACTERISTIC
/begin CHARACTERISTIC K_ZWRAMP_PLUS "max Rampensteigung" VALUE 0xa082665c _REC_VAL_20_s2 131.07 _CNV_R_R_Def_m_sw_q_554_CM -3276.8 3276.7 FORMAT "%5.2" /end CHARACTERISTIC
/begin CHARACTERISTIC S_APPLRESBHAEUMS "Schalter aktivierung Reset Diagnose hängende Umschaltung bei BA Wechsel" VALUE 0xa0826508 _REC_VAL_20_u1 1. _CNV_R_R_Def_dez_sl_551_CM 0. 1. FORMAT "%3.0" /end CHARACTERISTIC
/begin CHARACTERISTIC S_AUSW_V "1: eingerechnete Geschwindigkeit V, 0: eingerechnete Geschwindigkeit V_can" VALUE 0xa0826744 _REC_VAL_20_u1 99.45 _CNV_R_R_Def_dez_sl_551_CM 0. 255. FORMAT "%3.0" /end CHARACTERISTIC
/begin CHARACTERISTIC S_BAPRIOSTFEST "Schalter zum Festhalten Ba_prio bis nach Startende" VALUE 0xa0826509 _REC_VAL_20_u1 1. _CNV_R_R_Def_dez_sl_551_CM 0. 1. FORMAT "%3.0" /end CHARACTERISTIC
/begin CHARACTERISTIC S_BASTART_NKW "Schalter Betriebsart Start Drehzahl" VALUE 0xa082650a _REC_VAL_20_u1 1. _CNV_R_R_Def_dez_sl_551_CM 0. 1. FORMAT "%3.0" /end CHARACTERISTIC
/begin CHARACTERISTIC S_BASTATRES "Reset der aktuellen Verteilungsanzeige der Betriebsarten" VALUE 0xa082650b _REC_VAL_20_u1 1. _CNV_R_R_Def_dez_sl_551_CM 0. 1. FORMAT "%3.0" /end CHARACTERISTIC
/begin CHARACTERISTIC S_BASTATRESG "Reset der gesamten Verteilungsanzeige der Betriebsarten" VALUE 0xa082650c _REC_VAL_20_u1 1. _CNV_R_R_Def_dez_sl_551_CM 0. 1. FORMAT "%3.0" /end CHARACTERISTIC
/begin CHARACTERISTIC S_BA_TOGGLE "Schalter zum Einschalten Togglefunktion" VALUE 0xa082650d _REC_VAL_20_u1 1. _CNV_R_R_Def_dez_sl_551_CM 0. 1. FORMAT "%3.0" /end CHARACTERISTIC
/begin CHARACTERISTIC S_CLRTBABR "Schalter zum Löschen Fehlerzähler" VALUE 0xa082650e _REC_VAL_20_u1 1. _CNV_R_R_Def_dez_sl_551_CM 0. 1. FORMAT "%3.0" /end CHARACTERISTIC
/begin CHARACTERISTIC S_DESU_FETT "Schalter Aktivierung Einrechnung" VALUE 0xa082650f _REC_VAL_20_u1 1. _CNV_R_R_Def_dez_sl_551_CM 0. 1. FORMAT "%3.0" /end CHARACTERISTIC
/begin CHARACTERISTIC S_DESU_PULS "Schalter Aktivierung Einrechnung" VALUE 0xa0826510 _REC_VAL_20_u1 1. _CNV_R_R_Def_dez_sl_551_CM 0. 1. FORMAT "%3.0" /end CHARACTERISTIC
/begin CHARACTERISTIC S_DMDZWON "true: Momenteneingriff freigegeben" VALUE 0xa0826648 _REC_VAL_20_u1 99.45 _CNV_R_R_Def_dez_sl_551_CM 0. 255. FORMAT "%3.0" /end CHARACTERISTIC
/begin CHARACTERISTIC S_DYNMAN_RF "" VALUE 0xa082669a _REC_VAL_20_u1 99.45 _CNV_R_R_Def_dez_sl_551_CM 0. 255. FORMAT "%3.0" /end CHARACTERISTIC
/begin CHARACTERISTIC S_ETA_RES "true: Eta_res wird eingerechnet, ansonsten 100%" VALUE 0xa0826645 _REC_VAL_20_u1 99.45 _CNV_R_R_Def_dez_sl_551_CM 0. 255. FORMAT "%3.0" /end CHARACTERISTIC
/begin CHARACTERISTIC S_FAILSTARES "Rücksetzen Zähler Subba Abbruch" VALUE 0xa0825bf0 _REC_VAL_20_u1 1. _CNV_R_R_Def_dez_sl_551_CM 0. 1. FORMAT "%3.0" /end CHARACTERISTIC
/begin CHARACTERISTIC S_FWNW_APPL "Applikationsschalter Test F_wnwkhk_sw Einrechung" VALUE 0xa0825bfc _REC_VAL_20_u1 1. _CNV_R_R_Def_dez_sl_551_CM 0. 1. FORMAT "%3.0" /end CHARACTERISTIC
/begin CHARACTERISTIC S_GDNKW "Schalter" VALUE 0xa082b913 _REC_VAL_20_u1 1. _CNV_R_R_Def_dez_sl_551_CM 0. 1. FORMAT "%3.0" /end CHARACTERISTIC
/begin CHARACTERISTIC S_HAI_ON "" VALUE 0xa082669e _REC_VAL_20_u1 99.45 _CNV_R_R_Def_dez_sl_551_CM 0. 255. FORMAT "%3.0" /end CHARACTERISTIC
/begin CHARACTERISTIC S_IEFF_GS "" VALUE 0xa0826746 _REC_VAL_20_u1 99.45 _CNV_R_R_Def_dez_sl_551_CM 0. 255. FORMAT "%3.0" /end CHARACTERISTIC
/begin CHARACTERISTIC S_IPM_04 "IPM04 aktiv" VALUE 0xa08266e8 _REC_VAL_20_u1 99.45 _CNV_R_R_Def_dez_sl_551_CM 0. 255. FORMAT "%3.0" /end CHARACTERISTIC
/begin CHARACTERISTIC S_IPM_HS "" VALUE 0xa0826745 _REC_VAL_20_u1 99.45 _CNV_R_R_Def_dez_sl_551_CM 0. 255. FORMAT "%3.0" /end CHARACTERISTIC
/begin CHARACTERISTIC S_KATREGEN "" VALUE 0xa082b503 _REC_VAL_20_u1 99.45 _CNV_R_R_Def_dez_sl_551_CM 0. 255. FORMAT "%3.0" /end CHARACTERISTIC
/begin CHARACTERISTIC S_LA_MX "Schalter Berechnung Md_la_mx" VALUE 0xa082b502 _REC_VAL_20_u1 99.45 _CNV_R_R_Def_dez_sl_551_CM 0. 255. FORMAT "%3.0" /end CHARACTERISTIC
/begin CHARACTERISTIC S_LA_ZWMD "Schalter Freigabe Rampe F_lazw_md" VALUE 0xa082b504 _REC_VAL_20_u1 99.45 _CNV_R_R_Def_dez_sl_551_CM 0. 255. FORMAT "%3.0" /end CHARACTERISTIC
/begin CHARACTERISTIC S_MDBANL100_ENA "Schalter Aktivierung 100ms in MDBANL" VALUE 0xa082b914 _REC_VAL_20_u1 1. _CNV_R_R_Def_dez_sl_551_CM 0. 1. FORMAT "%3.0" /end CHARACTERISTIC
/begin CHARACTERISTIC S_MDIARLL_HD "true: Mdi_arll_zw statt Mdi_ar_f" VALUE 0xa0826644 _REC_VAL_20_u1 99.45 _CNV_R_R_Def_dez_sl_551_CM 0. 255. FORMAT "%3.0" /end CHARACTERISTIC
/begin CHARACTERISTIC S_MDIWUNSCH "Umstellung TORQ_DVCH mit/ohne Lastschlagfilter" VALUE 0xa082669f _REC_VAL_20_u1 99.45 _CNV_R_R_Def_dez_sl_551_CM 0. 255. FORMAT "%3.0" /end CHARACTERISTIC
/begin CHARACTERISTIC S_MDI_SOLL "" VALUE 0xa082669c _REC_VAL_20_u1 99.45 _CNV_R_R_Def_dez_sl_551_CM 0. 255. FORMAT "%3.0" /end CHARACTERISTIC
/begin CHARACTERISTIC S_MDI_SOLLCAN "Umschalter fuer Mdi_soll_can Applkonst" VALUE 0xa0826646 _REC_VAL_20_u1 99.45 _CNV_R_R_Def_dez_sl_551_CM 0. 255. FORMAT "%3.0" /end CHARACTERISTIC
/begin CHARACTERISTIC S_MDI_ZWHAND "true: Mdi_zw_soll aus Applkonst" VALUE 0xa0826647 _REC_VAL_20_u1 99.45 _CNV_R_R_Def_dez_sl_551_CM 0. 255. FORMAT "%3.0" /end CHARACTERISTIC
/begin CHARACTERISTIC S_MDKMX_UL "" VALUE 0xa082669b _REC_VAL_20_u1 99.45 _CNV_R_R_Def_dez_sl_551_CM 0. 255. FORMAT "%3.0" /end CHARACTERISTIC
/begin CHARACTERISTIC S_MDLLALL "Umschalter für Aufteilung Momenteneingriff" VALUE 0xa0826640 _REC_VAL_20_u1 99.45 _CNV_R_R_Def_dez_sl_551_CM 0. 255. FORMAT "%3.0" /end CHARACTERISTIC
/begin CHARACTERISTIC S_MDRESMN_ON "" VALUE 0xa0826643 _REC_VAL_20_u1 99.45 _CNV_R_R_Def_dez_sl_551_CM 0. 255. FORMAT "%3.0" /end CHARACTERISTIC
/begin CHARACTERISTIC S_MOTSTOPP_KL15 "Aktivierung Einrechung Kl15 vorab" VALUE 0xa0826511 _REC_VAL_20_u1 1. _CNV_R_R_Def_dez_sl_551_CM 0. 1. FORMAT "%3.0" /end CHARACTERISTIC
/begin CHARACTERISTIC S_NLDG "Schalter Einrechnung Fehler Drosselklappe" VALUE 0xa082b915 _REC_VAL_20_u1 1. _CNV_R_R_Def_dez_sl_551_CM 0. 1. FORMAT "%3.0" /end CHARACTERISTIC
/begin CHARACTERISTIC S_NLWAHL_MAN "Schalter manuelle Notlaufwahl" VALUE 0xa082b916 _REC_VAL_20_u1 1. _CNV_R_R_Def_dez_sl_551_CM 0. 1. FORMAT "%3.0" /end CHARACTERISTIC
/begin CHARACTERISTIC S_NOQUIT_TE "Keine Quittung für TE bei MD-Umschaltung" VALUE 0xa0825bf1 _REC_VAL_20_u1 1. _CNV_R_R_Def_dez_sl_551_CM 0. 1. FORMAT "%3.0" /end CHARACTERISTIC
/begin CHARACTERISTIC S_NOTL_AGR "Schalter Notlauf AGR" VALUE 0xa082b917 _REC_VAL_20_u1 1. _CNV_R_R_Def_dez_sl_551_CM 0. 1. FORMAT "%3.0" /end CHARACTERISTIC
/begin CHARACTERISTIC S_PRIONOTLR "Rücksetzen der Notfallmassnahme" VALUE 0xa0826512 _REC_VAL_20_u1 1. _CNV_R_R_Def_dez_sl_551_CM 0. 1. FORMAT "%3.0" /end CHARACTERISTIC
/begin CHARACTERISTIC S_PRIOSTATRE "Reset Statistik hängende Umschaltung wegen Prio" VALUE 0xa0826513 _REC_VAL_20_u1 1. _CNV_R_R_Def_dez_sl_551_CM 0. 1. FORMAT "%3.0" /end CHARACTERISTIC
/begin CHARACTERISTIC S_RFMIN_BAW "Freigabe Umschaltung an der Rf_min Grenze" VALUE 0xa0825bfd _REC_VAL_20_u1 1. _CNV_R_R_Def_dez_sl_551_CM 0. 1. FORMAT "%3.0" /end CHARACTERISTIC
/begin CHARACTERISTIC S_SCHNUMS "-" VALUE 0xa0825bd8 _REC_VAL_20_u1 99.45 _CNV_R_R_Def_dez_sl_551_CM 0. 255. FORMAT "%3.0" /end CHARACTERISTIC
/begin CHARACTERISTIC S_SIKOAKT_ENA "Einrechnen B_siko_akt in B_zw_dynman/B_md_dynman" VALUE 0xa082669d _REC_VAL_20_u1 99.45 _CNV_R_R_Def_dez_sl_551_CM 0. 255. FORMAT "%3.0" /end CHARACTERISTIC
/begin CHARACTERISTIC S_TMAX_HOM "Schalter maximale Zeit Hom" VALUE 0xa0826514 _REC_VAL_20_u1 1. _CNV_R_R_Def_dez_sl_551_CM 0. 1. FORMAT "%3.0" /end CHARACTERISTIC
/begin CHARACTERISTIC S_UMSSTATRES "Reset Statistik hängende Umschaltung wegen fehlender Quittung" VALUE 0xa0826515 _REC_VAL_20_u1 1. _CNV_R_R_Def_dez_sl_551_CM 0. 1. FORMAT "%3.0" /end CHARACTERISTIC
/begin CHARACTERISTIC S_UMS_VBSA "Schalter zum Abschalten Ausschalten SA bei Umschaltung" VALUE 0xa0825bee _REC_VAL_20_u1 99.45 _CNV_R_R_Def_dez_sl_551_CM 0. 255. FORMAT "%3.0" /end CHARACTERISTIC
/begin CHARACTERISTIC S_VB_BA "Schalter zum Nutzen Verbotsbits in DI Notlauf" VALUE 0xa0826516 _REC_VAL_20_u1 1. _CNV_R_R_Def_dez_sl_551_CM 0. 1. FORMAT "%3.0" /end CHARACTERISTIC
/begin COMPU_METHOD _CNV_R_R_Def_dez_sl_551_CM "Def_dez_sl_q1" RAT_FUNC "%6.3" "-" COEFFS 0. 1. 0. 0. 0. 1. /end COMPU_METHOD
/begin COMPU_METHOD _CNV_R_R_Def_f_ub_b_553_CM "Def_f_ub_b1" RAT_FUNC "%6.3" "-" COEFFS 0. 256. 0. 0. 0. 1. /end COMPU_METHOD
/begin COMPU_METHOD _CNV_R_R_Def_m_sw_q_554_CM "Def_m_sw_q0p1" RAT_FUNC "%6.3" "Nm" COEFFS 0. 10. 0. 0. 0. 1. /end COMPU_METHOD
/begin COMPU_METHOD _CNV_R_R_Def_f_uw_b_555_CM "Def_f_uw_b100" RAT_FUNC "%6.3" "%" COEFFS 0. 65536. 0. 0. 0. 100. /end COMPU_METHOD
/begin COMPU_METHOD _CNV_R_R_Def_f_uw_b_559_CM "Def_f_uw_b16" RAT_FUNC "%6.3" "-" COEFFS 0. 65536. 0. 0. 0. 16. /end COMPU_METHOD
/begin COMPU_METHOD _CNV_S_2_Def_bit_ub_563_CM "Def_bit_ub_0" TAB_VERB "%6.3" "-" COMPU_TAB_REF _CNV_S_2_Def_bit_ub_563 /end COMPU_METHOD
/begin COMPU_VTAB _CNV_S_2_Def_bit_ub_563 "Def_bit_ub_0" TAB_VERB 2 0 "FALSE" 1 "TRUE" /end COMPU_VTAB
/begin COMPU_METHOD _CNV_S_5_Def_ba_gdi_565_CM "Def_ba_gdi" TAB_VERB "%6.3" "-" COMPU_TAB_REF _CNV_S_5_Def_ba_gdi_565 /end COMPU_METHOD
/begin COMPU_VTAB _CNV_S_5_Def_ba_gdi_565 "Def_ba_gdi" TAB_VERB 5 0 "KEINE" 1 "Schicht" 2 "Homogen" 3 "Homogen_Schicht" 8 "NOTLAUF" /end COMPU_VTAB
/begin COMPU_METHOD _CNV_S_22_Def_ba_gdi_567_CM "Def_ba_gdi_sub" TAB_VERB "%6.3" "-" COMPU_TAB_REF _CNV_S_22_Def_ba_gdi_567 /end COMPU_METHOD
/begin COMPU_VTAB _CNV_S_22_Def_ba_gdi_567 "Def_ba_gdi_sub" TAB_VERB 22 0 "KEINE" 1 "Optimal" 2 "Lambda_1" 3 "Test_O2" 4 "KHM_DOE_LR" 5 "KHM_DOE_EM" 6 "Bauteilschutz" 7 "KHM_ZW" 8 "Desu_puls" 9 "NOxKat_reg" 10 "KHM_LR" 11 "KHM_EM" 12 "KHM_ZW_DE" 13 "KHM_LR_DE" 14 "KHM_DOE_LR_DE" 15 "NOTLAUF" 16 "TESTLAM" 17 "GL_ZSK" 18 "DESU_FETT" 19 "ZWAD" 20 "UESP" 21 "VL" /end COMPU_VTAB
/begin COMPU_METHOD _CNV_S_7_Def_bvgdi_568_CM "Def_bvgdi" TAB_VERB "%6.3" "-" COMPU_TAB_REF _CNV_S_7_Def_bvgdi_568 /end COMPU_METHOD
/begin COMPU_VTAB _CNV_S_7_Def_bvgdi_568 "Def_bvgdi" TAB_VERB 7 0 "KEINE" 1 "Verbot_Schicht" 2 "Verbot_Homogen" 3 "Verbot_Homogen_und_Schicht" 4 "Verbot_Homogenschicht" 5 "Verbot_Schicht_und_Homogenschicht" 6 "Verbot_Homogen_und_Homogenschicht" /end COMPU_VTAB
/begin COMPU_METHOD _CNV_R_R_Def_f_uw_b_571_CM "Def_f_uw_b1" RAT_FUNC "%6.3" "-" COEFFS 0. 65536. 0. 0. 0. 1. /end COMPU_METHOD
/begin COMPU_METHOD _CNV_R_R_Def_td_ub__574_CM "Def_td_ub_q0p1" RAT_FUNC "%6.3" "s" COEFFS 0. 10. 0. 0. 0. 1. /end COMPU_METHOD
/begin COMPU_METHOD _CNV_R_R_Def_p_sw_q_576_CM "Def_p_sw_q0p039" RAT_FUNC "%6.3" "hPa" COEFFS 0. 256. 0. 0. 0. 10. /end COMPU_METHOD
/begin COMPU_METHOD _CNV_R_R_Def_t_sw_q_578_CM "Def_t_sw_q0p1" RAT_FUNC "%6.3" "°C" COEFFS 0. 10. 0. 0. 0. 1. /end COMPU_METHOD
/begin COMPU_METHOD _CNV_R_R_Def_t_sw_q_579_CM "Def_t_sw_q0p01" RAT_FUNC "%6.3" "°C" COEFFS 0. 100. 0. 0. 0. 1. /end COMPU_METHOD
/begin COMPU_METHOD _CNV_R_R_Def_u_sb_q_583_CM "Def_u_sb_q0p0942" RAT_FUNC "%6.3" "V" COEFFS 0. 1. 0. 0. 0. 9.420000000000001e-002 /end COMPU_METHOD
/begin COMPU_METHOD _CNV_R_R_Def_f_ub_b_586_CM "Def_f_ub_b100" RAT_FUNC "%6.3" "%" COEFFS 0. 256. 0. 0. 0. 100. /end COMPU_METHOD
/begin COMPU_METHOD _CNV_R_R_Def_f_uw_b_590_CM "Def_f_uw_b2" RAT_FUNC "%6.3" "-" COEFFS 0. 65536. 0. 0. 0. 2. /end COMPU_METHOD
/begin COMPU_METHOD _CNV_R_R_Def_n_sw_q_595_CM "Def_n_sw_q1p0" RAT_FUNC "%6.3" "Upm" COEFFS 0. 1. 0. 0. 0. 1. /end COMPU_METHOD
/begin COMPU_METHOD _CNV_R_R_Def_rf_sw__598_CM "Def_rf_sw_q0p01" RAT_FUNC "%6.3" "%" COEFFS 0. 100. 0. 0. 0. 1. /end COMPU_METHOD
/begin COMPU_METHOD _CNV_R_R_Def_eta_sw_599_CM "Def_eta_sw_b200" RAT_FUNC "%6.3" "%" COEFFS 0. 32768. 0. 0. 0. 200. /end COMPU_METHOD
/begin COMPU_METHOD _CNV_R_R_Def_rk_sw__600_CM "Def_rk_sw_b1600" RAT_FUNC "%6.3" "%" COEFFS 0. 2048. 0. 0. 0. 100. /end COMPU_METHOD
/begin COMPU_METHOD _CNV_R_R_Def_zw_sw__604_CM "Def_zw_sw_q0p1" RAT_FUNC "%6.3" "°" COEFFS 0. 10. 0. 0. 0. 1. /end COMPU_METHOD
/begin COMPU_METHOD _CNV_R_R_Def_eta_sw_606_CM "Def_eta_sw_q0p00305" RAT_FUNC "%6.3" "%" COEFFS 0. 32767. 0. 0. 0. 100. /end COMPU_METHOD
/begin COMPU_METHOD _CNV_R_R_Def_f_ub_b_613_CM "Def_f_ub_b2" RAT_FUNC "%6.3" "-" COEFFS 0. 256. 0. 0. 0. 2. /end COMPU_METHOD
/begin COMPU_METHOD _CNV_R_R_Def_eta_uw_615_CM "Def_eta_uw_b200" RAT_FUNC "%6.3" "%" COEFFS 0. 65536. 0. 0. 0. 200. /end COMPU_METHOD
/begin COMPU_METHOD _CNV_R_R_Def_f_sw_b_616_CM "Def_f_sw_b2" RAT_FUNC "%6.3" "-" COEFFS 0. 65536. 0. 0. 0. 4. /end COMPU_METHOD
/begin COMPU_METHOD _CNV_R_R_Def_f_uw_b_617_CM "Def_f_uw_b64" RAT_FUNC "%6.3" "-" COEFFS 0. 65536. 0. 0. 0. 64. /end COMPU_METHOD
/begin COMPU_METHOD _CNV_R_R_Def_f_uw_b_622_CM "Def_f_uw_b1p0" RAT_FUNC "%6.3" "-" COEFFS 0. 65535. 0. 0. 0. 1. /end COMPU_METHOD
/begin COMPU_METHOD _CNV_R_R_Def_f_sw_b_623_CM "Def_f_sw_b64" RAT_FUNC "%6.3" "-" COEFFS 0. 32768. 0. 0. 0. 64. /end COMPU_METHOD
/begin COMPU_METHOD _CNV_R_R_Def_strv_u_636_CM "Def_strv_uw_b512" RAT_FUNC "%6.3" "1/m" COEFFS 0. 65536. 0. 0. 0. 512. /end COMPU_METHOD
/begin COMPU_METHOD _CNV_R_R_Def_m_sw_q_649_CM "Def_m_sw_q0p01" RAT_FUNC "%6.3" "Nm" COEFFS 0. 100. 0. 0. 0. 1. /end COMPU_METHOD
/begin COMPU_METHOD _CNV_R_R_Def_dm_sw__650_CM "Def_dm_sw_q0p1" RAT_FUNC "%6.3" "Nm/s" COEFFS 0. 10. 0. 0. 0. 1. /end COMPU_METHOD
/begin COMPU_METHOD _CNV_R_R_Def_td_uw__673_CM "Def_td_uw_q0p01" RAT_FUNC "%6.3" "s" COEFFS 0. 100. 0. 0. 0. 1. /end COMPU_METHOD
/begin COMPU_METHOD _CNV_S_29_Def_ba_anf_681_CM "Def_ba_anf" TAB_VERB "%6.3" "-" COMPU_TAB_REF _CNV_S_29_Def_ba_anf_681 /end COMPU_METHOD
/begin COMPU_VTAB _CNV_S_29_Def_ba_anf_681 "Def_ba_anf" TAB_VERB 29 0 "NOTL" 1 "BTS" 2 "APPL" 3 "MDMDL" 4 "STND" 5 "HEIZE" 6 "DIAG" 7 "KATHEIZE_1" 8 "HS_STND" 9 "S_STND" 10 "HOM_STND" 11 "KATHEIZE_2" 12 "RGN" 13 "DESU" 14 "UMS_ABBR" 15 "LATEST" 16 "START" 17 "GL" 18 "TE" 19 "SIKO" 20 "VBR" 21 "KOMF" 22 "LAAD" 23 "UESP" 24 "VL" 25 "DIAG2" 26 "MSA" 27 "NONOXT" 28 "LASONBER" /end COMPU_VTAB
/begin COMPU_METHOD _CNV_R_R_Def_wdk_sw_683_CM "Def_wdk_sw_q0p0244" RAT_FUNC "%6.3" "%" COEFFS 0. 4096. 0. 0. 0. 100. /end COMPU_METHOD
/begin COMPU_METHOD _CNV_S_17_Def_brenn__704_CM "Def_brenn_v_gdi" TAB_VERB "%6.3" "-" COMPU_TAB_REF _CNV_S_17_Def_brenn__704 /end COMPU_METHOD
/begin COMPU_VTAB _CNV_S_17_Def_brenn__704 "Def_brenn_v_gdi" TAB_VERB 17 0 "KEINE" 1 "H" 2 "HS__" 3 "HS_H" 4 "S_____" 5 "S____H" 6 "S_HS__" 7 "S_HS_H" 17 "H___H" 18 "H__HS" 20 "H___S" 33 "HS__H" 34 "HS_HS" 36 "HS__S" 65 "S__H" 66 "S_HS" 68 "S__S" /end COMPU_VTAB
/begin COMPU_METHOD _CNV_S_8_Def_st_mdi_705_CM "Def_st_mdinfo" TAB_VERB "%6.3" "-" COMPU_TAB_REF _CNV_S_8_Def_st_mdi_705 /end COMPU_METHOD
/begin COMPU_VTAB _CNV_S_8_Def_st_mdi_705 "Def_st_mdinfo" TAB_VERB 8 0 "KEINE" 1 "ASR" 2 "MSR" 3 "GS_DEC" 4 "GS_INC" 5 "AMT_DEC" 6 "AMT_INC" 7 "DCC" /end COMPU_VTAB
/begin COMPU_METHOD _CNV_S_17_Def_st_mdi_706_CM "Def_st_mdinfow" TAB_VERB "%6.3" "-" COMPU_TAB_REF _CNV_S_17_Def_st_mdi_706 /end COMPU_METHOD
/begin COMPU_VTAB _CNV_S_17_Def_st_mdi_706 "Def_st_mdinfow" TAB_VERB 17 0 "KEINE" 1 "ASR" 2 "MSR" 4 "GS_DEC" 8 "GS_INC" 16 "AMT_DEC" 32 "AMT_INC" 64 "DCC_INC" 128 "MDKMIN" 256 "MDKMIN_ASR" 512 "KUEHL" 1024 "VAR_UL" 2048 "NMAX" 4096 "VMAX" 8192 "KATSCHUTZ" 16384 "FESTSTELLBREMSE" 32768 "UNBEKANNT" /end COMPU_VTAB
/begin COMPU_METHOD _CNV_S_8_Def_stquit_707_CM "Def_stquitt" TAB_VERB "%6.3" "-" COMPU_TAB_REF _CNV_S_8_Def_stquit_707 /end COMPU_METHOD
/begin COMPU_VTAB _CNV_S_8_Def_stquit_707 "Def_stquitt" TAB_VERB 8 0 "KEINE" 1 "S_____" 2 "H" 3 "S____H" 4 "HS__" 5 "S_HS__" 6 "HS_H" 7 "S_HS_H" /end COMPU_VTAB
/begin COMPU_METHOD _CNV_R_R_Def_v_uw_q_726_CM "Def_v_uw_q1p0" RAT_FUNC "%6.3" "km/h" COEFFS 0. 1. 0. 0. 0. 1. /end COMPU_METHOD
/begin COMPU_METHOD _CNV_S_7_Def_ba_757_CM "Def_ba" TAB_VERB "%6.3" "-" COMPU_TAB_REF _CNV_S_7_Def_ba_757 /end COMPU_METHOD
/begin COMPU_VTAB _CNV_S_7_Def_ba_757 "Def_ba" TAB_VERB 7 0 "KEINE" 1 "UGD" 2 "GD" 3 "GD_KLEINER_HUB" 6 "DKNOTL" 7 "VVTNOTL1" 8 "VVTNOTL" /end COMPU_VTAB
/begin RECORD_LAYOUT _REC_VAL_20_u1 FNC_VALUES 1 UBYTE COLUMN_DIR DIRECT /end RECORD_LAYOUT
/begin RECORD_LAYOUT _REC_VAL_20_u2 FNC_VALUES 1 UWORD COLUMN_DIR DIRECT /end RECORD_LAYOUT
/begin RECORD_LAYOUT _REC_VAL_20_s2 FNC_VALUES 1 SWORD COLUMN_DIR DIRECT /end RECORD_LAYOUT
/begin RECORD_LAYOUT _REC_VAL_20_u4 FNC_VALUES 1 ULONG COLUMN_DIR DIRECT /end RECORD_LAYOUT
/begin RECORD_LAYOUT _REC_MAP_52_u1_s2_s2 NO_AXIS_PTS_X 1 UBYTE NO_AXIS_PTS_Y 2 UBYTE AXIS_PTS_X 3 SWORD INDEX_INCR DIRECT AXIS_PTS_Y 4 SWORD INDEX_INCR DIRECT FNC_VALUES 5 UBYTE COLUMN_DIR DIRECT /end RECORD_LAYOUT
/begin RECORD_LAYOUT _REC_MAP_52_UBYTE_u2_s2_s2 NO_AXIS_PTS_X 1 UBYTE NO_AXIS_PTS_Y 2 UBYTE AXIS_PTS_X 3 SWORD INDEX_INCR DIRECT AXIS_PTS_Y 4 SWORD INDEX_INCR DIRECT FNC_VALUES 5 UWORD COLUMN_DIR DIRECT /end RECORD_LAYOUT
/begin RECORD_LAYOUT _REC_MAP_52_UBYTE_s2_s2_s2 NO_AXIS_PTS_X 1 UBYTE NO_AXIS_PTS_Y 2 UBYTE AXIS_PTS_X 3 SWORD INDEX_INCR DIRECT AXIS_PTS_Y 4 SWORD INDEX_INCR DIRECT FNC_VALUES 5 SWORD COLUMN_DIR DIRECT /end RECORD_LAYOUT
/begin RECORD_LAYOUT _REC_MAP_52_u1_u2_s2 NO_AXIS_PTS_X 1 UBYTE NO_AXIS_PTS_Y 2 UBYTE AXIS_PTS_X 3 UWORD INDEX_INCR DIRECT AXIS_PTS_Y 4 SWORD INDEX_INCR DIRECT FNC_VALUES 5 UBYTE COLUMN_DIR DIRECT /end RECORD_LAYOUT
/begin RECORD_LAYOUT _REC_MAP_52_u1_u1_u1 NO_AXIS_PTS_X 1 UBYTE NO_AXIS_PTS_Y 2 UBYTE AXIS_PTS_X 3 UBYTE INDEX_INCR DIRECT AXIS_PTS_Y 4 UBYTE INDEX_INCR DIRECT FNC_VALUES 5 UBYTE COLUMN_DIR DIRECT /end RECORD_LAYOUT
/begin RECORD_LAYOUT _REC_CUR_TKL_UW_VV__u2_u2 NO_AXIS_PTS_X 1 UBYTE RESERVED 2 BYTE AXIS_PTS_X 3 UWORD INDEX_INCR DIRECT FNC_VALUES 4 UWORD COLUMN_DIR DIRECT /end RECORD_LAYOUT
/begin RECORD_LAYOUT _REC_CUR_TKL_UW_VV__u2_s2 NO_AXIS_PTS_X 1 UBYTE RESERVED 2 BYTE AXIS_PTS_X 3 SWORD INDEX_INCR DIRECT FNC_VALUES 4 UWORD COLUMN_DIR DIRECT /end RECORD_LAYOUT
/begin RECORD_LAYOUT _REC_CUR_TKL_UW_VV__u1_s2 NO_AXIS_PTS_X 1 UBYTE RESERVED 2 BYTE AXIS_PTS_X 3 SWORD INDEX_INCR DIRECT FNC_VALUES 4 UBYTE COLUMN_DIR DIRECT /end RECORD_LAYOUT
/begin RECORD_LAYOUT _REC_CUR_TKL_UW_VV__s2_s2 NO_AXIS_PTS_X 1 UBYTE RESERVED 2 BYTE AXIS_PTS_X 3 SWORD INDEX_INCR DIRECT FNC_VALUES 4 SWORD COLUMN_DIR DIRECT /end RECORD_LAYOUT
/begin RECORD_LAYOUT _REC_CUR_TKL_UW_VV__u1_u1 NO_AXIS_PTS_X 1 UBYTE RESERVED 2 BYTE AXIS_PTS_X 3 UBYTE INDEX_INCR DIRECT FNC_VALUES 4 UBYTE COLUMN_DIR DIRECT /end RECORD_LAYOUT
/begin RECORD_LAYOUT _REC_VAL_2_u1 FNC_VALUES 1 UBYTE COLUMN_DIR DIRECT /end RECORD_LAYOUT
/begin FUNCTION MDBAFAK ""
 /begin DEF_CHARACTERISTIC KF_BAUMS KF_FMDRES_RGN KF_FRKBGDYN_HS KF_FRKBGDYN_S KF_FSPR_BA KF_FSPR_BAW KF_QUIT_BAW KF_SBAUMS_H KF_SBAUMS_HS KF_SBAUMS_S KF_SUBSOLL KL_FTMDRES_RGN KL_FUESPAUS_INKR KL_FWNWKHK2_INI KL_FWNWKHK_INI KL_FWNWKH_INI K_BAW_HOMRGN K_FRKBG_HS K_FRKBG_S K_HOMOPT K_KHMDOE_WART K_NMAXBA K_PSPVDK_GDV K_RFMIN_OFS K_RFRESMAX_HYS K_TDMAX_BAWBEOPT K_TDTEVZU K_TDZWBAW_OFF K_TWARTEND K_WNWKH01 K_WNWKH10 K_WNWKHK_COPY K_WNWKHK_DOE2EE_EM K_WNWKHK_DOE2EE_LR K_WNWKHK_EE2DOE_EM K_WNWKHK_EE2DOE_LR K_WNWKHK_EM2LR K_WNWKHK_LR2EM S_FAILSTARES S_FWNW_APPL S_NOQUIT_TE S_RFMIN_BAW S_SCHNUMS S_UMS_VBSA /end DEF_CHARACTERISTIC
 /begin REF_CHARACTERISTIC K_NBAWNOTMX K_RF_MAX /end REF_CHARACTERISTIC
 /begin OUT_MEASUREMENT Ba_ist Ba_ist_sw Ba_prio_sw Ba_soll Ba_soll_sw Ba_subist Ba_subist_sw Ba_subprio_sw Ba_subsoll Ba_subsoll_sw Baw_ist Baw_soll F_atldyn_start F_dps_ba F_evmod F_llr_ba F_mdi_ba F_mdiop_ba F_mdres_rgn F_ml_ba F_nst_ba F_reib_ba F_spr_ba F_spr_baw F_st_ba F_uesp_aus F_vwi_ba F_wl_ba F_wnwkh F_wnwkhk F_wnwkhk_2 F_zw_ba F_zw_baw F_zw_hsplit Frkbgdyn_hs Frkbgdyn_s Mdi_res_gdi Nmax_ba Rf_egr_hs Rf_tev_hs Rk_soll_kr St_ba_agf St_ba_agf.B_hstoech St_ba_agf.B_khmdoe_anf St_baums St_bawu St_bvist St_bvso St_bvums St_disa_bmw St_disa_bmw.B_disa_stopp St_dknot St_dknot.B_vvt_dknotl St_mdbafak St_mdbafak.B_hmm_akt St_mdbafak.B_hom_akt St_mdbafak.B_hschicht St_mdbafak.B_la_stopp St_mdbafak.B_la_stopp1 St_mdbafak.B_la_stopp2 St_mdbafak.B_sch_akt St_mdbafak.B_schicht St_mdbafak2 St_mdbafak2.B_ba_um St_mdbafak2.B_mdres_rgn St_mdbafak2.B_tev_quitt St_mdbafak2.B_tev_stopp St_mdbafak2.B_zwbaw St_mdbafak3 St_mdbafak3.B_baums_akt St_mdbafak3.B_quit_baw St_mdbafak3.B_sbaums_akt St_mdbafak3.B_sbaums_ea St_mdbafak3.B_sbaums_fail St_quitt St_subziel St_tiausgang St_tiausgang.B_esp_h1 St_tiausgang.B_esp_h2 St_tiausgang.B_esp_hs1 St_tiausgang.B_esp_hs2 St_umsvorg T_tevzu Tdmax_bawbeopt Z_sbaums_fail Z_wart /end OUT_MEASUREMENT
 /begin IN_MEASUREMENT Ba_prio Ba_subprio Drk_soll Eta_lamb_bas F_atldyn F_wnwkhk_sw La_soll Mdi_zw_soll Nkw Nmax_notl Pspvdk Rf Rf_min Rf_res_max Rf_soll_h Rf_soll_hs Rk_kor_h Rk_kor_hs Rk_kor_s Rk_maxbg_hs Rk_maxbg_s Rk_min_h Rk_minbg_hs Rk_soll Rk_soll_h Rk_soll_hs Rk_soll_s St_ba_agf.B_hstoech St_ba_agf.B_khmdoe_anf St_bano St_bvmdi St_dps St_dps.B_dpsadp St_dps.B_gd St_dps.B_gdst St_dps.B_gdvhub St_khm St_khm.B_khm_h St_khm.B_khm_hs St_khm.B_khm_s St_mdbafak.B_hmm_akt St_mdbafak.B_hom_akt St_mdbafak.B_hschicht St_mdbafak.B_la_stopp St_mdbafak.B_la_stopp1 St_mdbafak.B_la_stopp2 St_mdbafak.B_sch_akt St_mdbafak.B_schicht St_mdbafak2.B_ba_um St_mdbafak2.B_mdres_rgn St_mdbafak2.B_tev_quitt St_mdbafak2.B_tev_stopp St_mdbafak2.B_zwbaw St_mdbafast St_mdbafast.B_beopt_aus St_mdbafast.B_priov_haeng St_mdbafast.B_ums_fast St_mdbanl St_mdbanl.B_agrzu_nl St_mdbanl.B_disa_nl St_mdbanl.B_evvt_vsa_nl St_mdbanl.B_evvt_vse_nl St_mdbanl.B_lastopp_nl St_mdbanl.B_tevzu_nl St_mdbanl.B_wesb1h_nl St_mdbanl.B_zw_nl St_mdrk St_mdrk.B_doe_h St_mdrk.B_doe_hs St_mdrk.B_doe_s St_mdrk.B_khmdoe_akt St_mdrk.B_la_prio St_mdrk.B_laprio_h St_mdrk.B_rfresmx_ba St_mdrk.B_rk_resmax St_mkwchn St_mkwchn.B_kwdreht St_pr St_pr.B_prsoll_h St_priodiag St_priodiag.B_badif_bv St_priodiag.B_badif_prio St_priodiag.B_bv_haeng St_priodiag.B_prio_haeng St_priodiag.B_prio_not St_priodiag.B_quit_notl St_priodiag.B_ums_not St_priodiag.B_ums_notl St_pwf St_pwf.B_pwf St_railko St_railko.B_prail_hs St_railko.B_prail_s St_railko.B_praildoe_h St_rf St_rf.B_rfmin St_sa St_sa.B_ums_vbsa St_sawe St_sawe.B_sa St_sawe.B_sae St_sawe.B_safast St_start St_start.B_jumpstart St_start.B_sta St_start.B_start St_start.B_startende St_start.B_wst St_tevanst St_tevanst.B_tev_zu St_ti St_ti.B_dosp_akt St_tiausgang.B_esp_h1 St_tiausgang.B_esp_h2 St_tiausgang.B_esp_hs1 St_tiausgang.B_esp_hs2 Tabg_nokmin /end IN_MEASUREMENT
/end FUNCTION
/begin FUNCTION MDBANL ""
 /begin DEF_CHARACTERISTIC CW_NOTLAUF KF_LA_NLEV KF_LA_NLKR KF_ZWOPT_NOTL KF_ZW_NOTL KL_MDMAXNL_1 KL_MDMAXNL_2 K_BAWU_NL1 K_BAWU_NL2 K_BAWU_NL3 K_DPOS_AGRZU K_LA_FIX K_MA_BAWUNL K_MA_LANL1 K_MA_LANL2 K_MA_NMAXNL K_MA_VBNL K_MA_ZWNL K_MDBANL_CFG K_MDBANL_CFG2 K_MDIMXNL_ARR K_MDMAX_ENA K_MDNOTL_NEG K_MDNOTL_POS K_NKWMX_HOS K_NKWMX_SCH K_NLWAHL_MAN K_NLWAHL_NMAXMAG K_NMAX_NL1 K_NMAX_NL2 K_NMAX_NL3 K_NOTLW_AGRAUF K_NOTLW_AGRZU K_NOTLW_ASEABGAS K_NOTLW_ASEKAT K_NOTLW_DKRATIO K_NOTLW_EVDIAG K_NOTLW_EVDIAG1 K_NOTLW_EVDIAG2 K_NOTLW_KRDWS K_NOTLW_NOTL3 K_NOTLW_PRAIL K_NOTLW_PRAILVCV K_NOTLW_PRAILVFD K_NOTLW_TEV K_NOTLW_UBAT K_POS_AGRZU K_UBMIN_NOTL S_GDNKW S_MDBANL100_ENA S_NLDG S_NLWAHL_MAN S_NOTL_AGR /end DEF_CHARACTERISTIC
 /begin OUT_MEASUREMENT Ba_vb_nl Ba_wu_nl Err_notl F_sicher_zw La_soll_notl1 La_soll_notl2 Mdi_max_notl Mdi_mxnl_min Nmax_notl Notl_wahl St_mdbanl St_mdbanl.B_agrzu_nl St_mdbanl.B_disa_nl St_mdbanl.B_evvt_vsa_nl St_mdbanl.B_evvt_vse_nl St_mdbanl.B_lastopp_nl St_mdbanl.B_tevzu_nl St_mdbanl.B_wesb1h_nl St_mdbanl.B_zw_nl St_mdbanl2 St_mdbanl2.B_gl_ernl St_mdbanl2.B_gl_lanl St_mdbanl2.B_gl_zilnl St_mdbanl2.B_prail_nl St_mdbanl2.B_vdoe_nl St_mdbanl3 St_mdbanl3.B_evdiag_b1 St_mdbanl3.B_evdiag_b2 St_mdbanl3.B_evvt_vsa St_mdbanl3.B_evvt_vse St_mdbanl3.B_fi_agr St_mdbanl3.B_fi_agrfs St_mdbanl3.B_fi_agrsens St_mdbanl3.B_mdmax_notl St_mdbanl4 St_mdbanl4.B_nkw_prail St_mdbanl4.B_nl10_agrauf St_mdbanl4.B_nl11_agrzu St_mdbanl4.B_nl9_tev St_mdbanl4.B_nldgh St_mdbanl4.B_nmax_mager St_mdbanl4.B_notl3 St_mdbanl4.B_pos_agrzu St_tevfi_status Zw_grund_nl Zw_opt_nl /end OUT_MEASUREMENT
 /begin IN_MEASUREMENT Agrpos Ba_ist Mdi_ist_m Nkw Rf St_anf_prail St_anf_prail.B_aprail_hom St_anf_prail.B_aprail_ndnotl St_anf_prail.B_prail_h St_anf_prail.B_prailvcv_h St_anf_prail.B_prailvfd_h St_ba St_ba.B_ase_abgas St_ba.B_ase_kat St_ba.B_vb_hmm St_ba.B_vb_sch St_dkratio St_dkratio.B_dkratio_h St_kr St_kr.B_clradkr St_kr.B_krdws St_kr.B_krndy St_kr.B_zwkraa St_mdbanl2.B_gl_ernl St_mdbanl2.B_gl_lanl St_mdbanl2.B_gl_zilnl St_mdbanl2.B_prail_nl St_mdbanl2.B_vdoe_nl St_mkwchn St_mkwchn.B_kwdreht St_start St_start.B_jumpstart St_start.B_sta St_start.B_start St_start.B_startende St_start.B_wst Status_kwnot Status_kwnot.B_kwnotl Ub /end IN_MEASUREMENT
/end FUNCTION
/begin FUNCTION MDBAPRIO ""
 /begin DEF_CHARACTERISTIC CW_BANOAPPL CW_BAWLL CW_BAWVL CW_GLAKTIV CW_LLBA CW_MSAV_GL CW_RGN CW_UMS_FAST CW_VAKTIV CW_VAKTIV2 KF_PRIO_NOTL KF_UMS_NOTL KL_MDIRGN_MX KL_PRIO_BA KL_TMAX_HOM KL_TMIN_SHS KL_ZAEHLVERZ K_ALLVERBOT K_BANOAPPL K_BANO_VERZ K_BASTART K_BAWKALT K_BAWSCHALT K_BAW_APPL K_BAW_APPSUB K_BAW_MOTSTOPP K_BA_AUSSETZ K_BA_TE K_BA_TOGGLE1 K_BA_TOGGLE2 K_BA_TOGSUB1 K_BA_TOGSUB2 K_BA_ZWGEMAD K_DTMINSHS K_HOMBTS K_HOMBTSSUB K_HOMHEIZ K_HOMHEIZSUB K_HOMLA1 K_HOMLA1SUB K_HOMTO2 K_HOMTO2SUB K_H_STANDARD K_KATREG K_KATREGSUB K_KEINE_BA K_LLSTAND K_LLSTANDSUB K_LLSTANDSUB_1 K_LLSTAND_1 K_MDIRGN_HYS K_NBAWNOTMX K_NKW_KOM_MN K_PRIORESET K_PRIORESETK K_PRMX_PRNOT K_PRMX_UMNOT K_PWG_KOM_MN K_SUBBA_ZWGEMAD K_TBA_TOGGLE K_TMAX_QUIT K_TMAX_UMS K_TMINHOMSTA K_TMOTMAX_ZSK K_TMXBASTART K_TUMS_MONIMX K_VB_APPL K_VLSTAND K_VLSTANDSUB K_VMAX_MHAUF K_VMAX_MHPLAUS K_V_KOM_MN S_APPLRESBHAEUMS S_BAPRIOSTFEST S_BASTART_NKW S_BASTATRES S_BASTATRESG S_BA_TOGGLE S_CLRTBABR S_DESU_FETT S_DESU_PULS S_MOTSTOPP_KL15 S_PRIONOTLR S_PRIOSTATRE S_TMAX_HOM S_UMSSTATRES S_VB_BA /end DEF_CHARACTERISTIC
 /begin REF_CHARACTERISTIC CW_HEIZART /end REF_CHARACTERISTIC
 /begin OUT_MEASUREMENT Ba_prio Ba_prio_tra Ba_subprio Baprio_HO Baprio_HSO Baprio_SO Baprio_appl Baprio_aussetzer Baprio_diagnose Baprio_dinotl Baprio_entschw Baprio_gl Baprio_haeums Baprio_heiz Baprio_katman1 Baprio_katman2 Baprio_katreg Baprio_komfort Baprio_mdi Baprio_motorstopp Baprio_pruef Baprio_siko Baprio_stand Baprio_start Baprio_tester Baprio_tev Baprio_ueh Baprio_uesp Baprio_vl Baprio_zwgemad Baums_moni Bav_appl Bav_dinotl Bav_mdi Bav_prio Bav_prio_v Bav_ueh Baw_appl Baw_aussetzer Baw_bronze Baw_diagnose Baw_dinotl Baw_entschw Baw_gesamt Baw_gl Baw_gold Baw_haeums Baw_heiz Baw_katreg Baw_komfort Baw_mdi Baw_motorstopp Baw_prio Baw_prionotl Baw_pruef Baw_siko Baw_silber Baw_standard Baw_start Baw_te Baw_ueh Baw_uesp Baw_umsnotl Baw_vl Baw_zwgemad Prio_sieg Prio_sieg_zahl Rt_bastat_h Rt_bastat_hs Rt_bastat_s Rt_bastat_sa Rt_bastatg_h Rt_bastatg_hs Rt_bastatg_s Rt_bastatg_sa St_bano St_bano_alt St_bano_halt St_bano_neu St_bano_prio St_baumsch St_baumsch.B_ba_toggle St_baumsch.B_ba_toggletime St_baumsch.B_babr St_baumsch.B_mdres_glll St_dps St_dps.B_dpsadp St_dps.B_gd St_dps.B_gdst St_dps.B_gdvhub St_kath_ena St_kath_ena.B_hsplit_ena St_kath_ena.B_nesps_ena St_kath_ena.B_verb_h St_kath_ena.B_verb_s St_khaktiv St_khaktiv.B_khaktiv_h St_khaktiv.B_khaktiv_s St_mdba_msa St_mdba_msa.B_msav_gl St_mdbafast St_mdbafast.B_beopt_aus St_mdbafast.B_priov_haeng St_mdbafast.B_ums_fast St_mdbaprio St_mdbaprio.B_anfll_komf St_mdbaprio.B_bastat_gee St_mdbaprio.B_bastat_mle St_mdbaprio.B_dghaeumsrst St_mdbaprio.B_katreganf St_mdbaprio.B_mhauf_anf St_mdbaprio.B_mhauf_plaus St_priodiag St_priodiag.B_badif_bv St_priodiag.B_badif_prio St_priodiag.B_bv_haeng St_priodiag.B_prio_haeng St_priodiag.B_prio_not St_priodiag.B_quit_notl St_priodiag.B_ums_not St_priodiag.B_ums_notl Subprio_bronze Subprio_gold Subprio_sieg Subprio_silber Subprio_sort T_babr T_minshs T_quit T_umsch Td_bastat_h Td_bastat_hs Td_bastat_s Td_bastat_sa Td_bastatg_h Td_bastatg_sa Td_baststg_hs Td_baststg_s Tums_moni Z_priohaeng Z_umshaeng Zaehl_bano_verz /end OUT_MEASUREMENT
 /begin IN_MEASUREMENT Ba_ist Ba_ist_sw Ba_prio_sw Ba_soll Ba_soll_sw Ba_subist Ba_vb_nl Ba_wu_nl Baw_katman1 Baw_katman2 Baw_tester Mdi_ml_soll Nkw Nkw_soll Prio_katman1 Prio_katman2 Pwg_ist St_atlstat St_atlstat.B_atl_bereit St_atlstat.B_atldyn St_atlstat.B_atlr St_atlstat.B_tvld_mod St_atlstat.B_ulvdyn St_atlstat.B_vlschalt St_ba St_ba.B_ase_abgas St_ba.B_ase_kat St_ba.B_vb_hmm St_ba.B_vb_sch St_bgkuppl1 St_bgkuppl1.B_ll St_bvmdi St_cybl St_cybl.B_gl_ad St_cybl.B_gl_adder St_cybl.B_gl_adz St_cybl.B_gl_faker St_cybl.B_gl_hz St_cybl.B_gl_wg1 St_cybl.B_gl_wg2 St_cybl.B_gl_zsk St_cybl.B_gl_zsw St_cybl.B_gl_zswz St_desul St_desul.B_desu_fett St_desul.B_desu_puls St_desul.B_desul_akt St_dkratio St_dkratio.B_dkratio_h St_dps.B_dpsadp St_dps.B_gd St_dps.B_gdst St_dps.B_gdvhub St_kath_ena.B_hsplit_ena St_kath_ena.B_nesps_ena St_kath_ena.B_verb_h St_kath_ena.B_verb_s St_katueb St_katueb.B_kathom St_katueb.B_nk_hom St_katueb.B_rgnkat St_katueb.B_rgnkat_hla1 St_kl15 St_kl15.B_kl15_ep St_kl15.B_kl15_vorab St_motzustd St_motzustd.B_ll_roh St_motzustd.B_vl St_msaa St_msae St_msae.B_mhauf1 St_msae.B_msastopt St_pruef St_pruef.B_pruef1 St_pruef.B_pruef2 St_pwf St_pwf.B_pwf St_sawe St_sawe.B_sa St_sawe.B_sae St_sawe.B_safast St_sk St_sk.B_sk_homla1 St_start St_start.B_jumpstart St_start.B_sta St_start.B_start St_start.B_startende St_start.B_wst St_testbs St_testbs.B_FI_ABGAS_TSENS St_testbs.B_FI_HFM St_testbs.B_FI_HFMPL St_testbs.B_FI_PUS St_testbs.B_FI_TANS St_testbs.B_FI_TKA St_testbs.B_FI_TMOT St_testbs.B_FI_VFZ St_tevein St_tevein.B_te St_tevein.B_te_la1 St_tevein.B_teblg St_tevein.B_tev_erf St_vrs_gdi_seg St_vrs_gdi_seg.B_amogr St_vrs_gdi_seg.B_auss_hom St_vrs_gdi_seg.B_zrseg_ausbzyk St_vrs_gdi_seg.B_zrseg_ausbzyk_alt St_vrs_gdi_seg.B_zrseg_aussa St_vrs_gdi_seg.B_zrseg_aussa_alt St_vrs_gdi_seg.B_zrseg_aussb St_vrs_gdi_seg.B_zrseg_aussb_alt St_wmschalt0 St_wmschalt0.B_beende St_wmschalt0.B_hz_wm St_wmschalt0.B_ntlkws_v St_zwbts1 St_zwbts1.B_bs1 St_zwbts1.B_bs2 St_zwbts1.B_bsmager St_zwbts1.B_lklpsaga St_zwbts1.B_lklpsbs St_zwbts1.B_lklpsmager St_zwgemad St_zwgemad.B_zwgemad_1 St_zwgemad.B_zwgemad_2 Tmot Tmot_start Tn_start_10 V /end IN_MEASUREMENT
/end FUNCTION
/begin FUNCTION md_30_67_3_ ""
 /begin SUB_FUNCTION MDBASCHALT MDBASIS MDDMK MDFW MDI MDIPMFW MDIST MDKW MDLA MDLDYNF MDLDYNR MDMAX MDNA MDNREG MDPWG MDR2MDK MDRDMK MDREIB MDRES MDRESKRLL MDRFMXATL MDRK MDSSM /end SUB_FUNCTION
/end FUNCTION
/begin FUNCTION MDBASCHALT ""
 /begin DEF_CHARACTERISTIC CW_MDISTOPP CW_MDZWHYS CW_ZWMIN_EXT KL_FMDRES_KH K_DMDIBAS_MN K_DMDIBAS_MX K_DMDZWO K_DMDZWOHYS K_DMDZWOLL K_DMDZWOLLHYS K_DMDZWU K_DMDZWUHYS K_DMDZWULL K_DMDZWULLHYS K_KHDIAG_FAK K_KHDIAG_FKH K_KHDIAG_NKWMX K_KMDZW_DASH K_MDISIKOHYST K_MDI_ZWHAND K_MDRESKH_MN K_MDRES_DIAGON K_MDZW_LSD K_PROZKH_MX K_ZR_KHDIAG K_ZWRAMP_MDMAX K_ZWRAMP_MIN K_ZWRAMP_NMX K_ZWRAMP_PLUS S_DMDZWON S_ETA_RES S_MDIARLL_HD S_MDI_SOLLCAN S_MDI_ZWHAND S_MDLLALL S_MDRESMN_ON /end DEF_CHARACTERISTIC
 /begin OUT_MEASUREMENT Dps_diff Md_res_diff Md_res_diffint Md_res_khint Md_res_khmn Md_soll_delta Mdi_arll Mdi_arll_la Mdi_arll_zw Mdi_bas_ba Mdi_bas_korr Mdi_la_soll Mdi_ml_soll Mdi_ml_sollvb Mdi_rk_soll Mdi_soll Mdi_soll_1 Mdi_soll_arll Mdi_soll_can Mdi_soll_canarll Mdi_soll_l Mdi_sollvb Mdi_zw_rampe Mdi_zw_soll Mdi_zw_sollcan Mdi_zw_sollvb Mdk_soll_plusgs Prozkh_md_res St_mdbaschalt St_mdbaschalt.B_mdibaskor St_mdbaschalt.B_mdzw_1 St_mdbaschalt.B_mdzw_2 St_mdbaschalt.B_mdzw_3 St_mdbaschalt.B_mdzw_4 St_mdbaschalt.B_mdzw_5 St_mdbaschalt.B_mdzw_hd St_mdbaschalt.B_mdzwhysoff St_mdbaschalt1 St_mdbaschalt1.B_mdkh_rbmcpl St_mdbaschalt1.B_mdkh_rbmsc St_mdbaschalt1.B_zw_khdiag St_mdbaschalt1.B_zw_khdiagon St_mdbaschalt1.B_zw_khproz St_mdbaschalt1.B_zwkh_red Zr_khdiag /end OUT_MEASUREMENT
 /begin IN_MEASUREMENT Ba_ist Eta_res Eta_rk_mdmx F_lazw_md F_wnwkh Md_la_mx Md_na Md_res_real Mdi_accs_plus Mdi_ar_f Mdi_asr_s Mdi_bas Mdi_bas_hs Mdi_bas_s Mdi_llrzw Mdi_msr_s Mdi_reib Mdi_res_kh Mdi_siko_l Mdi_siko_s Mdk_ext_min Mdk_fzdyn Mdk_min_res Mdkw_soll Mdkw_soll_l Nkw St_bgkuppl1 St_bgkuppl1.B_ll St_kl15 St_kl15.B_kl15_ep St_kl15.B_kl15_vorab St_ll St_ll.B_llr_on St_mdar0 St_mdar0.B_dmdp St_mdar0.B_dmls St_mdar0.B_dp St_mdar0.B_edp St_mdar0.B_elsd St_mdar0.B_ifdp St_mdar0.B_ls St_mdar0.B_lsd St_mdar1 St_mdar1.B_dash St_mdar1.B_iflsd St_mdar1.B_kf_at St_mdar1.B_ll_md St_mdar1.B_tl_md St_mdar1.B_vlschalt_verz St_mdbafak St_mdbafak.B_hmm_akt St_mdbafak.B_hom_akt St_mdbafak.B_hschicht St_mdbafak.B_la_stopp St_mdbafak.B_la_stopp1 St_mdbafak.B_la_stopp2 St_mdbafak.B_sch_akt St_mdbafak.B_schicht St_mdinfo_s St_mdk St_mdk.B_asr_akt St_mdk.B_getr_plus St_mdk.B_md_dynman St_mdk.B_mdk_plus St_mdk.B_msr_aktiv St_mdk.B_san St_mdk.B_siko_akt St_mdk.B_zw_dynman St_mdk1 St_mdk1.B_md_dynman1 St_mdk1.B_mdzw_min1 St_mdk1.B_mdzw_min2 St_mdk1.B_mdzw_plus St_mdk1.B_zwe_ar St_mdk1.B_zwe_fzdyn St_mdk1.B_zwe_kh St_mdk1.B_zwe_kupp St_mdk1.B_zwe_llr St_mdk1.B_zwe_res St_mdk1.B_zwe_resa St_mdk1.B_zwe_sa St_mdk1.B_zwe_start St_mdk3 St_mdk3.B_dynmnrf St_mdk3.B_hd St_mdk3.B_nwehd St_mdk3.B_vhd St_mini St_mini.B_mdimin_sa St_mini.B_zwmin_ext St_rf St_rf.B_rfmin St_start St_start.B_jumpstart St_start.B_sta St_start.B_start St_start.B_startende St_start.B_wst St_szboost St_szboost.B_kath /end IN_MEASUREMENT
/end FUNCTION
/begin FUNCTION MDBASIS "" /begin DEF_CHARACTERISTIC KF_DZW_KOEFF K_SEGBANK /end DEF_CHARACTERISTIC
 /begin OUT_MEASUREMENT Dzw_ist_quad Dzw_koeff Dzw_ve_quad Eta_zw_ist Eta_zw_ist1 Eta_zw_ist2 Eta_zwist_m Eta_zwve_m Mdi_bas Mdi_opt_lam /end OUT_MEASUREMENT
 /begin IN_MEASUREMENT Eta_lambda Eta_zw_ve Mdi_ist_m Mdi_opt_l1 Mdi_reib Mdk_ist Nkw Rf Segakt Zw_bas Zw_ist Zw_opt /end IN_MEASUREMENT
/end FUNCTION
/begin FUNCTION MDDMK ""
 /begin DEF_CHARACTERISTIC CW_DYNMAN KL_MDKMAXUL KL_MDKMINASR K_DYNMAN_DELTARF K_MDI_RESOFF K_MDI_RESON K_MDZWPLUS_HYS K_NWEHYS K_ST_LDMCHK K_ST_LDMINIT K_ST_LDMKUPP K_ST_LDMOFF K_ST_MDINFOGES K_ST_MDINFOL K_ST_MDINFOS K_VLLZWHD K_VLLZWHD_HYS S_DYNMAN_RF S_HAI_ON S_MDIWUNSCH S_MDI_SOLL S_MDKMX_UL S_SIKOAKT_ENA /end DEF_CHARACTERISTIC
 /begin REF_CHARACTERISTIC S_FZDYN_F S_KHDI /end REF_CHARACTERISTIC
 /begin OUT_MEASUREMENT Mdi_fzdyn_res Mdi_soll_k Mdi_soll_min3 Mdi_wunsch Mdk_ext_min Mdk_ext_plus1 Mdk_l1 Mdk_l2 Mdk_min_res Mdk_s1 Mdk_s2 Mdk_soll Mdk_soll_l Mdk_soll_min1 Mdk_soll_plus Mdk_ul_mx St_ldm_chk St_ldm_init St_ldm_off St_mdinfo_ges St_mdinfo_l St_mdinfo_s St_mdk St_mdk.B_asr_akt St_mdk.B_getr_plus St_mdk.B_md_dynman St_mdk.B_mdk_plus St_mdk.B_msr_aktiv St_mdk.B_san St_mdk.B_siko_akt St_mdk.B_zw_dynman St_mdk1 St_mdk1.B_md_dynman1 St_mdk1.B_mdzw_min1 St_mdk1.B_mdzw_min2 St_mdk1.B_mdzw_plus St_mdk1.B_zwe_ar St_mdk1.B_zwe_fzdyn St_mdk1.B_zwe_kh St_mdk1.B_zwe_kupp St_mdk1.B_zwe_llr St_mdk1.B_zwe_res St_mdk1.B_zwe_resa St_mdk1.B_zwe_sa St_mdk1.B_zwe_start St_mdk2 St_mdk2.B_accl_plus St_mdk2.B_accs_plus St_mdk2.B_asr_l St_mdk2.B_asr_s St_mdk2.B_gsl_minus St_mdk2.B_gsl_plus St_mdk2.B_gss_minus St_mdk2.B_gss_plus St_mdk2.B_mdres_wm St_mdk2.B_msr_l St_mdk2.B_msr_s St_mdk2.B_smgl_minus St_mdk2.B_smgl_plus St_mdk2.B_smgs_minus St_mdk2.B_smgs_plus St_mdk3 St_mdk3.B_dynmnrf St_mdk3.B_hd St_mdk3.B_nwehd St_mdk3.B_vhd /end OUT_MEASUREMENT
 /begin IN_MEASUREMENT Md_res Mdi_accl_plus Mdi_accs_plus Mdi_asr_l Mdi_asr_s Mdi_fsb Mdi_gsl_minus Mdi_gsl_plus Mdi_gss_minus Mdi_gss_plus Mdi_katschutz Mdi_max_notl Mdi_msr_l Mdi_msr_s Mdi_nmax Mdi_pmax Mdi_reib Mdi_res_kh Mdi_res_llmn Mdi_res_mdar Mdi_res_wm Mdi_smgl_minus Mdi_smgl_plus Mdi_smgs_minus Mdi_smgs_plus Mdi_vmax Mdk_asr_l Mdk_asr_s Mdk_ext_minus Mdk_ext_plus Mdk_fzdyn Mdk_kuehl_mx Mdk_min_f Mdk_msr_l Mdk_msr_s Mdk_wunsch Nkw Nwe Rf Rf_soll St_ar1 St_ar1.B_ar_akt St_ar1.B_ar_ber St_ar1.B_filtbp_ngrd St_ar1.B_kein_ar St_ar1.B_td_kupp St_ar1.B_zr_ar St_bgkuppl St_bgkuppl.B_kupp St_bgkuppl.B_kupp1 St_bgkuppl.B_kupp2 St_bgkuppl.B_kupp_ext St_bgkuppl.B_kupp_mod St_bgkuppl1 St_bgkuppl1.B_ll St_fw1 St_fw1.B_nschalt_akt St_fw1.B_nschalt_aktalt St_ll St_ll.B_llr_on St_mdar0 St_mdar0.B_dmdp St_mdar0.B_dmls St_mdar0.B_dp St_mdar0.B_edp St_mdar0.B_elsd St_mdar0.B_ifdp St_mdar0.B_ls St_mdar0.B_lsd St_mdar1 St_mdar1.B_dash St_mdar1.B_iflsd St_mdar1.B_kf_at St_mdar1.B_ll_md St_mdar1.B_tl_md St_mdar1.B_vlschalt_verz St_mdbafak2 St_mdbafak2.B_ba_um St_mdbafak2.B_mdres_rgn St_mdbafak2.B_tev_quitt St_mdbafak2.B_tev_stopp St_mdbafak2.B_zwbaw St_mdbaschalt St_mdbaschalt.B_mdibaskor St_mdbaschalt.B_mdzw_1 St_mdbaschalt.B_mdzw_2 St_mdbaschalt.B_mdzw_3 St_mdbaschalt.B_mdzw_4 St_mdbaschalt.B_mdzw_5 St_mdbaschalt.B_mdzw_hd St_mdbaschalt.B_mdzwhysoff St_mdk.B_asr_akt St_mdk.B_getr_plus St_mdk.B_md_dynman St_mdk.B_mdk_plus St_mdk.B_msr_aktiv St_mdk.B_san St_mdk.B_siko_akt St_mdk.B_zw_dynman St_mdres St_mdres.B_md_res St_mdres.B_mdres_akt St_mdrk2 St_mdrk2.B_espr_start St_mdrk2.B_hd_start St_mdrk2.B_klopfen_s St_mdrk2.B_nesps St_mdrk2.B_rfsollfil_dec St_mdrk2.B_rfsollfil_inc St_mdrk2.B_zwladif St_rf St_rf.B_rfmin St_sawe St_sawe.B_sa St_sawe.B_sae St_sawe.B_safast St_start St_start.B_jumpstart St_start.B_sta St_start.B_start St_start.B_startende St_start.B_wst V /end IN_MEASUREMENT
/end FUNCTION
/begin FUNCTION MDFW "" /begin DEF_CHARACTERISTIC KF_MDKMIN_FIL KL_MDKMIN_NA K_MDIPM_HYS K_MDNARAMP S_IPM_04 /end DEF_CHARACTERISTIC /begin REF_CHARACTERISTIC S_IPM_06 S_IPM_BSPORT /end REF_CHARACTERISTIC
 /begin OUT_MEASUREMENT Dmd_min F_n_nstat Md_na_ramp Mdk_fw Mdk_min_f Mdk_wunsch Mdk_wunsch_grad Mdk_wunsch_vb St_fw St_fw.B_hschalt_komb St_fw.B_kupp_extalt St_fw.B_ldm_akt04 St_fw.B_ldm_off St_fw.B_ldm_offhs St_fw.B_ldm_offreg St_fw.B_ldm_offrs St_fw.B_rschalt_komb St_fw1 St_fw1.B_nschalt_akt St_fw1.B_nschalt_aktalt Zk_mdk_min /end OUT_MEASUREMENT
 /begin IN_MEASUREMENT Mdk_max Mdk_min Mdk_wunsch_cnt Mdk_wunsch_rad Mdr_wunsch Nkw Nstat St_fdc St_fdc.B_sport St_fw.B_hschalt_komb St_fw.B_kupp_extalt St_fw.B_ldm_akt04 St_fw.B_ldm_off St_fw.B_ldm_offhs St_fw.B_ldm_offreg St_fw.B_ldm_offrs St_fw.B_rschalt_komb /end IN_MEASUREMENT
/end FUNCTION
/begin FUNCTION MDI ""
 /begin DEF_CHARACTERISTIC K_IEFF_FAK K_IEFF_GSMN K_IEFF_GSMX K_I_1GANG K_I_1GANGAT K_I_1GANGDKG K_I_2GANGAT K_I_2GANGDKG K_I_HA K_I_HAAT K_I_HADKG K_I_LGANG K_I_LGANGAT K_I_LGANGDKG K_NAB_MN K_NKW_PEMAX K_R_DYN K_R_DYNLDM K_V2NAB S_AUSW_V S_IEFF_GS S_IPM_HS /end DEF_CHARACTERISTIC
 /begin OUT_MEASUREMENT I_eff I_fw_ber I_ges I_ges_at I_ges_hs I_ha I_opt Md_rad_istlm N_ab Nkw_opt /end OUT_MEASUREMENT
 /begin IN_MEASUREMENT Gangi I_eff_gs Mdk_ist_lm Nkw V V_can Var_at Var_dkg Var_ldm /end IN_MEASUREMENT
/end FUNCTION
/begin FUNCTION MDIPMFW "" /end FUNCTION
/begin FUNCTION MDIST "" /begin DEF_CHARACTERISTIC K_MAT_MDIOP /end DEF_CHARACTERISTIC
 /begin OUT_MEASUREMENT Eta_ges_ist Eta_ist Mdi_ist_h Mdi_opt_1 Mdi_opt_2 Mdi_opt_h Mdi_opt_l1 Mdi_opt_s Mdi_s_istm Rk_opt_ist /end OUT_MEASUREMENT
 /begin IN_MEASUREMENT Ba_ist Ba_soll Eta_hs Eta_lamb_ist Eta_mdkh Eta_zw_ist1 Eta_zw_ist2 Eta_zyl_aus Etarf_s Mdi_ist_m Nkw Rf Rk_soll_h Rk_soll_hs Rk_soll_s St_bvist /end IN_MEASUREMENT
/end FUNCTION
/begin FUNCTION MDKW ""
 /begin OUT_MEASUREMENT Dmdkw_soll Mdi_soll_lk Mdi_soll_lkdyn Mdkw_soll Mdkw_soll_l /end OUT_MEASUREMENT
 /begin IN_MEASUREMENT Md_na Mdi_llrp Mdi_reib Mdk_soll Mdk_soll_l /end IN_MEASUREMENT
/end FUNCTION
/begin FUNCTION MDLA ""
 /begin DEF_CHARACTERISTIC CW_MDLA_VAR KF_LA_MDMX KL_ETA_LA K_BA_LAMD K_DPSVER_LAMD K_DPS_LAMD K_LAMDFAK K_LAZW_MINUS K_LAZW_PLUS K_LA_MDMN K_LA_OPT K_MD_RESMXLA K_TDLAMD_AUS K_TDLAMD_EIN K_TDLAMD_EIN2 K_TEBGLLA_OFF K_T_LAMD K_V_LAMD S_KATREGEN S_LA_MX S_LA_ZWMD /end DEF_CHARACTERISTIC
 /begin OUT_MEASUREMENT Eta_rk_md Eta_rk_mdmx F_la_zwmx F_lazw_md La_md La_soll_md Md_la_mx Mdi_la_sollbg Mdi_opt St_rf1 St_rf1.B_dps_lamd St_rf1.B_la_md St_rf1.B_la_zwmd St_rf1.B_v_lamd Tddpslamd Tdlamdaus Tdlamdein Tdlamdein2 /end OUT_MEASUREMENT
/end FUNCTION
/end MODULE
/end PROJECT
