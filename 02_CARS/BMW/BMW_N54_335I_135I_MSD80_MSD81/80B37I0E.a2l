ASAP2_VERSION 1 41
/begin PROJECT MSD70 "Spray Guided DI-System with Piezo Injectors for 6-Cylinder"
/begin HEADER "_default_HeaderComment" PROJECT_NO _0B /end HEADER
/begin MODULE _default_ModuleName "_default_ModuleLongIdentifier"
/begin MOD_COMMON "_default_ModCommonComment" DEPOSIT ABSOLUTE BYTE_ORDER MSB_LAST ALIGNMENT_BYTE 1 ALIGNMENT_WORD 2 ALIGNMENT_LONG 2 ALIGNMENT_FLOAT32_IEEE 2 ALIGNMENT_FLOAT64_IEEE 4 /end MOD_COMMON
/begin CHARACTERISTIC c_t_ecraspwm_fb_min "Time range necessary for identification of failure feedback minimal value" VALUE 0xa1029886 _REC_VAL_20_u1 25.5 _CNV_A_R_LINEAR_____4_CM 0. 25.5 DISPLAY_IDENTIFIER C_T_ECRASPWM_FB_MIN FORMAT "%4.1" /end CHARACTERISTIC
/begin CHARACTERISTIC c_t_ecraspwm_fb_max "Time range necessary for identification of failure feedback maximal value" VALUE 0xa1029885 _REC_VAL_20_u1 25.5 _CNV_A_R_LINEAR_____4_CM 0. 25.5 DISPLAY_IDENTIFIER C_T_ECRASPWM_FB_MAX FORMAT "%4.1" /end CHARACTERISTIC
/begin CHARACTERISTIC c_ecraspwm_diag_min_scp "Minimum duty cycle threshold of ECRAS_EL for electrical ECRAS diagnosis" VALUE 0xa1029316 _REC_VAL_20_u1 99.609375 _CNV_A_R_LINEAR_____5_CM 0. 99.609375 DISPLAY_IDENTIFIER C_ECRASPWM_DIAG_MIN_SCP FORMAT "%9.6" /end CHARACTERISTIC
/begin CHARACTERISTIC c_ecraspwm_diag_max_scg "Maximum duty cycle threshold of ECRAS_EL for electrical ECRAS diagnosis" VALUE 0xa1029314 _REC_VAL_20_u1 99.609375 _CNV_A_R_LINEAR_____5_CM 0. 99.609375 DISPLAY_IDENTIFIER C_ECRASPWM_DIAG_MAX_SCG FORMAT "%9.6" /end CHARACTERISTIC
/begin CHARACTERISTIC c_ecraspwm_diag_min_oc "Minimum duty cycle threshold of ECRAS_EL for electrical ECRAS diagnosis" VALUE 0xa1029315 _REC_VAL_20_u1 99.609375 _CNV_A_R_LINEAR_____5_CM 0. 99.609375 DISPLAY_IDENTIFIER C_ECRASPWM_DIAG_MIN_OC FORMAT "%9.6" /end CHARACTERISTIC
/begin CHARACTERISTIC c_abc_ecraspwm_fb "If C_ABC_ECRASPWM_FB  times sequentially a failure feedback for the same failure is detected, the failure LV_ERR_ECRASPWM_FB  is set." VALUE 0xa102904d _REC_VAL_20_u1 254. _CNV_A_R_LINEAR_____0_CM 1. 255. DISPLAY_IDENTIFIER C_ABC_ECRASPWM_FB FORMAT "%3.0" /end CHARACTERISTIC
/begin CHARACTERISTIC c_ecraspwm_min_fb "Minimum duty cycle of ECRASPWM to have a failure feedback from ECRAS control unit" VALUE 0xa1029317 _REC_VAL_20_u1 99.609375 _CNV_A_R_LINEAR_____5_CM 0. 99.609375 DISPLAY_IDENTIFIER C_ECRASPWM_MIN_FB FORMAT "%9.6" /end CHARACTERISTIC
/begin CHARACTERISTIC c_t_act_ecraspwm_fb "Minimum time necessary to have failure feedback from ECRAS control unit" VALUE 0xa10297e0 _REC_VAL_20_u2 6553.5 _CNV_A_R_LINEAR_____4_CM 0. 6553.5 DISPLAY_IDENTIFIER C_T_ACT_ECRASPWM_FB FORMAT "%6.1" /end CHARACTERISTIC
/begin CHARACTERISTIC c_vs_max_ecras_diag "Maximum VS treshold for deactivation for electrical ECRAS diagnosis" VALUE 0xa1029ca6 _REC_VAL_20_u1 255. _CNV_A_R_LINEAR_____6_CM 0. 255. DISPLAY_IDENTIFIER C_VS_MAX_ECRAS_DIAG FORMAT "%3.0" /end CHARACTERISTIC
/begin MEASUREMENT lv_err_slv_ivvt_in "Error flag solenoid valve of inlet camshaft 1" UBYTE _CNV_S_2_RANGE__0___1_CM 1 100. 0. 1. DISPLAY_IDENTIFIER LV_ERR_SLV_IVVT_IN ECU_ADDRESS 0xd00033c8 BIT_MASK 0x1 /end MEASUREMENT
/begin MEASUREMENT lv_err_slv_ivvt_ex "Error flag solenoid valve of exhaust camshaft 1" UBYTE _CNV_S_2_RANGE__0___1_CM 1 100. 0. 1. DISPLAY_IDENTIFIER LV_ERR_SLV_IVVT_EX ECU_ADDRESS 0xd00033c9 BIT_MASK 0x1 /end MEASUREMENT
/begin MEASUREMENT lv_inh_diag_slv_ivvt_in "Diagnosis inhibition IVVT_IN" UBYTE _CNV_S_2_RANGE__0___1_CM 1 100. 0. 1. DISPLAY_IDENTIFIER LV_INH_DIAG_SLV_IVVT_IN ECU_ADDRESS 0xd0003e14 BIT_MASK 0x1 /end MEASUREMENT
/begin CHARACTERISTIC c_slv_ivvt_pwm_diag_min_oc "Maximum threshold for OC diagnosis window" VALUE 0xa102978e _REC_VAL_20_u2 99.99847412109381 _CNV_A_R_LINEAR_____7_CM 0. 99.99847412109381 DISPLAY_IDENTIFIER C_SLV_IVVT_PWM_DIAG_MIN_OC FORMAT "%5.2" /end CHARACTERISTIC
/begin CHARACTERISTIC c_slv_ivvt_pwm_diag_min_scb "Minimum threshold for SCB diagnosis window" VALUE 0xa1029790 _REC_VAL_20_u2 99.99847412109381 _CNV_A_R_LINEAR_____7_CM 0. 99.99847412109381 DISPLAY_IDENTIFIER C_SLV_IVVT_PWM_DIAG_MIN_SCB FORMAT "%5.2" /end CHARACTERISTIC
/begin CHARACTERISTIC c_slv_ivvt_pwm_diag_max_scg "Maximum threshold for SCG diagnosis window" VALUE 0xa102978c _REC_VAL_20_u2 99.99847412109381 _CNV_A_R_LINEAR_____7_CM 0. 99.99847412109381 DISPLAY_IDENTIFIER C_SLV_IVVT_PWM_DIAG_MAX_SCG FORMAT "%5.2" /end CHARACTERISTIC
/begin MEASUREMENT lv_inh_diag_slv_ivvt_ex "Diagnosis inhibition IVVT_EX" UBYTE _CNV_S_2_RANGE__0___1_CM 1 100. 0. 1. DISPLAY_IDENTIFIER LV_INH_DIAG_SLV_IVVT_EX ECU_ADDRESS 0xd0003e15 BIT_MASK 0x1 /end MEASUREMENT
/begin CHARACTERISTIC c_n_max_fl_dly "Maximum engine speed for Full load recognition" VALUE 0xa1029624 _REC_VAL_20_u1 8160. _CNV_A_R_LINEAR_____9_CM 0. 8160. DISPLAY_IDENTIFIER C_N_MAX_FL_DLY FORMAT "%4.0" /end CHARACTERISTIC
/begin CHARACTERISTIC c_n_min_fl_dly "Minimum engine speed for Full load recognition" VALUE 0xa1029633 _REC_VAL_20_u1 8160. _CNV_A_R_LINEAR_____9_CM 0. 8160. DISPLAY_IDENTIFIER C_N_MIN_FL_DLY FORMAT "%4.0" /end CHARACTERISTIC
/begin CHARACTERISTIC c_t_max_fl_dly "Time after Start- Threshold value for Full load recognition" VALUE 0xa10298c2 _REC_VAL_20_u2 6553.5 _CNV_A_R_LINEAR_____4_CM 0. 6553.5 DISPLAY_IDENTIFIER C_T_MAX_FL_DLY FORMAT "%5.1" /end CHARACTERISTIC
/begin CHARACTERISTIC c_t_ti_dly_fl_2 "Delay time Full load" VALUE 0xa102997c _REC_VAL_20_u2 655.35 _CNV_A_R_LINEAR_____3_CM 0. 655.35 DISPLAY_IDENTIFIER C_T_TI_DLY_FL_2 FORMAT "%6.2" /end CHARACTERISTIC
/begin CHARACTERISTIC c_t_ti_dly_fl_at_1 "Delay time Full load AT" VALUE 0xa102997e _REC_VAL_20_u2 655.35 _CNV_A_R_LINEAR_____3_CM 0. 655.35 DISPLAY_IDENTIFIER C_T_TI_DLY_FL_AT_1 FORMAT "%6.2" /end CHARACTERISTIC
/begin CHARACTERISTIC c_t_ti_dly_fl_at_2 "Delay time Full load AT" VALUE 0xa1029980 _REC_VAL_20_u2 655.35 _CNV_A_R_LINEAR_____3_CM 0. 655.35 DISPLAY_IDENTIFIER C_T_TI_DLY_FL_AT_2 FORMAT "%6.2" /end CHARACTERISTIC
/begin CHARACTERISTIC c_tco_min_fl "Minimum temperature for FL" VALUE 0xa10299e0 _REC_VAL_20_u1 28.575 _CNV_A_R_LINEAR_____16_CM -48. 142.5 DISPLAY_IDENTIFIER C_TCO_MIN_FL FORMAT "%5.1" /end CHARACTERISTIC
/begin CHARACTERISTIC c_vs_min_fl "Minimum velocity for FL" VALUE 0xa1029cba _REC_VAL_20_u1 25.5 _CNV_A_R_LINEAR_____6_CM 0. 255. DISPLAY_IDENTIFIER C_VS_MIN_FL FORMAT "%3.0" /end CHARACTERISTIC
/begin MEASUREMENT lv_fl_raw "LV condition a) is fullfilled" UBYTE _CNV_S_2_RANGE__0___1_CM 1 100. 0. 1. DISPLAY_IDENTIFIER LV_FL_RAW ECU_ADDRESS 0xd0003cb9 BIT_MASK 0x1 /end MEASUREMENT
/begin MEASUREMENT lv_fl "Basic function FL" UBYTE _CNV_S_2_RANGE__0___1_CM 1 100. 0. 1. DISPLAY_IDENTIFIER LV_FL ECU_ADDRESS 0xd0003cb8 BIT_MASK 0x1 /end MEASUREMENT
/begin CHARACTERISTIC c_n_min_fl "Minimum engine speed for FL" VALUE 0xa1029632 _REC_VAL_20_u1 816. _CNV_A_R_LINEAR_____9_CM 0. 8160. DISPLAY_IDENTIFIER C_N_MIN_FL FORMAT "%4.0" /end CHARACTERISTIC
/begin CHARACTERISTIC c_t_min_fl_dly "Time after Start- Threshold for Full load recognition" VALUE 0xa10298f4 _REC_VAL_20_u2 6553.5 _CNV_A_R_LINEAR_____4_CM 0. 6553.5 DISPLAY_IDENTIFIER C_T_MIN_FL_DLY FORMAT "%5.1" /end CHARACTERISTIC
/begin MEASUREMENT lv_inf "Basic function \" Intercept \"" UBYTE _CNV_S_2_RANGE__0___1_CM 1 100. 0. 1. DISPLAY_IDENTIFIER LV_INF ECU_ADDRESS 0xd0003cba BIT_MASK 0x1 /end MEASUREMENT
/begin CHARACTERISTIC c_t_ti_dly_fl_1 "Delay time Full load" VALUE 0xa102997a _REC_VAL_20_u2 655.35 _CNV_A_R_LINEAR_____3_CM 0. 655.35 DISPLAY_IDENTIFIER C_T_TI_DLY_FL_1 FORMAT "%6.2" /end CHARACTERISTIC
/begin CHARACTERISTIC c_n_min_cp_fl "Minimum engine speed for FL at high canister purge load" VALUE 0xa102962f _REC_VAL_20_u1 8160. _CNV_A_R_LINEAR_____9_CM 0. 8160. DISPLAY_IDENTIFIER C_N_MIN_CP_FL FORMAT "%4.0" /end CHARACTERISTIC
/begin CHARACTERISTIC c_cl_mmv_thd_fl "threshold for high canister load" VALUE 0xa10291bc _REC_VAL_20_u2 1.99996948242188 _CNV_A_R_LINEAR_____8_CM 0. 1.99996948242188 DISPLAY_IDENTIFIER C_CL_MMV_THD_FL FORMAT "%7.5" /end CHARACTERISTIC
/begin AXIS_PTS ldpm_n_2_3 "" 0xa1021d3c n _REC_AXS_20_u2 816. _CNV_A_R_LINEAR_____13_CM 16 0. 8160. FORMAT "%4.0" /end AXIS_PTS
/begin CHARACTERISTIC ip_fac_tq_req_driv_fl "Driver wish threshold for full load recognition" CURVE 0xa10247d8 _REC_CUR_20_u2_u2 1.99996948242188 _CNV_A_R_LINEAR_____8_CM 0. 1.99996948242188 DISPLAY_IDENTIFIER IP_FAC_TQ_REQ_DRIV_FL FORMAT "%7.5"
 /begin AXIS_DESCR COM_AXIS n _CNV_A_R_LINEAR_____13_CM 16 0. 8160. FORMAT "%4.0" AXIS_PTS_REF ldpm_n_2_3 /end AXIS_DESCR
/end CHARACTERISTIC
/begin CHARACTERISTIC ip_load_thd_fl "Load threshold for Full load recognition" CURVE 0xa10260fc _REC_CUR_20_u2_u2 3.99993896484375 _CNV_A_R_LINEAR_____23_CM 0. 3.99993896484375 DISPLAY_IDENTIFIER IP_LOAD_THD_FL FORMAT "%7.5"
 /begin AXIS_DESCR COM_AXIS n _CNV_A_R_LINEAR_____13_CM 16 0. 8160. FORMAT "%4.0" AXIS_PTS_REF ldpm_n_2_3 /end AXIS_DESCR
/end CHARACTERISTIC
/begin CHARACTERISTIC c_fac_tq_req_fl_hys "Hysteresis for driver wish threshold for Full load recognition" VALUE 0xa10293c2 _REC_VAL_20_u2 1.99996948242188 _CNV_A_R_LINEAR_____8_CM 0. 1.99996948242188 DISPLAY_IDENTIFIER C_FAC_TQ_REQ_FL_HYS FORMAT "%7.5" /end CHARACTERISTIC
/begin CHARACTERISTIC c_load_thd_fl_hys "Hysteresis for load threshold for Full load recognition" VALUE 0xa102952e _REC_VAL_20_u2 3.99993896484375 _CNV_A_R_LINEAR_____23_CM 0. 3.99993896484375 DISPLAY_IDENTIFIER C_LOAD_THD_FL_HYS FORMAT "%7.5" /end CHARACTERISTIC
/begin AXIS_PTS ldp_n_grd_n_max_inf "" 0xa1020f1e n_grd _REC_AXS_20_u1 4096. _CNV_A_R_LINEAR_____28_CM 6 -4096. 0. FORMAT "%5.0" /end AXIS_PTS
/begin CHARACTERISTIC ip_n_max_inf "Maximum engine speed for intercept function" CURVE 0xa1026350 _REC_CUR_20_u1_u1 8160. _CNV_A_R_LINEAR_____9_CM 0. 8160. DISPLAY_IDENTIFIER IP_N_MAX_INF FORMAT "%4.0"
 /begin AXIS_DESCR COM_AXIS n_grd _CNV_A_R_LINEAR_____28_CM 6 -4096. 0. FORMAT "%5.0" AXIS_PTS_REF ldp_n_grd_n_max_inf /end AXIS_DESCR
/end CHARACTERISTIC
/begin CHARACTERISTIC c_n_grd_min "engine speed  gradient threshold for activating the intercept function" VALUE 0xa10295fd _REC_VAL_20_s1 204.8 _CNV_A_R_LINEAR_____29_CM -4096. 0. DISPLAY_IDENTIFIER C_N_GRD_MIN FORMAT "%7.0" /end CHARACTERISTIC
/begin MEASUREMENT lv_err_locan_boff "present error LOCAN bus off" UBYTE _CNV_S_2_RANGE__0___1_CM 1 100. 0. 1. DISPLAY_IDENTIFIER LV_ERR_LOCAN_BOFF ECU_ADDRESS 0xd0003469 BIT_MASK 0x1 /end MEASUREMENT
/begin MEASUREMENT lv_ti_ch "Auxiliary Function \" Catalyst Heating Injection\"." UBYTE _CNV_S_2_RANGE__0___1_CM 1 100. 0. 1. DISPLAY_IDENTIFIER LV_TI_CH ECU_ADDRESS 0xd0003cc1 BIT_MASK 0x1 /end MEASUREMENT
/begin MEASUREMENT lv_ch "Auxiliary Function \" Catalyst Heating Spark\"." UBYTE _CNV_S_2_RANGE__0___1_CM 1 100. 0. 1. DISPLAY_IDENTIFIER LV_CH ECU_ADDRESS 0xd0003cc0 BIT_MASK 0x1 /end MEASUREMENT
/begin MEASUREMENT lv_ch_n_sp_is "Catalyst Heating Function \"increased idle speed setpoint\"" UBYTE _CNV_S_2_RANGE__0___1_CM 1 100. 0. 1. DISPLAY_IDENTIFIER LV_CH_N_SP_IS ECU_ADDRESS 0xd0003cbe BIT_MASK 0x1 /end MEASUREMENT
/begin MEASUREMENT lv_ch_ivvt "Catalyst Heating Function \"increased valve overlap\"" UBYTE _CNV_S_2_RANGE__0___1_CM 1 100. 0. 1. DISPLAY_IDENTIFIER LV_CH_IVVT ECU_ADDRESS 0xd0003cbf BIT_MASK 0x1 /end MEASUREMENT
/begin CHARACTERISTIC ip_t_ch_n_sp_is "Activation time for CAT heating function 'idle speed setpoint'" MAP 0xa1027a64 _REC_MAP_20_u2_u1_u2 6553.5 _CNV_A_R_LINEAR_____4_CM 0. 6553.5 DISPLAY_IDENTIFIER IP_T_CH_N_SP_IS FORMAT "%6.1"
 /begin AXIS_DESCR COM_AXIS tco _CNV_A_R_LINEAR_____16_CM 8 -48. 142.5 FORMAT "%5.1" AXIS_PTS_REF ldpm_tco_2 /end AXIS_DESCR
 /begin AXIS_DESCR COM_AXIS ctr_km_can _CNV_A_R_LINEAR_____70_CM 4 0. 655350. FORMAT "%7.0" AXIS_PTS_REF ldpm_ctr_km_can_1 /end AXIS_DESCR
/end CHARACTERISTIC
/begin CHARACTERISTIC id_t_ch_ti "Activation time after start to switch on the injection time correction for catalyst heating" CURVE 0xa1022f28 _REC_CUR_20_u2_u1 6553.5 _CNV_A_R_LINEAR_____4_CM 0. 6553.5 DISPLAY_IDENTIFIER ID_T_CH_TI FORMAT "%6.1"
 /begin AXIS_DESCR COM_AXIS tco _CNV_A_R_LINEAR_____16_CM 8 -48. 142.5 FORMAT "%5.1" AXIS_PTS_REF ldpm_tco_2 /end AXIS_DESCR
/end CHARACTERISTIC
/begin MEASUREMENT lv_wup "Warm up functions active" UBYTE _CNV_S_2_RANGE__0___1_CM 1 100. 0. 1. DISPLAY_IDENTIFIER LV_WUP ECU_ADDRESS 0xd0003cc2 BIT_MASK 0x1 /end MEASUREMENT
/begin CHARACTERISTIC ip_t_ch_ivvt "Activation time for CAT heating function 'VANOS'" MAP 0xa1027a24 _REC_MAP_20_u2_u1_u2 6553.5 _CNV_A_R_LINEAR_____4_CM 0. 6553.5 DISPLAY_IDENTIFIER IP_T_CH_IVVT FORMAT "%6.1"
 /begin AXIS_DESCR COM_AXIS tco _CNV_A_R_LINEAR_____16_CM 8 -48. 142.5 FORMAT "%5.1" AXIS_PTS_REF ldpm_tco_2 /end AXIS_DESCR
 /begin AXIS_DESCR COM_AXIS ctr_km_can _CNV_A_R_LINEAR_____70_CM 4 0. 655350. FORMAT "%7.0" AXIS_PTS_REF ldpm_ctr_km_can_1 /end AXIS_DESCR
/end CHARACTERISTIC
/begin AXIS_PTS ldpm_tco_2 "" 0xa1022224 tco _REC_AXS_20_u1 190.5 _CNV_A_R_LINEAR_____16_CM 8 -48. 142.5 FORMAT "%5.1" /end AXIS_PTS
/begin CHARACTERISTIC ip_t_ch_tq_add "Activation time for CAT heating function 'IGA'" MAP 0xa1027aa4 _REC_MAP_20_u2_u1_u2 6553.5 _CNV_A_R_LINEAR_____4_CM 0. 6553.5 DISPLAY_IDENTIFIER IP_T_CH_TQ_ADD FORMAT "%6.1"
 /begin AXIS_DESCR COM_AXIS tco _CNV_A_R_LINEAR_____16_CM 8 -48. 142.5 FORMAT "%5.1" AXIS_PTS_REF ldpm_tco_2 /end AXIS_DESCR
 /begin AXIS_DESCR COM_AXIS ctr_km_can _CNV_A_R_LINEAR_____70_CM 4 0. 655350. FORMAT "%7.0" AXIS_PTS_REF ldpm_ctr_km_can_1 /end AXIS_DESCR
/end CHARACTERISTIC
/begin CHARACTERISTIC ip_t_ch_tq_add_wout_cat "Activation time for CAT heating function 'IGA', vehicle variant without catalyst" MAP 0xa1027b64 _REC_MAP_20_u2_u1_u2 6553.5 _CNV_A_R_LINEAR_____4_CM 0. 6553.5 DISPLAY_IDENTIFIER IP_T_CH_TQ_ADD_WOUT_CAT FORMAT "%6.1"
 /begin AXIS_DESCR COM_AXIS tco _CNV_A_R_LINEAR_____16_CM 8 -48. 142.5 FORMAT "%5.1" AXIS_PTS_REF ldpm_tco_2 /end AXIS_DESCR
 /begin AXIS_DESCR COM_AXIS ctr_km_can _CNV_A_R_LINEAR_____70_CM 4 0. 655350. FORMAT "%7.0" AXIS_PTS_REF ldpm_ctr_km_can_1 /end AXIS_DESCR
/end CHARACTERISTIC
/begin CHARACTERISTIC ip_t_ch_tq_add_is "Activation time for CAT heating function 'IGA at first idle phases'" MAP 0xa1027ae4 _REC_MAP_20_u2_u1_u2 6553.5 _CNV_A_R_LINEAR_____4_CM 0. 6553.5 DISPLAY_IDENTIFIER IP_T_CH_TQ_ADD_IS FORMAT "%6.1"
 /begin AXIS_DESCR COM_AXIS tco _CNV_A_R_LINEAR_____16_CM 8 -48. 142.5 FORMAT "%5.1" AXIS_PTS_REF ldpm_tco_2 /end AXIS_DESCR
 /begin AXIS_DESCR COM_AXIS ctr_km_can _CNV_A_R_LINEAR_____70_CM 4 0. 655350. FORMAT "%7.0" AXIS_PTS_REF ldpm_ctr_km_can_1 /end AXIS_DESCR
/end CHARACTERISTIC
/begin CHARACTERISTIC ip_t_ch_tq_add_is_wout_cat "Activation time for CAT heating function 'IGA at first idle phases', vehicle variant without catalyst" MAP 0xa1027b24 _REC_MAP_20_u2_u1_u2 6553.5 _CNV_A_R_LINEAR_____4_CM 0. 6553.5 DISPLAY_IDENTIFIER IP_T_CH_TQ_ADD_IS_WOUT_CAT FORMAT "%6.1"
 /begin AXIS_DESCR COM_AXIS tco _CNV_A_R_LINEAR_____16_CM 8 -48. 142.5 FORMAT "%5.1" AXIS_PTS_REF ldpm_tco_2 /end AXIS_DESCR
 /begin AXIS_DESCR COM_AXIS ctr_km_can _CNV_A_R_LINEAR_____70_CM 4 0. 655350. FORMAT "%7.0" AXIS_PTS_REF ldpm_ctr_km_can_1 /end AXIS_DESCR
/end CHARACTERISTIC
/begin AXIS_PTS ldpm_ctr_km_can_1 "" 0xa1021924 ctr_km_can _REC_AXS_20_u2 655350. _CNV_A_R_LINEAR_____70_CM 4 0. 655350. FORMAT "%7.0" /end AXIS_PTS
/begin MEASUREMENT lv_dcc_off_ecu "Irreversible DCC error" UBYTE _CNV_S_2_RANGE__0___1_CM 1 100. 0. 1. DISPLAY_IDENTIFIER LV_DCC_OFF_ECU ECU_ADDRESS 0xd0003e51 BIT_MASK 0x1 /end MEASUREMENT
/begin MEASUREMENT t_dcc_brake_det "Brake delay timer" UBYTE _CNV_A_R_LINEAR_____3_CM 1 100. 0. 2.55 DISPLAY_IDENTIFIER T_DCC_BRAKE_DET ECU_ADDRESS 0xd0003e50 FORMAT "%4.2" /end MEASUREMENT
/begin CHARACTERISTIC c_t_max_brake_det_dcc "Maximum Brake delay timer" VALUE 0xa10298b6 _REC_VAL_20_u1 2.55 _CNV_A_R_LINEAR_____3_CM 0. 2.55 DISPLAY_IDENTIFIER C_T_MAX_BRAKE_DET_DCC FORMAT "%4.2" /end CHARACTERISTIC
/begin MEASUREMENT lv_err_dcc "DCC error" UBYTE _CNV_S_2_RANGE__0___1_CM 1 100. 0. 1. DISPLAY_IDENTIFIER LV_ERR_DCC ECU_ADDRESS 0xd0003442 BIT_MASK 0x1 /end MEASUREMENT
/begin CHARACTERISTIC c_maf_cs_diag "MAF threshold for error detection" VALUE 0xa1029532 _REC_VAL_20_u2 1389. _CNV_A_R_LINEAR_____108_CM 0. 1389. DISPLAY_IDENTIFIER C_MAF_CS_DIAG FORMAT "%7.2" /end CHARACTERISTIC
/begin CHARACTERISTIC c_n_32_cs_diag "N32 threshold for error detection" VALUE 0xa10295ba _REC_VAL_20_u1 8160. _CNV_A_R_LINEAR_____9_CM 0. 8160. DISPLAY_IDENTIFIER C_N_32_CS_DIAG FORMAT "%4.0" /end CHARACTERISTIC
/begin MEASUREMENT lv_err_cs "Active CS error" UBYTE _CNV_S_2_RANGE__0___1_CM 1 100. 0. 1. DISPLAY_IDENTIFIER LV_ERR_CS ECU_ADDRESS 0xd0003445 BIT_MASK 0x1 /end MEASUREMENT
/begin MEASUREMENT lv_cs_diag "Flag set when vehicle was stopped = pre-condition for diagnosis cycle" UBYTE _CNV_S_2_RANGE__0___1_CM 1 100. 0. 1. DISPLAY_IDENTIFIER LV_CS_DIAG ECU_ADDRESS 0xc00002c5 BIT_MASK 0x1 /end MEASUREMENT
/begin MEASUREMENT lv_cs_swi "Flag set when CS change its state" UBYTE _CNV_S_2_RANGE__0___1_CM 1 100. 0. 1. DISPLAY_IDENTIFIER LV_CS_SWI ECU_ADDRESS 0xc00002c6 BIT_MASK 0x1 /end MEASUREMENT
/begin MEASUREMENT t_min_maf_cs_diag "Minimum diagnosis time for MAF condition" UBYTE _CNV_A_R_LINEAR_____35_CM 1 100. 0. 255. DISPLAY_IDENTIFIER T_MIN_MAF_CS_DIAG ECU_ADDRESS 0xc00002c4 FORMAT "%3.0" /end MEASUREMENT
/begin CHARACTERISTIC c_vs_cs_diag "Speed threshold for activation of diagnosis cycle" VALUE 0xa1029c69 _REC_VAL_20_u1 255. _CNV_A_R_LINEAR_____6_CM 0. 255. DISPLAY_IDENTIFIER C_VS_CS_DIAG FORMAT "%3.0" /end CHARACTERISTIC
/begin CHARACTERISTIC c_t_min_maf_cs_diag "Minimum diagnosis time for MAF condition" VALUE 0xa10298f6 _REC_VAL_20_u1 255. _CNV_A_R_LINEAR_____35_CM 0. 255. DISPLAY_IDENTIFIER C_T_MIN_MAF_CS_DIAG FORMAT "%3.0" /end CHARACTERISTIC
/begin MEASUREMENT lv_es "Engine operating state \"Engine stopped\"" UBYTE _CNV_S_2_RANGE__0___1_CM 1 100. 0. 1. DISPLAY_IDENTIFIER LV_ES ECU_ADDRESS 0xd0003cc6 BIT_MASK 0x1 /end MEASUREMENT
/begin MEASUREMENT lv_st "Engine operating state \"Start\"" UBYTE _CNV_S_2_RANGE__0___1_CM 1 100. 0. 1. DISPLAY_IDENTIFIER LV_ST ECU_ADDRESS 0xd0003cc7 BIT_MASK 0x1 /end MEASUREMENT
/begin MEASUREMENT lv_st_end "Engine operating state \"Start\" not active" UBYTE _CNV_S_2_RANGE__0___1_CM 1 100. 0. 1. DISPLAY_IDENTIFIER LV_ST_END ECU_ADDRESS 0xd0003cc8 BIT_MASK 0x1 /end MEASUREMENT
/begin CHARACTERISTIC ip_cyc_cast__tco "Cycle counter to define the duration of the start phase characterised by LV_ST" CURVE 0xa10231f4 _REC_CUR_20_u2_u1 65535. _CNV_A_R_LINEAR_____0_CM 0. 65535. DISPLAY_IDENTIFIER IP_CYC_CAST__TCO FORMAT "%5.0"
 /begin AXIS_DESCR COM_AXIS tco _CNV_A_R_LINEAR_____16_CM 9 -48. 142.5 FORMAT "%5.1" AXIS_PTS_REF ldpm_tco_9 /end AXIS_DESCR
/end CHARACTERISTIC
/begin MEASUREMENT lv_is "Engine operating state \"Idle Speed\"" UBYTE _CNV_S_2_RANGE__0___1_CM 1 100. 0. 1. DISPLAY_IDENTIFIER LV_IS ECU_ADDRESS 0xd0003cc9 BIT_MASK 0x1 /end MEASUREMENT
/begin CHARACTERISTIC c_n_max_bol_st "Engine speed threshold to detect LV_ST or LV_PL from LV_IS" VALUE 0xa1029611 _REC_VAL_20_u1 408. _CNV_A_R_LINEAR_____9_CM 0. 8160. DISPLAY_IDENTIFIER C_N_MAX_BOL_ST FORMAT "%4.0" /end CHARACTERISTIC
/begin MEASUREMENT lv_pl "Engine operating state „Part Load\"" UBYTE _CNV_S_2_RANGE__0___1_CM 1 100. 0. 1. DISPLAY_IDENTIFIER LV_PL ECU_ADDRESS 0xd0003cca BIT_MASK 0x1 /end MEASUREMENT
/begin MEASUREMENT lv_pu "Engine operating state \"Trailing throttle\"" UBYTE _CNV_S_2_RANGE__0___1_CM 1 100. 0. 1. DISPLAY_IDENTIFIER LV_PU ECU_ADDRESS 0xd0003ccb BIT_MASK 0x1 /end MEASUREMENT
/begin MEASUREMENT t_pu "Time elapsed into LV_PU" UWORD _CNV_A_R_LINEAR_____3_CM 1 100. 0. 655.35 DISPLAY_IDENTIFIER T_PU ECU_ADDRESS 0xd00050d0 FORMAT "%5.2" /end MEASUREMENT
/begin CHARACTERISTIC c_t_min_pu "Minimum delay time of PUC activation after entry of PU" VALUE 0xa10298fe _REC_VAL_20_u2 655.35 _CNV_A_R_LINEAR_____3_CM 0. 655.35 DISPLAY_IDENTIFIER C_T_MIN_PU FORMAT "%6.2" /end CHARACTERISTIC
/begin CHARACTERISTIC c_t_max_pu "Maximum delay time of PUC activation after entry of PU" VALUE 0xa10298ca _REC_VAL_20_u2 655.35 _CNV_A_R_LINEAR_____3_CM 0. 655.35 DISPLAY_IDENTIFIER C_T_MAX_PU FORMAT "%6.2" /end CHARACTERISTIC
/begin CHARACTERISTIC lc_inh_dt_pu "Manual inhibition bit for deactivation drivetrain impact for controlling transition to PUC" VALUE 0xa1029d4b _REC_VAL_20_u1 1. _CNV_S_2_RANGE______75_CM 0. 1. DISPLAY_IDENTIFIER LC_INH_DT_PU /end CHARACTERISTIC
/begin CHARACTERISTIC c_t_min_pu_msr "Minimum delay time of PUC activation after MSR" VALUE 0xa1029900 _REC_VAL_20_u2 655.35 _CNV_A_R_LINEAR_____3_CM 0. 655.35 DISPLAY_IDENTIFIER C_T_MIN_PU_MSR FORMAT "%6.2" /end CHARACTERISTIC
/begin CHARACTERISTIC c_t_min_pu_rng_l "Minimum delay time of PUC activation after entry of PU for LV_RNG_L =1" VALUE 0xa1029902 _REC_VAL_20_u2 655.35 _CNV_A_R_LINEAR_____3_CM 0. 655.35 DISPLAY_IDENTIFIER C_T_MIN_PU_RNG_L FORMAT "%6.2" /end CHARACTERISTIC
/begin MEASUREMENT lv_puc "engine operating state \"trailing throttle fuel cut off \"" UBYTE _CNV_S_2_RANGE__0___1_CM 1 100. 0. 1. DISPLAY_IDENTIFIER LV_PUC ECU_ADDRESS 0xd0003ccc BIT_MASK 0x1 /end MEASUREMENT
/begin CHARACTERISTIC id_n_hys_max_puc__gr_at "Engine speed hysteresis set entering LV_PUC" CURVE 0xa1022db0 _REC_CUR_20_u1_u1 8160. _CNV_A_R_LINEAR_____9_CM 0. 8160. DISPLAY_IDENTIFIER ID_N_HYS_MAX_PUC__GR_AT FORMAT "%4.0"
 /begin AXIS_DESCR COM_AXIS gr_at _CNV_A_R_LINEAR_____0_CM 13 0. 255. FORMAT "%3.0" AXIS_PTS_REF ldpm_gr_at_3 /end AXIS_DESCR
/end CHARACTERISTIC
/begin CHARACTERISTIC id_n_hys_max_puc__gr_mt "Engine speed hysteresis set entering LV_PUC" CURVE 0xa1022dc0 _REC_CUR_20_u1_u1 8160. _CNV_A_R_LINEAR_____9_CM 0. 8160. DISPLAY_IDENTIFIER ID_N_HYS_MAX_PUC__GR_MT FORMAT "%4.0"
 /begin AXIS_DESCR COM_AXIS gr_mt _CNV_A_R_LINEAR_____0_CM 13 0. 255. FORMAT "%3.0" AXIS_PTS_REF ldpm_gr_mt_3 /end AXIS_DESCR
/end CHARACTERISTIC
/begin CHARACTERISTIC id_n_hys_min_puc__gr_at "Engine speed hysteresis reset when C_CYCNR_HYS_PUC_xx achieved" CURVE 0xa1022dd0 _REC_CUR_20_u1_u1 8160. _CNV_A_R_LINEAR_____9_CM 0. 8160. DISPLAY_IDENTIFIER ID_N_HYS_MIN_PUC__GR_AT FORMAT "%4.0"
 /begin AXIS_DESCR COM_AXIS gr_at _CNV_A_R_LINEAR_____0_CM 13 0. 255. FORMAT "%3.0" AXIS_PTS_REF ldpm_gr_at_3 /end AXIS_DESCR
/end CHARACTERISTIC
/begin CHARACTERISTIC id_n_hys_min_puc__gr_mt "Engine speed hysteresis reset when C_CYCNR_HYS_PUC_xx achieved" CURVE 0xa1022de0 _REC_CUR_20_u1_u1 8160. _CNV_A_R_LINEAR_____9_CM 0. 8160. DISPLAY_IDENTIFIER ID_N_HYS_MIN_PUC__GR_MT FORMAT "%4.0"
 /begin AXIS_DESCR COM_AXIS gr_mt _CNV_A_R_LINEAR_____0_CM 13 0. 255. FORMAT "%3.0" AXIS_PTS_REF ldpm_gr_mt_3 /end AXIS_DESCR
/end CHARACTERISTIC
/begin CHARACTERISTIC id_n_hys_puc_st__gr_at "Engine speed hysteresis set entering LV_PUC in cold condition" CURVE 0xa1022df0 _REC_CUR_20_u1_u1 8160. _CNV_A_R_LINEAR_____9_CM 0. 8160. DISPLAY_IDENTIFIER ID_N_HYS_PUC_ST__GR_AT FORMAT "%4.0"
 /begin AXIS_DESCR COM_AXIS gr_at _CNV_A_R_LINEAR_____0_CM 13 0. 255. FORMAT "%3.0" AXIS_PTS_REF ldpm_gr_at_3 /end AXIS_DESCR
/end CHARACTERISTIC
/begin CHARACTERISTIC id_n_hys_puc_st__gr_mt "Engine speed hysteresis set entering LV_PUC in cold condition" CURVE 0xa1022e00 _REC_CUR_20_u1_u1 8160. _CNV_A_R_LINEAR_____9_CM 0. 8160. DISPLAY_IDENTIFIER ID_N_HYS_PUC_ST__GR_MT FORMAT "%4.0"
 /begin AXIS_DESCR COM_AXIS gr_mt _CNV_A_R_LINEAR_____0_CM 13 0. 255. FORMAT "%3.0" AXIS_PTS_REF ldpm_gr_mt_3 /end AXIS_DESCR
/end CHARACTERISTIC
/begin CHARACTERISTIC c_cycnr_hys_puc "Cycle counter to reset the LV_PUC engine speed hysteresis " VALUE 0xa10292e2 _REC_VAL_20_u2 655.35 _CNV_A_R_LINEAR_____145_CM 0. 65535. DISPLAY_IDENTIFIER C_CYCNR_HYS_PUC FORMAT "%5.0" /end CHARACTERISTIC
/begin CHARACTERISTIC c_cycnr_hys_puc_st "Cycle counter to reset the LV_PUC engine speed hysteresis in cold condition" VALUE 0xa10292e4 _REC_VAL_20_u2 655.35 _CNV_A_R_LINEAR_____145_CM 0. 65535. DISPLAY_IDENTIFIER C_CYCNR_HYS_PUC_ST FORMAT "%5.0" /end CHARACTERISTIC
/begin CHARACTERISTIC c_tco_min_puc_st "Coolant temperature to select the LV_PUC engine speed hysteresis" VALUE 0xa10299e6 _REC_VAL_20_u1 28.575 _CNV_A_R_LINEAR_____16_CM -48. 142.5 DISPLAY_IDENTIFIER C_TCO_MIN_PUC_ST FORMAT "%5.1" /end CHARACTERISTIC
/begin MEASUREMENT lv_puc_req "Engine operating state \"Trailing throttle\" for torque structure" UBYTE _CNV_S_2_RANGE__0___1_CM 1 100. 0. 1. DISPLAY_IDENTIFIER LV_PUC_REQ ECU_ADDRESS 0xd0003cce BIT_MASK 0x1 /end MEASUREMENT
/begin MEASUREMENT state_eng "" UBYTE _CNV_S_6_RANGE_STAT_146_CM 1 100. 0. 5. DISPLAY_IDENTIFIER STATE_ENG ECU_ADDRESS 0xd0003cc4 /end MEASUREMENT
/begin CHARACTERISTIC ip_n_min_puc__tco__gr_mt "LV_PUC engine speed threshold" MAP 0xa10263bc _REC_MAP_20_u1_u1_u1 8160. _CNV_A_R_LINEAR_____9_CM 0. 8160. DISPLAY_IDENTIFIER IP_N_MIN_PUC__TCO__GR_MT FORMAT "%4.0"
 /begin AXIS_DESCR COM_AXIS tco _CNV_A_R_LINEAR_____16_CM 6 -48. 142.5 FORMAT "%5.1" AXIS_PTS_REF ldpm_tco_1_6 /end AXIS_DESCR
 /begin AXIS_DESCR COM_AXIS gr_mt _CNV_A_R_LINEAR_____0_CM 13 0. 255. FORMAT "%3.0" AXIS_PTS_REF ldpm_gr_mt_3 /end AXIS_DESCR
/end CHARACTERISTIC
/begin CHARACTERISTIC ip_n_accout_min_puc__tco__gr_mt "LV_PUC engine speed threshold with air conditioned compressor active" MAP 0xa1026290 _REC_MAP_20_u1_u1_u1 8160. _CNV_A_R_LINEAR_____9_CM 0. 8160. DISPLAY_IDENTIFIER IP_N_ACCOUT_MIN_PUC__TCO__GR_MT FORMAT "%4.0"
 /begin AXIS_DESCR COM_AXIS tco _CNV_A_R_LINEAR_____16_CM 6 -48. 142.5 FORMAT "%5.1" AXIS_PTS_REF ldpm_tco_1_6 /end AXIS_DESCR
 /begin AXIS_DESCR COM_AXIS gr_mt _CNV_A_R_LINEAR_____0_CM 13 0. 255. FORMAT "%3.0" AXIS_PTS_REF ldpm_gr_mt_3 /end AXIS_DESCR
/end CHARACTERISTIC
/begin CHARACTERISTIC ip_n_accout_min_puc__tco__gr_at "LV_PUC engine speed threshold with air conditioned compressor active" MAP 0xa1026240 _REC_MAP_20_u1_u1_u1 8160. _CNV_A_R_LINEAR_____9_CM 0. 8160. DISPLAY_IDENTIFIER IP_N_ACCOUT_MIN_PUC__TCO__GR_AT FORMAT "%4.0"
 /begin AXIS_DESCR COM_AXIS tco _CNV_A_R_LINEAR_____16_CM 6 -48. 142.5 FORMAT "%5.1" AXIS_PTS_REF ldpm_tco_1_6 /end AXIS_DESCR
 /begin AXIS_DESCR COM_AXIS gr_at _CNV_A_R_LINEAR_____0_CM 13 0. 255. FORMAT "%3.0" AXIS_PTS_REF ldpm_gr_at_3 /end AXIS_DESCR
/end CHARACTERISTIC
/begin AXIS_PTS ldpm_tco_1_6 "" 0xa10221fa tco _REC_AXS_20_u1 28.575 _CNV_A_R_LINEAR_____16_CM 6 -48. 142.5 FORMAT "%5.1" /end AXIS_PTS
/begin AXIS_PTS ldpm_gr_mt_3 "" 0xa1021b1c gr_mt _REC_AXS_20_u1 255. _CNV_A_R_LINEAR_____0_CM 13 0. 255. FORMAT "%3.0" /end AXIS_PTS
/begin AXIS_PTS ldpm_gr_at_3 "" 0xa1021b00 gr_at _REC_AXS_20_u1 255. _CNV_A_R_LINEAR_____0_CM 13 0. 255. FORMAT "%3.0" /end AXIS_PTS
/begin CHARACTERISTIC c_n_dif_ast "Additional engine speed hysteresis to avoid \"LV_PU\" direct after start" VALUE 0xa10295da _REC_VAL_20_u2 50. _CNV_A_R_LINEAR_____13_CM 0. 1000. DISPLAY_IDENTIFIER C_N_DIF_AST FORMAT "%4.0" /end CHARACTERISTIC
/begin CHARACTERISTIC c_t_n_dif_ast "Tme after start where C_N_DIF_AST is additional calculated to engine speed hysteresis" VALUE 0xa1029912 _REC_VAL_20_u2 327.675 _CNV_A_R_LINEAR_____4_CM 0. 6553.5 DISPLAY_IDENTIFIER C_T_N_DIF_AST FORMAT "%6.1" /end CHARACTERISTIC
/begin CHARACTERISTIC ip_n_min_puc__tco__gr_at "LV_PUC engine speed threshold" MAP 0xa102636c _REC_MAP_20_u1_u1_u1 8160. _CNV_A_R_LINEAR_____9_CM 0. 8160. DISPLAY_IDENTIFIER IP_N_MIN_PUC__TCO__GR_AT FORMAT "%4.0"
 /begin AXIS_DESCR COM_AXIS tco _CNV_A_R_LINEAR_____16_CM 6 -48. 142.5 FORMAT "%5.1" AXIS_PTS_REF ldpm_tco_1_6 /end AXIS_DESCR
 /begin AXIS_DESCR COM_AXIS gr_at _CNV_A_R_LINEAR_____0_CM 13 0. 255. FORMAT "%3.0" AXIS_PTS_REF ldpm_gr_at_3 /end AXIS_DESCR
/end CHARACTERISTIC
/begin AXIS_PTS ldpm_tco_9 "" 0xa1022230 tco _REC_AXS_20_u1 28.575 _CNV_A_R_LINEAR_____16_CM 9 -48. 142.5 FORMAT "%5.1" /end AXIS_PTS
/begin MEASUREMENT lv_iga_min_puc "Conditions for IGA_MIN_PUC" UBYTE _CNV_S_2_RANGE__0___1_CM 1 100. 0. 1. DISPLAY_IDENTIFIER LV_IGA_MIN_PUC ECU_ADDRESS 0xd0003ccd BIT_MASK 0x1 /end MEASUREMENT
/begin CHARACTERISTIC c_t_min_pu_vs "Minimum delay time of PUC activation after entry of PU" VALUE 0xa1029904 _REC_VAL_20_u2 655.35 _CNV_A_R_LINEAR_____3_CM 0. 655.35 DISPLAY_IDENTIFIER C_T_MIN_PU_VS FORMAT "%6.2" /end CHARACTERISTIC
/begin AXIS_PTS ldp_n__t_min_pu "" 0xa1020eb4 n _REC_AXS_20_u2 8159. _CNV_A_R_LINEAR_____13_CM 8 1. 8160. FORMAT "%4.0" /end AXIS_PTS
/begin AXIS_PTS ldp_tco__t_min_pu "" 0xa1021294 tco _REC_AXS_20_u1 190.5 _CNV_A_R_LINEAR_____16_CM 6 -48. 142.5 FORMAT "%5.1" /end AXIS_PTS
/begin CHARACTERISTIC c_vs_min_pu "Threshold for vehicle speed for loading T_PU" VALUE 0xa1029cc2 _REC_VAL_20_u1 12.75 _CNV_A_R_LINEAR_____6_CM 0. 255. DISPLAY_IDENTIFIER C_VS_MIN_PU FORMAT "%3.0" /end CHARACTERISTIC
/begin CHARACTERISTIC ip_t_min_pu__n__tco "Minimum delay time of PUC activation" MAP 0xa1027cb0 _REC_MAP_20_u2_u2_u1 655.35 _CNV_A_R_LINEAR_____3_CM 0. 655.35 DISPLAY_IDENTIFIER IP_T_MIN_PU__N__TCO FORMAT "%6.2"
 /begin AXIS_DESCR COM_AXIS n _CNV_A_R_LINEAR_____13_CM 8 1. 8160. FORMAT "%4.0" AXIS_PTS_REF ldp_n__t_min_pu /end AXIS_DESCR
 /begin AXIS_DESCR COM_AXIS tco _CNV_A_R_LINEAR_____16_CM 6 -48. 142.5 FORMAT "%5.1" AXIS_PTS_REF ldp_tco__t_min_pu /end AXIS_DESCR
/end CHARACTERISTIC
/begin CHARACTERISTIC ip_t_min_pu_rng_l__n__tco "Minimum delay time of PUC activation" MAP 0xa1027d10 _REC_MAP_20_u2_u2_u1 655.35 _CNV_A_R_LINEAR_____3_CM 0. 655.35 DISPLAY_IDENTIFIER IP_T_MIN_PU_RNG_L__N__TCO FORMAT "%6.2"
 /begin AXIS_DESCR COM_AXIS n _CNV_A_R_LINEAR_____13_CM 8 1. 8160. FORMAT "%4.0" AXIS_PTS_REF ldp_n__t_min_pu /end AXIS_DESCR
 /begin AXIS_DESCR COM_AXIS tco _CNV_A_R_LINEAR_____16_CM 6 -48. 142.5 FORMAT "%5.1" AXIS_PTS_REF ldp_tco__t_min_pu /end AXIS_DESCR
/end CHARACTERISTIC
/begin AXIS_PTS ldp_tq_loss_ars_sp_can__puc "" 0xa1021554 tq_loss_ars_sp_can _REC_AXS_20_u2 2047.96875 _CNV_A_R_LINEAR_____65_CM 6 -1024. 1023.96875 FORMAT "%6.2" /end AXIS_PTS
/begin AXIS_PTS ldp_tq_loss_pste_2_sp_can__puc "" 0xa10215c4 tq_loss_pste_2_sp_can _REC_AXS_20_u2 2047.96875 _CNV_A_R_LINEAR_____65_CM 6 -1024. 1023.96875 FORMAT "%6.2" /end AXIS_PTS
/begin CHARACTERISTIC ip_n_min_puc_add_ars "Additive term for reactivation engine speed" CURVE 0xa102640a _REC_CUR_20_u1_u2 8160. _CNV_A_R_LINEAR_____9_CM 0. 8160. DISPLAY_IDENTIFIER IP_N_MIN_PUC_ADD_ARS FORMAT "%4.0"
 /begin AXIS_DESCR COM_AXIS tq_loss_ars_sp_can _CNV_A_R_LINEAR_____65_CM 6 -1024. 1023.96875 FORMAT "%6.2" AXIS_PTS_REF ldp_tq_loss_ars_sp_can__puc /end AXIS_DESCR
/end CHARACTERISTIC
/begin CHARACTERISTIC ip_n_min_puc_add_pste_2 "Additive term for reactivation engine speed" CURVE 0xa1026410 _REC_CUR_20_u1_u2 8160. _CNV_A_R_LINEAR_____9_CM 0. 8160. DISPLAY_IDENTIFIER IP_N_MIN_PUC_ADD_PSTE_2 FORMAT "%4.0"
 /begin AXIS_DESCR COM_AXIS tq_loss_pste_2_sp_can _CNV_A_R_LINEAR_____65_CM 6 -1024. 1023.96875 FORMAT "%6.2" AXIS_PTS_REF ldp_tq_loss_pste_2_sp_can__puc /end AXIS_DESCR
/end CHARACTERISTIC
/begin AXIS_PTS ldp_n_grd_n_dif_max_is "" 0xa1020f16 n_grd _REC_AXS_20_u1 8160. _CNV_A_R_LINEAR_____28_CM 6 -4096. 4064. FORMAT "%5.0" /end AXIS_PTS
/begin CHARACTERISTIC ip_n_dif_max_is "Engine speed hysteresis before \"Idle speed\" (LV_IS)" CURVE 0xa102632c _REC_CUR_20_u2_u1 8160. _CNV_A_R_LINEAR_____13_CM 0. 8160. DISPLAY_IDENTIFIER IP_N_DIF_MAX_IS FORMAT "%4.0"
 /begin AXIS_DESCR COM_AXIS n_grd _CNV_A_R_LINEAR_____28_CM 6 -4096. 4064. FORMAT "%5.0" AXIS_PTS_REF ldp_n_grd_n_dif_max_is /end AXIS_DESCR
/end CHARACTERISTIC
/begin MEASUREMENT lv_err_isc "error at idle speed control diagnosis" UBYTE _CNV_S_2_RANGE__0___1_CM 1 100. 0. 1. DISPLAY_IDENTIFIER LV_ERR_ISC ECU_ADDRESS 0xd000341d BIT_MASK 0x1 /end MEASUREMENT
/begin CHARACTERISTIC c_maf_max_diag_isc "Minimum mass air flow to perform idle speed valve Plausibility check" VALUE 0xa1029552 _REC_VAL_20_u1 1389. _CNV_A_R_LINEAR_____14_CM 0. 1389. DISPLAY_IDENTIFIER C_MAF_MAX_DIAG_ISC FORMAT "%4.0" /end CHARACTERISTIC
/begin CHARACTERISTIC c_n_dif_max_diag_isc "Maximum deviation above nominal idle speed" VALUE 0xa10295e8 _REC_VAL_20_u2 8160. _CNV_A_R_LINEAR_____13_CM 0. 8160. DISPLAY_IDENTIFIER C_N_DIF_MAX_DIAG_ISC FORMAT "%4.0" /end CHARACTERISTIC
/begin CHARACTERISTIC c_n_dif_min_diag_isc "Minimum deviation above nominal idle speed" VALUE 0xa10295ec _REC_VAL_20_u2 8160. _CNV_A_R_LINEAR_____13_CM 0. 8160. DISPLAY_IDENTIFIER C_N_DIF_MIN_DIAG_ISC FORMAT "%4.0" /end CHARACTERISTIC
/begin CHARACTERISTIC c_t_dly_isc_diag "Time delay for diagnosis activation" VALUE 0xa1029864 _REC_VAL_20_u2 6553.5 _CNV_A_R_LINEAR_____4_CM 0. 6553.5 DISPLAY_IDENTIFIER C_T_DLY_ISC_DIAG FORMAT "%6.1" /end CHARACTERISTIC
/begin MEASUREMENT t_isc_diag "Time delay for diagnosis activation" UWORD _CNV_A_R_LINEAR_____4_CM 1 100. 0. 6553.5 DISPLAY_IDENTIFIER T_ISC_DIAG ECU_ADDRESS 0xc00007fc FORMAT "%6.1" /end MEASUREMENT
/begin CHARACTERISTIC c_abc_inc_isc "Anti-bounce counter increment for idle speed Plausibility check" VALUE 0xa1029090 _REC_VAL_20_u1 255. _CNV_A_R_LINEAR_____0_CM 0. 255. DISPLAY_IDENTIFIER C_ABC_INC_ISC FORMAT "%3.0" /end CHARACTERISTIC
/begin CHARACTERISTIC c_abc_dec_isc "Anti-bounce counter decrement for idle speed Plausibility check" VALUE 0xa102904a _REC_VAL_20_u1 255. _CNV_A_R_LINEAR_____0_CM 0. 255. DISPLAY_IDENTIFIER C_ABC_DEC_ISC FORMAT "%3.0" /end CHARACTERISTIC
/begin CHARACTERISTIC c_flow_cps_max_diag_isc "maximum canister purge fuel flow from CPS to cylinder to perform idle speed plausibility check" VALUE 0xa10293d0 _REC_VAL_20_u2 7.9998779296875 _CNV_A_R_LINEAR_____147_CM 0. 7.9998779296875 DISPLAY_IDENTIFIER C_FLOW_CPS_MAX_DIAG_ISC FORMAT "%7.4" /end CHARACTERISTIC
/begin CHARACTERISTIC c_abc_max_isc "Maximum value of the anti-bounce counter for idle speed Plausibility check" VALUE 0xa102911b _REC_VAL_20_u1 254. _CNV_A_R_LINEAR_____0_CM 1. 255. DISPLAY_IDENTIFIER C_ABC_MAX_ISC FORMAT "%3.0" /end CHARACTERISTIC
/begin CHARACTERISTIC lc_inh_diag_isc_man "Manual inhibition of ISC diagnosis" VALUE 0xa1029d49 _REC_VAL_20_u1 1. _CNV_A_R_LINEAR_____0_CM 0. 1. DISPLAY_IDENTIFIER LC_INH_DIAG_ISC_MAN FORMAT "%1.0" /end CHARACTERISTIC
/begin CHARACTERISTIC lc_t_inh_isc_diag_ast "Switch for inhibitation of activation timer after start of ISC diagnosis" VALUE 0xa1029de7 _REC_VAL_20_u1 1. _CNV_S_2_RANGE__0___1_CM 0. 1. DISPLAY_IDENTIFIER LC_T_INH_ISC_DIAG_AST /end CHARACTERISTIC
/begin AXIS_PTS ldp_tco_st_ip_t_inh_isc_diag "" 0xa10212c8 tco_st _REC_AXS_20_u1 190.5 _CNV_A_R_LINEAR_____16_CM 6 -48. 142.5 FORMAT "%5.1" /end AXIS_PTS
/begin CHARACTERISTIC ip_t_inh_isc_diag_ast "Initialization for activation timer of idle speed diagnosis after start" CURVE 0xa1027c60 _REC_CUR_20_u1_u1 25.5 _CNV_A_R_LINEAR_____4_CM 0. 25.5 DISPLAY_IDENTIFIER IP_T_INH_ISC_DIAG_AST FORMAT "%4.1"
 /begin AXIS_DESCR COM_AXIS tco_st _CNV_A_R_LINEAR_____16_CM 6 -48. 142.5 FORMAT "%5.1" AXIS_PTS_REF ldp_tco_st_ip_t_inh_isc_diag /end AXIS_DESCR
/end CHARACTERISTIC
/begin MEASUREMENT t_inh_isc_diag_ast "Time delay for diagnosis activation after start" UBYTE _CNV_A_R_LINEAR_____4_CM 1 100. 0. 25.5 DISPLAY_IDENTIFIER T_INH_ISC_DIAG_AST ECU_ADDRESS 0xc0000800 FORMAT "%4.1" /end MEASUREMENT
/begin CHARACTERISTIC c_mtcpwm_i_max_pos "Limitation of I-share upwards" VALUE 0xa10295b6 _REC_VAL_20_s2 199.9969482421875 _CNV_A_R_LINEAR_____201_CM -100. 99.9969482421875 DISPLAY_IDENTIFIER C_MTCPWM_I_MAX_POS FORMAT "%8.3" /end CHARACTERISTIC
/begin MEASUREMENT tps_dif "gradient of controller deviation" UWORD _CNV_A_R_LINEAR_____223_CM 1 100. -119.5 119.5 DISPLAY_IDENTIFIER TPS_DIF ECU_ADDRESS 0xd00052b0 FORMAT "%8.3" /end MEASUREMENT
/begin CHARACTERISTIC ip_mtcpwm_d__tps_dif_grd "Position controller D-share" CURVE 0xa1026180 _REC_CUR_20_u2_u2 799.987793 _CNV_A_R_LINEAR_____224_CM -400. 399.987793 DISPLAY_IDENTIFIER IP_MTCPWM_D__TPS_DIF_GRD FORMAT "%7.2"
 /begin AXIS_DESCR COM_AXIS tps_dif_grd _CNV_A_R_LINEAR_____223_CM 8 -119.5 119.5 FORMAT "%8.3" AXIS_PTS_REF ldp_tps_dif_grd__mtcpwm_d /end AXIS_DESCR
/end CHARACTERISTIC
/begin CHARACTERISTIC ip_mtcpwm_i__tps_dif "Position controller I-share" CURVE 0xa1026190 _REC_CUR_20_u2_u2 199.99694824 _CNV_A_R_LINEAR_____225_CM -100. 99.99694824 DISPLAY_IDENTIFIER IP_MTCPWM_I__TPS_DIF FORMAT "%8.3"
 /begin AXIS_DESCR COM_AXIS tps_dif _CNV_A_R_LINEAR_____223_CM 8 -119.5 119.5 FORMAT "%8.3" AXIS_PTS_REF ldp_tps_dif__mtcpwm_i /end AXIS_DESCR
/end CHARACTERISTIC
/begin CHARACTERISTIC ip_mtcpwm_p__tps_dif "Position controller P-share" CURVE 0xa10261a8 _REC_CUR_20_u2_u2 799.987793 _CNV_A_R_LINEAR_____224_CM -400. 399.987793 DISPLAY_IDENTIFIER IP_MTCPWM_P__TPS_DIF FORMAT "%7.2"
 /begin AXIS_DESCR COM_AXIS tps_dif _CNV_A_R_LINEAR_____223_CM 8 -119.5 119.5 FORMAT "%8.3" AXIS_PTS_REF ldp_tps_dif__mtcpwm_p /end AXIS_DESCR
/end CHARACTERISTIC
/begin CHARACTERISTIC ip_mtcpwm_vb_fac__vb "Battery voltage correction" CURVE 0xa10261b8 _REC_CUR_20_u1_u1 1.99220002 _CNV_A_R_LINEAR_____97_CM 0. 1.99220002 DISPLAY_IDENTIFIER IP_MTCPWM_VB_FAC__VB FORMAT "%5.3"
 /begin AXIS_DESCR COM_AXIS vb _CNV_A_R_LINEAR_____21_CM 8 0. 25.8984 FORMAT "%3.1" AXIS_PTS_REF ldp_vb__mtcpwm_vb_fac /end AXIS_DESCR
/end CHARACTERISTIC
/begin MEASUREMENT mtcpwm_add "Duty cycle of the feed-forward-control" SWORD _CNV_A_R_LINEAR_____226_CM 1 100. -100. 99.99694824 DISPLAY_IDENTIFIER MTCPWM_ADD ECU_ADDRESS 0xd00052ba FORMAT "%8.3" /end MEASUREMENT
/begin MEASUREMENT mtcpwm_ctl "Duty cycle of the PID-controller" SLONG _CNV_A_R_LINEAR_____201_CM 1 100. -400. 400. DISPLAY_IDENTIFIER MTCPWM_CTL ECU_ADDRESS 0xd0005800 FORMAT "%8.3" /end MEASUREMENT
/begin MEASUREMENT mtcpwm_d "Duty cycle of the D-share" SWORD _CNV_A_R_LINEAR_____227_CM 1 100. -400. 399.987793 DISPLAY_IDENTIFIER MTCPWM_D ECU_ADDRESS 0xc000093e FORMAT "%7.2" /end MEASUREMENT
/begin MEASUREMENT mtcpwm_p "Duty cycle of the P-share" SWORD _CNV_A_R_LINEAR_____227_CM 1 100. -400. 399.987793 DISPLAY_IDENTIFIER MTCPWM_P ECU_ADDRESS 0xc000093a FORMAT "%7.2" /end MEASUREMENT
/begin MEASUREMENT mtcpwm_i "Duty cycle of the I-share" SWORD _CNV_A_R_LINEAR_____226_CM 1 100. -100. 99.99694824 DISPLAY_IDENTIFIER MTCPWM_I ECU_ADDRESS 0xc000093c FORMAT "%8.3" /end MEASUREMENT
/begin MEASUREMENT mtcpwm_i_add "Manipulated previous I-share" SWORD _CNV_A_R_LINEAR_____226_CM 1 100. -100. 99.99694824 DISPLAY_IDENTIFIER MTCPWM_I_ADD ECU_ADDRESS 0xc0000942 FORMAT "%8.3" /end MEASUREMENT
/begin MEASUREMENT tps_sp_lih_dif "Difference between TPS_SP and TPS_LIH" UWORD _CNV_A_R_LINEAR_____223_CM 1 100. -119.5 119.5 DISPLAY_IDENTIFIER TPS_SP_LIH_DIF ECU_ADDRESS 0xd00052b6 FORMAT "%8.3" /end MEASUREMENT
/begin CHARACTERISTIC c_tps_sp_lih_dif_hys "Hysteresis for detection of direction change" VALUE 0xa1029ab2 _REC_VAL_20_u2 119.5 _CNV_A_R_LINEAR_____221_CM 0. 119.5 DISPLAY_IDENTIFIER C_TPS_SP_LIH_DIF_HYS FORMAT "%7.3" /end CHARACTERISTIC
/begin CHARACTERISTIC c_mtcpwm_i_max_neg "Limitation of I-share downwards" VALUE 0xa10295b4 _REC_VAL_20_s2 199.9969482421875 _CNV_A_R_LINEAR_____201_CM -100. 99.9969482421875 DISPLAY_IDENTIFIER C_MTCPWM_I_MAX_NEG FORMAT "%8.3" /end CHARACTERISTIC
/begin CHARACTERISTIC c_mtcpwm_i_add "Init value for I-Part while TPS_SP_LIH_DIF is crossing LH" VALUE 0xa10295b0 _REC_VAL_20_s2 199.9969482421875 _CNV_A_R_LINEAR_____201_CM -100. 99.9969482421875 DISPLAY_IDENTIFIER C_MTCPWM_I_ADD FORMAT "%8.3" /end CHARACTERISTIC
/begin CHARACTERISTIC c_mtcpwm_add_fil "Filter parameter" VALUE 0xa10295a9 _REC_VAL_20_u1 0.99609375 _CNV_A_R_LINEAR_____27_CM 0. 0.99609375 DISPLAY_IDENTIFIER C_MTCPWM_ADD_FIL FORMAT "%5.3" /end CHARACTERISTIC
/begin CHARACTERISTIC ip_mtcpwm_i_fac__tps_av_lih_dif "Angle dependent I-part manipulation" CURVE 0xa10261a0 _REC_CUR_20_u1_u2 7.96875 _CNV_A_R_LINEAR_____184_CM 0. 7.96875 DISPLAY_IDENTIFIER IP_MTCPWM_I_FAC__TPS_AV_LIH_DIF FORMAT "%4.2"
 /begin AXIS_DESCR COM_AXIS tps_av_lih_dif _CNV_A_R_LINEAR_____223_CM 8 -119.5 119.5 FORMAT "%8.3" AXIS_PTS_REF ldp_tps_av_lih_dif_mtcpwm_i /end AXIS_DESCR
/end CHARACTERISTIC
/begin CHARACTERISTIC ip_mtcpwm_add__tps_sp_lih_dif "Setpoint dependent Feed Forward Value" CURVE 0xa1026170 _REC_CUR_20_u2_u2 199.99694824 _CNV_A_R_LINEAR_____225_CM -100. 99.99694824 DISPLAY_IDENTIFIER IP_MTCPWM_ADD__TPS_SP_LIH_DIF FORMAT "%8.3"
 /begin AXIS_DESCR COM_AXIS tps_sp_lih_dif _CNV_A_R_LINEAR_____223_CM 8 -119.5 119.5 FORMAT "%8.3" AXIS_PTS_REF ldp_tps_sp_lih_dif__mtcpwm_add /end AXIS_DESCR
/end CHARACTERISTIC
/begin MEASUREMENT mtcpwm_vb_fac "Battery voltage correction" UBYTE _CNV_A_R_LINEAR_____97_CM 1 100. 0. 1.99220002 DISPLAY_IDENTIFIER MTCPWM_VB_FAC ECU_ADDRESS 0xd0003eac FORMAT "%5.3" /end MEASUREMENT
/begin MEASUREMENT tps_dif_grd "Controller deviation" UWORD _CNV_A_R_LINEAR_____223_CM 1 100. -119.5 119.5 DISPLAY_IDENTIFIER TPS_DIF_GRD ECU_ADDRESS 0xc0000938 /end MEASUREMENT
/begin MEASUREMENT t_mtcpwm_close_act "time counter for closing condition" UWORD _CNV_A_R_LINEAR_____228_CM 1 100. 0. 5110. DISPLAY_IDENTIFIER T_MTCPWM_CLOSE_ACT ECU_ADDRESS 0xd00052b2 FORMAT "%5.0" /end MEASUREMENT
/begin MEASUREMENT tps_sp_ctl "throttle position setpoint ( + or - )" SWORD _CNV_A_R_LINEAR_____229_CM 1 100. -119.5 119.5 DISPLAY_IDENTIFIER TPS_SP_CTL ECU_ADDRESS 0xc0000940 FORMAT "%8.3" /end MEASUREMENT
/begin MEASUREMENT lv_tps_sp_pos "position detection of TPS-setpoint (0: below LIH; 1: above LIH)" UBYTE _CNV_S_2_RANGE__0___1_CM 1 100. 0. 1. DISPLAY_IDENTIFIER LV_TPS_SP_POS ECU_ADDRESS 0xc0000944 BIT_MASK 0x1 /end MEASUREMENT
/begin MEASUREMENT lv_tps_chg_pos "detection of changed direction from LV_TPS_SP_POS" UBYTE _CNV_S_2_RANGE__0___1_CM 1 100. 0. 1. DISPLAY_IDENTIFIER LV_TPS_CHG_POS ECU_ADDRESS 0xc0000945 BIT_MASK 0x1 /end MEASUREMENT
/begin CHARACTERISTIC c_t_mtcpwm_close_act_max "Timer threshold for switching to closing duty cycle" VALUE 0xa102990e _REC_VAL_20_u2 5. _CNV_A_R_LINEAR_____230_CM 0. 5. DISPLAY_IDENTIFIER C_T_MTCPWM_CLOSE_ACT_MAX FORMAT "%5.3" /end CHARACTERISTIC
/begin CHARACTERISTIC c_mtcpwm_close_max "duty cycle limitation at bottom mechanical limit" VALUE 0xa10295ac _REC_VAL_20_s2 199.9969482421875 _CNV_A_R_LINEAR_____201_CM -100. 99.9969482421875 DISPLAY_IDENTIFIER C_MTCPWM_CLOSE_MAX FORMAT "%8.3" /end CHARACTERISTIC
/begin CHARACTERISTIC c_tps_sp_stop_hys "setpoint hysteresis for closing throttle" VALUE 0xa1029ac8 _REC_VAL_20_u2 119.5 _CNV_A_R_LINEAR_____221_CM 0. 119.5 DISPLAY_IDENTIFIER C_TPS_SP_STOP_HYS FORMAT "%7.3" /end CHARACTERISTIC
/begin CHARACTERISTIC c_tps_sp_stop_max "threshold for testing duty cycle on value" VALUE 0xa1029aca _REC_VAL_20_u2 119.5 _CNV_A_R_LINEAR_____221_CM 0. 119.5 DISPLAY_IDENTIFIER C_TPS_SP_STOP_MAX FORMAT "%7.3" /end CHARACTERISTIC
/begin CHARACTERISTIC c_mtcpwm_i_ini "initialization of MTCPWM_I" VALUE 0xa10295b2 _REC_VAL_20_s2 199.9969482421875 _CNV_A_R_LINEAR_____201_CM -100. 99.9969482421875 DISPLAY_IDENTIFIER C_MTCPWM_I_INI FORMAT "%8.3" /end CHARACTERISTIC
/begin CHARACTERISTIC c_tps_sp_ctl_max "limitation of TPS_SP_CTL" VALUE 0xa1029aaa _REC_VAL_20_s2 119.5 _CNV_A_R_LINEAR_____229_CM -119.5 0. DISPLAY_IDENTIFIER C_TPS_SP_CTL_MAX FORMAT "%8.3" /end CHARACTERISTIC
/begin CHARACTERISTIC c_mtcpwm_close "closing duty cycle" VALUE 0xa10295aa _REC_VAL_20_s2 199.9969482421875 _CNV_A_R_LINEAR_____201_CM -100. 99.9969482421875 DISPLAY_IDENTIFIER C_MTCPWM_CLOSE FORMAT "%8.3" /end CHARACTERISTIC
/begin CHARACTERISTIC c_mtcpwm_hys "hysteresis to prevent MTCPWM-switching according to VB-changes" VALUE 0xa10295ae _REC_VAL_20_u2 100. _CNV_A_R_LINEAR_____231_CM 0. 100. DISPLAY_IDENTIFIER C_MTCPWM_HYS FORMAT "%7.3" /end CHARACTERISTIC
/begin MEASUREMENT mtcpwm "Duty cycle of the ETC Position Controller" SWORD _CNV_A_R_LINEAR_____226_CM 1 100. -100. 99.99694824 DISPLAY_IDENTIFIER MTCPWM ECU_ADDRESS 0xd00052b8 FORMAT "%8.3" /end MEASUREMENT
/begin MEASUREMENT lv_mtcpwm_close_act "logical variable (is set, if closing duty cycle is active" UBYTE _CNV_S_2_RANGE__0___1_CM 1 100. 0. 1. DISPLAY_IDENTIFIER LV_MTCPWM_CLOSE_ACT ECU_ADDRESS 0xd0003ead BIT_MASK 0x1 /end MEASUREMENT
/begin MEASUREMENT tps_av_lih_dif "Difference between TPS_AV and TPS_LIH" UWORD _CNV_A_R_LINEAR_____223_CM 1 100. -119.5 119.5 DISPLAY_IDENTIFIER TPS_AV_LIH_DIF ECU_ADDRESS 0xd00052b4 FORMAT "%8.3" /end MEASUREMENT
/begin AXIS_PTS ldp_tps_dif__mtcpwm_p "" 0xa10214ac tps_dif _REC_AXS_20_u2 239. _CNV_A_R_LINEAR_____223_CM 8 -119.5 119.5 FORMAT "%8.3" /end AXIS_PTS
/begin AXIS_PTS ldp_tps_dif__mtcpwm_i "" 0xa1021498 tps_dif _REC_AXS_20_u2 239. _CNV_A_R_LINEAR_____223_CM 8 -119.5 119.5 FORMAT "%8.3" /end AXIS_PTS
/begin AXIS_PTS ldp_tps_av_lih_dif_mtcpwm_i "" 0xa1021484 tps_av_lih_dif _REC_AXS_20_u2 239. _CNV_A_R_LINEAR_____223_CM 8 -119.5 119.5 FORMAT "%8.3" /end AXIS_PTS
/begin AXIS_PTS ldp_tps_dif_grd__mtcpwm_d "" 0xa10214c0 tps_dif_grd _REC_AXS_20_u2 239. _CNV_A_R_LINEAR_____223_CM 8 -119.5 119.5 FORMAT "%8.3" /end AXIS_PTS
/begin AXIS_PTS ldp_tps_sp_lih_dif__mtcpwm_add "" 0xa10214d4 tps_sp_lih_dif _REC_AXS_20_u2 239. _CNV_A_R_LINEAR_____223_CM 8 -119.5 119.5 FORMAT "%8.3" /end AXIS_PTS
/begin AXIS_PTS ldp_vb__mtcpwm_vb_fac "" 0xa1021700 vb _REC_AXS_20_u1 25.8984 _CNV_A_R_LINEAR_____21_CM 8 0. 25.8984 FORMAT "%3.1" /end AXIS_PTS
/begin CHARACTERISTIC c_mtcpwm_pi_max_diag "Diagnosis threshold for MTCPWM" VALUE 0xa10295b8 _REC_VAL_20_u2 100. _CNV_A_R_LINEAR_____231_CM 0. 100. DISPLAY_IDENTIFIER C_MTCPWM_PI_MAX_DIAG FORMAT "%7.3" /end CHARACTERISTIC
/begin CHARACTERISTIC c_tps_dif_max_diag "Maximum permissible control variance" VALUE 0xa1029a98 _REC_VAL_20_u2 119.5 _CNV_A_R_LINEAR_____221_CM 0. 119.5 DISPLAY_IDENTIFIER C_TPS_DIF_MAX_DIAG FORMAT "%7.3" /end CHARACTERISTIC
/begin CHARACTERISTIC c_t_tps_dif_diag "Tolerance time control variance" VALUE 0xa1029984 _REC_VAL_20_u1 2.55 _CNV_A_R_LINEAR_____3_CM 0. 2.55 DISPLAY_IDENTIFIER C_T_TPS_DIF_DIAG FORMAT "%4.2" /end CHARACTERISTIC
/begin CHARACTERISTIC c_t_mtcpwm_pi_diag_cur_off "Time threshold for end \"break-away\"" VALUE 0xa1029911 _REC_VAL_20_u1 2.55 _CNV_A_R_LINEAR_____3_CM 0. 2.55 DISPLAY_IDENTIFIER C_T_MTCPWM_PI_DIAG_CUR_OFF FORMAT "%4.2" /end CHARACTERISTIC
/begin CHARACTERISTIC c_t_mtcpwm_pi_diag "Tolerance time MTCPWM-error" VALUE 0xa1029910 _REC_VAL_20_u1 2.55 _CNV_A_R_LINEAR_____3_CM 0. 2.55 DISPLAY_IDENTIFIER C_T_MTCPWM_PI_DIAG FORMAT "%4.2" /end CHARACTERISTIC
/begin CHARACTERISTIC ip_n_max_tol_st "upper engine speed limit for ST" CURVE 0xa1026360 _REC_CUR_20_u1_u1 8160. _CNV_A_R_LINEAR_____9_CM 0. 8160. DISPLAY_IDENTIFIER IP_N_MAX_TOL_ST FORMAT "%4.0"
 /begin AXIS_DESCR COM_AXIS tco _CNV_A_R_LINEAR_____16_CM 9 -48. 142.5 FORMAT "%5.1" AXIS_PTS_REF ldpm_tco_9 /end AXIS_DESCR
/end CHARACTERISTIC
/begin MEASUREMENT cyc_st "Cycle counter during start if the first injection is applied" UBYTE _CNV_A_R_LINEAR_____0_CM 1 100. 0. 255. DISPLAY_IDENTIFIER CYC_ST ECU_ADDRESS 0xd0003c4b FORMAT "%3.0" /end MEASUREMENT
/begin MEASUREMENT state_err_amt_can "State of AMT Error intervention CAN 11H" UBYTE _CNV_A_R_LINEAR_____0_CM 1 100. 0. 5. DISPLAY_IDENTIFIER STATE_ERR_AMT_CAN ECU_ADDRESS 0xd0003e4d FORMAT "%2.0" /end MEASUREMENT
/begin MEASUREMENT lv_amt_es_req "AMT request of engine stop" UBYTE _CNV_S_2_RANGE__0___1_CM 1 100. 0. 1. DISPLAY_IDENTIFIER LV_AMT_ES_REQ ECU_ADDRESS 0xd0003e4f BIT_MASK 0x1 /end MEASUREMENT
/begin MEASUREMENT t_state_amt_1_diag "Intervention  in shift phase 1" UWORD _CNV_A_R_LINEAR_____3_CM 1 100. 0. 655.35 DISPLAY_IDENTIFIER T_STATE_AMT_1_DIAG ECU_ADDRESS 0xc0000bba FORMAT "%6.2" /end MEASUREMENT
/begin MEASUREMENT t_state_amt_2_diag "Intervention  in shift phase 2" UWORD _CNV_A_R_LINEAR_____3_CM 1 100. 0. 655.35 DISPLAY_IDENTIFIER T_STATE_AMT_2_DIAG ECU_ADDRESS 0xc0000bbc FORMAT "%6.2" /end MEASUREMENT
/begin MEASUREMENT t_state_amt_3_diag "Intervention  in shift phase 3" UWORD _CNV_A_R_LINEAR_____3_CM 1 100. 0. 655.35 DISPLAY_IDENTIFIER T_STATE_AMT_3_DIAG ECU_ADDRESS 0xc0000bbe FORMAT "%6.2" /end MEASUREMENT
/begin MEASUREMENT state_err_amt "State of AMT Error intervention" UBYTE _CNV_A_R_LINEAR_____0_CM 1 100. 0. 255. DISPLAY_IDENTIFIER STATE_ERR_AMT ECU_ADDRESS 0xd0003e4c FORMAT "%3.0" /end MEASUREMENT
/begin MEASUREMENT state_amt_old "Previos shift phase3" UBYTE _CNV_A_R_LINEAR_____0_CM 1 100. 0. 3. DISPLAY_IDENTIFIER STATE_AMT_OLD ECU_ADDRESS 0xc0000bc8 FORMAT "%2.0" /end MEASUREMENT
/begin MEASUREMENT t_state_clu_amt_diag "Timer clutch state " UWORD _CNV_A_R_LINEAR_____3_CM 1 100. 0. 655.35 DISPLAY_IDENTIFIER T_STATE_CLU_AMT_DIAG ECU_ADDRESS 0xc0000bc4 FORMAT "%6.2" /end MEASUREMENT
/begin CHARACTERISTIC c_vs_fil_amt "Vehicle speed threshold  engine stop" VALUE 0xa1029c98 _REC_VAL_20_u2 511.99218 _CNV_A_R_LINEAR_____66_CM 0. 511.99218 DISPLAY_IDENTIFIER C_VS_FIL_AMT FORMAT "%7.3" /end CHARACTERISTIC
/begin CHARACTERISTIC c_t_max_state_amt_1_diag "Max Intervention  in shift phase 1" VALUE 0xa10298d0 _REC_VAL_20_u2 655.35 _CNV_A_R_LINEAR_____3_CM 0. 655.35 DISPLAY_IDENTIFIER C_T_MAX_STATE_AMT_1_DIAG FORMAT "%6.2" /end CHARACTERISTIC
/begin CHARACTERISTIC c_t_max_state_amt_2_diag "Max Intervention  in shift phase 2" VALUE 0xa10298d2 _REC_VAL_20_u2 655.35 _CNV_A_R_LINEAR_____3_CM 0. 655.35 DISPLAY_IDENTIFIER C_T_MAX_STATE_AMT_2_DIAG FORMAT "%6.2" /end CHARACTERISTIC
/begin CHARACTERISTIC c_t_max_tqi_amt_diag "Max. timer shift intervention phase 1or 3" VALUE 0xa10298dc _REC_VAL_20_u2 655.35 _CNV_A_R_LINEAR_____3_CM 0. 655.35 DISPLAY_IDENTIFIER C_T_MAX_TQI_AMT_DIAG FORMAT "%6.2" /end CHARACTERISTIC
/begin CHARACTERISTIC c_tqi_amt_diag "Plausibility torque intervention hysteresis" VALUE 0xa1029b38 _REC_VAL_20_u2 1023.96875 _CNV_A_R_LINEAR_____30_CM 0. 1023.96875 DISPLAY_IDENTIFIER C_TQI_AMT_DIAG FORMAT "%7.2" /end CHARACTERISTIC
/begin CHARACTERISTIC c_tqi_amt_cond_diag "Torque at shift phase 0" VALUE 0xa1029b36 _REC_VAL_20_u2 1023.96875 _CNV_A_R_LINEAR_____30_CM 0. 1023.96875 DISPLAY_IDENTIFIER C_TQI_AMT_COND_DIAG FORMAT "%7.2" /end CHARACTERISTIC
/begin CHARACTERISTIC c_tqi_amt_can_es "Torque at engine stop" VALUE 0xa1029b34 _REC_VAL_20_u2 1023.96875 _CNV_A_R_LINEAR_____30_CM 0. 1023.96875 DISPLAY_IDENTIFIER C_TQI_AMT_CAN_ES FORMAT "%7.2" /end CHARACTERISTIC
/begin CHARACTERISTIC c_t_max_state_amt_3_diag "Max Intervention  in shift phase 3" VALUE 0xa10298d4 _REC_VAL_20_u2 655.35 _CNV_A_R_LINEAR_____3_CM 0. 655.35 DISPLAY_IDENTIFIER C_T_MAX_STATE_AMT_3_DIAG FORMAT "%6.2" /end CHARACTERISTIC
/begin CHARACTERISTIC c_t_max_state_clu_amt_diag "Max. time at clutch" VALUE 0xa10298d6 _REC_VAL_20_u2 655.35 _CNV_A_R_LINEAR_____3_CM 0. 655.35 DISPLAY_IDENTIFIER C_T_MAX_STATE_CLU_AMT_DIAG FORMAT "%6.2" /end CHARACTERISTIC
/begin MEASUREMENT tqi_amt_plaus "Plausibility torque" UWORD _CNV_A_R_LINEAR_____30_CM 1 100. 0. 1023.96875 DISPLAY_IDENTIFIER TQI_AMT_PLAUS ECU_ADDRESS 0xc0000bb8 FORMAT "%7.2" /end MEASUREMENT
/begin MEASUREMENT lv_ast "Auxiliary function \"After-start\"" UBYTE _CNV_S_2_RANGE__0___1_CM 1 100. 0. 1. DISPLAY_IDENTIFIER LV_AST ECU_ADDRESS 0xd0003d70 BIT_MASK 0x1 /end MEASUREMENT
/begin CHARACTERISTIC c_n_max_tps_ad "" VALUE 0xa102962e _REC_VAL_20_u1 8160. _CNV_A_R_LINEAR_____9_CM 0. 8160. DISPLAY_IDENTIFIER C_N_MAX_TPS_AD FORMAT "%4.0" /end CHARACTERISTIC
/begin CHARACTERISTIC c_t_max_tps_ad "Maximum time for Adaptation of the LIH and BOL position" VALUE 0xa10298d8 _REC_VAL_20_u1 1.275 _CNV_A_R_LINEAR_____230_CM 0. 1.275 DISPLAY_IDENTIFIER C_T_MAX_TPS_AD FORMAT "%4.3" /end CHARACTERISTIC
/begin CHARACTERISTIC c_t_max_tps_lih_chk "Maximum time for Limp Home recognition" VALUE 0xa10298d9 _REC_VAL_20_u1 1.275 _CNV_A_R_LINEAR_____230_CM 0. 1.275 DISPLAY_IDENTIFIER C_T_MAX_TPS_LIH_CHK FORMAT "%4.3" /end CHARACTERISTIC
/begin CHARACTERISTIC c_t_max_tps_sp_rst_chk "Maximum time to reach the position C_TPS_SP_RST_CHK" VALUE 0xa10298da _REC_VAL_20_u1 1.275 _CNV_A_R_LINEAR_____230_CM 0. 1.275 DISPLAY_IDENTIFIER C_T_MAX_TPS_SP_RST_CHK FORMAT "%4.3" /end CHARACTERISTIC
/begin CHARACTERISTIC c_t_tps_ad_hys "Time period for hysteresis band to Adaptation" VALUE 0xa1029982 _REC_VAL_20_u1 1.275 _CNV_A_R_LINEAR_____230_CM 0. 1.275 DISPLAY_IDENTIFIER C_T_TPS_AD_HYS FORMAT "%4.3" /end CHARACTERISTIC
/begin CHARACTERISTIC c_tco_max_tps_ad "" VALUE 0xa10299d7 _REC_VAL_20_u1 190.5 _CNV_A_R_LINEAR_____16_CM -48. 142.5 DISPLAY_IDENTIFIER C_TCO_MAX_TPS_AD FORMAT "%5.1" /end CHARACTERISTIC
/begin CHARACTERISTIC c_tco_min_tps_ad "" VALUE 0xa10299ea _REC_VAL_20_u1 190.5 _CNV_A_R_LINEAR_____16_CM -48. 142.5 DISPLAY_IDENTIFIER C_TCO_MIN_TPS_AD FORMAT "%5.1" /end CHARACTERISTIC
/begin CHARACTERISTIC c_tia_min_tps_ad "" VALUE 0xa1029a52 _REC_VAL_20_u1 190.5 _CNV_A_R_LINEAR_____16_CM -48. 142.5 DISPLAY_IDENTIFIER C_TIA_MIN_TPS_AD FORMAT "%4.1" /end CHARACTERISTIC
/begin CHARACTERISTIC c_tps_sp_bol_lgrd "Change limitation for stopping the lower position" VALUE 0xa1029aa6 _REC_VAL_20_u1 1.85271285 _CNV_A_R_LINEAR_____262_CM 7.29415e-003 1.860007 DISPLAY_IDENTIFIER C_TPS_SP_BOL_LGRD FORMAT "%4.3" /end CHARACTERISTIC
/begin CHARACTERISTIC c_tps_sp_rst_chk_bas "TPS_SP for testing the retracting spring" VALUE 0xa1029ac2 _REC_VAL_20_u2 119.5 _CNV_A_R_LINEAR_____221_CM 0. 119.5 DISPLAY_IDENTIFIER C_TPS_SP_RST_CHK_BAS /end CHARACTERISTIC
/begin CHARACTERISTIC c_tps_sp_rst_chk_hys "Hysteresis of C_TPS_SP_RST_CHK" VALUE 0xa1029ac4 _REC_VAL_20_u1 1.85271285 _CNV_A_R_LINEAR_____263_CM 7.29415e-003 1.860007 DISPLAY_IDENTIFIER C_TPS_SP_RST_CHK_HYS FORMAT "%4.3" /end CHARACTERISTIC
/begin CHARACTERISTIC c_tps_sp_rst_chk_lgrd "Change limitation for stopping the position C_TPS_SP_RST_CHK" VALUE 0xa1029ac5 _REC_VAL_20_u1 1.85271285 _CNV_A_R_LINEAR_____262_CM 7.29415e-003 1.860007 DISPLAY_IDENTIFIER C_TPS_SP_RST_CHK_LGRD FORMAT "%4.3" /end CHARACTERISTIC
/begin CHARACTERISTIC c_v_tps_ad_hys "Hysteresis band for Adaptation value determination" VALUE 0xa1029ba4 _REC_VAL_20_u1 1.24511719 _CNV_A_R_LINEAR_____245_CM 0. 1.24511719 DISPLAY_IDENTIFIER C_V_TPS_AD_HYS FORMAT "%4.3" /end CHARACTERISTIC
/begin CHARACTERISTIC c_v_tps_ad_win_lih "Adaptation window size (+/-) for Adaptation of the Limp Home position" VALUE 0xa1029baa _REC_VAL_20_u1 2.49023438 _CNV_A_R_LINEAR_____264_CM 0. 2.49023438 DISPLAY_IDENTIFIER C_V_TPS_AD_WIN_LIH FORMAT "%4.3" /end CHARACTERISTIC
/begin CHARACTERISTIC c_v_tps_sp_bol_1 "" VALUE 0xa1029bbe _REC_VAL_20_u1 4.998 _CNV_A_R_LINEAR_____189_CM 0. 4.998 DISPLAY_IDENTIFIER C_V_TPS_SP_BOL_1 FORMAT "%3.2" /end CHARACTERISTIC
/begin CHARACTERISTIC c_v_tps_sp_bol_2 "" VALUE 0xa1029bbf _REC_VAL_20_u1 4.998 _CNV_A_R_LINEAR_____189_CM 0. 4.998 DISPLAY_IDENTIFIER C_V_TPS_SP_BOL_2 FORMAT "%3.2" /end CHARACTERISTIC
/begin CHARACTERISTIC c_vb_min_tps_ad "" VALUE 0xa1029be2 _REC_VAL_20_u1 25.8984 _CNV_A_R_LINEAR_____21_CM 0. 25.8984 DISPLAY_IDENTIFIER C_VB_MIN_TPS_AD FORMAT "%3.1" /end CHARACTERISTIC
/begin MEASUREMENT lv_n_lim_tps_ad "Demand security trailing throttle fuel cut off (SAS)" UBYTE _CNV_S_2_RANGE__0___1_CM 1 100. 0. 1. DISPLAY_IDENTIFIER LV_N_LIM_TPS_AD ECU_ADDRESS 0xd0003e99 BIT_MASK 0x1 /end MEASUREMENT
/begin MEASUREMENT lv_tps_ad_cur_off "Demand ETC Limp Home" UBYTE _CNV_S_2_RANGE__0___1_CM 1 100. 0. 1. DISPLAY_IDENTIFIER LV_TPS_AD_CUR_OFF ECU_ADDRESS 0xd0003e9d BIT_MASK 0x1 /end MEASUREMENT
/begin MEASUREMENT lv_tps_ad_diag_cur_off "Demand ETC LIMP HOME" UBYTE _CNV_S_2_RANGE__0___1_CM 1 100. 0. 1. DISPLAY_IDENTIFIER LV_TPS_AD_DIAG_CUR_OFF ECU_ADDRESS 0xd0003e9a BIT_MASK 0x1 /end MEASUREMENT
/begin MEASUREMENT tps_sp_ad "Throttle position setpoint during Adaptation" UWORD _CNV_A_R_LINEAR_____221_CM 1 100. 0. 119.5 DISPLAY_IDENTIFIER TPS_SP_AD ECU_ADDRESS 0xd00052ae FORMAT "%7.3" /end MEASUREMENT
/begin MEASUREMENT v_tps_ad_el_bol_1 "Adaptation value for the lower electronic stop, TPS-channel 1" UWORD _CNV_A_R_LINEAR_____2_CM 1 100. 0. 4.9951171875 DISPLAY_IDENTIFIER V_TPS_AD_EL_BOL_1 ECU_ADDRESS 0xd0005298 FORMAT "%5.3" /end MEASUREMENT
/begin MEASUREMENT v_tps_ad_el_bol_2 "Adaptation value for the lower electronic stop, TPS-channel 2" UWORD _CNV_A_R_LINEAR_____2_CM 1 100. 0. 4.9951171875 DISPLAY_IDENTIFIER V_TPS_AD_EL_BOL_2 ECU_ADDRESS 0xd000529a FORMAT "%5.3" /end MEASUREMENT
/begin MEASUREMENT v_tps_ad_lih_1 "Adaptation value for the limp home position, TPS-channel 1" UWORD _CNV_A_R_LINEAR_____2_CM 1 100. 0. 4.9951171875 DISPLAY_IDENTIFIER V_TPS_AD_LIH_1 ECU_ADDRESS 0xd000529c FORMAT "%5.3" /end MEASUREMENT
/begin MEASUREMENT v_tps_ad_lih_2 "Adaptation value for the limp home position, TPS-channel 2" UWORD _CNV_A_R_LINEAR_____2_CM 1 100. 0. 4.9951171875 DISPLAY_IDENTIFIER V_TPS_AD_LIH_2 ECU_ADDRESS 0xd000529e FORMAT "%5.3" /end MEASUREMENT
/begin MEASUREMENT lv_tps_ad_act "TPS diagnosis/Adaptation condition is fulfilled" UBYTE _CNV_S_2_RANGE__0___1_CM 1 100. 0. 1. DISPLAY_IDENTIFIER LV_TPS_AD_ACT ECU_ADDRESS 0xd0003e9c BIT_MASK 0x1 /end MEASUREMENT
/begin MEASUREMENT tps_ad_slop_gain_1 "Adaptation value of the amplification factor of amplified poti 1" UWORD _CNV_A_R_LINEAR_____113_CM 1 100. 0. 7.9998779296875 DISPLAY_IDENTIFIER TPS_AD_SLOP_GAIN_1 ECU_ADDRESS 0xd00052a0 FORMAT "%6.4" /end MEASUREMENT
/begin MEASUREMENT tps_lih_1 "Limp home position of the throttle valve of TPS-Poti 1" UWORD _CNV_A_R_LINEAR_____221_CM 1 100. 0. 119.5 DISPLAY_IDENTIFIER TPS_LIH_1 ECU_ADDRESS 0xd00052a4 FORMAT "%7.3" /end MEASUREMENT
/begin MEASUREMENT tps_lih_2 "Limp home position  of the throttle valve of TPS-Poti 2" UWORD _CNV_A_R_LINEAR_____221_CM 1 100. 0. 119.5 DISPLAY_IDENTIFIER TPS_LIH_2 ECU_ADDRESS 0xd00052a6 FORMAT "%7.3" /end MEASUREMENT
/begin MEASUREMENT lv_tps_ad_req "Demand TPS-Adaptation" UBYTE _CNV_S_2_RANGE__0___1_CM 1 100. 0. 1. DISPLAY_IDENTIFIER LV_TPS_AD_REQ ECU_ADDRESS 0xd0003e9b BIT_MASK 0x1 /end MEASUREMENT
/begin CHARACTERISTIC c_tps_sp_spr_chk_up "TPS_SP for limp home spring test on the Adaptation routine" VALUE 0xa1029ac6 _REC_VAL_20_u2 119.5 _CNV_A_R_LINEAR_____221_CM 0. 119.5 DISPLAY_IDENTIFIER C_TPS_SP_SPR_CHK_UP FORMAT "%7.3" /end CHARACTERISTIC
/begin MEASUREMENT tps_lih_ini "" UWORD _CNV_A_R_LINEAR_____221_CM 1 100. 0. 119.5 DISPLAY_IDENTIFIER TPS_LIH_INI ECU_ADDRESS 0xd00052a8 FORMAT "%7.3" /end MEASUREMENT
/begin MEASUREMENT v_tps_ad_bol_gain_1 "Adaptation value for the lower mechanical stop of the amplification poti 1" UWORD _CNV_A_R_LINEAR_____2_CM 1 100. 0. 4.9951171875 DISPLAY_IDENTIFIER V_TPS_AD_BOL_GAIN_1 ECU_ADDRESS 0xc0000cbc FORMAT "%5.3" /end MEASUREMENT
/begin MEASUREMENT v_tps_ad_tol_1 "Non-amplified upper value for the Adaptation of amplified of TPS-channel 1" UWORD _CNV_A_R_LINEAR_____2_CM 1 100. 0. 4.9951171875 DISPLAY_IDENTIFIER V_TPS_AD_TOL_1 ECU_ADDRESS 0xc0000cc0 FORMAT "%5.3" /end MEASUREMENT
/begin MEASUREMENT v_tps_ad_tol_gain_1 "Amplified upper value for the Adaptation of amplified of TPS-channel 1" UWORD _CNV_A_R_LINEAR_____2_CM 1 100. 0. 4.9951171875 DISPLAY_IDENTIFIER V_TPS_AD_TOL_GAIN_1 ECU_ADDRESS 0xc0000cbe FORMAT "%5.3" /end MEASUREMENT
/begin MEASUREMENT inh_iv_tps_ad "logical variable to inhibit injection and ignition during TPS Adaptation" UBYTE _CNV_S_2_RANGE______265_R_CM 1 100. 0. 255. DISPLAY_IDENTIFIER INH_IV_TPS_AD ECU_ADDRESS 0xd0003e98 /end MEASUREMENT
/begin MEASUREMENT v_tps_ad_ofs_gain_1 "Adaptation value of the amplification offset of  of amplified poti 1" SWORD _CNV_A_R_LINEAR_____2_CM 1 100. -2.5 2.5 DISPLAY_IDENTIFIER V_TPS_AD_OFS_GAIN_1 ECU_ADDRESS 0xd00052a2 /end MEASUREMENT
/begin MEASUREMENT tps_ad_step "Steps of throttle Adaptation" ULONG _CNV_S_12_RANGE_TPS__266_CM 1 100. 0. 11. DISPLAY_IDENTIFIER TPS_AD_STEP ECU_ADDRESS 0xd00057fc /end MEASUREMENT
/begin CHARACTERISTIC c_tps_sp_rst_chk "TPS_SP for testing the retracting spring" VALUE 0xa1029ac0 _REC_VAL_20_u2 119.5 _CNV_A_R_LINEAR_____221_CM 0. 119.5 DISPLAY_IDENTIFIER C_TPS_SP_RST_CHK /end CHARACTERISTIC
/begin CHARACTERISTIC c_tps_av_rst_chk "Threshold for activation the position controller" VALUE 0xa1029a92 _REC_VAL_20_u2 119.5 _CNV_A_R_LINEAR_____221_CM 0. 119.5 DISPLAY_IDENTIFIER C_TPS_AV_RST_CHK FORMAT "%7.3" /end CHARACTERISTIC
/begin CHARACTERISTIC c_t_tps_av_rst_chk "Time condition for deactivation the position controller" VALUE 0xa1029983 _REC_VAL_20_u1 1.275 _CNV_A_R_LINEAR_____230_CM 0. 1.275 DISPLAY_IDENTIFIER C_T_TPS_AV_RST_CHK FORMAT "%5.3" /end CHARACTERISTIC
/begin CHARACTERISTIC c_v_tps_ad_win_bol "Adaptation window size (+/-) for Adaptation of lower stop" VALUE 0xa1029ba9 _REC_VAL_20_u1 2.49023438 _CNV_A_R_LINEAR_____264_CM 0. 2.49023438 DISPLAY_IDENTIFIER C_V_TPS_AD_WIN_BOL FORMAT "%4.3" /end CHARACTERISTIC
/begin CHARACTERISTIC c_v_tps_ad_win_2_bol "Adaptation window size (+/-) for continously mec BOL Adaptation of lower stop" VALUE 0xa1029ba8 _REC_VAL_20_u1 2.49023438 _CNV_A_R_LINEAR_____264_CM 0. 2.49023438 DISPLAY_IDENTIFIER C_V_TPS_AD_WIN_2_BOL FORMAT "%5.3" /end CHARACTERISTIC
/begin MEASUREMENT ctr_st_chk_chk_lih_1_ready "Start check check limp home 1 passed" UWORD _CNV_A_R_LINEAR_____0_CM 1 100. 0. 65535. DISPLAY_IDENTIFIER CTR_ST_CHK_CHK_LIH_1_READY ECU_ADDRESS 0xd00052aa FORMAT "%5.0" /end MEASUREMENT
/begin MEASUREMENT ctr_st_chk_chk_lih_1_err "Start check check limp home 1 not passed" UWORD _CNV_A_R_LINEAR_____0_CM 1 100. 0. 65535. DISPLAY_IDENTIFIER CTR_ST_CHK_CHK_LIH_1_ERR ECU_ADDRESS 0xd00052ac FORMAT "%5.0" /end MEASUREMENT
/begin MEASUREMENT lv_err_tps_st_chk_2 "TPS-error-bit (Return spring test)" UBYTE _CNV_S_2_RANGE__0___1_CM 1 100. 0. 1. DISPLAY_IDENTIFIER LV_ERR_TPS_ST_CHK_2 ECU_ADDRESS 0xd00033fc BIT_MASK 0x1 /end MEASUREMENT
/begin MEASUREMENT lv_err_tps_ad "TPS-error-bit (Adaptation)" UBYTE _CNV_S_2_RANGE__0___1_CM 1 100. 0. 1. DISPLAY_IDENTIFIER LV_ERR_TPS_AD ECU_ADDRESS 0xd00033f9 BIT_MASK 0x1 /end MEASUREMENT
/begin MEASUREMENT lv_err_tps_ad_bol "Error bit" UBYTE _CNV_S_2_RANGE__0___1_CM 1 100. 0. 1. DISPLAY_IDENTIFIER LV_ERR_TPS_AD_BOL ECU_ADDRESS 0xd00033fa BIT_MASK 0x1 /end MEASUREMENT
/begin CHARACTERISTIC c_t_dyw_tps_lih_chk "Time period for Dynamic window around Limp Home" VALUE 0xa1029884 _REC_VAL_20_u1 1.275 _CNV_A_R_LINEAR_____230_CM 0. 1.275 DISPLAY_IDENTIFIER C_T_DYW_TPS_LIH_CHK FORMAT "%4.3" /end CHARACTERISTIC
/begin CHARACTERISTIC c_v_tps_ad_bol_ini_1 "Start value for the Adaptation value lower start (Poti 1)" VALUE 0xa1029ba2 _REC_VAL_20_u1 4.998 _CNV_A_R_LINEAR_____189_CM 0. 4.998 DISPLAY_IDENTIFIER C_V_TPS_AD_BOL_INI_1 FORMAT "%3.2" /end CHARACTERISTIC
/begin CHARACTERISTIC c_v_tps_ad_bol_ini_2 "Start value for the Adaptation value lower start (Poti 2)" VALUE 0xa1029ba3 _REC_VAL_20_u1 4.998 _CNV_A_R_LINEAR_____189_CM 0. 4.998 DISPLAY_IDENTIFIER C_V_TPS_AD_BOL_INI_2 FORMAT "%3.2" /end CHARACTERISTIC
/begin CHARACTERISTIC c_v_tps_lih_chk_hys "Voltage window around Limp Home position for recognizing a correct MTC" VALUE 0xa1029bb2 _REC_VAL_20_u1 1.24511719 _CNV_A_R_LINEAR_____245_CM 0. 1.24511719 DISPLAY_IDENTIFIER C_V_TPS_LIH_CHK_HYS FORMAT "%4.3" /end CHARACTERISTIC
/begin CHARACTERISTIC c_v_tps_sp_lih_1 "Nominal value of the TPS-voltage in Limp Home for Poti 1" VALUE 0xa1029bc0 _REC_VAL_20_u1 4.998 _CNV_A_R_LINEAR_____189_CM 0. 4.998 DISPLAY_IDENTIFIER C_V_TPS_SP_LIH_1 FORMAT "%3.2" /end CHARACTERISTIC
/begin CHARACTERISTIC c_v_tps_sp_lih_2 "Nominal value of the TPS-voltage in Limp Home for Poti 1" VALUE 0xa1029bc1 _REC_VAL_20_u1 4.998 _CNV_A_R_LINEAR_____189_CM 0. 4.998 DISPLAY_IDENTIFIER C_V_TPS_SP_LIH_2 FORMAT "%3.2" /end CHARACTERISTIC
/begin CHARACTERISTIC c_tps_ad_slop_gain_ini_1 "" VALUE 0xa1029a8e _REC_VAL_20_u2 7.9998779296875 _CNV_A_R_LINEAR_____113_CM 0. 7.9998779296875 DISPLAY_IDENTIFIER C_TPS_AD_SLOP_GAIN_INI_1 FORMAT "%6.4" /end CHARACTERISTIC
/begin CHARACTERISTIC c_v_tps_ad_ofs_gain_ini_1 "" VALUE 0xa1029ba6 _REC_VAL_20_s2 5. _CNV_A_R_LINEAR_____2_CM -2.5 2.5 DISPLAY_IDENTIFIER C_V_TPS_AD_OFS_GAIN_INI_1 /end CHARACTERISTIC
/begin MEASUREMENT lv_err_tps_st_chk_1 "TPS-error-bit (Return spring test)" UBYTE _CNV_S_2_RANGE__0___1_CM 1 100. 0. 1. DISPLAY_IDENTIFIER LV_ERR_TPS_ST_CHK_1 ECU_ADDRESS 0xd00033fb BIT_MASK 0x1 /end MEASUREMENT
/begin CHARACTERISTIC c_t_tps_st_bol_hys "Time period for hysteresis band to Adaptation of BOL position during Start Check" VALUE 0xa1029986 _REC_VAL_20_u1 1.275 _CNV_A_R_LINEAR_____230_CM 0. 1.275 DISPLAY_IDENTIFIER C_T_TPS_ST_BOL_HYS FORMAT "%4.3" /end CHARACTERISTIC
/begin CHARACTERISTIC c_t_max_st_bol "Maximum time for Adaptation of BOL position during Start Check" VALUE 0xa10298cf _REC_VAL_20_u1 1.275 _CNV_A_R_LINEAR_____230_CM 0. 1.275 DISPLAY_IDENTIFIER C_T_MAX_ST_BOL FORMAT "%4.3" /end CHARACTERISTIC
/begin MEASUREMENT lv_tps_st_bol_end "MEC_BOL check in ST_BOL routine finished" UBYTE _CNV_S_2_RANGE__0___1_CM 1 100. 0. 1. DISPLAY_IDENTIFIER LV_TPS_ST_BOL_END ECU_ADDRESS 0xc0000cd8 BIT_MASK 0x1 /end MEASUREMENT
/begin MEASUREMENT lv_err_mtc_ctl_2 "Logical variable (set. if a MTCPWM error is present)" UBYTE _CNV_S_2_RANGE__0___1_CM 1 100. 0. 1. DISPLAY_IDENTIFIER LV_ERR_MTC_CTL_2 ECU_ADDRESS 0xd00033f7 BIT_MASK 0x1 /end MEASUREMENT
/begin MEASUREMENT lv_err_mtc_ctl_3 "Logical variable (set. if a MTCPWM error is present)" UBYTE _CNV_S_2_RANGE__0___1_CM 1 100. 0. 1. DISPLAY_IDENTIFIER LV_ERR_MTC_CTL_3 ECU_ADDRESS 0xd00033f8 BIT_MASK 0x1 /end MEASUREMENT
/begin MEASUREMENT lv_mtc_cur_off "Logical variable to switch off  the MTC-controller" UBYTE _CNV_S_2_RANGE__0___1_CM 1 100. 0. 1. DISPLAY_IDENTIFIER LV_MTC_CUR_OFF ECU_ADDRESS 0xd0003e92 BIT_MASK 0x1 /end MEASUREMENT
/begin MEASUREMENT tps_sp_pwl "Throttle position setpoint during post operating phase" UWORD _CNV_A_R_LINEAR_____221_CM 1 100. 0. 119.5 DISPLAY_IDENTIFIER TPS_SP_PWL ECU_ADDRESS 0xd0005290 FORMAT "%7.3" /end MEASUREMENT
/begin MEASUREMENT lv_tps_pwl "Bit for throttle position" UBYTE _CNV_S_2_RANGE__0___1_CM 1 100. 0. 1. DISPLAY_IDENTIFIER LV_TPS_PWL ECU_ADDRESS 0xd0003e93 BIT_MASK 0x1 /end MEASUREMENT
/begin CHARACTERISTIC c_tps_sp_pwl_lgrd "Gradiant limitation TPS" VALUE 0xa1029abc _REC_VAL_20_u2 119.5 _CNV_A_R_LINEAR_____271_CM 0. 119.5 DISPLAY_IDENTIFIER C_TPS_SP_PWL_LGRD FORMAT "%7.3" /end CHARACTERISTIC
/begin CHARACTERISTIC c_tps_sp_pwl_up "Threshold opening after power latch" VALUE 0xa1029abe _REC_VAL_20_u2 119.5 _CNV_A_R_LINEAR_____221_CM 0. 119.5 DISPLAY_IDENTIFIER C_TPS_SP_PWL_UP FORMAT "%7.3" /end CHARACTERISTIC
/begin CHARACTERISTIC c_tps_sp_as_man "Throttle position setpoint manual" VALUE 0xa1029aa2 _REC_VAL_20_u2 119.5 _CNV_A_R_LINEAR_____221_CM 0. 119.5 DISPLAY_IDENTIFIER C_TPS_SP_AS_MAN FORMAT "%7.3" /end CHARACTERISTIC
/begin CHARACTERISTIC c_tps_sp_ext_adj_ena "Variable enabled for throttle position setpoint manual or about PV_AV" VALUE 0xa1029aac _REC_VAL_20_u1 3. _CNV_A_R_LINEAR_____0_CM 0. 3. DISPLAY_IDENTIFIER C_TPS_SP_EXT_ADJ_ENA FORMAT "%2.0" /end CHARACTERISTIC
/begin CHARACTERISTIC c_pv_av_ext_adj_min "Min. threshold for external ajustment about PV_AV" VALUE 0xa1029726 _REC_VAL_20_u1 99.609375 _CNV_A_R_LINEAR_____5_CM 0. 99.609375 DISPLAY_IDENTIFIER C_PV_AV_EXT_ADJ_MIN FORMAT "%4.1" /end CHARACTERISTIC
/begin CHARACTERISTIC ip_tps_sp_pwl "throttle position setpoint during post operating phase" CURVE 0xa1028180 _REC_CUR_20_u2_u1 119.5 _CNV_A_R_LINEAR_____221_CM 0. 119.5 DISPLAY_IDENTIFIER IP_TPS_SP_PWL FORMAT "%7.3"
 /begin AXIS_DESCR COM_AXIS n_32 _CNV_A_R_LINEAR_____9_CM 4 0. 8160. FORMAT "%4.0" AXIS_PTS_REF ldp_n_32_tps_sp_pwl /end AXIS_DESCR
/end CHARACTERISTIC
/begin MEASUREMENT tps_sp_ext "Throttle position setpint of external device about PV_AV" UWORD _CNV_A_R_LINEAR_____221_CM 1 100. 0. 119.5 DISPLAY_IDENTIFIER TPS_SP_EXT ECU_ADDRESS 0xd000528c FORMAT "%7.3" /end MEASUREMENT
/begin MEASUREMENT lv_tps_sp_ext_adj "Bit active for external input of throtle position setpoint" UBYTE _CNV_S_2_RANGE__0___1_CM 1 100. 0. 1. DISPLAY_IDENTIFIER LV_TPS_SP_EXT_ADJ ECU_ADDRESS 0xd000406f BIT_MASK 0x1 /end MEASUREMENT
/begin MEASUREMENT lv_tps_sp_ext "Bit active for external input of throtle position setpoint for PV_AV setpoint" UBYTE _CNV_S_2_RANGE__0___1_CM 1 100. 0. 1. DISPLAY_IDENTIFIER LV_TPS_SP_EXT ECU_ADDRESS 0xd0003e94 BIT_MASK 0x1 /end MEASUREMENT
/begin MEASUREMENT lv_tps_sp_lih "Bit collecting the requests of all 3 monitoring levels to switch off MTC" UBYTE _CNV_S_2_RANGE__0___1_CM 1 100. 0. 1. DISPLAY_IDENTIFIER LV_TPS_SP_LIH ECU_ADDRESS 0xd0003e91 BIT_MASK 0x1 /end MEASUREMENT
/begin CHARACTERISTIC ip_tps_sp_ext_adj "external adjustment setpoint" CURVE 0xa1028174 _REC_CUR_20_u2_u1 119.5 _CNV_A_R_LINEAR_____221_CM 0. 119.5 DISPLAY_IDENTIFIER IP_TPS_SP_EXT_ADJ FORMAT "%7.3"
 /begin AXIS_DESCR COM_AXIS pv_av _CNV_A_R_LINEAR_____5_CM 6 0. 99.609375 FORMAT "%4.1" AXIS_PTS_REF ldp_pv_av__tps_sp_ext /end AXIS_DESCR
/end CHARACTERISTIC
/begin MEASUREMENT tps_sp_es "Throttle position setpoint for engine stopped" UWORD _CNV_A_R_LINEAR_____221_CM 1 100. 0. 119.5 DISPLAY_IDENTIFIER TPS_SP_ES ECU_ADDRESS 0xd000528e FORMAT "%7.3" /end MEASUREMENT
/begin CHARACTERISTIC ip_tps_sp_es "Throttle position setpoint for engine stopped" CURVE 0xa1028164 _REC_CUR_20_u2_u1 119.5 _CNV_A_R_LINEAR_____221_CM 0. 119.5 DISPLAY_IDENTIFIER IP_TPS_SP_ES FORMAT "%7.3"
 /begin AXIS_DESCR COM_AXIS tco _CNV_A_R_LINEAR_____16_CM 8 -48. 142.5 FORMAT "%5.1" AXIS_PTS_REF ldpm_tco_1_thro /end AXIS_DESCR
/end CHARACTERISTIC
/begin AXIS_PTS ldp_n_32_tps_sp_pwl "" 0xa1020e7e n_32 _REC_AXS_20_u1 816. _CNV_A_R_LINEAR_____9_CM 4 0. 8160. FORMAT "%4.0" /end AXIS_PTS
/begin AXIS_PTS ldp_pv_av__tps_sp_ext "" 0xa1021154 pv_av _REC_AXS_20_u1 99.609375 _CNV_A_R_LINEAR_____5_CM 6 0. 99.609375 FORMAT "%4.1" /end AXIS_PTS
/begin CHARACTERISTIC c_t_mtc_isa_off "Active time periodThrottle position setpoint" VALUE 0xa102990d _REC_VAL_20_u1 255. _CNV_A_R_LINEAR_____35_CM 0. 255. DISPLAY_IDENTIFIER C_T_MTC_ISA_OFF FORMAT "%3.0" /end CHARACTERISTIC
/begin AXIS_PTS ldpm_tco_1_thro "" 0xa1022218 tco _REC_AXS_20_u1 190.5 _CNV_A_R_LINEAR_____16_CM 8 -48. 142.5 FORMAT "%5.1" /end AXIS_PTS
/begin MEASUREMENT tps_sp_sel "selected throttle position setpoint before limitation" UWORD _CNV_A_R_LINEAR_____221_CM 1 100. 0. 119.5 DISPLAY_IDENTIFIER TPS_SP_SEL ECU_ADDRESS 0xc0000d00 FORMAT "%7.3" /end MEASUREMENT
/begin CHARACTERISTIC c_tps_av_bol "Lower limit (actual value) of the closing speed limitation of the throttle setpoint" VALUE 0xa1029a90 _REC_VAL_20_u2 119.5 _CNV_A_R_LINEAR_____221_CM 0. 119.5 DISPLAY_IDENTIFIER C_TPS_AV_BOL FORMAT "%7.3" /end CHARACTERISTIC
/begin CHARACTERISTIC c_tps_av_tol "Upper limit (actual value) of the closing speed limitation of the throttle setpoint" VALUE 0xa1029a94 _REC_VAL_20_u2 119.5 _CNV_A_R_LINEAR_____221_CM 0. 119.5 DISPLAY_IDENTIFIER C_TPS_AV_TOL FORMAT "%7.3" /end CHARACTERISTIC
/begin CHARACTERISTIC c_tps_sp_min "Lower limit of the throttle position setpoint" VALUE 0xa1029ab8 _REC_VAL_20_u2 119.5 _CNV_A_R_LINEAR_____221_CM 0. 119.5 DISPLAY_IDENTIFIER C_TPS_SP_MIN FORMAT "%7.3" /end CHARACTERISTIC
/begin CHARACTERISTIC c_tps_sp_min_tps_ad_req "Lower limit of the throttle position setpoint without throttle Adaptation" VALUE 0xa1029aba _REC_VAL_20_u2 119.5 _CNV_A_R_LINEAR_____221_CM 0. 119.5 DISPLAY_IDENTIFIER C_TPS_SP_MIN_TPS_AD_REQ FORMAT "%7.3" /end CHARACTERISTIC
/begin CHARACTERISTIC c_tps_sp_max_tps_ad_req "Upper limit of the throttle position setpoint without throttle Adaptation" VALUE 0xa1029ab6 _REC_VAL_20_u2 119.5 _CNV_A_R_LINEAR_____221_CM 0. 119.5 DISPLAY_IDENTIFIER C_TPS_SP_MAX_TPS_AD_REQ FORMAT "%7.3" /end CHARACTERISTIC
/begin CHARACTERISTIC c_tps_sp_max "Upper limit of the throttle position setpoint" VALUE 0xa1029ab4 _REC_VAL_20_u2 119.5 _CNV_A_R_LINEAR_____221_CM 0. 119.5 DISPLAY_IDENTIFIER C_TPS_SP_MAX FORMAT "%7.3" /end CHARACTERISTIC
/begin CHARACTERISTIC c_tps_sp_tol "Upper limit of opening velocity limitation the throttle position setpoint" VALUE 0xa1029acc _REC_VAL_20_u2 119.5 _CNV_A_R_LINEAR_____221_CM 0. 119.5 DISPLAY_IDENTIFIER C_TPS_SP_TOL FORMAT "%7.3" /end CHARACTERISTIC
/begin CHARACTERISTIC c_tps_sp_tol_tps_ad_req "Upper limit of opening velocity limitation the throttle position setpoint without throttle Adaptation" VALUE 0xa1029ace _REC_VAL_20_u2 119.5 _CNV_A_R_LINEAR_____221_CM 0. 119.5 DISPLAY_IDENTIFIER C_TPS_SP_TOL_TPS_AD_REQ FORMAT "%7.3" /end CHARACTERISTIC
/begin CHARACTERISTIC c_tps_sp_bol_tps_ad_req "Lower limit of opening velocity limitation the throttle position setpoint without throttle Adaptation" VALUE 0xa1029aa8 _REC_VAL_20_u2 119.5 _CNV_A_R_LINEAR_____221_CM 0. 119.5 DISPLAY_IDENTIFIER C_TPS_SP_BOL_TPS_AD_REQ FORMAT "%7.3" /end CHARACTERISTIC
/begin CHARACTERISTIC c_tps_sp_bol "Lower limit of opening velocity limitation the throttle position setpoint" VALUE 0xa1029aa4 _REC_VAL_20_u2 119.5 _CNV_A_R_LINEAR_____221_CM 0. 119.5 DISPLAY_IDENTIFIER C_TPS_SP_BOL FORMAT "%7.3" /end CHARACTERISTIC
/begin CHARACTERISTIC c_tps_sp_lgrd_tot "Threshold opening after power latch" VALUE 0xa1029ab0 _REC_VAL_20_u2 119.5 _CNV_A_R_LINEAR_____221_CM 0. 119.5 DISPLAY_IDENTIFIER C_TPS_SP_LGRD_TOT FORMAT "%7.3" /end CHARACTERISTIC
/begin MEASUREMENT tps_sp "real throttle angle setpoint for MTC-position controller" UWORD _CNV_A_R_LINEAR_____221_CM 1 100. 0. 119.5 DISPLAY_IDENTIFIER TPS_SP ECU_ADDRESS 0xd0005294 FORMAT "%7.3" /end MEASUREMENT
/begin MEASUREMENT tps_sp_lim "limited throttle position setpoint" UWORD _CNV_A_R_LINEAR_____221_CM 1 100. 0. 119.5 DISPLAY_IDENTIFIER TPS_SP_LIM ECU_ADDRESS 0xc0000d02 FORMAT "%7.3" /end MEASUREMENT
/begin MEASUREMENT tps_sp_lim_2 "Throttle position setpoint after gradient limitation over whole operating range" UWORD _CNV_A_R_LINEAR_____221_CM 1 100. 0. 119.5 DISPLAY_IDENTIFIER TPS_SP_LIM_2 ECU_ADDRESS 0xc0000d06 FORMAT "%7.3" /end MEASUREMENT
/begin MEASUREMENT tps_sp_lim_1 "Throttle position setpoint after absolute value limitation" UWORD _CNV_A_R_LINEAR_____221_CM 1 100. 0. 119.5 DISPLAY_IDENTIFIER TPS_SP_LIM_1 ECU_ADDRESS 0xc0000d04 FORMAT "%7.3" /end MEASUREMENT
/begin CHARACTERISTIC c_tps_sp_lgrd_stop "max. admissable gradient of throtle setpoint in the range of the top and bottom stop" VALUE 0xa1029aae _REC_VAL_20_u2 119.5 _CNV_A_R_LINEAR_____271_CM 0. 119.5 DISPLAY_IDENTIFIER C_TPS_SP_LGRD_STOP FORMAT "%7.3" /end CHARACTERISTIC
/begin MEASUREMENT lv_err_mtc_ctl_1 "Logical variable (set. if a MTCPWM error is present)" UBYTE _CNV_S_2_RANGE__0___1_CM 1 100. 0. 1. DISPLAY_IDENTIFIER LV_ERR_MTC_CTL_1 ECU_ADDRESS 0xd00033f6 BIT_MASK 0x1 /end MEASUREMENT
/begin MEASUREMENT isapwm "idle speed actuator duty cycle for substitute mass air flow calculation" UWORD _CNV_A_R_LINEAR_____7_CM 1 100. 0. 99.99847412109381 DISPLAY_IDENTIFIER ISAPWM ECU_ADDRESS 0xd0002c78 FORMAT "%5.2" /end MEASUREMENT
/begin MEASUREMENT lv_err_ecu_ram "Present error flag ECU_RAM" UBYTE _CNV_S_2_RANGE__0___1_CM 1 100. 0. 1. DISPLAY_IDENTIFIER LV_ERR_ECU_RAM ECU_ADDRESS 0xd0003430 BIT_MASK 0x1 /end MEASUREMENT
/begin MEASUREMENT lv_err_ecu_cks "ECU_CKS error detected" UBYTE _CNV_S_2_RANGE__0___1_CM 1 100. 0. 1. DISPLAY_IDENTIFIER LV_ERR_ECU_CKS ECU_ADDRESS 0xd00033ca BIT_MASK 0x1 /end MEASUREMENT
/begin MEASUREMENT lv_err_ecu_nvmy "Present ECU NVMY error" UBYTE _CNV_S_2_RANGE__0___1_CM 1 100. 0. 1. DISPLAY_IDENTIFIER LV_ERR_ECU_NVMY ECU_ADDRESS 0xd0003472 BIT_MASK 0x1 /end MEASUREMENT
/begin MEASUREMENT lv_err_cwp_plaus "Plausibility error electrical waterpump" UBYTE _CNV_S_2_RANGE__0___1_CM 1 100. 0. 1. DISPLAY_IDENTIFIER LV_ERR_CWP_PLAUS ECU_ADDRESS 0xd000346a BIT_MASK 0x1 /end MEASUREMENT
/begin CHARACTERISTIC c_t_cwp_dif_max "Timer Threshold CWP speed monitoring (Timer: T_CWP)" VALUE 0xa102982e _REC_VAL_20_u1 25.5 _CNV_A_R_LINEAR_____4_CM 0. 25.5 DISPLAY_IDENTIFIER C_T_CWP_DIF_MAX FORMAT "%4.1" /end CHARACTERISTIC
/begin CHARACTERISTIC c_tco_cwp_rel_min_diag "TCO min threshold to enable CWP speed monitoring" VALUE 0xa10299cb _REC_VAL_20_u1 190.5 _CNV_A_R_LINEAR_____16_CM -48. 142.5 DISPLAY_IDENTIFIER C_TCO_CWP_REL_MIN_DIAG FORMAT "%5.1" /end CHARACTERISTIC
/begin MEASUREMENT state_cwp_int "internal operation state of the CWP" UBYTE _CNV_A_R_LINEAR_____50_CM 1 100. 0. 10. DISPLAY_IDENTIFIER STATE_CWP_INT ECU_ADDRESS 0xd0003882 FORMAT "%2.0" /end MEASUREMENT
/begin CHARACTERISTIC c_t_v_cwp_max_diag "timer threshold (for transition condition \"G\")" VALUE 0xa102998e _REC_VAL_20_u1 25.5 _CNV_A_R_LINEAR_____4_CM 0. 25.5 DISPLAY_IDENTIFIER C_T_V_CWP_MAX_DIAG FORMAT "%4.1" /end CHARACTERISTIC
/begin AXIS_PTS ldp_state_cwp_int "" 0xa102115c state_cwp_int _REC_AXS_20_u1 1. _CNV_A_R_LINEAR_____50_CM 11 0. 10. FORMAT "%2.0" /end AXIS_PTS
/begin CHARACTERISTIC id_rel_cwp_pwr "power reduction of CWP" CURVE 0xa1022eb8 _REC_CUR_20_u1_u1 99.609375 _CNV_A_R_LINEAR_____5_CM 0. 99.609375 DISPLAY_IDENTIFIER ID_REL_CWP_PWR FORMAT "%4.1"
 /begin AXIS_DESCR COM_AXIS state_cwp_int _CNV_A_R_LINEAR_____50_CM 11 0. 10. FORMAT "%2.0" AXIS_PTS_REF ldp_state_cwp_int /end AXIS_DESCR
/end CHARACTERISTIC
/begin MEASUREMENT rel_cwp_pwr "relativ CWP power" UBYTE _CNV_A_R_LINEAR_____5_CM 1 100. 0. 99.609375 DISPLAY_IDENTIFIER REL_CWP_PWR ECU_ADDRESS 0xd0003881 FORMAT "%4.1" /end MEASUREMENT
/begin MEASUREMENT t_cwp_5 "Time delay before the transition to power reduced operation is performed due to electronics temp. too high" UBYTE _CNV_A_R_LINEAR_____4_CM 1 100. 0. 25.5 DISPLAY_IDENTIFIER T_CWP_5 ECU_ADDRESS 0xc00002d9 FORMAT "%4.1" /end MEASUREMENT
/begin MEASUREMENT n_rel_cwp_dif "Difference of actual waterpump speed range active to setpoint" UBYTE _CNV_A_R_LINEAR_____0_CM 1 100. 0. 255. DISPLAY_IDENTIFIER N_REL_CWP_DIF ECU_ADDRESS 0xd0003880 FORMAT "%3.0" /end MEASUREMENT
/begin CHARACTERISTIC c_n_rel_cwp_dif_max "Max- control deviation threshold for ratio speed stages diagnosis" VALUE 0xa1029644 _REC_VAL_20_u1 255. _CNV_A_R_LINEAR_____0_CM 0. 255. DISPLAY_IDENTIFIER C_N_REL_CWP_DIF_MAX FORMAT "%3.0" /end CHARACTERISTIC
/begin CHARACTERISTIC c_n_rel_cwp_hys "Ratio speed stages hysteresis" VALUE 0xa1029645 _REC_VAL_20_u1 255. _CNV_A_R_LINEAR_____0_CM 0. 255. DISPLAY_IDENTIFIER C_N_REL_CWP_HYS FORMAT "%3.0" /end CHARACTERISTIC
/begin CHARACTERISTIC c_t_cwp_lock_max "Timer Threshold locked active" VALUE 0xa102982f _REC_VAL_20_u1 25.5 _CNV_A_R_LINEAR_____4_CM 0. 25.5 DISPLAY_IDENTIFIER C_T_CWP_LOCK_MAX FORMAT "%4.1" /end CHARACTERISTIC
/begin CHARACTERISTIC c_t_cwp_temp_high_max "Timer threshold for internal CWP error 'Electronic temperature too high" VALUE 0xa1029830 _REC_VAL_20_u1 25.5 _CNV_A_R_LINEAR_____4_CM 0. 25.5 DISPLAY_IDENTIFIER C_T_CWP_TEMP_HIGH_MAX FORMAT "%4.1" /end CHARACTERISTIC
/begin CHARACTERISTIC c_t_cwp_vcc_plaus_max "Timer threshold for internal CWP error 'Supply voltage too high'" VALUE 0xa1029831 _REC_VAL_20_u1 25.5 _CNV_A_R_LINEAR_____4_CM 0. 25.5 DISPLAY_IDENTIFIER C_T_CWP_VCC_PLAUS_MAX FORMAT "%4.1" /end CHARACTERISTIC
/begin MEASUREMENT lv_cwp_not_plaus "Waterpump speed stages or temperature gradient out of range" UBYTE _CNV_S_2_RANGE__0___1_CM 1 100. 0. 1. DISPLAY_IDENTIFIER LV_CWP_NOT_PLAUS ECU_ADDRESS 0xd0003883 BIT_MASK 0x1 /end MEASUREMENT
/begin MEASUREMENT lv_cwp_tmp_off "Temporary shut down of the CWP triggered by internal CWP errors" UBYTE _CNV_S_2_RANGE__0___1_CM 1 100. 0. 1. DISPLAY_IDENTIFIER LV_CWP_TMP_OFF ECU_ADDRESS 0xd0003884 BIT_MASK 0x1 /end MEASUREMENT
/begin MEASUREMENT lv_cwp_off "Shut down of the CWP triggered by internal CWP errors, set after delay time" UBYTE _CNV_S_2_RANGE__0___1_CM 1 100. 0. 1. DISPLAY_IDENTIFIER LV_CWP_OFF ECU_ADDRESS 0xd0003885 BIT_MASK 0x1 /end MEASUREMENT
/begin MEASUREMENT t_cwp_dif_end_diag "Timer for CWP speed monitoring  End Diag detection" UBYTE _CNV_A_R_LINEAR_____4_CM 1 100. 0. 25.5 DISPLAY_IDENTIFIER T_CWP_DIF_END_DIAG ECU_ADDRESS 0xc00002d1 FORMAT "%4.1" /end MEASUREMENT
/begin MEASUREMENT t_cwp_lock "Time delay before the error management is triggered by the internal error 'Current consumption too high'" UBYTE _CNV_A_R_LINEAR_____4_CM 1 100. 0. 25.5 DISPLAY_IDENTIFIER T_CWP_LOCK ECU_ADDRESS 0xc00002d2 FORMAT "%4.1" /end MEASUREMENT
/begin MEASUREMENT t_cwp_temp_high "Time delay before the error management is triggered by the internal error 'Electronic temp. too high'" UBYTE _CNV_A_R_LINEAR_____4_CM 1 100. 0. 25.5 DISPLAY_IDENTIFIER T_CWP_TEMP_HIGH ECU_ADDRESS 0xc00002d3 FORMAT "%4.1" /end MEASUREMENT
/begin MEASUREMENT t_cwp_vcc_plaus "Time delay before the error management is triggered by the internal error 'Supply voltage too high'" UBYTE _CNV_A_R_LINEAR_____4_CM 1 100. 0. 25.5 DISPLAY_IDENTIFIER T_CWP_VCC_PLAUS ECU_ADDRESS 0xc00002d4 FORMAT "%4.1" /end MEASUREMENT
/begin MEASUREMENT t_cwp_cdn_diag_int_off "Time delay after the CDN Diag Flag can be set if no error is present --> End Diag Flag set by error Manag." UBYTE _CNV_A_R_LINEAR_____4_CM 1 100. 0. 25.5 DISPLAY_IDENTIFIER T_CWP_CDN_DIAG_INT_OFF ECU_ADDRESS 0xc00002d5 FORMAT "%4.1" /end MEASUREMENT
/begin MEASUREMENT t_cwp_dif "Timer for CWP speed monitoring " UBYTE _CNV_A_R_LINEAR_____4_CM 1 100. 0. 25.5 DISPLAY_IDENTIFIER T_CWP_DIF ECU_ADDRESS 0xc00002d0 FORMAT "%4.1" /end MEASUREMENT
/begin MEASUREMENT t_cwp_cdn_diag_pwr "Time delay after the CDN Diag Flag can be set if no error is present --> End Diag Flag set by error Manag." UBYTE _CNV_A_R_LINEAR_____4_CM 1 100. 0. 25.5 DISPLAY_IDENTIFIER T_CWP_CDN_DIAG_PWR ECU_ADDRESS 0xc00002d6 FORMAT "%4.1" /end MEASUREMENT
/begin MEASUREMENT t_cwp_4 "Time delay before the transition to power reduced operation is performed due to voltage supply too low" UBYTE _CNV_A_R_LINEAR_____4_CM 1 100. 0. 25.5 DISPLAY_IDENTIFIER T_CWP_4 ECU_ADDRESS 0xc00002d8 FORMAT "%4.1" /end MEASUREMENT
/begin CHARACTERISTIC c_temp_el_cwp_max_thd_1 "first power reduction threshold temperature CWP electronics" VALUE 0xa1029a1d _REC_VAL_20_u1 255. _CNV_A_R_ENSD_LINEA_415_CM -50. 205. DISPLAY_IDENTIFIER C_TEMP_EL_CWP_MAX_THD_1 FORMAT "%5.0" /end CHARACTERISTIC
/begin CHARACTERISTIC c_temp_el_cwp_max_thd_2 "second power reduction threshold temperature CWP electronics" VALUE 0xa1029a1e _REC_VAL_20_u1 255. _CNV_A_R_ENSD_LINEA_415_CM -50. 205. DISPLAY_IDENTIFIER C_TEMP_EL_CWP_MAX_THD_2 FORMAT "%5.0" /end CHARACTERISTIC
/begin CHARACTERISTIC c_temp_el_cwp_hys "Electronics CWP temperature hysteresis" VALUE 0xa1029a1c _REC_VAL_20_u1 255. _CNV_A_R_ENSD_LINEA_415_CM -50. 205. DISPLAY_IDENTIFIER C_TEMP_EL_CWP_HYS FORMAT "%5.0" /end CHARACTERISTIC
/begin CHARACTERISTIC c_t_temp_el_cwp_thd_1 "timer threshold (for first transition condition \"E\")" VALUE 0xa1029974 _REC_VAL_20_u1 25.5 _CNV_A_R_LINEAR_____4_CM 0. 25.5 DISPLAY_IDENTIFIER C_T_TEMP_EL_CWP_THD_1 FORMAT "%4.1" /end CHARACTERISTIC
/begin CHARACTERISTIC c_t_temp_el_cwp_thd_2 "timer threshold (for second transition condition \"E\")" VALUE 0xa1029975 _REC_VAL_20_u1 25.5 _CNV_A_R_LINEAR_____4_CM 0. 25.5 DISPLAY_IDENTIFIER C_T_TEMP_EL_CWP_THD_2 FORMAT "%4.1" /end CHARACTERISTIC
/begin CHARACTERISTIC c_v_cwp_min_diag_mon "min threshold voltage CWP to enable CWP speed monitoring" VALUE 0xa1029b58 _REC_VAL_20_u1 25.5 _CNV_A_R_LINEAR_____440_CM 0. 25.5 DISPLAY_IDENTIFIER C_V_CWP_MIN_DIAG_MON FORMAT "%4.1" /end CHARACTERISTIC
/begin MEASUREMENT lv_err_cwp_pwr "relative CWP power (reduced  power)" UBYTE _CNV_S_2_RANGE__0___1_CM 1 100. 0. 1. DISPLAY_IDENTIFIER LV_ERR_CWP_PWR ECU_ADDRESS 0xd000346c BIT_MASK 0x1 /end MEASUREMENT
/begin CHARACTERISTIC lc_swi_cwp_inp "Switch between lv_igk and lv_cdn_vb_min_diag" VALUE 0xa1029de3 _REC_VAL_20_u1 1. _CNV_A_R_LINEAR_____0_CM 0. 1. DISPLAY_IDENTIFIER LC_SWI_CWP_INP FORMAT "%2.0" /end CHARACTERISTIC
/begin CHARACTERISTIC c_abc_max_cwp_chk_inp "Number of timeouts for antibounce of lv_err_cw_com_plaus" VALUE 0xa1029103 _REC_VAL_20_u1 254. _CNV_A_R_LINEAR_____0_CM 1. 255. DISPLAY_IDENTIFIER C_ABC_MAX_CWP_CHK_INP FORMAT "%3.0" /end CHARACTERISTIC
/begin CHARACTERISTIC c_abc_inc_cwp_chk_inp "Antibounce increment for lv_err_cw_com_plaus" VALUE 0xa1029078 _REC_VAL_20_u1 255. _CNV_A_R_LINEAR_____0_CM 0. 255. DISPLAY_IDENTIFIER C_ABC_INC_CWP_CHK_INP FORMAT "%3.0" /end CHARACTERISTIC
/begin CHARACTERISTIC c_n_rel_cwp_sp_thd_min "Minimum CWP speed above the voltage monitoring is activated" VALUE 0xa1029646 _REC_VAL_20_u1 255. _CNV_A_R_LINEAR_____0_CM 0. 255. DISPLAY_IDENTIFIER C_N_REL_CWP_SP_THD_MIN FORMAT "%3.0" /end CHARACTERISTIC
/begin CHARACTERISTIC c_v_cwp_hys "Voltage Hysteresis" VALUE 0xa1029b56 _REC_VAL_20_u1 25.5 _CNV_A_R_LINEAR_____440_CM 0. 25.5 DISPLAY_IDENTIFIER C_V_CWP_HYS FORMAT "%4.1" /end CHARACTERISTIC
/begin CHARACTERISTIC c_v_cwp_min_diag_it "min threshold voltage CWP to enable CWP internal state" VALUE 0xa1029b57 _REC_VAL_20_u1 25.5 _CNV_A_R_LINEAR_____440_CM 0. 25.5 DISPLAY_IDENTIFIER C_V_CWP_MIN_DIAG_IT FORMAT "%4.1" /end CHARACTERISTIC
/begin MEASUREMENT lv_err_cwp_int_off "Electrical waterpump internal error" UBYTE _CNV_S_2_RANGE__0___1_CM 1 100. 0. 1. DISPLAY_IDENTIFIER LV_ERR_CWP_INT_OFF ECU_ADDRESS 0xd000346b BIT_MASK 0x1 /end MEASUREMENT
/begin MEASUREMENT lv_err_cwp_com_plaus "Plausibility error electrical waterpump communicatoin" UBYTE _CNV_S_2_RANGE__0___1_CM 1 100. 0. 1. DISPLAY_IDENTIFIER LV_ERR_CWP_COM_PLAUS ECU_ADDRESS 0xd000346d BIT_MASK 0x1 /end MEASUREMENT
/begin MEASUREMENT v_tps_gain_1 "Actual value of amplified TPS-channel 1" UWORD _CNV_A_R_LINEAR_____2_CM 1 100. 0. 4.9951171875 DISPLAY_IDENTIFIER V_TPS_GAIN_1 ECU_ADDRESS 0xd0004fd6 FORMAT "%5.3" /end MEASUREMENT
/begin MEASUREMENT lv_clc_2seg "" UBYTE _CNV_S_2_RANGE__0___1_CM 1 100. 0. 1. DISPLAY_IDENTIFIER LV_CLC_2SEG ECU_ADDRESS 0xd0003cd1 BIT_MASK 0x1 /end MEASUREMENT
/begin MEASUREMENT lv_clc_2seg_ena "" UBYTE _CNV_S_2_RANGE__0___1_CM 1 100. 0. 1. DISPLAY_IDENTIFIER LV_CLC_2SEG_ENA ECU_ADDRESS 0xd0003cd0 BIT_MASK 0x1 /end MEASUREMENT
/begin CHARACTERISTIC c_n_seg_2_ena "" VALUE 0xa1029649 _REC_VAL_20_u1 8160. _CNV_A_R_LINEAR_____9_CM 0. 8160. DISPLAY_IDENTIFIER C_N_SEG_2_ENA FORMAT "%4.0" /end CHARACTERISTIC
/begin MEASUREMENT state_diag_gs "Status of GS diagnosis for feedback to gearbox" UBYTE _CNV_A_R_LINEAR_____0_CM 1 100. 0. 255. DISPLAY_IDENTIFIER STATE_DIAG_GS ECU_ADDRESS 0xd0003e58 FORMAT "%3.0" /end MEASUREMENT
/begin MEASUREMENT lv_err_gs "Boolean for error currently present on GS" UBYTE _CNV_S_2_RANGE__0___1_CM 1 100. 0. 1. DISPLAY_IDENTIFIER LV_ERR_GS ECU_ADDRESS 0xd0003473 BIT_MASK 0x1 /end MEASUREMENT
/begin CHARACTERISTIC lc_var_gs_eobd "Logical constant for variant EOBD (=1) or US (=0)" VALUE 0xa1029e12 _REC_VAL_20_u1 1. _CNV_A_R_LINEAR_____0_CM 0. 1. DISPLAY_IDENTIFIER LC_VAR_GS_EOBD FORMAT "%2.0" /end CHARACTERISTIC
/begin MEASUREMENT lv_err_spi_knk "Present failure SPI-bus diagnosis for Knock sensor" UBYTE _CNV_S_2_RANGE__0___1_CM 1 100. 0. 1. DISPLAY_IDENTIFIER LV_ERR_SPI_KNK ECU_ADDRESS 0xd0003447 BIT_MASK 0x1 /end MEASUREMENT
/begin MEASUREMENT lv_err_spi_mps "Present failure SPI-bus diagnosis for Multi-powerstage" UBYTE _CNV_S_2_RANGE__0___1_CM 1 100. 0. 1. DISPLAY_IDENTIFIER LV_ERR_SPI_MPS ECU_ADDRESS 0xd0003446 BIT_MASK 0x1 /end MEASUREMENT
/begin CHARACTERISTIC c_t_max_rest "Time delay after switching on from LV_ST to detect LV_REST" VALUE 0xa10298ce _REC_VAL_20_u1 25.4 _CNV_A_R_LINEAR_____35_CM 1. 255. DISPLAY_IDENTIFIER C_T_MAX_REST FORMAT "%3.0" /end CHARACTERISTIC
/begin CHARACTERISTIC c_tco_dif_max_rest "Coolant temperature threshold to detect LV_REST" VALUE 0xa10299cd _REC_VAL_20_u1 0.6 _CNV_A_R_LINEAR_____24_CM 0. 60. DISPLAY_IDENTIFIER C_TCO_DIF_MAX_REST FORMAT "%4.1" /end CHARACTERISTIC
/begin MEASUREMENT lv_rest "Auxiliary function \"Re-start\"" UBYTE _CNV_S_2_RANGE__0___1_CM 1 100. 0. 1. DISPLAY_IDENTIFIER LV_REST ECU_ADDRESS 0xd0003cb2 BIT_MASK 0x1 /end MEASUREMENT
/begin MEASUREMENT cyc_cast "cycle counter at start and after start" UWORD _CNV_A_R_LINEAR_____0_CM 1 100. 0. 65535. DISPLAY_IDENTIFIER CYC_CAST ECU_ADDRESS 0xd00050cc FORMAT "%5.0" /end MEASUREMENT
/begin MEASUREMENT t_st_es "Time after transition from LV_ST to LV_ES" UWORD _CNV_A_R_LINEAR_____4_CM 1 100. 0.1 6553.5 DISPLAY_IDENTIFIER T_ST_ES ECU_ADDRESS 0xc0000086 FORMAT "%6.1" /end MEASUREMENT
/begin CHARACTERISTIC c_t_min_ecu_rest "Time threshold to detect new start after start-break off." VALUE 0xa10298f0 _REC_VAL_20_u2 6553.400000000001 _CNV_A_R_LINEAR_____4_CM 0.1 6553.5 DISPLAY_IDENTIFIER C_T_MIN_ECU_REST FORMAT "%6.1" /end CHARACTERISTIC
/begin CHARACTERISTIC c_cyc_cast_min_st_es "Min value of CYC_CAST for the detection of  LV_ST_ES" VALUE 0xa10292e0 _REC_VAL_20_u2 65535. _CNV_A_R_LINEAR_____0_CM 0. 65535. DISPLAY_IDENTIFIER C_CYC_CAST_MIN_ST_ES FORMAT "%5.0" /end CHARACTERISTIC
/begin MEASUREMENT lv_st_es "Detection of engine start break off (passive / active)" UBYTE _CNV_S_2_RANGE__0___1_CM 1 100. 0. 1. DISPLAY_IDENTIFIER LV_ST_ES ECU_ADDRESS 0xd0003cb3 BIT_MASK 0x1 /end MEASUREMENT
/begin MEASUREMENT lv_stall "Auxiliary function \"Engine Stall detected\"" UBYTE _CNV_S_2_RANGE__0___1_CM 1 100. 0. 1. DISPLAY_IDENTIFIER LV_STALL ECU_ADDRESS 0xd0003cb1 BIT_MASK 0x1 /end MEASUREMENT
/begin MEASUREMENT t_ast_rest "After start time for re-start" UWORD _CNV_A_R_LINEAR_____4_CM 1 100. 0. 6553.5 DISPLAY_IDENTIFIER T_AST_REST ECU_ADDRESS 0xd00050ca FORMAT "%6.1" /end MEASUREMENT
/begin CHARACTERISTIC c_cyc_cast_max_st_es "Max value of CYC_CAST for the beginning of  incrementation if LV_ST_ES is set" VALUE 0xa10292de _REC_VAL_20_u2 65535. _CNV_A_R_LINEAR_____0_CM 0. 65535. DISPLAY_IDENTIFIER C_CYC_CAST_MAX_ST_ES FORMAT "%5.0" /end CHARACTERISTIC
/begin AXIS_PTS ldpm_tco__n_stall "" 0xa1022264 tco _REC_AXS_20_u1 190.5 _CNV_A_R_LINEAR_____16_CM 9 -48. 142.5 FORMAT "%5.1" /end AXIS_PTS
/begin CHARACTERISTIC ip_n_bol_stall "Minimum engine speed for engine stalling detection" CURVE 0xa10262e0 _REC_CUR_20_u2_u1 8160. _CNV_A_R_LINEAR_____13_CM 0. 8160. DISPLAY_IDENTIFIER IP_N_BOL_STALL FORMAT "%4.0"
 /begin AXIS_DESCR COM_AXIS tco _CNV_A_R_LINEAR_____16_CM 9 -48. 142.5 FORMAT "%5.1" AXIS_PTS_REF ldpm_tco__n_stall /end AXIS_DESCR
/end CHARACTERISTIC
/begin CHARACTERISTIC ip_n_tol_stall "Maximum engine speed for engine stalling detection" CURVE 0xa1026558 _REC_CUR_20_u2_u1 8160. _CNV_A_R_LINEAR_____13_CM 0. 8160. DISPLAY_IDENTIFIER IP_N_TOL_STALL FORMAT "%4.0"
 /begin AXIS_DESCR COM_AXIS tco _CNV_A_R_LINEAR_____16_CM 9 -48. 142.5 FORMAT "%5.1" AXIS_PTS_REF ldpm_tco__n_stall /end AXIS_DESCR
/end CHARACTERISTIC
/begin CHARACTERISTIC c_n_max_cdn_stall "Engine speed threshold for deactivation of stalling detection" VALUE 0xa1029614 _REC_VAL_20_u2 8160. _CNV_A_R_LINEAR_____13_CM 0. 8160. DISPLAY_IDENTIFIER C_N_MAX_CDN_STALL FORMAT "%4.0" /end CHARACTERISTIC
/begin CHARACTERISTIC c_ctr_n_win_stall "Counter of N true events" VALUE 0xa10292b0 _REC_VAL_20_u1 255. _CNV_A_R_LINEAR_____0_CM 0. 255. DISPLAY_IDENTIFIER C_CTR_N_WIN_STALL FORMAT "%3.0" /end CHARACTERISTIC
/begin MEASUREMENT ctr_n_win_stall "Number of events inside the stall rpm range" UBYTE _CNV_A_R_LINEAR_____0_CM 1 100. 0. 255. DISPLAY_IDENTIFIER CTR_N_WIN_STALL ECU_ADDRESS 0xc000008c FORMAT "%3.0" /end MEASUREMENT
/begin MEASUREMENT lv_wup_can "Indication for CAT heating ended" UBYTE _CNV_S_2_RANGE__0___1_CM 1 100. 0. 1. DISPLAY_IDENTIFIER LV_WUP_CAN ECU_ADDRESS 0xd0003cb4 BIT_MASK 0x1 /end MEASUREMENT
/begin MEASUREMENT t_ast "Time after start" UWORD _CNV_A_R_LINEAR_____4_CM 1 100. 0. 6553.5 DISPLAY_IDENTIFIER T_AST ECU_ADDRESS 0xd00050c8 FORMAT "%6.1" /end MEASUREMENT
/begin MEASUREMENT t_ast_diag "After start time for common sensor diagnosis" UWORD _CNV_A_R_LINEAR_____253_CM 1 100. 0. 32767.5 DISPLAY_IDENTIFIER T_AST_DIAG ECU_ADDRESS 0xd00050ce FORMAT "%6.1" /end MEASUREMENT
/begin MEASUREMENT tco_rest "Coolant temperature, stored to detect a re-start" UBYTE _CNV_A_R_LINEAR_____16_CM 1 100. -48. 142.5 DISPLAY_IDENTIFIER TCO_REST ECU_ADDRESS 0xd0003cb0 FORMAT "%5.1" /end MEASUREMENT
/begin MEASUREMENT lv_inh_diag_nox_sens_1 "Inhibit flag for NOx-Sensor heater OBD I diagnosis" UBYTE _CNV_S_2_RANGE__0___1_CM 1 100. 0. 1. DISPLAY_IDENTIFIER LV_INH_DIAG_NOX_SENS_1 ECU_ADDRESS 0xd0003ad8 BIT_MASK 0x1 /end MEASUREMENT
/begin MEASUREMENT lv_inh_diag_nox_sens_2 "Inhibit flag for NOx-Sensor heater OBD I diagnosis" UBYTE _CNV_S_2_RANGE__0___1_CM 1 100. 0. 1. DISPLAY_IDENTIFIER LV_INH_DIAG_NOX_SENS_2 ECU_ADDRESS 0xd0003adb BIT_MASK 0x1 /end MEASUREMENT
/begin MEASUREMENT lv_err_nox_sens_can_boff "CAN bus, at which the NOx-Sensor is connected, is into the state bus off" UBYTE _CNV_S_2_RANGE__0___1_CM 1 100. 0. 1. DISPLAY_IDENTIFIER LV_ERR_NOX_SENS_CAN_BOFF ECU_ADDRESS 0xd0003ada BIT_MASK 0x1 /end MEASUREMENT
/begin MEASUREMENT lv_err_tout_nox_sens_1 "logical variable timeout error CAN message NOX_SENS_i" UBYTE _CNV_S_2_RANGE__0___1_CM 1 100. 0. 1. DISPLAY_IDENTIFIER LV_ERR_TOUT_NOX_SENS_1 ECU_ADDRESS 0xd0003479 BIT_MASK 0x1 /end MEASUREMENT
/begin MEASUREMENT lv_err_tout_nox_sens_2 "logical variable timeout error CAN message NOX_SENS_i" UBYTE _CNV_S_2_RANGE__0___1_CM 1 100. 0. 1. DISPLAY_IDENTIFIER LV_ERR_TOUT_NOX_SENS_2 ECU_ADDRESS 0xd000347a BIT_MASK 0x1 /end MEASUREMENT
/begin MEASUREMENT lv_err_nox_sens_can_msg_lost_1 "NOx-Sensor lost message failure is present" UBYTE _CNV_S_2_RANGE__0___1_CM 1 100. 0. 1. DISPLAY_IDENTIFIER LV_ERR_NOX_SENS_CAN_MSG_LOST_1 ECU_ADDRESS 0xd0003ad9 BIT_MASK 0x1 /end MEASUREMENT
/begin MEASUREMENT lv_err_nox_sens_can_msg_lost_2 "NOx-Sensor lost message failure is present" UBYTE _CNV_S_2_RANGE__0___1_CM 1 100. 0. 1. DISPLAY_IDENTIFIER LV_ERR_NOX_SENS_CAN_MSG_LOST_2 ECU_ADDRESS 0xd0003adc BIT_MASK 0x1 /end MEASUREMENT
/begin CHARACTERISTIC c_n_s_clc_hys "engine speed hysteresis for the deactivation of the stratified mode related modules" VALUE 0xa1029648 _REC_VAL_20_u1 408. _CNV_A_R_LINEAR_____9_CM 0. 8160. DISPLAY_IDENTIFIER C_N_S_CLC_HYS FORMAT "%4.0" /end CHARACTERISTIC
/begin CHARACTERISTIC c_n_afl_clc "engine speed limit for the deactivation of the AFL mode related modules" VALUE 0xa10295d4 _REC_VAL_20_u1 408. _CNV_A_R_LINEAR_____9_CM 0. 8160. DISPLAY_IDENTIFIER C_N_AFL_CLC FORMAT "%4.0" /end CHARACTERISTIC
/begin CHARACTERISTIC c_n_afl_clc_hys "engine speed hysteresis for the deactivation of the AFL mode related modules" VALUE 0xa10295d5 _REC_VAL_20_u1 408. _CNV_A_R_LINEAR_____9_CM 0. 8160. DISPLAY_IDENTIFIER C_N_AFL_CLC_HYS FORMAT "%4.0" /end CHARACTERISTIC
/begin MEASUREMENT lv_afl_clc "logical varaible for the deactivation of all AFL mode relevant modules" UBYTE _CNV_S_2_RANGE__0___1_CM 1 100. 0. 1. DISPLAY_IDENTIFIER LV_AFL_CLC ECU_ADDRESS 0xd0003afb BIT_MASK 0x1 /end MEASUREMENT
/begin CHARACTERISTIC c_n_s_clc "engine speed limit for calculation of stratified mode" VALUE 0xa1029647 _REC_VAL_20_u1 8160. _CNV_A_R_LINEAR_____9_CM 0. 8160. DISPLAY_IDENTIFIER C_N_S_CLC FORMAT "%4.0" /end CHARACTERISTIC
/begin MEASUREMENT lv_inh_s "Inhibit of stratified mode due to project specific requests." UBYTE _CNV_S_2_RANGE__0___1_CM 1 100. 0. 1. DISPLAY_IDENTIFIER LV_INH_S ECU_ADDRESS 0xd0003af8 BIT_MASK 0x1 /end MEASUREMENT
/begin MEASUREMENT lv_inh_afl "Inhibit of AFL mode due to project specific requests." UBYTE _CNV_S_2_RANGE__0___1_CM 1 100. 0. 1. DISPLAY_IDENTIFIER LV_INH_AFL ECU_ADDRESS 0xd0003af9 BIT_MASK 0x1 /end MEASUREMENT
/begin MEASUREMENT lv_s_clc "Switch to deactivate calculations for stratified mode" UBYTE _CNV_S_2_RANGE__0___1_CM 1 100. 0. 1. DISPLAY_IDENTIFIER LV_S_CLC ECU_ADDRESS 0xd0003afa BIT_MASK 0x1 /end MEASUREMENT
/begin MEASUREMENT lv_auth_lamb_s "logical variable stratified mode possible in lambda" UBYTE _CNV_S_2_RANGE__0___1_CM 1 100. 0. 1. DISPLAY_IDENTIFIER LV_AUTH_LAMB_S ECU_ADDRESS 0xd0003b00 BIT_MASK 0x1 /end MEASUREMENT
/begin MEASUREMENT lamb_sp_s_raw "raw value lambda setpoint for stratified mode" UWORD _CNV_A_R_LINEAR_____122_CM 1 100. 0. 31.9990234375 DISPLAY_IDENTIFIER LAMB_SP_S_RAW ECU_ADDRESS 0xc0000218 FORMAT "%7.4" /end MEASUREMENT
/begin CHARACTERISTIC c_hys_lamb_min_s "hysteresis for minimum lambda threshold for stratified mode" VALUE 0xa102949a _REC_VAL_20_u2 31.9990234375 _CNV_A_R_LINEAR_____122_CM 0. 31.9990234375 DISPLAY_IDENTIFIER C_HYS_LAMB_MIN_S FORMAT "%7.4" /end CHARACTERISTIC
/begin CHARACTERISTIC c_crlc_lamb_sp_s "correlation filter constant for LAMB_SP_S filtering" VALUE 0xa1029204 _REC_VAL_20_u2 0.9999847412109381 _CNV_A_R_LINEAR_____68_CM 0. 0.9999847412109381 DISPLAY_IDENTIFIER C_CRLC_LAMB_SP_S FORMAT "%7.5" /end CHARACTERISTIC
/begin CHARACTERISTIC c_lamb_sp_s_ini "initialization value for LAMB_SP_S after reset" VALUE 0xa1029508 _REC_VAL_20_u2 31.9990234375 _CNV_A_R_LINEAR_____122_CM 0. 31.9990234375 DISPLAY_IDENTIFIER C_LAMB_SP_S_INI FORMAT "%7.4" /end CHARACTERISTIC
/begin CHARACTERISTIC ip_lamb_min_s "minimum lambda for stratified mode" MAP 0xa1026010 _REC_MAP_20_u2_u1_u2 31.9990234375 _CNV_A_R_LINEAR_____122_CM 0. 31.9990234375 DISPLAY_IDENTIFIER IP_LAMB_MIN_S FORMAT "%7.4"
 /begin AXIS_DESCR COM_AXIS n_32 _CNV_A_R_LINEAR_____9_CM 8 0. 8160. FORMAT "%4.0" AXIS_PTS_REF ldp_n_32__lamb_min_s /end AXIS_DESCR
 /begin AXIS_DESCR COM_AXIS tqi_req_fast _CNV_A_R_LINEAR_____65_CM 8 -1024. 1023.96875 FORMAT "%8.2" AXIS_PTS_REF ldp_tqi_req_fast__lamb_min_s /end AXIS_DESCR
/end CHARACTERISTIC
/begin AXIS_PTS ldp_n_32__lamb_min_s "" 0xa1020d84 n_32 _REC_AXS_20_u1 8160. _CNV_A_R_LINEAR_____9_CM 8 0. 8160. FORMAT "%4.0" /end AXIS_PTS
/begin AXIS_PTS ldp_tqi_req_fast__lamb_min_s "" 0xa10215d4 tqi_req_fast _REC_AXS_20_u2 2047.96875 _CNV_A_R_LINEAR_____65_CM 8 -1024. 1023.96875 FORMAT "%8.2" /end AXIS_PTS
/begin CHARACTERISTIC c_fac_lamb_afs "air fuel stoichiometric factor (typical value 14.71)" VALUE 0xa1029386 _REC_VAL_20_u2 31.9990234375 _CNV_A_R_LINEAR_____122_CM 0. 31.9990234375 DISPLAY_IDENTIFIER C_FAC_LAMB_AFS FORMAT "%7.4" /end CHARACTERISTIC
/begin CHARACTERISTIC lc_lamb_sp_s_raw_ext "Switch between layer and internal calcualtion of Lamb_SP_S" VALUE 0xa1029d73 _REC_VAL_20_u1 1. _CNV_A_R_LINEAR_____0_CM 0. 1. DISPLAY_IDENTIFIER LC_LAMB_SP_S_RAW_EXT FORMAT "%1.0" /end CHARACTERISTIC
/begin MEASUREMENT lamb_sp_s "lambda setpoint for stratified mode" UWORD _CNV_A_R_LINEAR_____122_CM 1 100. 0. 31.9990234375 DISPLAY_IDENTIFIER LAMB_SP_S ECU_ADDRESS 0xd0004ec4 FORMAT "%7.4" /end MEASUREMENT
/begin MEASUREMENT lv_tqi_plaus_hom_afs_req "Request for combustion mode switch to homogeneous stoichiometric due to  torque plausibility check" UBYTE _CNV_S_2_RANGE__0___1_CM 1 100. 0. 1. DISPLAY_IDENTIFIER LV_TQI_PLAUS_HOM_AFS_REQ ECU_ADDRESS 0xd0003afc BIT_MASK 0x1 /end MEASUREMENT
/begin MEASUREMENT lv_tqi_plaus_hom_afs_act "Time duration forced combustion mode switch to HOM_AFS due to torque plausibility check" UBYTE _CNV_S_2_RANGE__0___1_CM 1 100. 0. 1. DISPLAY_IDENTIFIER LV_TQI_PLAUS_HOM_AFS_ACT ECU_ADDRESS 0xd0003afd BIT_MASK 0x1 /end MEASUREMENT
/begin MEASUREMENT t_tqi_plaus_swi "Actual time duration in non HOM_AFS state in case of torque limitation due to torque plausibility check" UBYTE _CNV_A_R_LINEAR_____3_CM 1 100. 0. 2.55 DISPLAY_IDENTIFIER T_TQI_PLAUS_SWI ECU_ADDRESS 0xd0003afe FORMAT "%4.2" /end MEASUREMENT
/begin CHARACTERISTIC c_n_hom_act_thd "Threshold on engine speed for activation torque plausibility testing" VALUE 0xa1029600 _REC_VAL_20_u1 8160. _CNV_A_R_LINEAR_____9_CM 0. 8160. DISPLAY_IDENTIFIER C_N_HOM_ACT_THD FORMAT "%4.0" /end CHARACTERISTIC
/begin CHARACTERISTIC c_n_hom_act_hys "Hysteresis on engine speed" VALUE 0xa10295ff _REC_VAL_20_u1 8160. _CNV_A_R_LINEAR_____9_CM 0. 8160. DISPLAY_IDENTIFIER C_N_HOM_ACT_HYS FORMAT "%4.0" /end CHARACTERISTIC
/begin CHARACTERISTIC c_pv_hom_act_hys "Hysteresis on pedal value" VALUE 0xa1029735 _REC_VAL_20_u1 99.609375 _CNV_A_R_LINEAR_____5_CM 0. 99.609375 DISPLAY_IDENTIFIER C_PV_HOM_ACT_HYS FORMAT "%4.1" /end CHARACTERISTIC
/begin CHARACTERISTIC c_fac_tq_hom_act_hys "Hysteresis on torque scaling factor for cruise control" VALUE 0xa10293b4 _REC_VAL_20_u2 1.99996948242188 _CNV_A_R_LINEAR_____8_CM 0. 1.99996948242188 DISPLAY_IDENTIFIER C_FAC_TQ_HOM_ACT_HYS FORMAT "%7.5" /end CHARACTERISTIC
/begin CHARACTERISTIC c_t_max_tqi_plaus_swi "Maximum switching time to HOM_AFS in case of torque plausibility check" VALUE 0xa10298de _REC_VAL_20_u1 2.55 _CNV_A_R_LINEAR_____3_CM 0. 2.55 DISPLAY_IDENTIFIER C_T_MAX_TQI_PLAUS_SWI FORMAT "%4.2" /end CHARACTERISTIC
/begin MEASUREMENT lv_iga_and_inj_swi_1 "Logical variable controlling ignition and injection  mode (stratified or homofenous)" UBYTE _CNV_S_2_RANGE__0___1_CM 1 100. 0. 1. DISPLAY_IDENTIFIER LV_IGA_AND_INJ_SWI_1 ECU_ADDRESS 0xd0003831 BIT_MASK 0x1 /end MEASUREMENT
/begin MEASUREMENT lv_iga_and_inj_swi_2 "Logical variable controlling ignition and injection  mode (stratified or homofenous)" UBYTE _CNV_S_2_RANGE__0___1_CM 1 100. 0. 1. DISPLAY_IDENTIFIER LV_IGA_AND_INJ_SWI_2 ECU_ADDRESS 0xd0003832 BIT_MASK 0x1 /end MEASUREMENT
/begin MEASUREMENT lv_s_run "flag to activate stratified calculations" UBYTE _CNV_S_2_RANGE__0___1_CM 1 100. 0. 1. DISPLAY_IDENTIFIER LV_S_RUN ECU_ADDRESS 0xd0003828 BIT_MASK 0x1 /end MEASUREMENT
/begin MEASUREMENT lv_hom_run "flag to activate homogeneous calculations" UBYTE _CNV_S_2_RANGE__0___1_CM 1 100. 0. 1. DISPLAY_IDENTIFIER LV_HOM_RUN ECU_ADDRESS 0xd0003827 BIT_MASK 0x1 /end MEASUREMENT
/begin MEASUREMENT lv_hom_afs_req "request for AFS mode" UBYTE _CNV_S_2_RANGE__0___1_CM 1 100. 0. 1. DISPLAY_IDENTIFIER LV_HOM_AFS_REQ ECU_ADDRESS 0xd0003829 BIT_MASK 0x1 /end MEASUREMENT
/begin MEASUREMENT lv_s_act "stratified ignition and injection parameters are applied to the engine" UBYTE _CNV_S_2_RANGE__0___1_CM 1 100. 0. 1. DISPLAY_IDENTIFIER LV_S_ACT ECU_ADDRESS 0xd000382a BIT_MASK 0x1 /end MEASUREMENT
/begin MEASUREMENT state_cmb_ctl "states of the combustion management" UBYTE _CNV_S_9_STATE_CMB__535_CM 1 100. 0. 8. DISPLAY_IDENTIFIER STATE_CMB_CTL ECU_ADDRESS 0xd0003826 /end MEASUREMENT
/begin MEASUREMENT lv_iga_and_inj_swi "logical variable controlling ignition and injection mode (stratified or homogeneous)" UBYTE _CNV_S_2_RANGE__0___1_CM 1 100. 0. 1. DISPLAY_IDENTIFIER LV_IGA_AND_INJ_SWI ECU_ADDRESS 0xd000382b BIT_MASK 0x1 /end MEASUREMENT
/begin MEASUREMENT lv_fup_sp_swi "flag for fuel pressure setpoint switch" UBYTE _CNV_S_2_RANGE__0___1_CM 1 100. 0. 1. DISPLAY_IDENTIFIER LV_FUP_SP_SWI ECU_ADDRESS 0xd000382c BIT_MASK 0x1 /end MEASUREMENT
/begin MEASUREMENT lv_hom_afl_act "homogeneous air fuel lean mode active" UBYTE _CNV_S_2_RANGE__0___1_CM 1 100. 0. 1. DISPLAY_IDENTIFIER LV_HOM_AFL_ACT ECU_ADDRESS 0xd000382d BIT_MASK 0x1 /end MEASUREMENT
/begin MEASUREMENT lv_hom_afs_act "logical variable indicates active homogeneous stoichiometric state" UBYTE _CNV_S_2_RANGE__0___1_CM 1 100. 0. 1. DISPLAY_IDENTIFIER LV_HOM_AFS_ACT ECU_ADDRESS 0xd000382e BIT_MASK 0x1 /end MEASUREMENT
/begin MEASUREMENT opm_av "Combustion mode Actual Mode" UBYTE _CNV_S_5_STATE_OPM_536_CM 1 100. 0. 8. DISPLAY_IDENTIFIER OPM_AV ECU_ADDRESS 0xd0003825 /end MEASUREMENT
/begin MEASUREMENT opm_req "Combustion mode Requested Mode" UBYTE _CNV_S_5_STATE_OPM_536_CM 1 100. 0. 8. DISPLAY_IDENTIFIER OPM_REQ ECU_ADDRESS 0xd0003824 /end MEASUREMENT
/begin MEASUREMENT lv_sp_rate_cyl_egr_swi "Logical variable for switching between the hom IGA correction and the strat IGA correction" UBYTE _CNV_S_2_RANGE__0___1_CM 1 100. 0. 1. DISPLAY_IDENTIFIER LV_SP_RATE_CYL_EGR_SWI ECU_ADDRESS 0xd0003830 BIT_MASK 0x1 /end MEASUREMENT
/begin MEASUREMENT lv_hom_act "homogeneous ignition and injection parameters are applied to the engine" UBYTE _CNV_S_2_RANGE__0___1_CM 1 100. 0. 1. DISPLAY_IDENTIFIER LV_HOM_ACT ECU_ADDRESS 0xd000382f BIT_MASK 0x1 /end MEASUREMENT
/begin MEASUREMENT lv_s_ena "catalyst heating home" UBYTE _CNV_S_2_RANGE__0___1_CM 1 100. 0. 1. DISPLAY_IDENTIFIER LV_S_ENA ECU_ADDRESS 0xd0003833 BIT_MASK 0x1 /end MEASUREMENT
/begin MEASUREMENT lv_hom_ena "catalyst heating home" UBYTE _CNV_S_2_RANGE__0___1_CM 1 100. 0. 1. DISPLAY_IDENTIFIER LV_HOM_ENA ECU_ADDRESS 0xd0003834 BIT_MASK 0x1 /end MEASUREMENT
/begin MEASUREMENT lv_mplh_ena "catalyst heating home enable" UBYTE _CNV_S_2_RANGE__0___1_CM 1 100. 0. 1. DISPLAY_IDENTIFIER LV_MPLH_ENA ECU_ADDRESS 0xd0003835 BIT_MASK 0x1 /end MEASUREMENT
/begin MEASUREMENT lamb_sp_s_ext "lambda setpoint for stratified mode" UWORD _CNV_A_R_LINEAR_____122_CM 1 100. 0. 31.9990234375 DISPLAY_IDENTIFIER LAMB_SP_S_EXT ECU_ADDRESS 0xd0004c18 FORMAT "%7.4" /end MEASUREMENT
/begin MEASUREMENT lv_iga_and_inj_swi_homs_1 "Logical variable controlling igintion and injection mode (stratified or homogeneous)" UBYTE _CNV_S_2_RANGE__0___1_CM 1 100. 0. 1. DISPLAY_IDENTIFIER LV_IGA_AND_INJ_SWI_HOMS_1 ECU_ADDRESS 0xd0003836 BIT_MASK 0x1 /end MEASUREMENT
/begin MEASUREMENT lv_iga_and_inj_swi_homs_2 "Logical variable controlling igintion and injection mode (stratified or homogeneous)" UBYTE _CNV_S_2_RANGE__0___1_CM 1 100. 0. 1. DISPLAY_IDENTIFIER LV_IGA_AND_INJ_SWI_HOMS_2 ECU_ADDRESS 0xd0003837 BIT_MASK 0x1 /end MEASUREMENT
/begin MEASUREMENT lv_iga_and_inj_swi_homs "Logical variable controlling igintion and injection mode (stratified or homogeneous)" UBYTE _CNV_S_2_RANGE__0___1_CM 1 100. 0. 1. DISPLAY_IDENTIFIER LV_IGA_AND_INJ_SWI_HOMS ECU_ADDRESS 0xd0003838 BIT_MASK 0x1 /end MEASUREMENT
/begin MEASUREMENT lv_ftl_min_act "Activation conditions for Diagnosis passed" UBYTE _CNV_S_2_RANGE__0___1_CM 1 100. 0. 1. DISPLAY_IDENTIFIER LV_FTL_MIN_ACT ECU_ADDRESS 0xc0000678 BIT_MASK 0x1 /end MEASUREMENT
/begin CHARACTERISTIC lc_state_ftl_min_ena "Logical variable for function enable condition" VALUE 0xa1029dd9 _REC_VAL_20_u1 1. _CNV_A_R_LINEAR_____0_CM 0. 1. DISPLAY_IDENTIFIER LC_STATE_FTL_MIN_ENA FORMAT "%1.0" /end CHARACTERISTIC
/begin CHARACTERISTIC c_ftl_min_diag_le "threshold fuel level left " VALUE 0xa10293f6 _REC_VAL_20_u1 127. _CNV_A_R_LINEAR_____76_CM 0. 127. DISPLAY_IDENTIFIER C_FTL_MIN_DIAG_LE FORMAT "%3.0" /end CHARACTERISTIC
/begin CHARACTERISTIC c_ftl_min_diag_ri "threshold fuel level right " VALUE 0xa10293f7 _REC_VAL_20_u1 127. _CNV_A_R_LINEAR_____76_CM 0. 127. DISPLAY_IDENTIFIER C_FTL_MIN_DIAG_RI FORMAT "%3.0" /end CHARACTERISTIC
/begin CHARACTERISTIC c_teg_dyn_ftl_min "Temperature threshold" VALUE 0xa1029a14 _REC_VAL_20_u2 2047. _CNV_A_R_LINEAR_____123_CM 0. 2047. DISPLAY_IDENTIFIER C_TEG_DYN_FTL_MIN FORMAT "%7.2" /end CHARACTERISTIC
/begin CHARACTERISTIC c_teg_dyn_ftl_hys "Temperature hysteresis" VALUE 0xa1029a12 _REC_VAL_20_u2 2047. _CNV_A_R_LINEAR_____123_CM 0. 2047. DISPLAY_IDENTIFIER C_TEG_DYN_FTL_HYS FORMAT "%7.2" /end CHARACTERISTIC
/begin CHARACTERISTIC c_ftl_min_diag_hys "Hysteresis" VALUE 0xa10293f5 _REC_VAL_20_u1 127. _CNV_A_R_LINEAR_____76_CM 0. 127. DISPLAY_IDENTIFIER C_FTL_MIN_DIAG_HYS FORMAT "%3.0" /end CHARACTERISTIC
/begin MEASUREMENT lv_err_ftl_min "Fuel tank level low Injection intervention" UBYTE _CNV_S_2_RANGE__0___1_CM 1 100. 0. 1. DISPLAY_IDENTIFIER LV_ERR_FTL_MIN ECU_ADDRESS 0xd00033bb BIT_MASK 0x1 /end MEASUREMENT
/begin MEASUREMENT ratio_ftl "ratio of counter" UWORD _CNV_A_R_LINEAR_____150_CM 1 100. 0. 1. DISPLAY_IDENTIFIER RATIO_FTL ECU_ADDRESS 0xc0000670 FORMAT "%7.5" /end MEASUREMENT
/begin MEASUREMENT ratio_ftl_ini "ratio of initialisation counter" UWORD _CNV_A_R_LINEAR_____150_CM 1 100. 0. 1. DISPLAY_IDENTIFIER RATIO_FTL_INI ECU_ADDRESS 0xc0000672 FORMAT "%7.5" /end MEASUREMENT
/begin MEASUREMENT ctr_ftl_min_act "Precounter FTL events" UWORD _CNV_A_R_LINEAR_____0_CM 1 100. 0. 65535. DISPLAY_IDENTIFIER CTR_FTL_MIN_ACT ECU_ADDRESS 0xc0000674 FORMAT "%5.0" /end MEASUREMENT
/begin MEASUREMENT ctr_er_ftl_min "er counter" UWORD _CNV_A_R_LINEAR_____0_CM 1 100. 0. 65535. DISPLAY_IDENTIFIER CTR_ER_FTL_MIN ECU_ADDRESS 0xc0000676 FORMAT "%5.0" /end MEASUREMENT
/begin MEASUREMENT inh_iv_ftl_min "Bit coded inhbit condition cylinder selective for fuel tank low level" UBYTE _CNV_A_R_LINEAR_____0_CM 1 100. 0. 255. DISPLAY_IDENTIFIER INH_IV_FTL_MIN ECU_ADDRESS 0xd0003e60 FORMAT "%3.0" /end MEASUREMENT
/begin CHARACTERISTIC c_fac_ratio_ftl_ini_min "Correction factor" VALUE 0xa102939a _REC_VAL_20_u2 655.35 _CNV_A_R_LINEAR_____404_CM 0. 655.35 DISPLAY_IDENTIFIER C_FAC_RATIO_FTL_INI_MIN FORMAT "%6.2" /end CHARACTERISTIC
/begin CHARACTERISTIC c_fac_ratio_ftl_ini_max "Correction factor" VALUE 0xa1029398 _REC_VAL_20_u2 655.35 _CNV_A_R_LINEAR_____404_CM 0. 655.35 DISPLAY_IDENTIFIER C_FAC_RATIO_FTL_INI_MAX FORMAT "%6.2" /end CHARACTERISTIC
/begin CHARACTERISTIC c_ctr_ftl_max "Counter for maximum of increments" VALUE 0xa1029296 _REC_VAL_20_u2 65535. _CNV_A_R_LINEAR_____0_CM 0. 65535. DISPLAY_IDENTIFIER C_CTR_FTL_MAX FORMAT "%5.0" /end CHARACTERISTIC
/begin CHARACTERISTIC c_ti_lam_cor_ftl_min "TI_LAM_COR threshold" VALUE 0xa1029a46 _REC_VAL_20_s2 99.99847412109381 _CNV_A_R_LINEAR_____110_CM -50. 49.9984741210938 DISPLAY_IDENTIFIER C_TI_LAM_COR_FTL_MIN FORMAT "%5.4" /end CHARACTERISTIC
/begin CHARACTERISTIC c_inh_iv_ftl_min "Bitmask of inhibit cylinders" VALUE 0xa10294bc _REC_VAL_20_u1 255. _CNV_A_R_LINEAR_____0_CM 0. 255. DISPLAY_IDENTIFIER C_INH_IV_FTL_MIN FORMAT "%3.0" /end CHARACTERISTIC
/begin CHARACTERISTIC c_abc_inc_ftl_min "increment" VALUE 0xa1029085 _REC_VAL_20_u1 255. _CNV_A_R_LINEAR_____0_CM 0. 255. DISPLAY_IDENTIFIER C_ABC_INC_FTL_MIN FORMAT "%3.0" /end CHARACTERISTIC
/begin CHARACTERISTIC c_abc_dec_ftl_min "decrement" VALUE 0xa1029049 _REC_VAL_20_u1 255. _CNV_A_R_LINEAR_____0_CM 0. 255. DISPLAY_IDENTIFIER C_ABC_DEC_FTL_MIN FORMAT "%3.0" /end CHARACTERISTIC
/begin CHARACTERISTIC c_abc_max_ftl_min "maximum" VALUE 0xa1029110 _REC_VAL_20_u1 255. _CNV_A_R_LINEAR_____0_CM 0. 255. DISPLAY_IDENTIFIER C_ABC_MAX_FTL_MIN FORMAT "%3.0" /end CHARACTERISTIC
/begin CHARACTERISTIC c_lamb_sp_ftl_min "Threshold lambda SP" VALUE 0xa1029504 _REC_VAL_20_u2 31.9990234375 _CNV_A_R_LINEAR_____122_CM 0. 31.9990234375 DISPLAY_IDENTIFIER C_LAMB_SP_FTL_MIN FORMAT "%7.4" /end CHARACTERISTIC
/begin CHARACTERISTIC c_lamb_1_ftl_min "lambda threshold" VALUE 0xa10294c6 _REC_VAL_20_u2 31.9990234375 _CNV_A_R_LINEAR_____122_CM 0. 31.9990234375 DISPLAY_IDENTIFIER C_LAMB_1_FTL_MIN FORMAT "%7.4" /end CHARACTERISTIC
/begin CHARACTERISTIC c_lamb_2_ftl_min "lambda threshold" VALUE 0xa10294c8 _REC_VAL_20_u2 31.9990234375 _CNV_A_R_LINEAR_____122_CM 0. 31.9990234375 DISPLAY_IDENTIFIER C_LAMB_2_FTL_MIN FORMAT "%7.4" /end CHARACTERISTIC
/begin CHARACTERISTIC c_ctr_ftl_ratio_max "Maximum of increments for ratio" VALUE 0xa102929a _REC_VAL_20_u2 65535. _CNV_A_R_LINEAR_____0_CM 0. 65535. DISPLAY_IDENTIFIER C_CTR_FTL_RATIO_MAX FORMAT "%5.0" /end CHARACTERISTIC
/begin MEASUREMENT lv_err_t_es "Engine off duration error" UBYTE _CNV_S_2_RANGE__0___1_CM 1 100. 0. 1. DISPLAY_IDENTIFIER LV_ERR_T_ES ECU_ADDRESS 0xd0003405 BIT_MASK 0x1 /end MEASUREMENT
/begin MEASUREMENT state_rbm_cs "Interface of CS monitor with the Rate-Based Monitoring statistics" UBYTE _CNV_A_R_LINEAR_____0_CM 1 100. 0. 7. DISPLAY_IDENTIFIER STATE_RBM_CS ECU_ADDRESS 0xd0003e1c FORMAT "%1.0" /end MEASUREMENT
/begin MEASUREMENT err_vimpwm_1_fb "The failure status of the failure feedback coming from the VIM_1 control unit" UBYTE _CNV_A_R_LINEAR_____0_CM 1 100. 0. 255. DISPLAY_IDENTIFIER ERR_VIMPWM_1_FB ECU_ADDRESS 0xd0003e6a FORMAT "%3.0" /end MEASUREMENT
/begin MEASUREMENT err_vimpwm_2_fb "The failure status of the failure feedback coming from the VIM_2 control unit" UBYTE _CNV_A_R_LINEAR_____0_CM 1 100. 0. 255. DISPLAY_IDENTIFIER ERR_VIMPWM_2_FB ECU_ADDRESS 0xd0003e6b FORMAT "%3.0" /end MEASUREMENT
/begin MEASUREMENT t_vimpwm_1_fb "Timer counting tlow for failure feedback recognition" UBYTE _CNV_A_R_LINEAR_____4_CM 1 100. 0. 25.5 DISPLAY_IDENTIFIER T_VIMPWM_1_FB ECU_ADDRESS 0xc0000e0c FORMAT "%4.1" /end MEASUREMENT
/begin MEASUREMENT t_vimpwm_2_fb "Timer counting tlow for failure feedback recognition" UBYTE _CNV_A_R_LINEAR_____4_CM 1 100. 0. 25.5 DISPLAY_IDENTIFIER T_VIMPWM_2_FB ECU_ADDRESS 0xc0000e0d FORMAT "%4.1" /end MEASUREMENT
/begin MEASUREMENT lv_vimpwm_1_fb_vld "If lv_vimpwm_1_fb_vld = 1 the failure number err_vimpwm_1_fb (01H) is valid" UBYTE _CNV_S_2_RANGE__0___1_CM 1 100. 0. 1. DISPLAY_IDENTIFIER LV_VIMPWM_1_FB_VLD ECU_ADDRESS 0xd0003e6e BIT_MASK 0x1 /end MEASUREMENT
/begin MEASUREMENT lv_vimpwm_2_fb_vld "If lv_vimpwm_2_fb_vld = 1 the failure number err_vimpwm_2_fb (01H) is valid" UBYTE _CNV_S_2_RANGE__0___1_CM 1 100. 0. 1. DISPLAY_IDENTIFIER LV_VIMPWM_2_FB_VLD ECU_ADDRESS 0xd0003e6f BIT_MASK 0x1 /end MEASUREMENT
/begin MEASUREMENT lv_err_vimpwm_2_fb "Error currently present, indicated by failure feedback from DISA control unit." UBYTE _CNV_S_2_RANGE__0___1_CM 1 100. 0. 1. DISPLAY_IDENTIFIER LV_ERR_VIMPWM_2_FB ECU_ADDRESS 0xd0003404 BIT_MASK 0x1 /end MEASUREMENT
/begin MEASUREMENT abc_vimpwm_2_fb "Anti bounce counter for DISA failure feedback diagnosis" UBYTE _CNV_A_R_LINEAR_____0_CM 1 100. 0. 255. DISPLAY_IDENTIFIER ABC_VIMPWM_2_FB ECU_ADDRESS 0xc0000e0f FORMAT "%3.0" /end MEASUREMENT
/begin MEASUREMENT t_act_vimpwm_1_fb "Time with vimpwm_1 > c_vimpwm_min_fb necessary to have failure feedback from DISA control unit" UWORD _CNV_A_R_LINEAR_____4_CM 1 100. 0. 6553.5 DISPLAY_IDENTIFIER T_ACT_VIMPWM_1_FB ECU_ADDRESS 0xc0000e08 FORMAT "%6.1" /end MEASUREMENT
/begin MEASUREMENT t_act_vimpwm_2_fb "Time with vimpwm_2 > c_vimpwm_min_fb necessary to have failure feedback from DISA control unit" UWORD _CNV_A_R_LINEAR_____4_CM 1 100. 0. 6553.5 DISPLAY_IDENTIFIER T_ACT_VIMPWM_2_FB ECU_ADDRESS 0xc0000e0a FORMAT "%6.1" /end MEASUREMENT
/begin CHARACTERISTIC c_t_vimpwm_1_fb_max "Time range necessary for identification of failure feedback minimal value" VALUE 0xa1029998 _REC_VAL_20_u1 2.55 _CNV_A_R_LINEAR_____4_CM 0. 25.5 DISPLAY_IDENTIFIER C_T_VIMPWM_1_FB_MAX FORMAT "%4.1" /end CHARACTERISTIC
/begin CHARACTERISTIC c_t_vimpwm_2_fb_max "Time range necessary for identification of failure feedback minimal value" VALUE 0xa102999a _REC_VAL_20_u1 2.55 _CNV_A_R_LINEAR_____4_CM 0. 25.5 DISPLAY_IDENTIFIER C_T_VIMPWM_2_FB_MAX FORMAT "%4.1" /end CHARACTERISTIC
/begin CHARACTERISTIC c_t_vimpwm_1_fb_min "Time range necessary for identification of failure feedback minimal value" VALUE 0xa1029999 _REC_VAL_20_u1 2.55 _CNV_A_R_LINEAR_____4_CM 0. 25.5 DISPLAY_IDENTIFIER C_T_VIMPWM_1_FB_MIN FORMAT "%4.1" /end CHARACTERISTIC
/begin CHARACTERISTIC c_t_vimpwm_2_fb_min "Time range necessary for identification of failure feedback minimal value" VALUE 0xa102999b _REC_VAL_20_u1 2.55 _CNV_A_R_LINEAR_____4_CM 0. 25.5 DISPLAY_IDENTIFIER C_T_VIMPWM_2_FB_MIN FORMAT "%4.1" /end CHARACTERISTIC
/begin MEASUREMENT lv_err_vim_2 "Boolean for error currently present on VIM_2 (VIM_L) signal." UBYTE _CNV_S_2_RANGE__0___1_CM 1 100. 0. 1. DISPLAY_IDENTIFIER LV_ERR_VIM_2 ECU_ADDRESS 0xd0003e6d BIT_MASK 0x1 /end MEASUREMENT
/begin MEASUREMENT abc_vimpwm_1_fb "Anti bounce counter for DISA failure feedback diagnosis" UBYTE _CNV_A_R_LINEAR_____0_CM 1 100. 0. 255. DISPLAY_IDENTIFIER ABC_VIMPWM_1_FB ECU_ADDRESS 0xc0000e0e FORMAT "%3.0" /end MEASUREMENT
/begin CHARACTERISTIC c_vim_pwm_diag_min_scp "Minimum threshold for SCB diagnosis window" VALUE 0xa1029c1e _REC_VAL_20_s2 199.9969482421875 _CNV_A_R_LINEAR_____201_CM -100. 99.9969482421875 DISPLAY_IDENTIFIER C_VIM_PWM_DIAG_MIN_SCP FORMAT "%8.3" /end CHARACTERISTIC
/begin CHARACTERISTIC c_vim_pwm_diag_min_oc "Minimum threshold for OC diagnosis window" VALUE 0xa1029c1c _REC_VAL_20_s2 199.9969482421875 _CNV_A_R_LINEAR_____201_CM -100. 99.9969482421875 DISPLAY_IDENTIFIER C_VIM_PWM_DIAG_MIN_OC FORMAT "%8.3" /end CHARACTERISTIC
/begin CHARACTERISTIC c_vim_pwm_diag_max_scg "Maximum threshold for SCG diagnosis window" VALUE 0xa1029c1a _REC_VAL_20_s2 199.9969482421875 _CNV_A_R_LINEAR_____201_CM -100. 99.9969482421875 DISPLAY_IDENTIFIER C_VIM_PWM_DIAG_MAX_SCG FORMAT "%8.3" /end CHARACTERISTIC
/begin CHARACTERISTIC c_abc_max_vimpwm_1_fb "ABC maximum for VIMPWM_1_FB diagnosis" VALUE 0xa1029162 _REC_VAL_20_u1 254. _CNV_A_R_LINEAR_____0_CM 1. 255. DISPLAY_IDENTIFIER C_ABC_MAX_VIMPWM_1_FB FORMAT "%3.0" /end CHARACTERISTIC
/begin CHARACTERISTIC c_abc_max_vimpwm_2_fb "ABC maximum for VIMPWM_2_FB diagnosis" VALUE 0xa1029163 _REC_VAL_20_u1 254. _CNV_A_R_LINEAR_____0_CM 1. 255. DISPLAY_IDENTIFIER C_ABC_MAX_VIMPWM_2_FB FORMAT "%3.0" /end CHARACTERISTIC
/begin CHARACTERISTIC c_abc_inc_vimpwm_2_fb "ABC increment for VIMPWM_2_FB diagnosis" VALUE 0xa10290d7 _REC_VAL_20_u1 255. _CNV_A_R_LINEAR_____0_CM 0. 255. DISPLAY_IDENTIFIER C_ABC_INC_VIMPWM_2_FB FORMAT "%3.0" /end CHARACTERISTIC
/begin CHARACTERISTIC c_abc_inc_vimpwm_1_fb "ABC increment for VIMPWM_1_FB diagnosis" VALUE 0xa10290d6 _REC_VAL_20_u1 255. _CNV_A_R_LINEAR_____0_CM 0. 255. DISPLAY_IDENTIFIER C_ABC_INC_VIMPWM_1_FB FORMAT "%3.0" /end CHARACTERISTIC
/begin CHARACTERISTIC c_vimpwm_1_min_fb "Minimum duty cycle of VIMPWM_1 to have a failure feedback from DISA control unit" VALUE 0xa1029c20 _REC_VAL_20_s2 199.9969482421875 _CNV_A_R_LINEAR_____201_CM -100. 99.9969482421875 DISPLAY_IDENTIFIER C_VIMPWM_1_MIN_FB FORMAT "%8.3" /end CHARACTERISTIC
/begin CHARACTERISTIC c_vimpwm_2_min_fb "Minimum duty cycle of VIMPWM_2 to have a failure feedback from DISA control unit" VALUE 0xa1029c22 _REC_VAL_20_s2 199.9969482421875 _CNV_A_R_LINEAR_____201_CM -100. 99.9969482421875 DISPLAY_IDENTIFIER C_VIMPWM_2_MIN_FB FORMAT "%8.3" /end CHARACTERISTIC
/begin CHARACTERISTIC c_t_act_vimpwm_1_fb "Minimum time necessary to have failure feedback from DISA control unit" VALUE 0xa10297e8 _REC_VAL_20_u2 6553.5 _CNV_A_R_LINEAR_____4_CM 0. 6553.5 DISPLAY_IDENTIFIER C_T_ACT_VIMPWM_1_FB FORMAT "%5.1" /end CHARACTERISTIC
/begin CHARACTERISTIC c_t_act_vimpwm_2_fb "Minimum time necessary to have failure feedback from DISA control unit" VALUE 0xa10297ea _REC_VAL_20_u2 6553.5 _CNV_A_R_LINEAR_____4_CM 0. 6553.5 DISPLAY_IDENTIFIER C_T_ACT_VIMPWM_2_FB FORMAT "%5.1" /end CHARACTERISTIC
/begin MEASUREMENT lv_err_vimpwm_1_fb "Error currently present, indicated by failure feedback from DISA control unit." UBYTE _CNV_S_2_RANGE__0___1_CM 1 100. 0. 1. DISPLAY_IDENTIFIER LV_ERR_VIMPWM_1_FB ECU_ADDRESS 0xd0003403 BIT_MASK 0x1 /end MEASUREMENT
/begin MEASUREMENT lv_inh_diag_vim_1_el "Diagnosis inhibition VIM_1 diagnosis " UBYTE _CNV_S_2_RANGE__0___1_CM 1 100. 0. 1. DISPLAY_IDENTIFIER LV_INH_DIAG_VIM_1_EL ECU_ADDRESS 0xd0003e70 BIT_MASK 0x1 /end MEASUREMENT
/begin MEASUREMENT lv_inh_diag_vim_2_el "Diagnosis inhibition VIM_2 diagnosis " UBYTE _CNV_S_2_RANGE__0___1_CM 1 100. 0. 1. DISPLAY_IDENTIFIER LV_INH_DIAG_VIM_2_EL ECU_ADDRESS 0xd0003e71 BIT_MASK 0x1 /end MEASUREMENT
/begin MEASUREMENT lv_err_vim_1 "Boolean for error currently present on VIM_1 (VIM_H) signal." UBYTE _CNV_S_2_RANGE__0___1_CM 1 100. 0. 1. DISPLAY_IDENTIFIER LV_ERR_VIM_1 ECU_ADDRESS 0xd0003e6c BIT_MASK 0x1 /end MEASUREMENT
/begin MEASUREMENT lv_err_vim_1_el "Boolean for error currently present on VIM_1 (VIM_H) signal." UBYTE _CNV_S_2_RANGE__0___1_CM 1 100. 0. 1. DISPLAY_IDENTIFIER LV_ERR_VIM_1_EL ECU_ADDRESS 0xd0003401 BIT_MASK 0x1 /end MEASUREMENT
/begin MEASUREMENT lv_err_vim_2_el "Boolean for error currently present on VIM_1 (VIM_H) signal." UBYTE _CNV_S_2_RANGE__0___1_CM 1 100. 0. 1. DISPLAY_IDENTIFIER LV_ERR_VIM_2_EL ECU_ADDRESS 0xd0003402 BIT_MASK 0x1 /end MEASUREMENT
/begin MEASUREMENT cdn_diag_vim_1_el " Diagnosis condition for each symptom of VIM_1 " UBYTE _CNV_A_R_LINEAR_____0_CM 1 100. 0. 7. DISPLAY_IDENTIFIER CDN_DIAG_VIM_1_EL ECU_ADDRESS 0xc0000e12 FORMAT "%1.0" /end MEASUREMENT
/begin MEASUREMENT cdn_diag_vim_2_el " Diagnosis condition for each symptom of VIM_2" UBYTE _CNV_A_R_LINEAR_____0_CM 1 100. 0. 7. DISPLAY_IDENTIFIER CDN_DIAG_VIM_2_EL ECU_ADDRESS 0xc0000e13 FORMAT "%1.0" /end MEASUREMENT
/begin CHARACTERISTIC c_abc_inc_vim_1_el "Debounce counter increment VIM_1 diagnosis" VALUE 0xa10290d3 _REC_VAL_20_u1 255. _CNV_A_R_LINEAR_____0_CM 0. 255. DISPLAY_IDENTIFIER C_ABC_INC_VIM_1_EL FORMAT "%3.0" /end CHARACTERISTIC
/begin CHARACTERISTIC c_abc_inc_vim_2_el "Debounce counter increment VIM_2 diagnosis" VALUE 0xa10290d4 _REC_VAL_20_u1 255. _CNV_A_R_LINEAR_____0_CM 0. 255. DISPLAY_IDENTIFIER C_ABC_INC_VIM_2_EL FORMAT "%3.0" /end CHARACTERISTIC
/begin CHARACTERISTIC c_abc_max_vim_1_el "Debounce counter increment VIM_1 diagnosis" VALUE 0xa102915f _REC_VAL_20_u1 254. _CNV_A_R_LINEAR_____0_CM 1. 255. DISPLAY_IDENTIFIER C_ABC_MAX_VIM_1_EL FORMAT "%3.0" /end CHARACTERISTIC
/begin CHARACTERISTIC c_abc_max_vim_2_el "Debounce counter increment VIM_2 diagnosis" VALUE 0xa1029160 _REC_VAL_20_u1 254. _CNV_A_R_LINEAR_____0_CM 1. 255. DISPLAY_IDENTIFIER C_ABC_MAX_VIM_2_EL FORMAT "%3.0" /end CHARACTERISTIC
/begin CHARACTERISTIC c_n_max_err_vim_fb "Engine speed threshold, no VIM feedback error above" VALUE 0xa1029620 _REC_VAL_20_u1 8160. _CNV_A_R_LINEAR_____9_CM 0. 8160. DISPLAY_IDENTIFIER C_N_MAX_ERR_VIM_FB FORMAT "%4.0" /end CHARACTERISTIC
/begin CHARACTERISTIC c_abc_inc_tam_can "Antibounce increment TAM_CAN diagnosis" VALUE 0xa10290b8 _REC_VAL_20_u1 255. _CNV_A_R_LINEAR_____0_CM 0. 255. DISPLAY_IDENTIFIER C_ABC_INC_TAM_CAN FORMAT "%3.0" /end CHARACTERISTIC
/begin CHARACTERISTIC c_abc_max_tam_can "Antibounce maximum TAM_CAN diagnosis" VALUE 0xa1029144 _REC_VAL_20_u1 255. _CNV_A_R_LINEAR_____0_CM 0. 255. DISPLAY_IDENTIFIER C_ABC_MAX_TAM_CAN FORMAT "%3.0" /end CHARACTERISTIC
/begin CHARACTERISTIC c_tam_dif_st_end "Minimum TAM difference to detect a moving signal after start" VALUE 0xa10299b7 _REC_VAL_20_u1 190.5 _CNV_A_R_LINEAR_____24_CM 0. 190.5 DISPLAY_IDENTIFIER C_TAM_DIF_ST_END FORMAT "%5.1" /end CHARACTERISTIC
/begin CHARACTERISTIC c_t_es_min_tam_diag "Maximum engine stop time to activate the diagnosis condition" VALUE 0xa1029892 _REC_VAL_20_u2 65535. _CNV_A_R_LINEAR_____77_CM 0. 65535. DISPLAY_IDENTIFIER C_T_ES_MIN_TAM_DIAG FORMAT "%5.0" /end CHARACTERISTIC
/begin CHARACTERISTIC c_tam_min_tam_diag "Minimum ambient temperature to activate the diagnosis conditon" VALUE 0xa10299c3 _REC_VAL_20_u1 190.5 _CNV_A_R_LINEAR_____16_CM -48. 142.5 DISPLAY_IDENTIFIER C_TAM_MIN_TAM_DIAG FORMAT "%6.2" /end CHARACTERISTIC
/begin CHARACTERISTIC c_tam_max_tam_diag "Maximum ambient temperature to activate the diagnosis conditon" VALUE 0xa10299be _REC_VAL_20_u1 190.5 _CNV_A_R_LINEAR_____16_CM -48. 142.5 DISPLAY_IDENTIFIER C_TAM_MAX_TAM_DIAG FORMAT "%6.2" /end CHARACTERISTIC
/begin CHARACTERISTIC c_tam_dif_plaus_min "Minimum TAM difference to detect a moving signal during engine run" VALUE 0xa10299b6 _REC_VAL_20_u1 190.5 _CNV_A_R_LINEAR_____24_CM 0. 190.5 DISPLAY_IDENTIFIER C_TAM_DIF_PLAUS_MIN FORMAT "%5.1" /end CHARACTERISTIC
/begin CHARACTERISTIC c_tam_dif_max_err "Temperature difference to detect a TAM error" VALUE 0xa10299b5 _REC_VAL_20_u1 190.5 _CNV_A_R_LINEAR_____24_CM 0. 190.5 DISPLAY_IDENTIFIER C_TAM_DIF_MAX_ERR FORMAT "%5.1" /end CHARACTERISTIC
/begin CHARACTERISTIC c_t_ast_max_tam_diag "Maximum time after start to deactivate the diagnosis condition" VALUE 0xa1029810 _REC_VAL_20_u2 6553.5 _CNV_A_R_LINEAR_____4_CM 0. 6553.5 DISPLAY_IDENTIFIER C_T_AST_MAX_TAM_DIAG FORMAT "%5.1" /end CHARACTERISTIC
/begin CHARACTERISTIC c_t_tam_dif_max_err "Anti-bounce time to detect a TAM error" VALUE 0xa1029970 _REC_VAL_20_u1 25.5 _CNV_A_R_LINEAR_____4_CM 0. 25.5 DISPLAY_IDENTIFIER C_T_TAM_DIF_MAX_ERR FORMAT "%3.1" /end CHARACTERISTIC
/begin CHARACTERISTIC c_vs_min_vld_tam_err "Minimum vehicle speed to count time period for error validation" VALUE 0xa1029cca _REC_VAL_20_u1 255. _CNV_A_R_LINEAR_____6_CM 0. 255. DISPLAY_IDENTIFIER C_VS_MIN_VLD_TAM_ERR FORMAT "%3.0" /end CHARACTERISTIC
/begin MEASUREMENT lv_err_tam "Present failure on TIA sensor(s) which might affect temperature TAM" UBYTE _CNV_S_2_RANGE__0___1_CM 1 100. 0. 1. DISPLAY_IDENTIFIER LV_ERR_TAM ECU_ADDRESS 0xd0003b88 BIT_MASK 0x1 /end MEASUREMENT
/begin MEASUREMENT lv_err_tam_can "TAM error send by CAN " UBYTE _CNV_S_2_RANGE__0___1_CM 1 100. 0. 1. DISPLAY_IDENTIFIER LV_ERR_TAM_CAN ECU_ADDRESS 0xd000348b BIT_MASK 0x1 /end MEASUREMENT
/begin MEASUREMENT t_tam_dif_diag "Time for anti-bounce the temperature difference" UBYTE _CNV_A_R_LINEAR_____4_CM 1 100. 0. 25.5 DISPLAY_IDENTIFIER T_TAM_DIF_DIAG ECU_ADDRESS 0xc0000bae FORMAT "%4.1" /end MEASUREMENT
/begin CHARACTERISTIC c_t_vs_min_vld_tam_err "Minimum time period of vehicle with speed" VALUE 0xa10299b0 _REC_VAL_20_u2 6553.5 _CNV_A_R_LINEAR_____4_CM 0. 6553.5 DISPLAY_IDENTIFIER C_T_VS_MIN_VLD_TAM_ERR FORMAT "%5.1" /end CHARACTERISTIC
/begin MEASUREMENT t_vs_min_vld_tam_err "Timer of vehicle speed period" UWORD _CNV_A_R_LINEAR_____4_CM 1 100. 0. 6553.5 DISPLAY_IDENTIFIER T_VS_MIN_VLD_TAM_ERR ECU_ADDRESS 0xc0000ba8 FORMAT "%5.1" /end MEASUREMENT
/begin MEASUREMENT lv_err_tam_plaus "TAM sensor signal is not plausible" UBYTE _CNV_S_2_RANGE__0___1_CM 1 100. 0. 1. DISPLAY_IDENTIFIER LV_ERR_TAM_PLAUS ECU_ADDRESS 0xd000348c BIT_MASK 0x1 /end MEASUREMENT
/begin MEASUREMENT lv_det_err_tam_plaus "TAM-plaus error is detected but not validated" UBYTE _CNV_S_2_RANGE__0___1_CM 1 100. 0. 1. DISPLAY_IDENTIFIER LV_DET_ERR_TAM_PLAUS ECU_ADDRESS 0xc0000bb1 BIT_MASK 0x1 /end MEASUREMENT
/begin MEASUREMENT lv_vs_cdn_tam_err "Bit information of status vehicle was driven with speed to validate the diagnosis result" UBYTE _CNV_S_2_RANGE__0___1_CM 1 100. 0. 1. DISPLAY_IDENTIFIER LV_VS_CDN_TAM_ERR ECU_ADDRESS 0xc0000bb2 BIT_MASK 0x1 /end MEASUREMENT
/begin MEASUREMENT tam_dif_plaus "TAM difference to detect a moving signal" UBYTE _CNV_A_R_LINEAR_____24_CM 1 100. 0. 190.5 DISPLAY_IDENTIFIER TAM_DIF_PLAUS ECU_ADDRESS 0xc0000bac FORMAT "%5.1" /end MEASUREMENT
/begin MEASUREMENT tam_dif_diag "TAM difference to detect a TAM error" UBYTE _CNV_A_R_LINEAR_____24_CM 1 100. 0. 190.5 DISPLAY_IDENTIFIER TAM_DIF_DIAG ECU_ADDRESS 0xc0000bad FORMAT "%5.1" /end MEASUREMENT
/begin MEASUREMENT tam_dif_max_diag "Maximum reached TAM in diagnosis cycle" UBYTE _CNV_A_R_LINEAR_____16_CM 1 100. -48. 142.5 DISPLAY_IDENTIFIER TAM_DIF_MAX_DIAG ECU_ADDRESS 0xc0000baf FORMAT "%6.2" /end MEASUREMENT
/begin MEASUREMENT tam_dif_min_diag "Minimum reached TAM in diagnosis cycle" UBYTE _CNV_A_R_LINEAR_____16_CM 1 100. -48. 142.5 DISPLAY_IDENTIFIER TAM_DIF_MIN_DIAG ECU_ADDRESS 0xc0000bb0 FORMAT "%6.2" /end MEASUREMENT
/begin MEASUREMENT lv_end_rbm_tam_plaus "End of diagnosis cycle for RBM statistics TAM_PLAUS" UBYTE _CNV_S_2_RANGE__0___1_CM 1 100. 0. 1. DISPLAY_IDENTIFIER LV_END_RBM_TAM_PLAUS ECU_ADDRESS 0xd0003b89 BIT_MASK 0x1 /end MEASUREMENT
/begin MEASUREMENT lv_cdn_rbm_tam_plaus "Diagnosis condition for RBM statistics TAM_PLAUS" UBYTE _CNV_S_2_RANGE__0___1_CM 1 100. 0. 1. DISPLAY_IDENTIFIER LV_CDN_RBM_TAM_PLAUS ECU_ADDRESS 0xc0000bb3 BIT_MASK 0x1 /end MEASUREMENT
/begin MEASUREMENT lv_cnl_diag_tam_plaus "Irreversible stop of diagnosis TAM_PLAUS" UBYTE _CNV_S_2_RANGE__0___1_CM 1 100. 0. 1. DISPLAY_IDENTIFIER LV_CNL_DIAG_TAM_PLAUS ECU_ADDRESS 0xc0000bb4 BIT_MASK 0x1 /end MEASUREMENT
/begin CHARACTERISTIC c_tco_2_st_min_tam_diag "Minimum exhaust engine cooling temperature to activate the diagnosis condition" VALUE 0xa10299c8 _REC_VAL_20_u1 190.5 _CNV_A_R_LINEAR_____16_CM -48. 142.5 DISPLAY_IDENTIFIER C_TCO_2_ST_MIN_TAM_DIAG FORMAT "%6.2" /end CHARACTERISTIC
/begin CHARACTERISTIC c_tco_2_tia_dif_max "Maximum deviation between TCO_2 and TIA to start TAM_PLAUS diagnosis" VALUE 0xa10299c9 _REC_VAL_20_u1 190.5 _CNV_A_R_LINEAR_____24_CM 0. 190.5 DISPLAY_IDENTIFIER C_TCO_2_TIA_DIF_MAX FORMAT "%5.1" /end CHARACTERISTIC
/begin MEASUREMENT lv_err_ldm "LDM error reversible / irreversible" UBYTE _CNV_S_2_RANGE__0___1_CM 1 100. 0. 1. DISPLAY_IDENTIFIER LV_ERR_LDM ECU_ADDRESS 0xd0003443 BIT_MASK 0x1 /end MEASUREMENT
/begin MEASUREMENT lv_ldm_off_ecu "Irreversible LDM error" UBYTE _CNV_S_2_RANGE__0___1_CM 1 100. 0. 1. DISPLAY_IDENTIFIER LV_LDM_OFF_ECU ECU_ADDRESS 0xd0003e54 BIT_MASK 0x1 /end MEASUREMENT
/begin MEASUREMENT lv_ldm_ena_plaus_err "Conditions for enabling LDM not plausible" UBYTE _CNV_S_2_RANGE__0___1_CM 1 100. 0. 1. DISPLAY_IDENTIFIER LV_LDM_ENA_PLAUS_ERR ECU_ADDRESS 0xd0003e55 BIT_MASK 0x1 /end MEASUREMENT
/begin MEASUREMENT lv_ldm_brake_plaus_err "Conditions for enabling LDM not plausible" UBYTE _CNV_S_2_RANGE__0___1_CM 1 100. 0. 1. DISPLAY_IDENTIFIER LV_LDM_BRAKE_PLAUS_ERR ECU_ADDRESS 0xd0003e56 BIT_MASK 0x1 /end MEASUREMENT
/begin MEASUREMENT t_ldm_brake_det "Brake delay timer" UBYTE _CNV_A_R_LINEAR_____3_CM 1 100. 0. 2.55 DISPLAY_IDENTIFIER T_LDM_BRAKE_DET ECU_ADDRESS 0xc0000888 FORMAT "%4.2" /end MEASUREMENT
/begin MEASUREMENT lv_ldm_off_ecu_1 "LDM irreversible OFF" UBYTE _CNV_S_2_RANGE__0___1_CM 1 100. 0. 1. DISPLAY_IDENTIFIER LV_LDM_OFF_ECU_1 ECU_ADDRESS 0xc0000889 BIT_MASK 0x1 /end MEASUREMENT
/begin MEASUREMENT lv_ldm_off_ecu_2 "LDM reversible OFF" UBYTE _CNV_S_2_RANGE__0___1_CM 1 100. 0. 1. DISPLAY_IDENTIFIER LV_LDM_OFF_ECU_2 ECU_ADDRESS 0xc000088a BIT_MASK 0x1 /end MEASUREMENT
/begin CHARACTERISTIC c_t_max_brake_det_ldm "Maximum Brake delay timer" VALUE 0xa10298b7 _REC_VAL_20_u1 2.55 _CNV_A_R_LINEAR_____3_CM 0. 2.55 DISPLAY_IDENTIFIER C_T_MAX_BRAKE_DET_LDM FORMAT "%4.2" /end CHARACTERISTIC
/begin CHARACTERISTIC lc_ldm_ena_plaus_err "LC for enabling diagnosis due to plausibility error" VALUE 0xa1029d74 _REC_VAL_20_u1 1. _CNV_S_2_RANGE__0___1_CM 0. 1. DISPLAY_IDENTIFIER LC_LDM_ENA_PLAUS_ERR BIT_MASK 0x1 /end CHARACTERISTIC
/begin MEASUREMENT lv_inh_diag_vcv "Inhibition bit for the fuel pressure actuator diagnosis" UBYTE _CNV_S_2_RANGE__0___1_CM 1 100. 0. 1. DISPLAY_IDENTIFIER LV_INH_DIAG_VCV ECU_ADDRESS 0xd00039f0 BIT_MASK 0x1 /end MEASUREMENT
/begin CHARACTERISTIC c_abc_max_vcv "Maximum value for antibounce counter" VALUE 0xa102915d _REC_VAL_20_u1 254. _CNV_A_R_LINEAR_____0_CM 1. 255. DISPLAY_IDENTIFIER C_ABC_MAX_VCV FORMAT "%3.0" /end CHARACTERISTIC
/begin CHARACTERISTIC c_abc_inc_vcv "Antibounce counter increment" VALUE 0xa10290d1 _REC_VAL_20_u1 255. _CNV_A_R_LINEAR_____0_CM 0. 255. DISPLAY_IDENTIFIER C_ABC_INC_VCV FORMAT "%3.0" /end CHARACTERISTIC
/begin CHARACTERISTIC c_pwm_vcv_max_diag_scg "Maximum threshold for SCG diagnosis window" VALUE 0xa1029758 _REC_VAL_20_u1 99.609375 _CNV_A_R_LINEAR_____5_CM 0. 99.609375 DISPLAY_IDENTIFIER C_PWM_VCV_MAX_DIAG_SCG FORMAT "%9.6" /end CHARACTERISTIC
/begin CHARACTERISTIC c_pwm_vcv_min_diag_scp "Minimum threshold for SCP diagnosis window" VALUE 0xa102976f _REC_VAL_20_u1 99.609375 _CNV_A_R_LINEAR_____5_CM 0. 99.609375 DISPLAY_IDENTIFIER C_PWM_VCV_MIN_DIAG_SCP FORMAT "%9.6" /end CHARACTERISTIC
/begin CHARACTERISTIC c_pwm_vcv_min_diag_oc "Minimum threshold for OC diagnosis window" VALUE 0xa102976e _REC_VAL_20_u1 99.609375 _CNV_A_R_LINEAR_____5_CM 0. 99.609375 DISPLAY_IDENTIFIER C_PWM_VCV_MIN_DIAG_OC FORMAT "%9.6" /end CHARACTERISTIC
/begin MEASUREMENT lv_err_vcv "Present failure:failure after filtering of diagnosis VCV" UBYTE _CNV_S_2_RANGE__0___1_CM 1 100. 0. 1. DISPLAY_IDENTIFIER LV_ERR_VCV ECU_ADDRESS 0xd00034d5 BIT_MASK 0x1 /end MEASUREMENT
/begin MEASUREMENT cdn_diag_vcv "Diagnosis condition for each symptom of VCV" UBYTE _CNV_A_R_LINEAR_____0_CM 1 100. 0. 7. DISPLAY_IDENTIFIER CDN_DIAG_VCV ECU_ADDRESS 0xc0000dfc FORMAT "%3.0" /end MEASUREMENT
/begin MEASUREMENT lv_err_fup "FUP sensor error detected" UBYTE _CNV_S_2_RANGE__0___1_CM 1 100. 0. 1. DISPLAY_IDENTIFIER LV_ERR_FUP ECU_ADDRESS 0xd00034d4 BIT_MASK 0x1 /end MEASUREMENT
/begin CHARACTERISTIC c_v_fup_mv_max_diag "Threshold value V_FUP_MV to detect short circuit in signal wire to VB" VALUE 0xa1029b60 _REC_VAL_20_u2 4.9951171875 _CNV_A_R_LINEAR_____2_CM 0. 4.9951171875 DISPLAY_IDENTIFIER C_V_FUP_MV_MAX_DIAG FORMAT "%5.3" /end CHARACTERISTIC
/begin CHARACTERISTIC c_v_fup_mv_min_diag "Threshold value V_FUP_MV to detect short circuit in signal wire to ground or wire break" VALUE 0xa1029b62 _REC_VAL_20_u2 4.9951171875 _CNV_A_R_LINEAR_____2_CM 0. 4.9951171875 DISPLAY_IDENTIFIER C_V_FUP_MV_MIN_DIAG FORMAT "%5.3" /end CHARACTERISTIC
/begin CHARACTERISTIC c_abc_inc_fup "Increment debounce counter" VALUE 0xa1029086 _REC_VAL_20_u1 255. _CNV_A_R_LINEAR_____0_CM 0. 255. DISPLAY_IDENTIFIER C_ABC_INC_FUP FORMAT "%3.0" /end CHARACTERISTIC
/begin CHARACTERISTIC c_abc_max_fup "Maximum value debounce counter" VALUE 0xa1029111 _REC_VAL_20_u1 254. _CNV_A_R_LINEAR_____0_CM 1. 255. DISPLAY_IDENTIFIER C_ABC_MAX_FUP FORMAT "%3.0" /end CHARACTERISTIC
/begin CHARACTERISTIC c_n_32_fup_diag_max "Maximum engine speed for FUP diagnosis" VALUE 0xa10295bd _REC_VAL_20_u1 8160. _CNV_A_R_LINEAR_____9_CM 0. 8160. DISPLAY_IDENTIFIER C_N_32_FUP_DIAG_MAX FORMAT "%4.0" /end CHARACTERISTIC
/begin MEASUREMENT lv_inh_diag_fup "Inhibition bit for the fuel pressure sensor diagnosis" UBYTE _CNV_S_2_RANGE__0___1_CM 1 100. 0. 1. DISPLAY_IDENTIFIER LV_INH_DIAG_FUP ECU_ADDRESS 0xd00039ec BIT_MASK 0x1 /end MEASUREMENT
/begin MEASUREMENT lv_inh_diag_tam_plaus "Inhibition of TAM plaus diagnosis due to present error" UBYTE _CNV_S_2_RANGE__0___1_CM 1 100. 0. 1. DISPLAY_IDENTIFIER LV_INH_DIAG_TAM_PLAUS ECU_ADDRESS 0xd0003b8d BIT_MASK 0x1 /end MEASUREMENT
/begin MEASUREMENT lv_diag_cdn_tam_plaus "Flag for status \"all TCO / TCO_2 diagnosis cycle are finished\"" UBYTE _CNV_S_2_RANGE__0___1_CM 1 100. 0. 1. DISPLAY_IDENTIFIER LV_DIAG_CDN_TAM_PLAUS ECU_ADDRESS 0xd0003b8e BIT_MASK 0x1 /end MEASUREMENT
/begin MEASUREMENT state_rbm_tam_plaus "Interface of TAM_PLAUS monitor with the Rate-Based Monitoring statistics" UBYTE _CNV_A_R_LINEAR_____0_CM 1 100. 0. 7. DISPLAY_IDENTIFIER STATE_RBM_TAM_PLAUS ECU_ADDRESS 0xd0003b8c FORMAT "%1.0" /end MEASUREMENT
/begin CHARACTERISTIC lc_inh_diag_tam_plaus "Switch to shut off the TAM plaus diagnosis (=1)" VALUE 0xa1029d4a _REC_VAL_20_u1 1. _CNV_A_R_LINEAR_____0_CM 0. 1. DISPLAY_IDENTIFIER LC_INH_DIAG_TAM_PLAUS FORMAT "%2.0" /end CHARACTERISTIC
/begin MEASUREMENT lv_err_fup_efp "FUP sensor error detected" UBYTE _CNV_S_2_RANGE__0___1_CM 1 100. 0. 1. DISPLAY_IDENTIFIER LV_ERR_FUP_EFP ECU_ADDRESS 0xd00034d6 BIT_MASK 0x1 /end MEASUREMENT
/begin CHARACTERISTIC c_v_fup_efp_mv_max_diag "threshold value V_FUP_EFP to detect short circuit in signal wire to VB" VALUE 0xa1029b5c _REC_VAL_20_u2 4.9951171875 _CNV_A_R_LINEAR_____2_CM 0. 4.9951171875 DISPLAY_IDENTIFIER C_V_FUP_EFP_MV_MAX_DIAG FORMAT "%5.3" /end CHARACTERISTIC
/begin CHARACTERISTIC c_v_fup_efp_mv_min_diag "threshold value V_FUP_EFP to detect short circuit in signal wire to ground or wire break" VALUE 0xa1029b5e _REC_VAL_20_u2 4.9951171875 _CNV_A_R_LINEAR_____2_CM 0. 4.9951171875 DISPLAY_IDENTIFIER C_V_FUP_EFP_MV_MIN_DIAG FORMAT "%5.3" /end CHARACTERISTIC
/begin CHARACTERISTIC c_abc_inc_fup_efp "increment debounce counter" VALUE 0xa1029087 _REC_VAL_20_u1 255. _CNV_A_R_LINEAR_____0_CM 0. 255. DISPLAY_IDENTIFIER C_ABC_INC_FUP_EFP FORMAT "%3.0" /end CHARACTERISTIC
/begin CHARACTERISTIC c_abc_max_fup_efp "maximum value debounce counter" VALUE 0xa1029112 _REC_VAL_20_u1 254. _CNV_A_R_LINEAR_____0_CM 1. 255. DISPLAY_IDENTIFIER C_ABC_MAX_FUP_EFP FORMAT "%3.0" /end CHARACTERISTIC
/begin MEASUREMENT lv_inh_diag_fup_efp "inhibition bit for the fuel pressure sensor diagnosis (low pressure circuit)" UBYTE _CNV_S_2_RANGE__0___1_CM 1 100. 0. 1. DISPLAY_IDENTIFIER LV_INH_DIAG_FUP_EFP ECU_ADDRESS 0xd0003a04 BIT_MASK 0x1 /end MEASUREMENT
/begin CHARACTERISTIC lc_egy_min_diag "Activation of energy spare mode diagnosis" VALUE 0xa1029d23 _REC_VAL_20_u1 1. _CNV_S_2_RANGE__0___1_CM 0. 1. DISPLAY_IDENTIFIER LC_EGY_MIN_DIAG /end CHARACTERISTIC
/begin MEASUREMENT lv_err_egy_min "Energy spare mode error flag" UBYTE _CNV_S_2_RANGE__0___1_CM 1 100. 0. 1. DISPLAY_IDENTIFIER LV_ERR_EGY_MIN ECU_ADDRESS 0xd0003466 BIT_MASK 0x1 /end MEASUREMENT
/begin COMPU_METHOD _CNV_A_R_LINEAR_____0_CM "" RAT_FUNC "%6.3" "-" COEFFS 0 1. 0. 0 0 1 /end COMPU_METHOD
/begin COMPU_METHOD _CNV_S_2_RANGE__0___1_CM "" TAB_VERB "%6.3" "-" COMPU_TAB_REF _CNV_S_2_RANGE__0___1 /end COMPU_METHOD
/begin COMPU_VTAB _CNV_S_2_RANGE__0___1 "" TAB_VERB 2 0 "0" 1 "1" /end COMPU_VTAB
/begin COMPU_METHOD _CNV_A_R_LINEAR_____2_CM "" RAT_FUNC "%6.3" "V" COEFFS 0 204.8 0. 0 0 1 /end COMPU_METHOD
/begin COMPU_METHOD _CNV_A_R_LINEAR_____3_CM "" RAT_FUNC "%6.3" "s" COEFFS 0 100. 0. 0 0 1 /end COMPU_METHOD
/begin COMPU_METHOD _CNV_A_R_LINEAR_____4_CM "" RAT_FUNC "%6.3" "s" COEFFS 0 10. 0. 0 0 1 /end COMPU_METHOD
/begin COMPU_METHOD _CNV_A_R_LINEAR_____5_CM "" RAT_FUNC "%6.3" "%" COEFFS 0 2.56 0. 0 0 1 /end COMPU_METHOD
/begin COMPU_METHOD _CNV_A_R_LINEAR_____6_CM "" RAT_FUNC "%6.3" "km/h" COEFFS 0 1. 0. 0 0 1 /end COMPU_METHOD
/begin COMPU_METHOD _CNV_A_R_LINEAR_____7_CM "" RAT_FUNC "%6.3" "%" COEFFS 0 655.3599999999997 0. 0 0 1 /end COMPU_METHOD
/begin COMPU_METHOD _CNV_A_R_LINEAR_____8_CM "" RAT_FUNC "%6.3" "-" COEFFS 0 32767.99999999992 0. 0 0 1 /end COMPU_METHOD
/begin COMPU_METHOD _CNV_A_R_LINEAR_____9_CM "" RAT_FUNC "%6.3" "rpm" COEFFS 0 3.125e-002 0. 0 0 1 /end COMPU_METHOD
/begin COMPU_METHOD _CNV_A_R_LINEAR_____13_CM "" RAT_FUNC "%6.3" "rpm" COEFFS 0 1. 0. 0 0 1 /end COMPU_METHOD
/begin COMPU_METHOD _CNV_A_R_LINEAR_____14_CM "" RAT_FUNC "%6.3" "mg/stk" COEFFS 0 0.183585313174946 0. 0 0 1 /end COMPU_METHOD
/begin COMPU_METHOD _CNV_A_R_LINEAR_____16_CM "" RAT_FUNC "%6.3" "°C" COEFFS 0 1.333333333333333 64. 0 0 1 /end COMPU_METHOD
/begin COMPU_METHOD _CNV_A_R_LINEAR_____21_CM "" RAT_FUNC "%6.3" "V" COEFFS 0 9.846168103048838 0. 0 0 1 /end COMPU_METHOD
/begin COMPU_METHOD _CNV_A_R_LINEAR_____23_CM "" RAT_FUNC "%6.3" "-" COEFFS 0 16384. 0. 0 0 1 /end COMPU_METHOD
/begin COMPU_METHOD _CNV_A_R_LINEAR_____24_CM "" RAT_FUNC "%6.3" "°C" COEFFS 0 1.333333333333333 0. 0 0 1 /end COMPU_METHOD
/begin COMPU_METHOD _CNV_A_R_LINEAR_____27_CM "" RAT_FUNC "%6.3" "-" COEFFS 0 256. 0. 0 0 1 /end COMPU_METHOD
/begin COMPU_METHOD _CNV_A_R_LINEAR_____28_CM "" RAT_FUNC "%6.3" "rpm/s" COEFFS 0 3.125e-002 128. 0 0 1 /end COMPU_METHOD
/begin COMPU_METHOD _CNV_A_R_LINEAR_____29_CM "" RAT_FUNC "%6.3" "rpm/s" COEFFS 0 3.125e-002 0. 0 0 1 /end COMPU_METHOD
/begin COMPU_METHOD _CNV_A_R_LINEAR_____30_CM "" RAT_FUNC "%6.3" "Nm" COEFFS 0 32. 0. 0 0 1 /end COMPU_METHOD
/begin COMPU_METHOD _CNV_A_R_LINEAR_____35_CM "" RAT_FUNC "%6.3" "s" COEFFS 0 1. 0. 0 0 1 /end COMPU_METHOD
/begin COMPU_METHOD _CNV_A_R_LINEAR_____50_CM "" RAT_FUNC "%6.3" "" COEFFS 0 1. 0. 0 0 1 /end COMPU_METHOD
/begin COMPU_METHOD _CNV_A_R_LINEAR_____65_CM "" RAT_FUNC "%6.3" "Nm" COEFFS 0 32. 32768. 0 0 1 /end COMPU_METHOD
/begin COMPU_METHOD _CNV_A_R_LINEAR_____66_CM "" RAT_FUNC "%6.3" "km/h" COEFFS 0 128.0000018750286 0. 0 0 1 /end COMPU_METHOD
/begin COMPU_METHOD _CNV_A_R_LINEAR_____68_CM "" RAT_FUNC "%6.3" "-" COEFFS 0 65535.99999999996 0. 0 0 1 /end COMPU_METHOD
/begin COMPU_METHOD _CNV_A_R_LINEAR_____70_CM "" RAT_FUNC "%6.3" "km" COEFFS 0 0.1 0. 0 0 1 /end COMPU_METHOD
/begin COMPU_METHOD _CNV_S_2_RANGE______75_CM "" TAB_VERB "%6.3" "" COMPU_TAB_REF _CNV_S_2_RANGE______75 /end COMPU_METHOD
/begin COMPU_VTAB _CNV_S_2_RANGE______75 "" TAB_VERB 2 0 "0" 1 "1" /end COMPU_VTAB
/begin COMPU_METHOD _CNV_A_R_LINEAR_____76_CM "" RAT_FUNC "%6.3" "l" COEFFS 0 1. 0. 0 0 1 /end COMPU_METHOD
/begin COMPU_METHOD _CNV_A_R_LINEAR_____77_CM "" RAT_FUNC "%6.3" "min" COEFFS 0 1. 0. 0 0 1 /end COMPU_METHOD
/begin COMPU_METHOD _CNV_A_R_LINEAR_____97_CM "" RAT_FUNC "%6.3" "-" COEFFS 0 127.9991955827809 0. 0 0 1 /end COMPU_METHOD
/begin COMPU_METHOD _CNV_A_R_LINEAR_____108_CM "" RAT_FUNC "%6.3" "mg/stk" COEFFS 0 47.18142548596112 0. 0 0 1 /end COMPU_METHOD
/begin COMPU_METHOD _CNV_A_R_LINEAR_____110_CM "" RAT_FUNC "%6.3" "%" COEFFS 0 655.3599999999997 -1.455191522836685e-011 0 0 1 /end COMPU_METHOD
/begin COMPU_METHOD _CNV_A_R_LINEAR_____113_CM "" RAT_FUNC "%6.3" "-" COEFFS 0 8192. 0. 0 0 1 /end COMPU_METHOD
/begin COMPU_METHOD _CNV_A_R_LINEAR_____122_CM "" RAT_FUNC "%6.3" "-" COEFFS 0 1024. 0. 0 0 1 /end COMPU_METHOD
/begin COMPU_METHOD _CNV_A_R_LINEAR_____123_CM "" RAT_FUNC "%6.3" "°C" COEFFS 0 16. 0. 0 0 1 /end COMPU_METHOD
/begin COMPU_METHOD _CNV_A_R_LINEAR_____145_CM "" RAT_FUNC "%6.3" "Seg" COEFFS 0 1. 0. 0 0 1 /end COMPU_METHOD
/begin COMPU_METHOD _CNV_S_6_RANGE_STAT_146_CM "" TAB_VERB "%6.3" "" COMPU_TAB_REF _CNV_S_6_RANGE_STAT_146 /end COMPU_METHOD
/begin COMPU_VTAB _CNV_S_6_RANGE_STAT_146 "" TAB_VERB 6 0 "ES" 1 "ST" 2 "IS" 3 "PL" 4 "PU" 5 "PUC" /end COMPU_VTAB
/begin COMPU_METHOD _CNV_A_R_LINEAR_____147_CM "" RAT_FUNC "%6.3" "kg/h" COEFFS 0 8192. 0. 0 0 1 /end COMPU_METHOD
/begin COMPU_METHOD _CNV_A_R_LINEAR_____150_CM "" RAT_FUNC "%6.3" "-" COEFFS 0 65535. 0. 0 0 1 /end COMPU_METHOD
/begin COMPU_METHOD _CNV_A_R_LINEAR_____184_CM "" RAT_FUNC "%6.3" "-" COEFFS 0 32. 0. 0 0 1 /end COMPU_METHOD
/begin COMPU_METHOD _CNV_A_R_LINEAR_____189_CM "" RAT_FUNC "%6.3" "V" COEFFS 0 51.0204081632653 0. 0 0 1 /end COMPU_METHOD
/begin COMPU_METHOD _CNV_A_R_LINEAR_____201_CM "" RAT_FUNC "%6.3" "%" COEFFS 0 327.68 0. 0 0 1 /end COMPU_METHOD
/begin COMPU_METHOD _CNV_A_R_LINEAR_____221_CM "" RAT_FUNC "%6.3" "°TPS" COEFFS 0 137.0962343096234 0. 0 0 1 /end COMPU_METHOD
/begin COMPU_METHOD _CNV_A_R_LINEAR_____223_CM "" RAT_FUNC "%6.3" "°TPS" COEFFS 0 137.0962343096234 16383. 0 0 1 /end COMPU_METHOD
/begin COMPU_METHOD _CNV_A_R_LINEAR_____224_CM "" RAT_FUNC "%6.3" "%" COEFFS 0 81.91999999679995 32767.99999871998 0 0 1 /end COMPU_METHOD
/begin COMPU_METHOD _CNV_A_R_LINEAR_____225_CM "" RAT_FUNC "%6.3" "%" COEFFS 0 327.680000003584 32768.00000035841 0 0 1 /end COMPU_METHOD
/begin COMPU_METHOD _CNV_A_R_LINEAR_____226_CM "" RAT_FUNC "%6.3" "%" COEFFS 0 327.680000003584 3.584063961170614e-007 0 0 1 /end COMPU_METHOD
/begin COMPU_METHOD _CNV_A_R_LINEAR_____227_CM "" RAT_FUNC "%6.3" "%" COEFFS 0 81.91999999679995 -1.280022843275219e-006 0 0 1 /end COMPU_METHOD
/begin COMPU_METHOD _CNV_A_R_LINEAR_____228_CM "" RAT_FUNC "%6.3" "ms" COEFFS 0 0.2 0. 0 0 1 /end COMPU_METHOD
/begin COMPU_METHOD _CNV_A_R_LINEAR_____229_CM "" RAT_FUNC "%6.3" "°TPS" COEFFS 0 137.0962343096234 1.818989403545857e-012 0 0 1 /end COMPU_METHOD
/begin COMPU_METHOD _CNV_A_R_LINEAR_____230_CM "" RAT_FUNC "%6.3" "s" COEFFS 0 200. 0. 0 0 1 /end COMPU_METHOD
/begin COMPU_METHOD _CNV_A_R_LINEAR_____231_CM "" RAT_FUNC "%6.3" "%" COEFFS 0 327.67 0. 0 0 1 /end COMPU_METHOD
/begin COMPU_METHOD _CNV_A_R_LINEAR_____245_CM "" RAT_FUNC "%6.3" "V" COEFFS 0 204.7999995887937 0. 0 0 1 /end COMPU_METHOD
/begin COMPU_METHOD _CNV_A_R_LINEAR_____253_CM "" RAT_FUNC "%6.3" "s" COEFFS 0 2. 0. 0 0 1 /end COMPU_METHOD
/begin COMPU_METHOD _CNV_A_R_LINEAR_____262_CM "" RAT_FUNC "%6.3" "°TPS/5ms" COEFFS 0 137.0962586026216 -6.746863121520619e-007 0 0 1 /end COMPU_METHOD
/begin COMPU_METHOD _CNV_A_R_LINEAR_____263_CM "" RAT_FUNC "%6.3" "°TPS" COEFFS 0 137.0962586026216 -6.746863121520619e-007 0 0 1 /end COMPU_METHOD
/begin COMPU_METHOD _CNV_A_R_LINEAR_____264_CM "" RAT_FUNC "%6.3" "V" COEFFS 0 102.3999997943969 0. 0 0 1 /end COMPU_METHOD
/begin COMPU_METHOD _CNV_S_2_RANGE______265_R_CM "" TAB_VERB "%6.3" "" COMPU_TAB_REF _CNV_S_2_RANGE______265_R /end COMPU_METHOD
/begin COMPU_VTAB_RANGE _CNV_S_2_RANGE______265_R "" 2 0 0 "0" 1 255 "1" /end COMPU_VTAB_RANGE
/begin COMPU_METHOD _CNV_S_12_RANGE_TPS__266_CM "" TAB_VERB "%6.3" "" COMPU_TAB_REF _CNV_S_12_RANGE_TPS__266 /end COMPU_METHOD
/begin COMPU_VTAB _CNV_S_12_RANGE_TPS__266 "" TAB_VERB 12 0 "ST_LIH_1" 1 "ST_UP_POS" 2 "ST_LIH_2" 3 "ST_BOL" 4 "ST_END" 5 "AD_LIH_1" 6 "AD_UP_POS" 7 "AD_LIH_2" 8 "AD_LOW_STOP" 9 "AD_GO_LIH" 10 "AD_LIH_3" 11 "AD_END" /end COMPU_VTAB
/begin COMPU_METHOD _CNV_A_R_LINEAR_____271_CM "" RAT_FUNC "%6.3" "°TPS/10ms" COEFFS 0 137.0962343096234 0. 0 0 1 /end COMPU_METHOD
/begin COMPU_METHOD _CNV_A_R_LINEAR_____404_CM "" RAT_FUNC "%6.3" "-" COEFFS 0 100. 0. 0 0 1 /end COMPU_METHOD
/begin COMPU_METHOD _CNV_A_R_ENSD_LINEA_415_CM "" RAT_FUNC "%6.3" "°C" COEFFS 0 1. 50. 0 0 1 /end COMPU_METHOD
/begin COMPU_METHOD _CNV_A_R_LINEAR_____440_CM "" RAT_FUNC "%6.3" "V" COEFFS 0 10. 0. 0 0 1 /end COMPU_METHOD
/begin COMPU_METHOD _CNV_S_9_STATE_CMB__535_CM "" TAB_VERB "%6.3" "-" COMPU_TAB_REF _CNV_S_9_STATE_CMB__535 /end COMPU_METHOD
/begin COMPU_VTAB _CNV_S_9_STATE_CMB__535 "" TAB_VERB 9 0 "HOM_AFS" 1 "AFS_TO_AFL" 2 "HOM_AFL" 3 "AFL_TO_AFS" 4 "HOM_TO_S" 5 "BACKS" 6 "S" 7 "S_TO_HOM" 8 "BACKHOM" /end COMPU_VTAB
/begin COMPU_METHOD _CNV_S_5_STATE_OPM_536_CM "" TAB_VERB "%6.3" "-" COMPU_TAB_REF _CNV_S_5_STATE_OPM_536 /end COMPU_METHOD
/begin COMPU_VTAB _CNV_S_5_STATE_OPM_536 "" TAB_VERB 5 0 "NO ACTION" 1 "S" 2 "AFS" 3 "AFL" 8 "LIH" /end COMPU_VTAB
/begin RECORD_LAYOUT _REC_VAL_20_u1 FNC_VALUES 1 UBYTE COLUMN_DIR DIRECT /end RECORD_LAYOUT
/begin RECORD_LAYOUT _REC_VAL_20_u2 FNC_VALUES 1 UWORD COLUMN_DIR DIRECT /end RECORD_LAYOUT
/begin RECORD_LAYOUT _REC_AXS_20_u1 NO_AXIS_PTS_X 1 UBYTE AXIS_PTS_X 2 UBYTE INDEX_INCR DIRECT /end RECORD_LAYOUT
/begin RECORD_LAYOUT _REC_CUR_20_u1_u1 FNC_VALUES 1 UBYTE COLUMN_DIR DIRECT /end RECORD_LAYOUT
/begin RECORD_LAYOUT _REC_VAL_20_s2 FNC_VALUES 1 SWORD COLUMN_DIR DIRECT /end RECORD_LAYOUT
/begin RECORD_LAYOUT _REC_MAP_20_u2_u2_u1 FNC_VALUES 1 UWORD COLUMN_DIR DIRECT /end RECORD_LAYOUT
/begin RECORD_LAYOUT _REC_AXS_20_u2 NO_AXIS_PTS_X 1 UWORD AXIS_PTS_X 2 UWORD INDEX_INCR DIRECT /end RECORD_LAYOUT
/begin RECORD_LAYOUT _REC_CUR_20_u2_u1 FNC_VALUES 1 UWORD COLUMN_DIR DIRECT /end RECORD_LAYOUT
/begin RECORD_LAYOUT _REC_CUR_20_u2_u2 FNC_VALUES 1 UWORD COLUMN_DIR DIRECT /end RECORD_LAYOUT
/begin RECORD_LAYOUT _REC_VAL_20_s1 FNC_VALUES 1 SBYTE COLUMN_DIR DIRECT /end RECORD_LAYOUT
/begin RECORD_LAYOUT _REC_MAP_20_u2_u1_u2 FNC_VALUES 1 UWORD COLUMN_DIR DIRECT /end RECORD_LAYOUT
/begin RECORD_LAYOUT _REC_CUR_20_u1_u2 FNC_VALUES 1 UBYTE COLUMN_DIR DIRECT /end RECORD_LAYOUT
/begin RECORD_LAYOUT _REC_MAP_20_u1_u1_u1 FNC_VALUES 1 UBYTE COLUMN_DIR DIRECT /end RECORD_LAYOUT
/begin FUNCTION DIA_ETC_Actuator_diagnosis_and_Adaptation "_ETC Actuator diagnosis and Adaptation"
 /begin DEF_CHARACTERISTIC c_mtcpwm_pi_max_diag c_tps_dif_max_diag c_t_tps_dif_diag c_t_mtcpwm_pi_diag_cur_off c_t_mtcpwm_pi_diag c_n_max_tps_ad c_t_max_tps_ad c_t_max_tps_lih_chk c_t_max_tps_sp_rst_chk c_t_tps_ad_hys c_tco_max_tps_ad c_tco_min_tps_ad c_tia_min_tps_ad c_tps_sp_bol_lgrd c_tps_sp_rst_chk_bas c_tps_sp_rst_chk_hys c_tps_sp_rst_chk_lgrd c_v_tps_ad_hys c_v_tps_ad_win_lih c_v_tps_sp_bol_1 c_v_tps_sp_bol_2 c_vb_min_tps_ad c_tps_sp_spr_chk_up c_tps_sp_rst_chk c_tps_av_rst_chk c_t_tps_av_rst_chk c_v_tps_ad_win_bol c_v_tps_ad_win_2_bol c_t_dyw_tps_lih_chk c_v_tps_ad_bol_ini_1 c_v_tps_ad_bol_ini_2 c_v_tps_lih_chk_hys c_v_tps_sp_lih_1 c_v_tps_sp_lih_2 c_tps_ad_slop_gain_ini_1 c_v_tps_ad_ofs_gain_ini_1 c_t_tps_st_bol_hys c_t_max_st_bol /end DEF_CHARACTERISTIC
 /begin OUT_MEASUREMENT lv_n_lim_tps_ad lv_tps_ad_cur_off lv_tps_ad_diag_cur_off tps_sp_ad v_tps_ad_el_bol_1 v_tps_ad_el_bol_2 v_tps_ad_lih_1 v_tps_ad_lih_2 lv_tps_ad_act tps_ad_slop_gain_1 tps_lih_1 tps_lih_2 lv_tps_ad_req tps_lih_ini v_tps_ad_bol_gain_1 v_tps_ad_tol_1 v_tps_ad_tol_gain_1 inh_iv_tps_ad v_tps_ad_ofs_gain_1 tps_ad_step ctr_st_chk_chk_lih_1_ready ctr_st_chk_chk_lih_1_err lv_err_tps_st_chk_2 lv_err_tps_ad lv_err_tps_ad_bol lv_err_tps_st_chk_1 lv_tps_st_bol_end lv_err_mtc_ctl_2 lv_err_mtc_ctl_3 lv_err_mtc_ctl_1 v_tps_gain_1 /end OUT_MEASUREMENT
/end FUNCTION
/begin FUNCTION DIA_Electric_solenoid_valve_diagnosis "_Electric solenoid valve diagnosis"
 /begin DEF_CHARACTERISTIC c_slv_ivvt_pwm_diag_min_oc c_slv_ivvt_pwm_diag_min_scb c_slv_ivvt_pwm_diag_max_scg /end DEF_CHARACTERISTIC
 /begin OUT_MEASUREMENT lv_err_slv_ivvt_in lv_err_slv_ivvt_ex lv_inh_diag_slv_ivvt_in lv_inh_diag_slv_ivvt_ex /end OUT_MEASUREMENT
/end FUNCTION
/begin FUNCTION DIA_AMT_intervention_plausibility "_AMT intervention plausibility"
 /begin DEF_CHARACTERISTIC c_vs_fil_amt c_t_max_state_amt_1_diag c_t_max_state_amt_2_diag c_t_max_tqi_amt_diag c_tqi_amt_diag c_tqi_amt_cond_diag c_tqi_amt_can_es c_t_max_state_amt_3_diag c_t_max_state_clu_amt_diag /end DEF_CHARACTERISTIC
 /begin OUT_MEASUREMENT state_err_amt_can lv_amt_es_req t_state_amt_1_diag t_state_amt_2_diag t_state_amt_3_diag state_err_amt state_amt_old t_state_clu_amt_diag tqi_amt_plaus /end OUT_MEASUREMENT
/end FUNCTION
/begin FUNCTION DIA_GS_intervention_plausibility_Diagnosis "_GS intervention plausibility Diagnosis" /end FUNCTION
/begin FUNCTION DIA_Distance_cruise_control_diagnosis "_Distance cruise control diagnosis" /begin DEF_CHARACTERISTIC c_t_max_brake_det_dcc /end DEF_CHARACTERISTIC /begin OUT_MEASUREMENT lv_dcc_off_ecu t_dcc_brake_det lv_err_dcc /end OUT_MEASUREMENT /end FUNCTION
/begin FUNCTION DIA_Electronically_controlled_radiator_shutter_diagnosis "_Electronically controlled radiator shutter diagnosis"
 /begin DEF_CHARACTERISTIC c_t_ecraspwm_fb_min c_t_ecraspwm_fb_max c_ecraspwm_diag_min_scp c_ecraspwm_diag_max_scg c_ecraspwm_diag_min_oc c_abc_ecraspwm_fb c_ecraspwm_min_fb c_t_act_ecraspwm_fb c_vs_max_ecras_diag /end DEF_CHARACTERISTIC
/end FUNCTION
/begin FUNCTION DIA_Upstream_oxygen_sensor_signal_monitoring "_Upstream oxygen sensor signal monitoring" /end FUNCTION
/begin FUNCTION DIA_CAN_diagnosis_for_NOX_control "_CAN diagnosis for NOX control"
 /begin OUT_MEASUREMENT lv_err_locan_boff lv_err_tout_nox_sens_1 lv_err_tout_nox_sens_2 lv_err_nox_sens_can_msg_lost_1 lv_err_nox_sens_can_msg_lost_2 /end OUT_MEASUREMENT
/end FUNCTION
/begin FUNCTION DIA_NOx_Sensor_Diagnosis___OBD_I "_NOx-Sensor Diagnosis - OBD I"
 /begin OUT_MEASUREMENT lv_inh_diag_nox_sens_1 lv_inh_diag_nox_sens_2 lv_err_nox_sens_can_boff /end OUT_MEASUREMENT
/end FUNCTION
/begin FUNCTION DIA_Clutch_switch_diagnosis "_Clutch switch diagnosis"
 /begin DEF_CHARACTERISTIC c_maf_cs_diag c_n_32_cs_diag c_vs_cs_diag c_t_min_maf_cs_diag /end DEF_CHARACTERISTIC
 /begin OUT_MEASUREMENT lv_err_cs lv_cs_diag lv_cs_swi t_min_maf_cs_diag state_rbm_cs /end OUT_MEASUREMENT
/end FUNCTION
/begin FUNCTION DIA_ECU_selftest "_ECU-selftest" /begin OUT_MEASUREMENT lv_err_ecu_ram lv_err_ecu_cks lv_err_ecu_nvmy /end OUT_MEASUREMENT /end FUNCTION
/begin FUNCTION DIA_SPI_Bus_diagnosis "_SPI-Bus diagnosis" /begin OUT_MEASUREMENT lv_err_spi_knk lv_err_spi_mps /end OUT_MEASUREMENT /end FUNCTION
/begin FUNCTION DIA_Automatic_gear_shift_signal_diagnosis "_Automatic gear shift signal diagnosis" /begin DEF_CHARACTERISTIC lc_var_gs_eobd /end DEF_CHARACTERISTIC /begin OUT_MEASUREMENT state_diag_gs lv_err_gs /end OUT_MEASUREMENT /end FUNCTION
/begin FUNCTION DIA_Diagnosis_Electrical_Controlled_Waterpump "_Diagnosis Electrical Controlled Waterpump"
 /begin DEF_CHARACTERISTIC c_t_cwp_dif_max c_tco_cwp_rel_min_diag c_t_v_cwp_max_diag ldp_state_cwp_int id_rel_cwp_pwr c_n_rel_cwp_dif_max c_n_rel_cwp_hys c_t_cwp_lock_max c_t_cwp_temp_high_max c_t_cwp_vcc_plaus_max c_temp_el_cwp_max_thd_1 c_temp_el_cwp_max_thd_2 c_temp_el_cwp_hys c_t_temp_el_cwp_thd_1 c_t_temp_el_cwp_thd_2 c_v_cwp_min_diag_mon lc_swi_cwp_inp c_abc_max_cwp_chk_inp c_abc_inc_cwp_chk_inp c_n_rel_cwp_sp_thd_min c_v_cwp_hys c_v_cwp_min_diag_it /end DEF_CHARACTERISTIC
 /begin OUT_MEASUREMENT lv_err_cwp_plaus state_cwp_int rel_cwp_pwr t_cwp_5 n_rel_cwp_dif lv_cwp_not_plaus lv_cwp_tmp_off lv_cwp_off t_cwp_dif_end_diag t_cwp_lock t_cwp_temp_high t_cwp_vcc_plaus t_cwp_cdn_diag_int_off t_cwp_dif t_cwp_cdn_diag_pwr t_cwp_4 lv_err_cwp_pwr lv_err_cwp_int_off lv_err_cwp_com_plaus /end OUT_MEASUREMENT
/end FUNCTION
/begin FUNCTION DIA_IS_Control_Diag "_IS_Control_Diag"
 /begin DEF_CHARACTERISTIC c_maf_max_diag_isc c_n_dif_max_diag_isc c_n_dif_min_diag_isc c_t_dly_isc_diag c_abc_inc_isc c_abc_dec_isc c_flow_cps_max_diag_isc c_abc_max_isc lc_inh_diag_isc_man lc_t_inh_isc_diag_ast ldp_tco_st_ip_t_inh_isc_diag ip_t_inh_isc_diag_ast /end DEF_CHARACTERISTIC
 /begin OUT_MEASUREMENT t_isc_diag t_inh_isc_diag_ast /end OUT_MEASUREMENT
/end FUNCTION
/begin FUNCTION DIA_IS_Control_Diag__AI "_IS_Control_Diag__AI" /begin OUT_MEASUREMENT lv_err_isc /end OUT_MEASUREMENT /end FUNCTION
/begin FUNCTION DIA_Fuel_reserve_diagnosis "_DIA Fuel reserve diagnosis"
 /begin DEF_CHARACTERISTIC lc_state_ftl_min_ena c_ftl_min_diag_le c_ftl_min_diag_ri c_teg_dyn_ftl_min c_teg_dyn_ftl_hys c_ftl_min_diag_hys c_fac_ratio_ftl_ini_min c_fac_ratio_ftl_ini_max c_ctr_ftl_max c_ti_lam_cor_ftl_min c_inh_iv_ftl_min c_abc_inc_ftl_min c_abc_dec_ftl_min c_abc_max_ftl_min c_lamb_sp_ftl_min c_lamb_1_ftl_min c_lamb_2_ftl_min c_ctr_ftl_ratio_max /end DEF_CHARACTERISTIC
 /begin OUT_MEASUREMENT lv_ftl_min_act lv_err_ftl_min ratio_ftl ratio_ftl_ini ctr_ftl_min_act ctr_er_ftl_min inh_iv_ftl_min /end OUT_MEASUREMENT
/end FUNCTION
/begin FUNCTION DIA_Vima_actuator_feedback_diagnosis "_Vima actuator feedback diagnosis"
 /begin DEF_CHARACTERISTIC c_t_vimpwm_1_fb_max c_t_vimpwm_2_fb_max c_t_vimpwm_1_fb_min c_t_vimpwm_2_fb_min c_vim_pwm_diag_min_scp c_vim_pwm_diag_min_oc c_vim_pwm_diag_max_scg c_abc_max_vimpwm_1_fb c_abc_max_vimpwm_2_fb c_abc_inc_vimpwm_2_fb c_abc_inc_vimpwm_1_fb c_vimpwm_1_min_fb c_vimpwm_2_min_fb c_t_act_vimpwm_1_fb c_t_act_vimpwm_2_fb c_abc_inc_vim_1_el c_abc_inc_vim_2_el c_abc_max_vim_1_el c_abc_max_vim_2_el c_n_max_err_vim_fb /end DEF_CHARACTERISTIC
 /begin OUT_MEASUREMENT err_vimpwm_1_fb err_vimpwm_2_fb t_vimpwm_1_fb t_vimpwm_2_fb lv_vimpwm_1_fb_vld lv_vimpwm_2_fb_vld lv_err_vimpwm_2_fb abc_vimpwm_2_fb t_act_vimpwm_1_fb t_act_vimpwm_2_fb lv_err_vim_2 abc_vimpwm_1_fb lv_err_vimpwm_1_fb lv_inh_diag_vim_1_el lv_inh_diag_vim_2_el lv_err_vim_1 lv_err_vim_1_el lv_err_vim_2_el cdn_diag_vim_1_el cdn_diag_vim_2_el /end OUT_MEASUREMENT
/end FUNCTION
/begin FUNCTION DIA_Ambient_temperature_sensor "_Ambient temperature sensor"
 /begin DEF_CHARACTERISTIC c_abc_inc_tam_can c_abc_max_tam_can c_tam_dif_st_end c_t_es_min_tam_diag c_tam_min_tam_diag c_tam_max_tam_diag c_tam_dif_plaus_min c_tam_dif_max_err c_t_ast_max_tam_diag c_t_tam_dif_max_err c_vs_min_vld_tam_err c_t_vs_min_vld_tam_err c_tco_2_st_min_tam_diag c_tco_2_tia_dif_max lc_inh_diag_tam_plaus /end DEF_CHARACTERISTIC
 /begin OUT_MEASUREMENT lv_err_tam lv_err_tam_can t_tam_dif_diag t_vs_min_vld_tam_err lv_err_tam_plaus lv_det_err_tam_plaus lv_vs_cdn_tam_err tam_dif_plaus tam_dif_diag tam_dif_max_diag tam_dif_min_diag lv_end_rbm_tam_plaus lv_cdn_rbm_tam_plaus lv_cnl_diag_tam_plaus lv_inh_diag_tam_plaus lv_diag_cdn_tam_plaus state_rbm_tam_plaus /end OUT_MEASUREMENT
/end FUNCTION
/begin FUNCTION DIA_Engine_Off_Duration_diagnosis "_Engine Off Duration diagnosis" /begin OUT_MEASUREMENT lv_err_t_es /end OUT_MEASUREMENT /end FUNCTION
/begin FUNCTION DIA_LDM_diagnosis__LV_ERR_LDM_ "_LDM diagnosis (LV_ERR_LDM)" /begin DEF_CHARACTERISTIC c_t_max_brake_det_ldm lc_ldm_ena_plaus_err /end DEF_CHARACTERISTIC
 /begin OUT_MEASUREMENT lv_err_ldm lv_ldm_off_ecu lv_ldm_ena_plaus_err lv_ldm_brake_plaus_err t_ldm_brake_det lv_ldm_off_ecu_1 lv_ldm_off_ecu_2 /end OUT_MEASUREMENT
/end FUNCTION
/begin FUNCTION DIA_Fuel_Pressure_Actuator_Diag "_Fuel_Pressure_Actuator_Diag"
 /begin DEF_CHARACTERISTIC c_abc_max_vcv c_abc_inc_vcv c_pwm_vcv_max_diag_scg c_pwm_vcv_min_diag_scp c_pwm_vcv_min_diag_oc /end DEF_CHARACTERISTIC
 /begin OUT_MEASUREMENT lv_err_vcv cdn_diag_vcv /end OUT_MEASUREMENT
/end FUNCTION
/begin FUNCTION DIA_Fuel_Pressure_Sensor_Diag "_Fuel_Pressure_Sensor_Diag"
 /begin DEF_CHARACTERISTIC c_v_fup_mv_max_diag c_v_fup_mv_min_diag c_abc_inc_fup c_abc_max_fup c_n_32_fup_diag_max /end DEF_CHARACTERISTIC
 /begin OUT_MEASUREMENT lv_err_fup /end OUT_MEASUREMENT
/end FUNCTION
/begin FUNCTION DIA_Fuel_Pressure_Actuator_Diag_AI "_Fuel_Pressure_Actuator_Diag_AI" /begin OUT_MEASUREMENT lv_inh_diag_vcv /end OUT_MEASUREMENT /end FUNCTION
/begin FUNCTION DIA_Fuel_Pressure_Sensor_Diag_AI "_Fuel_Pressure_Sensor_Diag_AI" /begin OUT_MEASUREMENT lv_inh_diag_fup /end OUT_MEASUREMENT /end FUNCTION
/begin FUNCTION DIA_FUP_EFP_Sensor_Diag__AI "" /begin OUT_MEASUREMENT lv_inh_diag_fup_efp /end OUT_MEASUREMENT /end FUNCTION
/begin FUNCTION DIA_FUP_EFP_Sensor_Diag ""
 /begin DEF_CHARACTERISTIC c_v_fup_efp_mv_max_diag c_v_fup_efp_mv_min_diag c_abc_inc_fup_efp c_abc_max_fup_efp /end DEF_CHARACTERISTIC
 /begin OUT_MEASUREMENT lv_err_fup_efp /end OUT_MEASUREMENT
/end FUNCTION
/begin FUNCTION Energy_spare_mode_diag "_Energy spare mode diag" /begin DEF_CHARACTERISTIC lc_egy_min_diag /end DEF_CHARACTERISTIC /begin OUT_MEASUREMENT lv_err_egy_min /end OUT_MEASUREMENT /end FUNCTION
/begin FUNCTION C_C_ETC "C_C_ETC"
 /begin SUB_FUNCTION ETC_Throttle_position_setpoint_calculation ETC_Position_controller ETC_Throttle_position_setpoint_selection ETC_Application_incidences_throttle_position_setpoint_selection /end SUB_FUNCTION
/end FUNCTION
/begin FUNCTION ETC_Throttle_position_setpoint_calculation "_Throttle position setpoint calculation" /begin OUT_MEASUREMENT isapwm /end OUT_MEASUREMENT /end FUNCTION
/begin FUNCTION ETC_Position_controller "_Position controller"
 /begin DEF_CHARACTERISTIC c_mtcpwm_i_max_pos ip_mtcpwm_d__tps_dif_grd ip_mtcpwm_i__tps_dif ip_mtcpwm_p__tps_dif ip_mtcpwm_vb_fac__vb c_tps_sp_lih_dif_hys c_mtcpwm_i_max_neg c_mtcpwm_i_add c_mtcpwm_add_fil ip_mtcpwm_i_fac__tps_av_lih_dif ip_mtcpwm_add__tps_sp_lih_dif c_t_mtcpwm_close_act_max c_mtcpwm_close_max c_tps_sp_stop_hys c_tps_sp_stop_max c_mtcpwm_i_ini c_tps_sp_ctl_max c_mtcpwm_close c_mtcpwm_hys /end DEF_CHARACTERISTIC
 /begin OUT_MEASUREMENT tps_dif mtcpwm_add mtcpwm_ctl mtcpwm_d mtcpwm_p mtcpwm_i mtcpwm_i_add tps_sp_lih_dif mtcpwm_vb_fac tps_dif_grd t_mtcpwm_close_act tps_sp_ctl lv_tps_sp_pos lv_tps_chg_pos mtcpwm lv_mtcpwm_close_act tps_av_lih_dif /end OUT_MEASUREMENT
/end FUNCTION
/begin FUNCTION ETC_Throttle_position_setpoint_selection "_Throttle position setpoint selection"
 /begin DEF_CHARACTERISTIC c_tps_av_bol c_tps_av_tol c_tps_sp_min c_tps_sp_min_tps_ad_req c_tps_sp_max_tps_ad_req c_tps_sp_max c_tps_sp_tol c_tps_sp_tol_tps_ad_req c_tps_sp_bol_tps_ad_req c_tps_sp_bol c_tps_sp_lgrd_tot c_tps_sp_lgrd_stop /end DEF_CHARACTERISTIC
 /begin OUT_MEASUREMENT lv_mtc_cur_off lv_tps_sp_lih tps_sp_sel tps_sp tps_sp_lim tps_sp_lim_2 tps_sp_lim_1 /end OUT_MEASUREMENT
/end FUNCTION
/begin FUNCTION ETC_Application_incidences_throttle_position_setpoint_selection "_Application incidences throttle position setpoint selection"
 /begin DEF_CHARACTERISTIC c_tps_sp_pwl_lgrd c_tps_sp_pwl_up c_tps_sp_as_man c_tps_sp_ext_adj_ena c_pv_av_ext_adj_min ip_tps_sp_pwl ip_tps_sp_ext_adj ip_tps_sp_es c_t_mtc_isa_off /end DEF_CHARACTERISTIC
 /begin OUT_MEASUREMENT tps_sp_pwl lv_tps_pwl tps_sp_ext lv_tps_sp_ext_adj lv_tps_sp_ext tps_sp_es /end OUT_MEASUREMENT
/end FUNCTION
/begin FUNCTION C_5_EOS "C_5_EOS"
 /begin SUB_FUNCTION EOS_General_engine_operating_states EOS_Basic_operating_states__LV_ST__LV_IS__LV_REQ_ISC__LV_PL__LV_PU___LV_PUC EOS_Basic_functions__FL___INF EOS_Auxiliary_start_functions EOS_Combustion_Management EOS_Catalyst_heating_functions EOS_Combustion_switch_request_to_homogeneous_stoichiometric_for_torque_plausibility_check EOS_Runtime_Optimization_by_Recurrence_Switch EOS_Aux_Start_Fct EOS_Combust_State_Manager EOS_Combust_Mode_Switch EOS_Lambda_Test_Stratified_Mode /end SUB_FUNCTION
/end FUNCTION
/begin FUNCTION EOS_General_engine_operating_states "_General engine operating states" /begin DEF_CHARACTERISTIC ip_n_max_tol_st /end DEF_CHARACTERISTIC /end FUNCTION
/begin FUNCTION EOS_Basic_operating_states__LV_ST__LV_IS__LV_REQ_ISC__LV_PL__LV_PU___LV_PUC "_Basic operating states: LV_ST, LV_IS, LV_REQ_ISC, LV_PL, LV_PU & LV_PUC"
 /begin DEF_CHARACTERISTIC ip_cyc_cast__tco c_n_max_bol_st c_t_min_pu c_t_max_pu lc_inh_dt_pu c_t_min_pu_msr c_t_min_pu_rng_l id_n_hys_max_puc__gr_at id_n_hys_max_puc__gr_mt id_n_hys_min_puc__gr_at id_n_hys_min_puc__gr_mt id_n_hys_puc_st__gr_at id_n_hys_puc_st__gr_mt c_cycnr_hys_puc c_cycnr_hys_puc_st c_tco_min_puc_st ip_n_min_puc__tco__gr_mt ip_n_accout_min_puc__tco__gr_mt ip_n_accout_min_puc__tco__gr_at c_n_dif_ast c_t_n_dif_ast ip_n_min_puc__tco__gr_at c_t_min_pu_vs c_vs_min_pu ip_t_min_pu__n__tco ip_t_min_pu_rng_l__n__tco ip_n_min_puc_add_ars ip_n_min_puc_add_pste_2 ip_n_dif_max_is /end DEF_CHARACTERISTIC
 /begin OUT_MEASUREMENT lv_es lv_st lv_st_end lv_is lv_pl lv_pu t_pu lv_puc lv_puc_req state_eng lv_iga_min_puc /end OUT_MEASUREMENT
/end FUNCTION
/begin FUNCTION EOS_Basic_functions__FL___INF "_Basic functions: FL, INF & REACX"
 /begin DEF_CHARACTERISTIC c_n_max_fl_dly c_n_min_fl_dly c_t_max_fl_dly c_t_ti_dly_fl_2 c_t_ti_dly_fl_at_1 c_t_ti_dly_fl_at_2 c_tco_min_fl c_vs_min_fl c_n_min_fl c_t_min_fl_dly c_t_ti_dly_fl_1 c_n_min_cp_fl c_cl_mmv_thd_fl ip_fac_tq_req_driv_fl ip_load_thd_fl c_fac_tq_req_fl_hys c_load_thd_fl_hys ldp_n_grd_n_max_inf ip_n_max_inf c_n_grd_min /end DEF_CHARACTERISTIC
 /begin OUT_MEASUREMENT lv_fl_raw lv_fl lv_inf /end OUT_MEASUREMENT
/end FUNCTION
/begin FUNCTION EOS_Auxiliary_start_functions "_Auxiliary start functions"
 /begin DEF_CHARACTERISTIC c_t_max_rest c_tco_dif_max_rest c_t_min_ecu_rest c_cyc_cast_min_st_es c_cyc_cast_max_st_es ip_n_bol_stall ip_n_tol_stall c_n_max_cdn_stall c_ctr_n_win_stall /end DEF_CHARACTERISTIC
 /begin OUT_MEASUREMENT lv_ast lv_rest cyc_cast t_st_es lv_st_es lv_stall t_ast_rest ctr_n_win_stall lv_wup_can t_ast t_ast_diag tco_rest /end OUT_MEASUREMENT
/end FUNCTION
/begin FUNCTION EOS_Combustion_Management "_Combustion_Management" /begin DEF_CHARACTERISTIC c_n_s_clc_hys c_n_afl_clc c_n_afl_clc_hys c_n_s_clc /end DEF_CHARACTERISTIC /begin OUT_MEASUREMENT lv_afl_clc lv_s_clc /end OUT_MEASUREMENT /end FUNCTION
/begin FUNCTION EOS_Catalyst_heating_functions "_Catalyst heating functions"
 /begin DEF_CHARACTERISTIC ip_t_ch_n_sp_is id_t_ch_ti ip_t_ch_ivvt ip_t_ch_tq_add ip_t_ch_tq_add_wout_cat ip_t_ch_tq_add_is ip_t_ch_tq_add_is_wout_cat /end DEF_CHARACTERISTIC
 /begin OUT_MEASUREMENT lv_ti_ch lv_ch lv_ch_n_sp_is lv_ch_ivvt lv_wup /end OUT_MEASUREMENT
/end FUNCTION
/begin FUNCTION EOS_Combustion_switch_request_to_homogeneous_stoichiometric_for_torque_plausibility_check "_Combustion switch request to homogeneous stoichiometric for torque plausibility check"
 /begin DEF_CHARACTERISTIC c_n_hom_act_thd c_n_hom_act_hys c_pv_hom_act_hys c_fac_tq_hom_act_hys c_t_max_tqi_plaus_swi /end DEF_CHARACTERISTIC
 /begin OUT_MEASUREMENT lv_tqi_plaus_hom_afs_req lv_tqi_plaus_hom_afs_act t_tqi_plaus_swi /end OUT_MEASUREMENT
/end FUNCTION
/begin FUNCTION EOS_Runtime_Optimization_by_Recurrence_Switch "_Runtime Optimization by Recurrence Switch" /begin DEF_CHARACTERISTIC c_n_seg_2_ena /end DEF_CHARACTERISTIC /begin OUT_MEASUREMENT lv_clc_2seg lv_clc_2seg_ena /end OUT_MEASUREMENT /end FUNCTION
/begin FUNCTION EOS_Aux_Start_Fct "" /begin OUT_MEASUREMENT cyc_st /end OUT_MEASUREMENT /end FUNCTION
/begin FUNCTION EOS_Combust_State_Manager "_Combust_State_Manager"
 /begin OUT_MEASUREMENT lv_iga_and_inj_swi_1 lv_iga_and_inj_swi_2 lv_s_run lv_hom_run lv_hom_afs_req lv_s_act state_cmb_ctl lv_iga_and_inj_swi lv_fup_sp_swi lv_hom_afl_act lv_hom_afs_act opm_av opm_req lv_sp_rate_cyl_egr_swi lv_hom_act lv_s_ena lv_hom_ena lv_mplh_ena lv_iga_and_inj_swi_homs_1 lv_iga_and_inj_swi_homs_2 lv_iga_and_inj_swi_homs /end OUT_MEASUREMENT
/end FUNCTION
/begin FUNCTION EOS_Combust_Mode_Switch "_Combust_Mode_Switch" /begin OUT_MEASUREMENT lv_inh_s lv_inh_afl /end OUT_MEASUREMENT /end FUNCTION
/begin FUNCTION EOS_Lambda_Test_Stratified_Mode "_Lambda_Test_Stratified_Mode"
 /begin DEF_CHARACTERISTIC c_hys_lamb_min_s c_crlc_lamb_sp_s c_lamb_sp_s_ini ip_lamb_min_s ldp_n_32__lamb_min_s ldp_tqi_req_fast__lamb_min_s c_fac_lamb_afs lc_lamb_sp_s_raw_ext /end DEF_CHARACTERISTIC
 /begin OUT_MEASUREMENT lv_auth_lamb_s lamb_sp_s_raw lamb_sp_s lamb_sp_s_ext /end OUT_MEASUREMENT
/end FUNCTION
/begin FUNCTION C_8_ISC "C_8_ISC"
 /begin SUB_FUNCTION ISC_Idle_speed_control ISC_Idle_speed_torque_reserve ISC_Application_Incidence_for_Idle_Speed_Control /end SUB_FUNCTION
/end FUNCTION
/end MODULE
/end PROJECT
