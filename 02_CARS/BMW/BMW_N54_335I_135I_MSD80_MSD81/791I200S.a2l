ASAP2_VERSION 1 41
/begin PROJECT MSD85 "Spray Guided DI-System with Piezo Injectors for 8-Cylinder"
/begin HEADER "_default_HeaderComment" PROJECT_NO _91 /end HEADER
/begin MODULE _default_ModuleName "_default_ModuleLongIdentifier"
/begin MOD_COMMON "_default_ModCommonComment" DEPOSIT ABSOLUTE BYTE_ORDER MSB_LAST ALIGNMENT_BYTE 1 ALIGNMENT_WORD 2 ALIGNMENT_LONG 2 ALIGNMENT_FLOAT32_IEEE 2 ALIGNMENT_FLOAT64_IEEE 4 /end MOD_COMMON
/begin MEASUREMENT err_ecraspwm_fb "The failure status of the failure feedback coming from the ECRAS control unit " UBYTE _CNV_A_R_LINEAR_____0_CM 1 100. 0. 8. DISPLAY_IDENTIFIER ERR_ECRASPWM_FB ECU_ADDRESS 0xd0008e56 FORMAT "%1.0" /end MEASUREMENT
/begin MEASUREMENT t_ecraspwm_fb "Timer counting tlow for failure feedback recognition" UBYTE _CNV_A_R_LINEAR_____4_CM 1 100. 0. 25.5 DISPLAY_IDENTIFIER T_ECRASPWM_FB ECU_ADDRESS 0xd0000ae4 FORMAT "%4.1" /end MEASUREMENT
/begin MEASUREMENT cdn_diag_ecras_el "Diagnosis condition for each symptom of ECRAS_EL	" UBYTE _CNV_A_R_LINEAR_____0_CM 1 100. 0. 7. DISPLAY_IDENTIFIER CDN_DIAG_ECRAS_EL ECU_ADDRESS 0xd0000ae5 FORMAT "%1.0" /end MEASUREMENT
/begin CHARACTERISTIC c_t_ecraspwm_fb_min_1 "Time range for identification of the ECRAS feedback 'diagnosis ability', min value " VALUE 0xa080c1a2 _REC_VAL_20_u1 25.5 _CNV_A_R_LINEAR_____4_CM 0. 25.5 DISPLAY_IDENTIFIER C_T_ECRASPWM_FB_MIN_1 FORMAT "%4.1" /end CHARACTERISTIC
/begin CHARACTERISTIC c_t_ecraspwm_fb_min_2 "Time range for identification of the ECRAS feedback 'elctrical failure ECRAS_UP', min value " VALUE 0xa080c1a3 _REC_VAL_20_u1 25.5 _CNV_A_R_LINEAR_____4_CM 0. 25.5 DISPLAY_IDENTIFIER C_T_ECRASPWM_FB_MIN_2 FORMAT "%4.1" /end CHARACTERISTIC
/begin CHARACTERISTIC c_t_ecraspwm_fb_min_3 "Time range for identification of the ECRAS feedback 'mechanical failure ECRAS_UP', min value " VALUE 0xa080c1a4 _REC_VAL_20_u1 25.5 _CNV_A_R_LINEAR_____4_CM 0. 25.5 DISPLAY_IDENTIFIER C_T_ECRASPWM_FB_MIN_3 FORMAT "%4.1" /end CHARACTERISTIC
/begin CHARACTERISTIC c_t_ecraspwm_fb_min_4 "Time range for identification of the ECRAS feedback 'electrical failure ECRAS_DOWN', min value " VALUE 0xa080c1a5 _REC_VAL_20_u1 25.5 _CNV_A_R_LINEAR_____4_CM 0. 25.5 DISPLAY_IDENTIFIER C_T_ECRASPWM_FB_MIN_4 FORMAT "%4.1" /end CHARACTERISTIC
/begin CHARACTERISTIC c_t_ecraspwm_fb_min_5 "Time range for identification of the ECRAS feedback 'electrical failure ECRAS_UP/_DOWN', min value " VALUE 0xa080c1a6 _REC_VAL_20_u1 25.5 _CNV_A_R_LINEAR_____4_CM 0. 25.5 DISPLAY_IDENTIFIER C_T_ECRASPWM_FB_MIN_5 FORMAT "%4.1" /end CHARACTERISTIC
/begin CHARACTERISTIC c_t_ecraspwm_fb_min_6 "Time range for identification of the ECRAS feedback 'mech. failure ECRAS_UP, el. ECRAS_DOWN', min value " VALUE 0xa080c1a7 _REC_VAL_20_u1 25.5 _CNV_A_R_LINEAR_____4_CM 0. 25.5 DISPLAY_IDENTIFIER C_T_ECRASPWM_FB_MIN_6 FORMAT "%4.1" /end CHARACTERISTIC
/begin CHARACTERISTIC c_t_ecraspwm_fb_max "C_T_ECRASPWM_FB_MAX" VALUE 0xa080c19b _REC_VAL_20_u1 25.5 _CNV_A_R_LINEAR_____4_CM 0. 25.5 DISPLAY_IDENTIFIER C_T_ECRASPWM_FB_MAX FORMAT "%4.1" /end CHARACTERISTIC
/begin CHARACTERISTIC c_t_ecraspwm_fb_max_1 "Time range for identification of the ECRAS feedback 'diagnosis ability', max value" VALUE 0xa080c19c _REC_VAL_20_u1 25.5 _CNV_A_R_LINEAR_____4_CM 0. 25.5 DISPLAY_IDENTIFIER C_T_ECRASPWM_FB_MAX_1 FORMAT "%4.1" /end CHARACTERISTIC
/begin CHARACTERISTIC c_t_ecraspwm_fb_max_2 "Time range for identification of the ECRAS feedback 'elctrical failure ECRAS_UP', max value" VALUE 0xa080c19d _REC_VAL_20_u1 25.5 _CNV_A_R_LINEAR_____4_CM 0. 25.5 DISPLAY_IDENTIFIER C_T_ECRASPWM_FB_MAX_2 FORMAT "%4.1" /end CHARACTERISTIC
/begin CHARACTERISTIC c_t_ecraspwm_fb_max_3 "Time range for identification of the ECRAS feedback 'mechanical failure ECRAS_UP', max value" VALUE 0xa080c19e _REC_VAL_20_u1 25.5 _CNV_A_R_LINEAR_____4_CM 0. 25.5 DISPLAY_IDENTIFIER C_T_ECRASPWM_FB_MAX_3 FORMAT "%4.1" /end CHARACTERISTIC
/begin CHARACTERISTIC c_t_ecraspwm_fb_max_4 "Time range for identification of the ECRAS feedback 'electrical failure ECRAS_DOWN', max value" VALUE 0xa080c19f _REC_VAL_20_u1 25.5 _CNV_A_R_LINEAR_____4_CM 0. 25.5 DISPLAY_IDENTIFIER C_T_ECRASPWM_FB_MAX_4 FORMAT "%4.1" /end CHARACTERISTIC
/begin CHARACTERISTIC c_t_ecraspwm_fb_max_5 "Time range for identification of the ECRAS feedback 'electrical failure ECRAS_UP/_DOWN', max value" VALUE 0xa080c1a0 _REC_VAL_20_u1 25.5 _CNV_A_R_LINEAR_____4_CM 0. 25.5 DISPLAY_IDENTIFIER C_T_ECRASPWM_FB_MAX_5 FORMAT "%4.1" /end CHARACTERISTIC
/begin CHARACTERISTIC c_t_ecraspwm_fb_max_6 "Time range for identification of the ECRAS feedback 'mech. failure ECRAS_UP, el. ECRAS_DOWN', max value" VALUE 0xa080c1a1 _REC_VAL_20_u1 25.5 _CNV_A_R_LINEAR_____4_CM 0. 25.5 DISPLAY_IDENTIFIER C_T_ECRASPWM_FB_MAX_6 FORMAT "%4.1" /end CHARACTERISTIC
/begin CHARACTERISTIC c_abc_inc_ecras_el "Antibounce counter increment" VALUE 0xa080b935 _REC_VAL_20_u1 255. _CNV_A_R_LINEAR_____0_CM 0. 255. DISPLAY_IDENTIFIER C_ABC_INC_ECRAS_EL FORMAT "%3.0" /end CHARACTERISTIC
/begin CHARACTERISTIC c_abc_max_ecras_el "Maximum value for antibounce counter" VALUE 0xa080b9fd _REC_VAL_20_u1 254. _CNV_A_R_LINEAR_____0_CM 1. 255. DISPLAY_IDENTIFIER C_ABC_MAX_ECRAS_EL FORMAT "%3.0" /end CHARACTERISTIC
/begin CHARACTERISTIC c_abc_inc_ecras_up_fb "anti bounce counter increment for ECRAS_UP diagnosis " VALUE 0xa080b936 _REC_VAL_20_u1 255. _CNV_A_R_LINEAR_____0_CM 0. 255. DISPLAY_IDENTIFIER C_ABC_INC_ECRAS_UP_FB FORMAT "%3.0" /end CHARACTERISTIC
/begin CHARACTERISTIC c_abc_max_ecras_up_fb "maximal value of anti bounce counter for ECRAS_UP diagnosis " VALUE 0xa080b9fe _REC_VAL_20_u1 254. _CNV_A_R_LINEAR_____0_CM 1. 255. DISPLAY_IDENTIFIER C_ABC_MAX_ECRAS_UP_FB FORMAT "%3.0" /end CHARACTERISTIC
/begin CHARACTERISTIC c_abc_inc_ecras_down_fb "anti bounce counter increment for ECRAS_DOWN diagnosis " VALUE 0xa080b934 _REC_VAL_20_u1 255. _CNV_A_R_LINEAR_____0_CM 0. 255. DISPLAY_IDENTIFIER C_ABC_INC_ECRAS_DOWN_FB FORMAT "%3.0" /end CHARACTERISTIC
/begin CHARACTERISTIC c_abc_max_ecras_down_fb "maximal value of anti bounce counter for ECRAS_DOWN diagnosis " VALUE 0xa080b9fc _REC_VAL_20_u1 254. _CNV_A_R_LINEAR_____0_CM 1. 255. DISPLAY_IDENTIFIER C_ABC_MAX_ECRAS_DOWN_FB FORMAT "%3.0" /end CHARACTERISTIC
/begin CHARACTERISTIC c_t_diag_ecras "Maximum waiting time for answer of ECRAS control unit" VALUE 0xa080c160 _REC_VAL_20_u1 25.5 _CNV_A_R_LINEAR_____4_CM 0. 25.5 DISPLAY_IDENTIFIER C_T_DIAG_ECRAS FORMAT "%4.1" /end CHARACTERISTIC
/begin CHARACTERISTIC c_t_ecras_down_det "Time window for diagnosis / learning of ECRAS_DOWN " VALUE 0xa080c199 _REC_VAL_20_u1 25.5 _CNV_A_R_LINEAR_____4_CM 0. 25.5 DISPLAY_IDENTIFIER C_T_ECRAS_DOWN_DET FORMAT "%4.1" /end CHARACTERISTIC
/begin CHARACTERISTIC c_t_min_ecras_down_det "Time range for identification of the ECRAS feedback SCG or normal PWM, min value" VALUE 0xa080c21f _REC_VAL_20_u1 25.5 _CNV_A_R_LINEAR_____4_CM 0. 25.5 DISPLAY_IDENTIFIER C_T_MIN_ECRAS_DOWN_DET FORMAT "%4.1" /end CHARACTERISTIC
/begin CHARACTERISTIC c_t_max_ecras_down_det "Time range for identification of the ECRAS feedback SCG or normal PWM, max value" VALUE 0xa080c1eb _REC_VAL_20_u1 25.5 _CNV_A_R_LINEAR_____4_CM 0. 25.5 DISPLAY_IDENTIFIER C_T_MAX_ECRAS_DOWN_DET FORMAT "%4.1" /end CHARACTERISTIC
/begin CHARACTERISTIC c_ctr_ecras_down_det "Counter threshold for detection of ECRAS_DOWN" VALUE 0xa080bb86 _REC_VAL_20_u1 255. _CNV_A_R_LINEAR_____0_CM 0. 255. DISPLAY_IDENTIFIER C_CTR_ECRAS_DOWN_DET FORMAT "%3.0" /end CHARACTERISTIC
/begin CHARACTERISTIC c_ecraspwm_diag_min_scp "Minimum duty cycle threshold of ECRAS_EL for electrical ECRAS diagnosis" VALUE 0xa080bc59 _REC_VAL_20_u1 99.609375 _CNV_A_R_LINEAR_____5_CM 0. 99.609375 DISPLAY_IDENTIFIER C_ECRASPWM_DIAG_MIN_SCP FORMAT "%9.6" /end CHARACTERISTIC
/begin CHARACTERISTIC c_ecraspwm_diag_max_scg "Maximum duty cycle threshold of ECRAS_EL for electrical ECRAS diagnosis" VALUE 0xa080bc57 _REC_VAL_20_u1 99.609375 _CNV_A_R_LINEAR_____5_CM 0. 99.609375 DISPLAY_IDENTIFIER C_ECRASPWM_DIAG_MAX_SCG FORMAT "%9.6" /end CHARACTERISTIC
/begin CHARACTERISTIC c_ecraspwm_diag_min_oc "Minimum duty cycle threshold of ECRAS_EL for electrical ECRAS diagnosis" VALUE 0xa080bc58 _REC_VAL_20_u1 99.609375 _CNV_A_R_LINEAR_____5_CM 0. 99.609375 DISPLAY_IDENTIFIER C_ECRASPWM_DIAG_MIN_OC FORMAT "%9.6" /end CHARACTERISTIC
/begin CHARACTERISTIC c_abc_ecraspwm_fb "If C_ABC_ECRASPWM_FB  times sequentially a failure feedback for the same failure is detected, the failure LV_ERR_ECRASPWM_FB  is set." VALUE 0xa080b8d1 _REC_VAL_20_u1 254. _CNV_A_R_LINEAR_____0_CM 1. 255. DISPLAY_IDENTIFIER C_ABC_ECRASPWM_FB FORMAT "%3.0" /end CHARACTERISTIC
/begin CHARACTERISTIC c_ecraspwm_min_fb "Minimum duty cycle of ECRASPWM to have a failure feedback from ECRAS control unit" VALUE 0xa080bc5b _REC_VAL_20_u1 99.609375 _CNV_A_R_LINEAR_____5_CM 0. 99.609375 DISPLAY_IDENTIFIER C_ECRASPWM_MIN_FB FORMAT "%9.6" /end CHARACTERISTIC
/begin CHARACTERISTIC c_t_act_ecraspwm_fb "Minimum time necessary to have failure feedback from ECRAS control unit" VALUE 0xa080c10c _REC_VAL_20_u2 6553.5 _CNV_A_R_LINEAR_____4_CM 0. 6553.5 DISPLAY_IDENTIFIER C_T_ACT_ECRASPWM_FB FORMAT "%6.1" /end CHARACTERISTIC
/begin MEASUREMENT lv_err_ecras_el "Boolean for error currently present on ECRAS command signal" UBYTE _CNV_S_2_RANGE__0___1_CM 1 100. 0. 1. DISPLAY_IDENTIFIER LV_ERR_ECRAS_EL ECU_ADDRESS 0xd0008023 BIT_MASK 0x1 /end MEASUREMENT
/begin MEASUREMENT lv_err_ecras "Boolean for error currently present on ECRAS command signal." UBYTE _CNV_S_2_RANGE__0___1_CM 1 100. 0. 1. DISPLAY_IDENTIFIER LV_ERR_ECRAS ECU_ADDRESS 0xd0008e57 BIT_MASK 0x1 /end MEASUREMENT
/begin MEASUREMENT lv_err_ecraspwm_fb "Error currently present, indicated by failure feedback from ECRAS control unit" UBYTE _CNV_S_2_RANGE__0___1_CM 1 100. 0. 1. DISPLAY_IDENTIFIER LV_ERR_ECRASPWM_FB ECU_ADDRESS 0xd0008022 BIT_MASK 0x1 /end MEASUREMENT
/begin MEASUREMENT err_diag_ecraspwm "Raw value of error symptom for ECRASPWM detected on interface ECU and ECRAS control unit	" UBYTE _CNV_A_R_LINEAR_____0_CM 1 100. 0. 8. DISPLAY_IDENTIFIER ERR_DIAG_ECRASPWM ECU_ADDRESS 0xd0008e54 FORMAT "%1.0" /end MEASUREMENT
/begin MEASUREMENT lv_intr_diag_ecras_el "Boolean for irreversible interrupt of ECARS_EL diagnosis" UBYTE _CNV_S_2_RANGE__0___1_CM 1 100. 0. 1. DISPLAY_IDENTIFIER LV_INTR_DIAG_ECRAS_EL ECU_ADDRESS 0xd0008e58 BIT_MASK 0x1 /end MEASUREMENT
/begin CHARACTERISTIC c_vs_max_ecras_diag "Maximum VS treshold for deactivation for electrical ECRAS diagnosis" VALUE 0xa080c4cc _REC_VAL_20_u1 255. _CNV_A_R_LINEAR_____6_CM 0. 255. DISPLAY_IDENTIFIER C_VS_MAX_ECRAS_DIAG FORMAT "%3.0" /end CHARACTERISTIC
/begin MEASUREMENT lv_ecras_fb_det "Change from short circuit to ground to normal PWM signal detected (bit 1 ERR_DIAG_ECRASPWM 1->0)" UBYTE _CNV_S_2_RANGE__0___1_CM 1 100. 0. 1. DISPLAY_IDENTIFIER LV_ECRAS_FB_DET ECU_ADDRESS 0xd0000aee BIT_MASK 0x1 /end MEASUREMENT
/begin MEASUREMENT lv_err_ecras_up_fb "ECRAS_UP error currently present, indicated by failure feedback from ECRAS control unit" UBYTE _CNV_S_2_RANGE__0___1_CM 1 100. 0. 1. DISPLAY_IDENTIFIER LV_ERR_ECRAS_UP_FB ECU_ADDRESS 0xd0008024 BIT_MASK 0x1 /end MEASUREMENT
/begin MEASUREMENT lv_err_ecras_down_fb "ECRAS_DOWN error currently present, indicated by failure feedback from ECRAS control unit." UBYTE _CNV_S_2_RANGE__0___1_CM 1 100. 0. 1. DISPLAY_IDENTIFIER LV_ERR_ECRAS_DOWN_FB ECU_ADDRESS 0xd0008025 BIT_MASK 0x1 /end MEASUREMENT
/begin MEASUREMENT lv_diag_ecras "Diagnosis mode of ECRAS control unit activated (10% PWM)" UBYTE _CNV_S_2_RANGE__0___1_CM 1 100. 0. 1. DISPLAY_IDENTIFIER LV_DIAG_ECRAS ECU_ADDRESS 0xd0008e59 BIT_MASK 0x1 /end MEASUREMENT
/begin MEASUREMENT lv_diag_ecras_end "Diagnosis mode feedback of ECRAS control unit received (diagnosis ability of ECRAS detected)" UBYTE _CNV_S_2_RANGE__0___1_CM 1 100. 0. 1. DISPLAY_IDENTIFIER LV_DIAG_ECRAS_END ECU_ADDRESS 0xd0008e5a BIT_MASK 0x1 /end MEASUREMENT
/begin MEASUREMENT lv_edge_ecras_up "Detected change in LV_ECRAS_UP_1" UBYTE _CNV_S_2_RANGE__0___1_CM 1 100. 0. 1. DISPLAY_IDENTIFIER LV_EDGE_ECRAS_UP ECU_ADDRESS 0xd0000aef BIT_MASK 0x1 /end MEASUREMENT
/begin MEASUREMENT lv_edge_ecras_down "Detected change in LV_ECRAS_DOWN_1" UBYTE _CNV_S_2_RANGE__0___1_CM 1 100. 0. 1. DISPLAY_IDENTIFIER LV_EDGE_ECRAS_DOWN ECU_ADDRESS 0xd0000af0 BIT_MASK 0x1 /end MEASUREMENT
/begin MEASUREMENT lv_ecras_fb_diag "Feedback of ECRAS control unit or timeout detected" UBYTE _CNV_S_2_RANGE__0___1_CM 1 100. 0. 1. DISPLAY_IDENTIFIER LV_ECRAS_FB_DIAG ECU_ADDRESS 0xd0000af1 BIT_MASK 0x1 /end MEASUREMENT
/begin MEASUREMENT lv_ecras_down_det_rst "Reset learning of ECRAS_DOWN" UBYTE _CNV_S_2_RANGE__0___1_CM 1 100. 0. 1. DISPLAY_IDENTIFIER LV_ECRAS_DOWN_DET_RST ECU_ADDRESS 0xd0000af2 BIT_MASK 0x1 /end MEASUREMENT
/begin MEASUREMENT lv_diag_ecras_err_end "Diagnosis mode feedback of ECRAS control unit not received (diagnosis ability of ECRAS not detected)" UBYTE _CNV_S_2_RANGE__0___1_CM 1 100. 0. 1. DISPLAY_IDENTIFIER LV_DIAG_ECRAS_ERR_END ECU_ADDRESS 0xd0008e5b BIT_MASK 0x1 /end MEASUREMENT
/begin MEASUREMENT lv_var_ecras_down "ECRAS_DOWN flap of ECRAS system detected (2 flap system)" UBYTE _CNV_S_2_RANGE__0___1_CM 1 100. 0. 1. DISPLAY_IDENTIFIER LV_VAR_ECRAS_DOWN ECU_ADDRESS 0xd0008e5c BIT_MASK 0x1 /end MEASUREMENT
/begin MEASUREMENT lv_ecras_down_det_set "Diagnosis / learning of ECRAS_DOWN run through one-time" UBYTE _CNV_S_2_RANGE__0___1_CM 1 100. 0. 1. DISPLAY_IDENTIFIER LV_ECRAS_DOWN_DET_SET ECU_ADDRESS 0xd0008e5d BIT_MASK 0x1 /end MEASUREMENT
/begin MEASUREMENT lv_ecras_down_det_act "Bit indicating learning of ECRAS_DOWN" UBYTE _CNV_S_2_RANGE__0___1_CM 1 100. 0. 1. DISPLAY_IDENTIFIER LV_ECRAS_DOWN_DET_ACT ECU_ADDRESS 0xd0008e5e BIT_MASK 0x1 /end MEASUREMENT
/begin MEASUREMENT t_diag_ecras "Timer for waiting of answer of ECRAS control unit " UBYTE _CNV_A_R_LINEAR_____4_CM 1 100. 0. 25.5 DISPLAY_IDENTIFIER T_DIAG_ECRAS ECU_ADDRESS 0xd0000ae8 FORMAT "%4.1" /end MEASUREMENT
/begin MEASUREMENT t_ecras_down_det "Timer for learning of ECRAS_DOWN" UBYTE _CNV_A_R_LINEAR_____4_CM 1 100. 0. 25.5 DISPLAY_IDENTIFIER T_ECRAS_DOWN_DET ECU_ADDRESS 0xd0000ae9 FORMAT "%4.1" /end MEASUREMENT
/begin MEASUREMENT t_ecras_down_det_neg "Timer indicating time since start of short circuit to ground phase of ECRASPWM" UBYTE _CNV_A_R_LINEAR_____4_CM 1 100. 0. 25.5 DISPLAY_IDENTIFIER T_ECRAS_DOWN_DET_NEG ECU_ADDRESS 0xd0000aea FORMAT "%4.1" /end MEASUREMENT
/begin MEASUREMENT t_ecras_down_det_pos "Timer indicating time since start of normal ECRASPWM signal (no SCG)" UBYTE _CNV_A_R_LINEAR_____4_CM 1 100. 0. 25.5 DISPLAY_IDENTIFIER T_ECRAS_DOWN_DET_POS ECU_ADDRESS 0xd0000aeb FORMAT "%4.1" /end MEASUREMENT
/begin MEASUREMENT ctr_ecras_down_det "Counter for detecting ECRAS_DOWN" UBYTE _CNV_A_R_LINEAR_____0_CM 1 100. 0. 255. DISPLAY_IDENTIFIER CTR_ECRAS_DOWN_DET ECU_ADDRESS 0xd0000aec FORMAT "%3.0" /end MEASUREMENT
/begin MEASUREMENT state_ecras_fb "State of the received feedback from ECRAS control unit" UBYTE _CNV_S_7_STATE_ECRA_7_CM 1 100. 0. 6. DISPLAY_IDENTIFIER STATE_ECRAS_FB ECU_ADDRESS 0xd0000ae7 /end MEASUREMENT
/begin CHARACTERISTIC c_n_max_fl_dly "Maximum engine speed for Full load recognition" VALUE 0xa080bf8a _REC_VAL_20_u1 8160. _CNV_A_R_LINEAR_____10_CM 0. 8160. DISPLAY_IDENTIFIER C_N_MAX_FL_DLY FORMAT "%4.0" /end CHARACTERISTIC
/begin CHARACTERISTIC c_n_min_fl_dly "Minimum engine speed for Full load recognition" VALUE 0xa080bf9a _REC_VAL_20_u1 8160. _CNV_A_R_LINEAR_____10_CM 0. 8160. DISPLAY_IDENTIFIER C_N_MIN_FL_DLY FORMAT "%4.0" /end CHARACTERISTIC
/begin CHARACTERISTIC c_t_max_fl_dly "Time after Start- Threshold value for Full load recognition" VALUE 0xa080c1f0 _REC_VAL_20_u2 6553.5 _CNV_A_R_LINEAR_____4_CM 0. 6553.5 DISPLAY_IDENTIFIER C_T_MAX_FL_DLY FORMAT "%5.1" /end CHARACTERISTIC
/begin CHARACTERISTIC c_t_ti_dly_fl_2 "Delay time Full load" VALUE 0xa080c284 _REC_VAL_20_u2 655.35 _CNV_A_R_LINEAR_____3_CM 0. 655.35 DISPLAY_IDENTIFIER C_T_TI_DLY_FL_2 FORMAT "%6.2" /end CHARACTERISTIC
/begin CHARACTERISTIC c_t_ti_dly_fl_at_1 "Delay time Full load AT" VALUE 0xa080c286 _REC_VAL_20_u2 655.35 _CNV_A_R_LINEAR_____3_CM 0. 655.35 DISPLAY_IDENTIFIER C_T_TI_DLY_FL_AT_1 FORMAT "%6.2" /end CHARACTERISTIC
/begin CHARACTERISTIC c_t_ti_dly_fl_at_2 "Delay time Full load AT" VALUE 0xa080c288 _REC_VAL_20_u2 655.35 _CNV_A_R_LINEAR_____3_CM 0. 655.35 DISPLAY_IDENTIFIER C_T_TI_DLY_FL_AT_2 FORMAT "%6.2" /end CHARACTERISTIC
/begin CHARACTERISTIC c_tco_min_fl "Minimum temperature for FL" VALUE 0xa080c2d5 _REC_VAL_20_u1 28.575 _CNV_A_R_LINEAR_____17_CM -48. 142.5 DISPLAY_IDENTIFIER C_TCO_MIN_FL FORMAT "%5.1" /end CHARACTERISTIC
/begin CHARACTERISTIC c_vs_min_fl "Minimum velocity for FL" VALUE 0xa080c4dd _REC_VAL_20_u1 25.5 _CNV_A_R_LINEAR_____6_CM 0. 255. DISPLAY_IDENTIFIER C_VS_MIN_FL FORMAT "%3.0" /end CHARACTERISTIC
/begin MEASUREMENT lv_fl_raw "LV condition a) is fullfilled" UBYTE _CNV_S_2_RANGE__0___1_CM 1 100. 0. 1. DISPLAY_IDENTIFIER LV_FL_RAW ECU_ADDRESS 0xd0008c09 BIT_MASK 0x1 /end MEASUREMENT
/begin MEASUREMENT lv_fl "Basic function FL" UBYTE _CNV_S_2_RANGE__0___1_CM 1 100. 0. 1. DISPLAY_IDENTIFIER LV_FL ECU_ADDRESS 0xd0008c08 BIT_MASK 0x1 /end MEASUREMENT
/begin CHARACTERISTIC c_n_min_fl "Minimum engine speed for FL" VALUE 0xa080bf99 _REC_VAL_20_u1 816. _CNV_A_R_LINEAR_____10_CM 0. 8160. DISPLAY_IDENTIFIER C_N_MIN_FL FORMAT "%4.0" /end CHARACTERISTIC
/begin CHARACTERISTIC c_t_min_fl_dly "Time after Start- Threshold for Full load recognition" VALUE 0xa080c222 _REC_VAL_20_u2 6553.5 _CNV_A_R_LINEAR_____4_CM 0. 6553.5 DISPLAY_IDENTIFIER C_T_MIN_FL_DLY FORMAT "%5.1" /end CHARACTERISTIC
/begin MEASUREMENT lv_inf "Basic function \" Intercept \"" UBYTE _CNV_S_2_RANGE__0___1_CM 1 100. 0. 1. DISPLAY_IDENTIFIER LV_INF ECU_ADDRESS 0xd0008c0a BIT_MASK 0x1 /end MEASUREMENT
/begin CHARACTERISTIC c_t_ti_dly_fl_1 "Delay time Full load" VALUE 0xa080c282 _REC_VAL_20_u2 655.35 _CNV_A_R_LINEAR_____3_CM 0. 655.35 DISPLAY_IDENTIFIER C_T_TI_DLY_FL_1 FORMAT "%6.2" /end CHARACTERISTIC
/begin CHARACTERISTIC c_n_min_cp_fl "Minimum engine speed for FL at high canister purge load" VALUE 0xa080bf94 _REC_VAL_20_u1 8160. _CNV_A_R_LINEAR_____10_CM 0. 8160. DISPLAY_IDENTIFIER C_N_MIN_CP_FL FORMAT "%4.0" /end CHARACTERISTIC
/begin CHARACTERISTIC c_cl_mmv_thd_fl "threshold for high canister load" VALUE 0xa080baaa _REC_VAL_20_u2 1.99996948242188 _CNV_A_R_LINEAR_____9_CM 0. 1.99996948242188 DISPLAY_IDENTIFIER C_CL_MMV_THD_FL FORMAT "%7.5" /end CHARACTERISTIC
/begin AXIS_PTS ldpm_n_2_3 "" 0xa080958c n _REC_AXS_20_u2 816. _CNV_A_R_LINEAR_____14_CM 16 0. 8160. FORMAT "%4.0" /end AXIS_PTS
/begin CHARACTERISTIC ip_fac_tq_req_driv_fl "Driver wish threshold for full load recognition" CURVE 0xa080abdc _REC_CUR_20_u2_u2 1.99996948242188 _CNV_A_R_LINEAR_____9_CM 0. 1.99996948242188 DISPLAY_IDENTIFIER IP_FAC_TQ_REQ_DRIV_FL FORMAT "%7.5"
 /begin AXIS_DESCR COM_AXIS n _CNV_A_R_LINEAR_____14_CM 16 0. 8160. FORMAT "%4.0" AXIS_PTS_REF ldpm_n_2_3 /end AXIS_DESCR
/end CHARACTERISTIC
/begin CHARACTERISTIC ip_load_thd_fl "Load threshold for Full load recognition" CURVE 0xa080ae88 _REC_CUR_20_u2_u2 3.99993896484375 _CNV_A_R_LINEAR_____24_CM 0. 3.99993896484375 DISPLAY_IDENTIFIER IP_LOAD_THD_FL FORMAT "%7.5"
 /begin AXIS_DESCR COM_AXIS n _CNV_A_R_LINEAR_____14_CM 16 0. 8160. FORMAT "%4.0" AXIS_PTS_REF ldpm_n_2_3 /end AXIS_DESCR
/end CHARACTERISTIC
/begin CHARACTERISTIC c_fac_tq_req_fl_hys "Hysteresis for driver wish threshold for Full load recognition" VALUE 0xa080bd18 _REC_VAL_20_u2 1.99996948242188 _CNV_A_R_LINEAR_____9_CM 0. 1.99996948242188 DISPLAY_IDENTIFIER C_FAC_TQ_REQ_FL_HYS FORMAT "%7.5" /end CHARACTERISTIC
/begin CHARACTERISTIC c_load_thd_fl_hys "Hysteresis for load threshold for Full load recognition" VALUE 0xa080be1a _REC_VAL_20_u2 3.99993896484375 _CNV_A_R_LINEAR_____24_CM 0. 3.99993896484375 DISPLAY_IDENTIFIER C_LOAD_THD_FL_HYS FORMAT "%7.5" /end CHARACTERISTIC
/begin AXIS_PTS ldp_n_grd_n_max_inf "" 0xa0808b20 n_grd _REC_AXS_20_u1 4096. _CNV_A_R_LINEAR_____29_CM 6 -4096. 0. FORMAT "%5.0" /end AXIS_PTS
/begin CHARACTERISTIC ip_n_max_inf "Maximum engine speed for intercept function" CURVE 0xa080b0ac _REC_CUR_20_u1_u1 8160. _CNV_A_R_LINEAR_____10_CM 0. 8160. DISPLAY_IDENTIFIER IP_N_MAX_INF FORMAT "%4.0"
 /begin AXIS_DESCR COM_AXIS n_grd _CNV_A_R_LINEAR_____29_CM 6 -4096. 0. FORMAT "%5.0" AXIS_PTS_REF ldp_n_grd_n_max_inf /end AXIS_DESCR
/end CHARACTERISTIC
/begin CHARACTERISTIC c_n_grd_min "engine speed  gradient threshold for activating the intercept function" VALUE 0xa080bf33 _REC_VAL_20_s1 204.8 _CNV_A_R_LINEAR_____30_CM -4096. 0. DISPLAY_IDENTIFIER C_N_GRD_MIN FORMAT "%7.0" /end CHARACTERISTIC
/begin MEASUREMENT lv_ti_ch "Auxiliary Function \" Catalyst Heating Injection\"." UBYTE _CNV_S_2_RANGE__0___1_CM 1 100. 0. 1. DISPLAY_IDENTIFIER LV_TI_CH ECU_ADDRESS 0xd0008c0d BIT_MASK 0x1 /end MEASUREMENT
/begin MEASUREMENT lv_ch_n_sp_is "Catalyst Heating Function \"increased idle speed setpoint\"" UBYTE _CNV_S_2_RANGE__0___1_CM 1 100. 0. 1. DISPLAY_IDENTIFIER LV_CH_N_SP_IS ECU_ADDRESS 0xd0008c0c BIT_MASK 0x1 /end MEASUREMENT
/begin MEASUREMENT lv_wup "Warm up functions active" UBYTE _CNV_S_2_RANGE__0___1_CM 1 100. 0. 1. DISPLAY_IDENTIFIER LV_WUP ECU_ADDRESS 0xd0008c0e BIT_MASK 0x1 /end MEASUREMENT
/begin CHARACTERISTIC c_maf_cs_diag "MAF threshold for error detection" VALUE 0xa080be1e _REC_VAL_20_u2 1389. _CNV_A_R_LINEAR_____111_CM 0. 1389. DISPLAY_IDENTIFIER C_MAF_CS_DIAG FORMAT "%7.2" /end CHARACTERISTIC
/begin CHARACTERISTIC c_n_32_cs_diag "N32 threshold for error detection" VALUE 0xa080befb _REC_VAL_20_u1 8160. _CNV_A_R_LINEAR_____10_CM 0. 8160. DISPLAY_IDENTIFIER C_N_32_CS_DIAG FORMAT "%4.0" /end CHARACTERISTIC
/begin MEASUREMENT lv_err_cs "Active CS error" UBYTE _CNV_S_2_RANGE__0___1_CM 1 100. 0. 1. DISPLAY_IDENTIFIER LV_ERR_CS ECU_ADDRESS 0xd0007f90 BIT_MASK 0x1 /end MEASUREMENT
/begin MEASUREMENT lv_cs_diag "Flag set when vehicle was stopped = pre-condition for diagnosis cycle" UBYTE _CNV_S_2_RANGE__0___1_CM 1 100. 0. 1. DISPLAY_IDENTIFIER LV_CS_DIAG ECU_ADDRESS 0xd0000589 BIT_MASK 0x1 /end MEASUREMENT
/begin MEASUREMENT lv_cs_swi "Flag set when CS change its state" UBYTE _CNV_S_2_RANGE__0___1_CM 1 100. 0. 1. DISPLAY_IDENTIFIER LV_CS_SWI ECU_ADDRESS 0xd000058a BIT_MASK 0x1 /end MEASUREMENT
/begin MEASUREMENT t_min_maf_cs_diag "Minimum diagnosis time for MAF condition" UBYTE _CNV_A_R_LINEAR_____36_CM 1 100. 0. 255. DISPLAY_IDENTIFIER T_MIN_MAF_CS_DIAG ECU_ADDRESS 0xd0000588 FORMAT "%3.0" /end MEASUREMENT
/begin CHARACTERISTIC c_vs_cs_diag "Speed threshold for activation of diagnosis cycle" VALUE 0xa080c48e _REC_VAL_20_u1 255. _CNV_A_R_LINEAR_____6_CM 0. 255. DISPLAY_IDENTIFIER C_VS_CS_DIAG FORMAT "%3.0" /end CHARACTERISTIC
/begin CHARACTERISTIC c_t_min_maf_cs_diag "Minimum diagnosis time for MAF condition" VALUE 0xa080c224 _REC_VAL_20_u1 255. _CNV_A_R_LINEAR_____36_CM 0. 255. DISPLAY_IDENTIFIER C_T_MIN_MAF_CS_DIAG FORMAT "%3.0" /end CHARACTERISTIC
/begin MEASUREMENT lv_es "Engine operating state \"Engine stopped\"" UBYTE _CNV_S_2_RANGE__0___1_CM 1 100. 0. 1. DISPLAY_IDENTIFIER LV_ES ECU_ADDRESS 0xd0008c12 BIT_MASK 0x1 /end MEASUREMENT
/begin MEASUREMENT lv_st "Engine operating state \"Start\"" UBYTE _CNV_S_2_RANGE__0___1_CM 1 100. 0. 1. DISPLAY_IDENTIFIER LV_ST ECU_ADDRESS 0xd0008c13 BIT_MASK 0x1 /end MEASUREMENT
/begin MEASUREMENT lv_st_end "Engine operating state \"Start\" not active" UBYTE _CNV_S_2_RANGE__0___1_CM 1 100. 0. 1. DISPLAY_IDENTIFIER LV_ST_END ECU_ADDRESS 0xd0008c14 BIT_MASK 0x1 /end MEASUREMENT
/begin CHARACTERISTIC ip_cyc_cast__tco "Cycle counter to define the duration of the start phase characterised by LV_ST" CURVE 0xa080a104 _REC_CUR_20_u2_u1 65535. _CNV_A_R_LINEAR_____0_CM 0. 65535. DISPLAY_IDENTIFIER IP_CYC_CAST__TCO FORMAT "%5.0"
 /begin AXIS_DESCR COM_AXIS tco _CNV_A_R_LINEAR_____17_CM 9 -48. 142.5 FORMAT "%5.1" AXIS_PTS_REF ldpm_tco_9 /end AXIS_DESCR
/end CHARACTERISTIC
/begin MEASUREMENT lv_is "Engine operating state \"Idle Speed\"" UBYTE _CNV_S_2_RANGE__0___1_CM 1 100. 0. 1. DISPLAY_IDENTIFIER LV_IS ECU_ADDRESS 0xd0008c15 BIT_MASK 0x1 /end MEASUREMENT
/begin CHARACTERISTIC c_n_max_bol_st "Engine speed threshold to detect LV_ST or LV_PL from LV_IS" VALUE 0xa080bf5f _REC_VAL_20_u1 408. _CNV_A_R_LINEAR_____10_CM 0. 8160. DISPLAY_IDENTIFIER C_N_MAX_BOL_ST FORMAT "%4.0" /end CHARACTERISTIC
/begin MEASUREMENT lv_pl "Engine operating state „Part Load\"" UBYTE _CNV_S_2_RANGE__0___1_CM 1 100. 0. 1. DISPLAY_IDENTIFIER LV_PL ECU_ADDRESS 0xd0008c16 BIT_MASK 0x1 /end MEASUREMENT
/begin MEASUREMENT lv_pu "Engine operating state \"Trailing throttle\"" UBYTE _CNV_S_2_RANGE__0___1_CM 1 100. 0. 1. DISPLAY_IDENTIFIER LV_PU ECU_ADDRESS 0xd0008c17 BIT_MASK 0x1 /end MEASUREMENT
/begin MEASUREMENT t_pu "Time elapsed into LV_PU" UWORD _CNV_A_R_LINEAR_____3_CM 1 100. 0. 655.35 DISPLAY_IDENTIFIER T_PU ECU_ADDRESS 0xd000a7cc FORMAT "%5.2" /end MEASUREMENT
/begin CHARACTERISTIC c_t_max_pu "Maximum delay time of PUC activation after entry of PU" VALUE 0xa080c1f8 _REC_VAL_20_u2 655.35 _CNV_A_R_LINEAR_____3_CM 0. 655.35 DISPLAY_IDENTIFIER C_T_MAX_PU FORMAT "%6.2" /end CHARACTERISTIC
/begin CHARACTERISTIC lc_inh_dt_pu "Manual inhibition bit for deactivation drivetrain impact for controlling transition to PUC" VALUE 0xa080c580 _REC_VAL_20_u1 1. _CNV_S_2_RANGE______76_CM 0. 1. DISPLAY_IDENTIFIER LC_INH_DT_PU /end CHARACTERISTIC
/begin CHARACTERISTIC c_t_min_pu_msr "Minimum delay time of PUC activation after MSR" VALUE 0xa080c228 _REC_VAL_20_u2 655.35 _CNV_A_R_LINEAR_____3_CM 0. 655.35 DISPLAY_IDENTIFIER C_T_MIN_PU_MSR FORMAT "%6.2" /end CHARACTERISTIC
/begin CHARACTERISTIC c_t_min_pu_rng_l "Minimum delay time of PUC activation after entry of PU for LV_RNG_L =1" VALUE 0xa080c22a _REC_VAL_20_u2 655.35 _CNV_A_R_LINEAR_____3_CM 0. 655.35 DISPLAY_IDENTIFIER C_T_MIN_PU_RNG_L FORMAT "%6.2" /end CHARACTERISTIC
/begin MEASUREMENT lv_puc "engine operating state \"trailing throttle fuel cut off \"" UBYTE _CNV_S_2_RANGE__0___1_CM 1 100. 0. 1. DISPLAY_IDENTIFIER LV_PUC ECU_ADDRESS 0xd0008c18 BIT_MASK 0x1 /end MEASUREMENT
/begin CHARACTERISTIC id_n_hys_max_puc__gr_at "Engine speed hysteresis set entering LV_PUC for AT transmission" CURVE 0xa0809c54 _REC_CUR_20_u1_u1 8160. _CNV_A_R_LINEAR_____10_CM 0. 8160. DISPLAY_IDENTIFIER ID_N_HYS_MAX_PUC__GR_AT FORMAT "%4.0"
 /begin AXIS_DESCR COM_AXIS gr_at _CNV_A_R_LINEAR_____0_CM 8 0. 255. FORMAT "%3.0" AXIS_PTS_REF ldpm_gr_at_3 /end AXIS_DESCR
/end CHARACTERISTIC
/begin CHARACTERISTIC id_n_hys_max_puc__gr_mt "Engine speed hysteresis set entering LV_PUC for MT transmissions" CURVE 0xa0809c5c _REC_CUR_20_u1_u1 8160. _CNV_A_R_LINEAR_____10_CM 0. 8160. DISPLAY_IDENTIFIER ID_N_HYS_MAX_PUC__GR_MT FORMAT "%4.0"
 /begin AXIS_DESCR COM_AXIS gr_mt _CNV_A_R_LINEAR_____0_CM 8 0. 255. FORMAT "%3.0" AXIS_PTS_REF ldpm_gr_mt_3 /end AXIS_DESCR
/end CHARACTERISTIC
/begin CHARACTERISTIC id_n_hys_min_puc__gr_at "Engine speed hysteresis reset when C_CYC_HYS_PUC_xx achieved for AT transmission" MAP 0xa0809c64 _REC_MAP_20_u1_u1_u1 8160. _CNV_A_R_LINEAR_____10_CM 0. 8160. DISPLAY_IDENTIFIER ID_N_HYS_MIN_PUC__GR_AT FORMAT "%4.0"
 /begin AXIS_DESCR COM_AXIS gr_at _CNV_A_R_LINEAR_____0_CM 8 0. 255. FORMAT "%3.0" AXIS_PTS_REF ldpm_gr_at_3 /end AXIS_DESCR
 /begin AXIS_DESCR COM_AXIS vs _CNV_A_R_LINEAR_____6_CM 4 0. 255. FORMAT "%3.0" AXIS_PTS_REF ldpm_vs /end AXIS_DESCR
/end CHARACTERISTIC
/begin CHARACTERISTIC id_n_hys_min_puc__gr_mt "Engine speed hysteresis reset when C_CYCNR_HYS_PUC_xx achieved for MT transmission" MAP 0xa0809c84 _REC_MAP_20_u1_u1_u1 8160. _CNV_A_R_LINEAR_____10_CM 0. 8160. DISPLAY_IDENTIFIER ID_N_HYS_MIN_PUC__GR_MT FORMAT "%4.0"
 /begin AXIS_DESCR COM_AXIS gr_mt _CNV_A_R_LINEAR_____0_CM 8 0. 255. FORMAT "%3.0" AXIS_PTS_REF ldpm_gr_mt_3 /end AXIS_DESCR
 /begin AXIS_DESCR COM_AXIS vs _CNV_A_R_LINEAR_____6_CM 4 0. 255. FORMAT "%3.0" AXIS_PTS_REF ldpm_vs /end AXIS_DESCR
/end CHARACTERISTIC
/begin CHARACTERISTIC id_n_hys_puc_st__gr_at "Engine speed hysteresis set entering LV_PUC in cold condition for AT transmission" CURVE 0xa0809ca4 _REC_CUR_20_u1_u1 8160. _CNV_A_R_LINEAR_____10_CM 0. 8160. DISPLAY_IDENTIFIER ID_N_HYS_PUC_ST__GR_AT FORMAT "%4.0"
 /begin AXIS_DESCR COM_AXIS gr_at _CNV_A_R_LINEAR_____0_CM 8 0. 255. FORMAT "%3.0" AXIS_PTS_REF ldpm_gr_at_3 /end AXIS_DESCR
/end CHARACTERISTIC
/begin CHARACTERISTIC id_n_hys_puc_st__gr_mt "Engine speed hysteresis set entering LV_PUC in cold condition for MT transmission" CURVE 0xa0809cac _REC_CUR_20_u1_u1 8160. _CNV_A_R_LINEAR_____10_CM 0. 8160. DISPLAY_IDENTIFIER ID_N_HYS_PUC_ST__GR_MT FORMAT "%4.0"
 /begin AXIS_DESCR COM_AXIS gr_mt _CNV_A_R_LINEAR_____0_CM 8 0. 255. FORMAT "%3.0" AXIS_PTS_REF ldpm_gr_mt_3 /end AXIS_DESCR
/end CHARACTERISTIC
/begin CHARACTERISTIC c_cycnr_hys_puc "Cycle counter to reset the LV_PUC engine speed hysteresis " VALUE 0xa080bc24 _REC_VAL_20_u2 655.35 _CNV_A_R_LINEAR_____160_CM 0. 65535. DISPLAY_IDENTIFIER C_CYCNR_HYS_PUC FORMAT "%5.0" /end CHARACTERISTIC
/begin CHARACTERISTIC c_cycnr_hys_puc_st "Cycle counter to reset the LV_PUC engine speed hysteresis in cold condition" VALUE 0xa080bc26 _REC_VAL_20_u2 655.35 _CNV_A_R_LINEAR_____160_CM 0. 65535. DISPLAY_IDENTIFIER C_CYCNR_HYS_PUC_ST FORMAT "%5.0" /end CHARACTERISTIC
/begin CHARACTERISTIC c_tco_min_puc_st "Coolant temperature to select the LV_PUC engine speed hysteresis" VALUE 0xa080c2da _REC_VAL_20_u1 28.575 _CNV_A_R_LINEAR_____17_CM -48. 142.5 DISPLAY_IDENTIFIER C_TCO_MIN_PUC_ST FORMAT "%5.1" /end CHARACTERISTIC
/begin MEASUREMENT lv_puc_req "Engine operating state \"Trailing throttle\" for torque structure" UBYTE _CNV_S_2_RANGE__0___1_CM 1 100. 0. 1. DISPLAY_IDENTIFIER LV_PUC_REQ ECU_ADDRESS 0xd0008c1a BIT_MASK 0x1 /end MEASUREMENT
/begin MEASUREMENT state_eng "" UBYTE _CNV_S_6_RANGE_STAT_161_CM 1 100. 0. 5. DISPLAY_IDENTIFIER STATE_ENG ECU_ADDRESS 0xd0008c10 /end MEASUREMENT
/begin CHARACTERISTIC ip_n_accout_min_puc__tco__gr_mt "LV_PUC engine speed threshold with air conditioned compressor active" MAP 0xa080afec _REC_MAP_20_u1_u1_u1 8160. _CNV_A_R_LINEAR_____10_CM 0. 8160. DISPLAY_IDENTIFIER IP_N_ACCOUT_MIN_PUC__TCO__GR_MT FORMAT "%4.0"
 /begin AXIS_DESCR COM_AXIS tco _CNV_A_R_LINEAR_____17_CM 6 -48. 142.5 FORMAT "%5.1" AXIS_PTS_REF ldpm_tco_1_6 /end AXIS_DESCR
 /begin AXIS_DESCR COM_AXIS gr_mt _CNV_A_R_LINEAR_____0_CM 8 0. 255. FORMAT "%3.0" AXIS_PTS_REF ldpm_gr_mt_3 /end AXIS_DESCR
/end CHARACTERISTIC
/begin CHARACTERISTIC ip_n_accout_min_puc__tco__gr_at "LV_PUC engine speed threshold with air conditioned compressor active" MAP 0xa080afbc _REC_MAP_20_u1_u1_u1 8160. _CNV_A_R_LINEAR_____10_CM 0. 8160. DISPLAY_IDENTIFIER IP_N_ACCOUT_MIN_PUC__TCO__GR_AT FORMAT "%4.0"
 /begin AXIS_DESCR COM_AXIS tco _CNV_A_R_LINEAR_____17_CM 6 -48. 142.5 FORMAT "%5.1" AXIS_PTS_REF ldpm_tco_1_6 /end AXIS_DESCR
 /begin AXIS_DESCR COM_AXIS gr_at _CNV_A_R_LINEAR_____0_CM 8 0. 255. FORMAT "%3.0" AXIS_PTS_REF ldpm_gr_at_3 /end AXIS_DESCR
/end CHARACTERISTIC
/begin AXIS_PTS ldpm_tco_1_6 "" 0xa0809778 tco _REC_AXS_20_u1 28.575 _CNV_A_R_LINEAR_____17_CM 6 -48. 142.5 FORMAT "%5.1" /end AXIS_PTS
/begin AXIS_PTS ldpm_gr_mt_3 "" 0xa0809458 gr_mt _REC_AXS_20_u1 255. _CNV_A_R_LINEAR_____0_CM 8 0. 255. FORMAT "%3.0" /end AXIS_PTS
/begin CHARACTERISTIC c_n_dif_ast "Additional engine speed hysteresis to avoid \"LV_PU\" direct after start" VALUE 0xa080bf1a _REC_VAL_20_u2 50. _CNV_A_R_LINEAR_____14_CM 0. 1000. DISPLAY_IDENTIFIER C_N_DIF_AST FORMAT "%4.0" /end CHARACTERISTIC
/begin CHARACTERISTIC c_t_n_dif_ast "Tme after start where C_N_DIF_AST is additional calculated to engine speed hysteresis" VALUE 0xa080c236 _REC_VAL_20_u2 327.675 _CNV_A_R_LINEAR_____4_CM 0. 6553.5 DISPLAY_IDENTIFIER C_T_N_DIF_AST FORMAT "%6.1" /end CHARACTERISTIC
/begin CHARACTERISTIC ip_n_min_puc__tco__gr_at "LV_PUC engine speed threshold" MAP 0xa080b0c0 _REC_MAP_20_u1_u1_u1 8160. _CNV_A_R_LINEAR_____10_CM 0. 8160. DISPLAY_IDENTIFIER IP_N_MIN_PUC__TCO__GR_AT FORMAT "%4.0"
 /begin AXIS_DESCR COM_AXIS tco _CNV_A_R_LINEAR_____17_CM 6 -48. 142.5 FORMAT "%5.1" AXIS_PTS_REF ldpm_tco_1_6 /end AXIS_DESCR
 /begin AXIS_DESCR COM_AXIS gr_at _CNV_A_R_LINEAR_____0_CM 8 0. 255. FORMAT "%3.0" AXIS_PTS_REF ldpm_gr_at_3 /end AXIS_DESCR
/end CHARACTERISTIC
/begin AXIS_PTS ldpm_tco_9 "" 0xa0809788 tco _REC_AXS_20_u1 28.575 _CNV_A_R_LINEAR_____17_CM 9 -48. 142.5 FORMAT "%5.1" /end AXIS_PTS
/begin MEASUREMENT lv_iga_min_puc "Conditions for IGA_MIN_PUC" UBYTE _CNV_S_2_RANGE__0___1_CM 1 100. 0. 1. DISPLAY_IDENTIFIER LV_IGA_MIN_PUC ECU_ADDRESS 0xd0008c19 BIT_MASK 0x1 /end MEASUREMENT
/begin CHARACTERISTIC c_t_min_pu_vs "Minimum delay time of PUC activation after entry of PU" VALUE 0xa080c22c _REC_VAL_20_u2 655.35 _CNV_A_R_LINEAR_____3_CM 0. 655.35 DISPLAY_IDENTIFIER C_T_MIN_PU_VS FORMAT "%6.2" /end CHARACTERISTIC
/begin AXIS_PTS ldp_n__t_min_pu "" 0xa0808abc n _REC_AXS_20_u2 8159. _CNV_A_R_LINEAR_____14_CM 8 1. 8160. FORMAT "%4.0" /end AXIS_PTS
/begin AXIS_PTS ldp_tco__t_min_pu "" 0xa0808dec tco _REC_AXS_20_u1 190.5 _CNV_A_R_LINEAR_____17_CM 6 -48. 142.5 FORMAT "%5.1" /end AXIS_PTS
/begin CHARACTERISTIC c_vs_min_pu "Threshold for vehicle speed for loading T_PU" VALUE 0xa080c4e6 _REC_VAL_20_u1 12.75 _CNV_A_R_LINEAR_____6_CM 0. 255. DISPLAY_IDENTIFIER C_VS_MIN_PU FORMAT "%3.0" /end CHARACTERISTIC
/begin CHARACTERISTIC ip_t_min_pu__n__tco "Minimum delay time of PUC activation" MAP 0xa0815e84 _REC_MAP_20_u2_u2_u1 655.35 _CNV_A_R_LINEAR_____3_CM 0. 655.35 DISPLAY_IDENTIFIER IP_T_MIN_PU__N__TCO FORMAT "%6.2"
 /begin AXIS_DESCR COM_AXIS n _CNV_A_R_LINEAR_____14_CM 8 1. 8160. FORMAT "%4.0" AXIS_PTS_REF ldp_n__t_min_pu /end AXIS_DESCR
 /begin AXIS_DESCR COM_AXIS tco _CNV_A_R_LINEAR_____17_CM 6 -48. 142.5 FORMAT "%5.1" AXIS_PTS_REF ldp_tco__t_min_pu /end AXIS_DESCR
/end CHARACTERISTIC
/begin AXIS_PTS ldp_tq_loss_ars_sp_can__puc "" 0xa0808fcc tq_loss_ars_sp_can _REC_AXS_20_u2 2047.96875 _CNV_A_R_LINEAR_____87_CM 6 -1024. 1023.96875 FORMAT "%6.2" /end AXIS_PTS
/begin CHARACTERISTIC ip_n_min_puc_add_ars "Additive term for reactivation engine speed" CURVE 0xa080b126 _REC_CUR_20_u1_u2 8160. _CNV_A_R_LINEAR_____10_CM 0. 8160. DISPLAY_IDENTIFIER IP_N_MIN_PUC_ADD_ARS FORMAT "%4.0"
 /begin AXIS_DESCR COM_AXIS tq_loss_ars_sp_can _CNV_A_R_LINEAR_____87_CM 6 -1024. 1023.96875 FORMAT "%6.2" AXIS_PTS_REF ldp_tq_loss_ars_sp_can__puc /end AXIS_DESCR
/end CHARACTERISTIC
/begin AXIS_PTS ldp_n_grd_n_dif_max_is "" 0xa0808b18 n_grd _REC_AXS_20_u1 8160. _CNV_A_R_LINEAR_____29_CM 6 -4096. 4064. FORMAT "%5.0" /end AXIS_PTS
/begin CHARACTERISTIC ip_n_dif_max_is "Engine speed hysteresis before \"Idle speed\" (LV_IS)" CURVE 0xa080b070 _REC_CUR_20_u2_u1 8160. _CNV_A_R_LINEAR_____14_CM 0. 8160. DISPLAY_IDENTIFIER IP_N_DIF_MAX_IS FORMAT "%4.0"
 /begin AXIS_DESCR COM_AXIS n_grd _CNV_A_R_LINEAR_____29_CM 6 -4096. 4064. FORMAT "%5.0" AXIS_PTS_REF ldp_n_grd_n_dif_max_is /end AXIS_DESCR
/end CHARACTERISTIC
/begin CHARACTERISTIC ip_t_min_pu_rng_l__n__tco "Minimum delay time of PUC activation" MAP 0xa0815ee4 _REC_MAP_20_u2_u2_u1 655.35 _CNV_A_R_LINEAR_____3_CM 0. 655.35 DISPLAY_IDENTIFIER IP_T_MIN_PU_RNG_L__N__TCO FORMAT "%6.2"
 /begin AXIS_DESCR COM_AXIS n _CNV_A_R_LINEAR_____14_CM 8 1. 8160. FORMAT "%4.0" AXIS_PTS_REF ldp_n__t_min_pu /end AXIS_DESCR
 /begin AXIS_DESCR COM_AXIS tco _CNV_A_R_LINEAR_____17_CM 6 -48. 142.5 FORMAT "%5.1" AXIS_PTS_REF ldp_tco__t_min_pu /end AXIS_DESCR
/end CHARACTERISTIC
/begin CHARACTERISTIC ip_n_min_puc__tco__gr_mt "LV_PUC engine speed threshold" MAP 0xa080b0f0 _REC_MAP_20_u1_u1_u1 8160. _CNV_A_R_LINEAR_____10_CM 0. 8160. DISPLAY_IDENTIFIER IP_N_MIN_PUC__TCO__GR_MT FORMAT "%4.0"
 /begin AXIS_DESCR COM_AXIS tco _CNV_A_R_LINEAR_____17_CM 6 -48. 142.5 FORMAT "%5.1" AXIS_PTS_REF ldpm_tco_1_6 /end AXIS_DESCR
 /begin AXIS_DESCR COM_AXIS gr_mt _CNV_A_R_LINEAR_____0_CM 8 0. 255. FORMAT "%3.0" AXIS_PTS_REF ldpm_gr_mt_3 /end AXIS_DESCR
/end CHARACTERISTIC
/begin CHARACTERISTIC ip_n_min_puc_add_pste_2 "Additive term for reactivation engine speed" CURVE 0xa080b12c _REC_CUR_20_u1_u2 8160. _CNV_A_R_LINEAR_____10_CM 0. 8160. DISPLAY_IDENTIFIER IP_N_MIN_PUC_ADD_PSTE_2 FORMAT "%4.0"
 /begin AXIS_DESCR COM_AXIS tq_loss_pste_2_sp_can _CNV_A_R_LINEAR_____87_CM 6 -1024. 1023.96875 FORMAT "%6.2" AXIS_PTS_REF ldp_tq_loss_pste_2_sp_can__puc /end AXIS_DESCR
/end CHARACTERISTIC
/begin AXIS_PTS ldp_tq_loss_pste_2_sp_can__puc "" 0xa0809024 tq_loss_pste_2_sp_can _REC_AXS_20_u2 2047.96875 _CNV_A_R_LINEAR_____87_CM 6 -1024. 1023.96875 FORMAT "%6.2" /end AXIS_PTS
/begin CHARACTERISTIC ip_t_min_pu_s "Minimum delay time of PUC activation after entry of PU in s mode" CURVE 0xa080b440 _REC_CUR_20_u2_u2 655.35 _CNV_A_R_LINEAR_____3_CM 0. 655.35 DISPLAY_IDENTIFIER IP_T_MIN_PU_S FORMAT "%6.2"
 /begin AXIS_DESCR COM_AXIS n _CNV_A_R_LINEAR_____14_CM 3 0. 8160. FORMAT "%4.0" AXIS_PTS_REF ldpm_n_t_min_pu_opm /end AXIS_DESCR
/end CHARACTERISTIC
/begin CHARACTERISTIC ip_t_min_pu_hom "Minimum delay time of PUC activation after entry of PU in homogenius mode" CURVE 0xa080b43a _REC_CUR_20_u2_u2 655.35 _CNV_A_R_LINEAR_____3_CM 0. 655.35 DISPLAY_IDENTIFIER IP_T_MIN_PU_HOM FORMAT "%6.2"
 /begin AXIS_DESCR COM_AXIS n _CNV_A_R_LINEAR_____14_CM 3 0. 8160. FORMAT "%4.0" AXIS_PTS_REF ldpm_n_t_min_pu_opm /end AXIS_DESCR
/end CHARACTERISTIC
/begin AXIS_PTS ldpm_n_t_min_pu_opm "" 0xa0809704 n _REC_AXS_20_u2 8160. _CNV_A_R_LINEAR_____14_CM 3 0. 8160. FORMAT "%4.0" /end AXIS_PTS
/begin CHARACTERISTIC c_clc_state_clu_amt "Constant to define closed clutch depending on shift-process AMT via CAN" VALUE 0xa080baaf _REC_VAL_20_u1 255. _CNV_A_R_LINEAR_____0_CM 0. 255. DISPLAY_IDENTIFIER C_CLC_STATE_CLU_AMT FORMAT "%3.0" /end CHARACTERISTIC
/begin CHARACTERISTIC c_t_min_pu_vs_cs "Minimum delay time for enry PUC due to clutch switch for MT" VALUE 0xa080c22e _REC_VAL_20_u2 655.35 _CNV_A_R_LINEAR_____3_CM 0. 655.35 DISPLAY_IDENTIFIER C_T_MIN_PU_VS_CS FORMAT "%6.2" /end CHARACTERISTIC
/begin CHARACTERISTIC c_vs_pu_cs_min "Minimum vehicle speed for delayed PUC due to clutch switch for MT" VALUE 0xa080c4f3 _REC_VAL_20_u1 255. _CNV_A_R_LINEAR_____6_CM 0. 255. DISPLAY_IDENTIFIER C_VS_PU_CS_MIN FORMAT "%3.0" /end CHARACTERISTIC
/begin CHARACTERISTIC c_vs_pu_cs_max "Maximum vehicle speed for delayed PUC due to clutch switch for MT" VALUE 0xa080c4f2 _REC_VAL_20_u1 255. _CNV_A_R_LINEAR_____6_CM 0. 255. DISPLAY_IDENTIFIER C_VS_PU_CS_MAX FORMAT "%3.0" /end CHARACTERISTIC
/begin MEASUREMENT lv_cs_puc "Clutch switch information including AMT" UBYTE _CNV_S_2_RANGE__0___1_CM 1 100. 0. 1. DISPLAY_IDENTIFIER LV_CS_PUC ECU_ADDRESS 0xd0000b5a BIT_MASK 0x1 /end MEASUREMENT
/begin AXIS_PTS ldpm_gr_at_3 "" 0xa080944c gr_at _REC_AXS_20_u1 255. _CNV_A_R_LINEAR_____0_CM 8 0. 255. FORMAT "%3.0" /end AXIS_PTS
/begin AXIS_PTS ldpm_vs "" 0xa08098c2 vs _REC_AXS_20_u1 255. _CNV_A_R_LINEAR_____6_CM 4 0. 255. FORMAT "%3.0" /end AXIS_PTS
/begin CHARACTERISTIC lc_n_hys_cyl_cut_off_at_conf "Logical constant for premature reset to minimum engine speed hysteresis, vehicle with automatic transmission" VALUE 0xa080c5b5 _REC_VAL_20_u1 1. _CNV_S_2_RANGE______76_CM 0. 1. DISPLAY_IDENTIFIER LC_N_HYS_CYL_CUT_OFF_AT_CONF /end CHARACTERISTIC
/begin CHARACTERISTIC lc_n_hys_cyl_cut_off_mt_conf "Logical constant for premature reset to minimum engine speed hysteresis, vehicle with manual transmission" VALUE 0xa080c5b6 _REC_VAL_20_u1 1. _CNV_S_2_RANGE______76_CM 0. 1. DISPLAY_IDENTIFIER LC_N_HYS_CYL_CUT_OFF_MT_CONF /end CHARACTERISTIC
/begin CHARACTERISTIC lc_inh_puc_nt_req "Manual switch to inhibit PUC due to regeneration of NOx managment" VALUE 0xa080c596 _REC_VAL_20_u1 1. _CNV_S_2_RANGE__0___1_CM 0. 1. DISPLAY_IDENTIFIER LC_INH_PUC_NT_REQ /end CHARACTERISTIC
/begin MEASUREMENT t_is "Time since the activation of the state idle speed" UWORD _CNV_A_R_LINEAR_____3_CM 1 100. 0. 655.35 DISPLAY_IDENTIFIER T_IS ECU_ADDRESS 0xd000a7ce FORMAT "%5.2" /end MEASUREMENT
/begin CHARACTERISTIC ip_n_min_puc_add "Additive term for reactivation engine speed" CURVE 0xa080b120 _REC_CUR_20_u1_u2 8160. _CNV_A_R_LINEAR_____10_CM 0. 8160. DISPLAY_IDENTIFIER IP_N_MIN_PUC_ADD FORMAT "%4.0"
 /begin AXIS_DESCR COM_AXIS tq_loss_add _CNV_A_R_LINEAR_____87_CM 6 -1024. 1023.96875 FORMAT "%6.2" AXIS_PTS_REF ldp_tq_loss_add__puc /end AXIS_DESCR
/end CHARACTERISTIC
/begin AXIS_PTS ldp_tq_loss_add__puc "" 0xa0808fa8 tq_loss_add _REC_AXS_20_u2 2047.96875 _CNV_A_R_LINEAR_____87_CM 6 -1024. 1023.96875 FORMAT "%6.2" /end AXIS_PTS
/begin MEASUREMENT tq_add_is_bol "Filtered calculated torque reserve bottom limit at idle" SWORD _CNV_A_R_LINEAR_____31_CM 1 100. -1024. 1023.96875 DISPLAY_IDENTIFIER TQ_ADD_IS_BOL ECU_ADDRESS 0xd000a900 FORMAT "%8.2" /end MEASUREMENT
/begin MEASUREMENT tq_dif_add_is_tol "Idle speed torque reserve limitation for stabilization the ISC at high torque reserves" SWORD _CNV_A_R_LINEAR_____31_CM 1 100. -1024. 1023.96875 DISPLAY_IDENTIFIER TQ_DIF_ADD_IS_TOL ECU_ADDRESS 0xd000a902 FORMAT "%8.2" /end MEASUREMENT
/begin CHARACTERISTIC c_tq_add_is_bol_crlc "Filter constant for torque reserve" VALUE 0xa080c362 _REC_VAL_20_u1 0.99609375 _CNV_A_R_LINEAR_____28_CM 0. 0.99609375 DISPLAY_IDENTIFIER C_TQ_ADD_IS_BOL_CRLC FORMAT "%5.3" /end CHARACTERISTIC
/begin MEASUREMENT tq_add_is_bol_opm_1 "Torque reserve at idle (mode 1)" SWORD _CNV_A_R_LINEAR_____31_CM 1 100. -1024. 1023.96875 DISPLAY_IDENTIFIER TQ_ADD_IS_BOL_OPM_1 ECU_ADDRESS 0xd000107e FORMAT "%8.2" /end MEASUREMENT
/begin MEASUREMENT tq_add_is_bol_opm_2 "Torque reserve at idle (mode 2)" SWORD _CNV_A_R_LINEAR_____31_CM 1 100. -1024. 1023.96875 DISPLAY_IDENTIFIER TQ_ADD_IS_BOL_OPM_2 ECU_ADDRESS 0xd0001080 FORMAT "%8.2" /end MEASUREMENT
/begin MEASUREMENT tq_add_is_bol_sel "Calculated torque reserve bottom limit at idle" SWORD _CNV_A_R_LINEAR_____31_CM 1 100. -1024. 1023.96875 DISPLAY_IDENTIFIER TQ_ADD_IS_BOL_SEL ECU_ADDRESS 0xd000107c FORMAT "%8.2" /end MEASUREMENT
/begin MEASUREMENT lv_tq_add_is_opm_sel_1 "Boolean for operation mode 1" UBYTE _CNV_S_2_RANGE__0___1_CM 1 100. 0. 1. DISPLAY_IDENTIFIER LV_TQ_ADD_IS_OPM_SEL_1 ECU_ADDRESS 0xd000108a BIT_MASK 0x1 /end MEASUREMENT
/begin MEASUREMENT lv_tq_add_is_opm_sel_2 "Boolean for operation mode 2" UBYTE _CNV_S_2_RANGE__0___1_CM 1 100. 0. 1. DISPLAY_IDENTIFIER LV_TQ_ADD_IS_OPM_SEL_2 ECU_ADDRESS 0xd000108b BIT_MASK 0x1 /end MEASUREMENT
/begin MEASUREMENT lv_tq_add_is_opm_rls "Boolean for internal error" UBYTE _CNV_S_2_RANGE__0___1_CM 1 100. 0. 1. DISPLAY_IDENTIFIER LV_TQ_ADD_IS_OPM_RLS ECU_ADDRESS 0xd000108c BIT_MASK 0x1 /end MEASUREMENT
/begin CHARACTERISTIC ip_t_n_dif_ofs_pred_opm_2 "Time constant for calculation of predicted engine speed deviation (mode 2)" CURVE 0xa080b468 _REC_CUR_20_u1_u2 7.96875 _CNV_A_R_LINEAR_____191_CM 0. 7.96875 DISPLAY_IDENTIFIER IP_T_N_DIF_OFS_PRED_OPM_2 FORMAT "%4.2"
 /begin AXIS_DESCR COM_AXIS n _CNV_A_R_LINEAR_____14_CM 8 0. 8160. FORMAT "%4.0" AXIS_PTS_REF ldpm_n_t_n_dif_ofs_pred /end AXIS_DESCR
/end CHARACTERISTIC
/begin CHARACTERISTIC id_tq_add_is_opm_av "Operation mode matrix (actual)" CURVE 0xa0809ed0 _REC_CUR_20_u1_u1 7. _CNV_A_R_LINEAR_____0_CM 1. 8. DISPLAY_IDENTIFIER ID_TQ_ADD_IS_OPM_AV FORMAT "%1.0"
 /begin AXIS_DESCR COM_AXIS opm_av _CNV_A_R_LINEAR_____0_CM 8 0. 8. FORMAT "%1.0" AXIS_PTS_REF ldpm_opm_av /end AXIS_DESCR
/end CHARACTERISTIC
/begin CHARACTERISTIC id_tq_add_is_opm_req "Operation mode matrix (requested)" CURVE 0xa0809ed8 _REC_CUR_20_u1_u1 7. _CNV_A_R_LINEAR_____0_CM 1. 8. DISPLAY_IDENTIFIER ID_TQ_ADD_IS_OPM_REQ FORMAT "%1.0"
 /begin AXIS_DESCR COM_AXIS opm_req _CNV_A_R_LINEAR_____0_CM 8 0. 8. FORMAT "%1.0" AXIS_PTS_REF ldpm_opm_req /end AXIS_DESCR
/end CHARACTERISTIC
/begin MEASUREMENT n_dif_ofs_pred_opm_1 "Predicted engine speed difference for torque reserve calculation (mode 1)" SWORD _CNV_A_R_LINEAR_____14_CM 1 100. -32768. 32767. DISPLAY_IDENTIFIER N_DIF_OFS_PRED_OPM_1 ECU_ADDRESS 0xd0001074 FORMAT "%6.0" /end MEASUREMENT
/begin MEASUREMENT n_dif_ofs_pred_cs_opm_1 "Predicted engine speed difference for torque reserve calculation at drive-off-support (mode 1)" SWORD _CNV_A_R_LINEAR_____14_CM 1 100. -32768. 32767. DISPLAY_IDENTIFIER N_DIF_OFS_PRED_CS_OPM_1 ECU_ADDRESS 0xd0001078 FORMAT "%6.0" /end MEASUREMENT
/begin MEASUREMENT n_dif_ofs_pred_opm_2 "Predicted engine speed difference for torque reserve calculation (mode 2)" SWORD _CNV_A_R_LINEAR_____14_CM 1 100. -32768. 32767. DISPLAY_IDENTIFIER N_DIF_OFS_PRED_OPM_2 ECU_ADDRESS 0xd0001076 FORMAT "%6.0" /end MEASUREMENT
/begin MEASUREMENT n_dif_ofs_pred_cs_opm_2 "Predicted engine speed difference for torque reserve calculation at drive-off-support (mode 2)" SWORD _CNV_A_R_LINEAR_____14_CM 1 100. -32768. 32767. DISPLAY_IDENTIFIER N_DIF_OFS_PRED_CS_OPM_2 ECU_ADDRESS 0xd000107a FORMAT "%6.0" /end MEASUREMENT
/begin MEASUREMENT t_n_dif_ofs_pred_opm_1 "Prediction time for engine speed difference (mode 1)" UBYTE _CNV_A_R_LINEAR_____191_CM 1 100. 0. 7.96875 DISPLAY_IDENTIFIER T_N_DIF_OFS_PRED_OPM_1 ECU_ADDRESS 0xd0001084 FORMAT "%4.2" /end MEASUREMENT
/begin MEASUREMENT t_n_dif_ofs_pred_opm_2 "Prediction time for engine speed difference (mode 2)" UBYTE _CNV_A_R_LINEAR_____191_CM 1 100. 0. 7.96875 DISPLAY_IDENTIFIER T_N_DIF_OFS_PRED_OPM_2 ECU_ADDRESS 0xd0001085 FORMAT "%4.2" /end MEASUREMENT
/begin MEASUREMENT t_n_dif_ofs_pred_cs_opm_2 "Prediction time for engine speed difference at drive-off-support (mode 2)" UBYTE _CNV_A_R_LINEAR_____191_CM 1 100. 0. 7.96875 DISPLAY_IDENTIFIER T_N_DIF_OFS_PRED_CS_OPM_2 ECU_ADDRESS 0xd0001087 FORMAT "%4.2" /end MEASUREMENT
/begin MEASUREMENT n_dif_pred_opm_1 "Predicted idle speed control variable (mode 1)" SWORD _CNV_A_R_LINEAR_____14_CM 1 100. -32768. 32767. DISPLAY_IDENTIFIER N_DIF_PRED_OPM_1 ECU_ADDRESS 0xd000106c FORMAT "%6.0" /end MEASUREMENT
/begin MEASUREMENT n_dif_pred_cs_opm_1 "Predicted idle speed control variable at drive-off-support (mode 2)" SWORD _CNV_A_R_LINEAR_____14_CM 1 100. -32768. 32767. DISPLAY_IDENTIFIER N_DIF_PRED_CS_OPM_1 ECU_ADDRESS 0xd0001070 FORMAT "%6.0" /end MEASUREMENT
/begin MEASUREMENT n_dif_pred_opm_2 "Predicted idle speed control variable (mode 2)" SWORD _CNV_A_R_LINEAR_____14_CM 1 100. -32768. 32767. DISPLAY_IDENTIFIER N_DIF_PRED_OPM_2 ECU_ADDRESS 0xd000106e FORMAT "%6.0" /end MEASUREMENT
/begin MEASUREMENT n_dif_pred_cs_opm_2 "Predicted idle speed control variable at drive-off-support (mode 2)" SWORD _CNV_A_R_LINEAR_____14_CM 1 100. -32768. 32767. DISPLAY_IDENTIFIER N_DIF_PRED_CS_OPM_2 ECU_ADDRESS 0xd0001072 FORMAT "%6.0" /end MEASUREMENT
/begin MEASUREMENT t_n_dif_ofs_pred_cs_opm_1 "Prediction time for engine speed difference at drive-off-support (mode 1)" UBYTE _CNV_A_R_LINEAR_____191_CM 1 100. 0. 7.96875 DISPLAY_IDENTIFIER T_N_DIF_OFS_PRED_CS_OPM_1 ECU_ADDRESS 0xd0001086 FORMAT "%4.2" /end MEASUREMENT
/begin MEASUREMENT fac_tq_add_is_bol_opm_2 "Resulting factor for TQ_ADD_IS_BOL_BAS (mode 2)" UBYTE _CNV_A_R_LINEAR_____192_CM 1 100. 0. 7.96875 DISPLAY_IDENTIFIER FAC_TQ_ADD_IS_BOL_OPM_2 ECU_ADDRESS 0xd0001089 FORMAT "%4.2" /end MEASUREMENT
/begin MEASUREMENT fac_tq_add_is_bol_opm_1 "Resulting factor for TQ_ADD_IS_BOL_BAS (mode 1)" UBYTE _CNV_A_R_LINEAR_____192_CM 1 100. 0. 7.96875 DISPLAY_IDENTIFIER FAC_TQ_ADD_IS_BOL_OPM_1 ECU_ADDRESS 0xd0001088 FORMAT "%4.2" /end MEASUREMENT
/begin AXIS_PTS ldpm_n_sp_is_tq_add_is_bol_bas "" 0xa08096f4 n_sp_is _REC_AXS_20_u2 8160. _CNV_A_R_LINEAR_____14_CM 6 0. 8160. FORMAT "%4.0" /end AXIS_PTS
/begin AXIS_PTS ldpm_tco_tq_add_is_bol_bas "" 0xa0809822 tco _REC_AXS_20_u1 190.5 _CNV_A_R_LINEAR_____17_CM 6 -48. 142.5 FORMAT "%5.1" /end AXIS_PTS
/begin AXIS_PTS ldpm_toil_ip_fac_temp_tq_add_is "" 0xa0809872 toil _REC_AXS_20_u1 200. _CNV_A_R_LINEAR_____26_CM 6 -40. 160. FORMAT "%3.0" /end AXIS_PTS
/begin AXIS_PTS ldpm_tia_ip_fac_temp_tq_add_is "" 0xa080984a tia _REC_AXS_20_u1 190.5 _CNV_A_R_LINEAR_____17_CM 6 -48. 142.5 FORMAT "%5.1" /end AXIS_PTS
/begin AXIS_PTS ldpm_maf_fac_tq_add_is "" 0xa08094b4 maf _REC_AXS_20_u2 1389. _CNV_A_R_LINEAR_____111_CM 6 0. 1389. FORMAT "%4.0" /end AXIS_PTS
/begin AXIS_PTS ldpm_vs_fil_ip_fac_vs_tq_add_is "" 0xa08098ec vs_fil _REC_AXS_20_u2 511.99218 _CNV_A_R_LINEAR_____86_CM 4 0. 511.99218 FORMAT "%7.3" /end AXIS_PTS
/begin AXIS_PTS ldpm_maf_lgrd_tq_add_is_bol "" 0xa0809520 maf _REC_AXS_20_u2 1389. _CNV_A_R_LINEAR_____111_CM 6 0. 1389. FORMAT "%4.0" /end AXIS_PTS
/begin CHARACTERISTIC ip_t_n_dif_ofs_pred_opm_1 "Time constant for calculation of predicted engine speed deviation (mode 1)" CURVE 0xa080b460 _REC_CUR_20_u1_u2 7.96875 _CNV_A_R_LINEAR_____191_CM 0. 7.96875 DISPLAY_IDENTIFIER IP_T_N_DIF_OFS_PRED_OPM_1 FORMAT "%4.2"
 /begin AXIS_DESCR COM_AXIS n _CNV_A_R_LINEAR_____14_CM 8 0. 8160. FORMAT "%4.0" AXIS_PTS_REF ldpm_n_t_n_dif_ofs_pred /end AXIS_DESCR
/end CHARACTERISTIC
/begin CHARACTERISTIC ip_t_n_dif_ofs_pred_cs_opm_2 "Time constant for calculation of predicted engine speed deviation at drive-off-support (mode2)" CURVE 0xa080b450 _REC_CUR_20_u1_u2 7.96875 _CNV_A_R_LINEAR_____191_CM 0. 7.96875 DISPLAY_IDENTIFIER IP_T_N_DIF_OFS_PRED_CS_OPM_2 FORMAT "%4.2"
 /begin AXIS_DESCR COM_AXIS n _CNV_A_R_LINEAR_____14_CM 8 0. 8160. FORMAT "%4.0" AXIS_PTS_REF ldpm_n_t_n_dif_ofs_pred /end AXIS_DESCR
/end CHARACTERISTIC
/begin CHARACTERISTIC ip_t_n_dif_ofs_pred_cs_opm_1 "Time constant for calculation of predicted engine speed deviation at drive-off-support (mode1)" CURVE 0xa080b448 _REC_CUR_20_u1_u2 7.96875 _CNV_A_R_LINEAR_____191_CM 0. 7.96875 DISPLAY_IDENTIFIER IP_T_N_DIF_OFS_PRED_CS_OPM_1 FORMAT "%4.2"
 /begin AXIS_DESCR COM_AXIS n _CNV_A_R_LINEAR_____14_CM 8 0. 8160. FORMAT "%4.0" AXIS_PTS_REF ldpm_n_t_n_dif_ofs_pred /end AXIS_DESCR
/end CHARACTERISTIC
/begin CHARACTERISTIC ip_tq_add_is_bol_bas_opm_1 "Basis torque reserve at idle (mode1)" MAP 0xa08161a4 _REC_MAP_20_u2_u2_u1 1023.96875 _CNV_A_R_LINEAR_____31_CM 0. 1023.96875 DISPLAY_IDENTIFIER IP_TQ_ADD_IS_BOL_BAS_OPM_1 FORMAT "%7.2"
 /begin AXIS_DESCR COM_AXIS n_sp_is _CNV_A_R_LINEAR_____14_CM 6 0. 8160. FORMAT "%4.0" AXIS_PTS_REF ldpm_n_sp_is_tq_add_is_bol_bas /end AXIS_DESCR
 /begin AXIS_DESCR COM_AXIS tco _CNV_A_R_LINEAR_____17_CM 6 -48. 142.5 FORMAT "%5.1" AXIS_PTS_REF ldpm_tco_tq_add_is_bol_bas /end AXIS_DESCR
/end CHARACTERISTIC
/begin CHARACTERISTIC ip_tq_add_is_bol_bas_opm_2 "Basis torque reserve at idle (mode2)" MAP 0xa08161ec _REC_MAP_20_u2_u2_u1 1023.96875 _CNV_A_R_LINEAR_____31_CM 0. 1023.96875 DISPLAY_IDENTIFIER IP_TQ_ADD_IS_BOL_BAS_OPM_2 FORMAT "%7.2"
 /begin AXIS_DESCR COM_AXIS n_sp_is _CNV_A_R_LINEAR_____14_CM 6 0. 8160. FORMAT "%4.0" AXIS_PTS_REF ldpm_n_sp_is_tq_add_is_bol_bas /end AXIS_DESCR
 /begin AXIS_DESCR COM_AXIS tco _CNV_A_R_LINEAR_____17_CM 6 -48. 142.5 FORMAT "%5.1" AXIS_PTS_REF ldpm_tco_tq_add_is_bol_bas /end AXIS_DESCR
/end CHARACTERISTIC
/begin CHARACTERISTIC ip_fac_temp_tq_add_is_bas_opm_1 "Temperature correction for IP_TQ_ADD_IS_BOL_BAS (mode1)" MAP 0xa080a540 _REC_MAP_20_u1_u1_u1 1.9921875 _CNV_A_R_LINEAR_____103_CM 0. 1.9921875 DISPLAY_IDENTIFIER IP_FAC_TEMP_TQ_ADD_IS_BAS_OPM_1 FORMAT "%8.6"
 /begin AXIS_DESCR COM_AXIS tia _CNV_A_R_LINEAR_____17_CM 6 -48. 142.5 FORMAT "%5.1" AXIS_PTS_REF ldpm_tia_ip_fac_temp_tq_add_is /end AXIS_DESCR
 /begin AXIS_DESCR COM_AXIS toil _CNV_A_R_LINEAR_____26_CM 6 -40. 160. FORMAT "%3.0" AXIS_PTS_REF ldpm_toil_ip_fac_temp_tq_add_is /end AXIS_DESCR
/end CHARACTERISTIC
/begin CHARACTERISTIC ip_fac_temp_tq_add_is_bas_opm_2 "Temperature correction for IP_TQ_ADD_IS_BOL_BAS (mode2)" MAP 0xa080a564 _REC_MAP_20_u1_u1_u1 1.9921875 _CNV_A_R_LINEAR_____103_CM 0. 1.9921875 DISPLAY_IDENTIFIER IP_FAC_TEMP_TQ_ADD_IS_BAS_OPM_2 FORMAT "%8.6"
 /begin AXIS_DESCR COM_AXIS tia _CNV_A_R_LINEAR_____17_CM 6 -48. 142.5 FORMAT "%5.1" AXIS_PTS_REF ldpm_tia_ip_fac_temp_tq_add_is /end AXIS_DESCR
 /begin AXIS_DESCR COM_AXIS toil _CNV_A_R_LINEAR_____26_CM 6 -40. 160. FORMAT "%3.0" AXIS_PTS_REF ldpm_toil_ip_fac_temp_tq_add_is /end AXIS_DESCR
/end CHARACTERISTIC
/begin CHARACTERISTIC ip_fac_tq_add_is_bol_opm_1 "Factor for basis torque reserve at idle due to N_DIF_PRED and load without drive (mode1)" MAP 0xa080a8e8 _REC_MAP_20_u1_u2_u2 7.96875 _CNV_A_R_LINEAR_____192_CM 0. 7.96875 DISPLAY_IDENTIFIER IP_FAC_TQ_ADD_IS_BOL_OPM_1 FORMAT "%4.2"
 /begin AXIS_DESCR COM_AXIS n_dif_pred_pl_drof _CNV_A_R_LINEAR_____193_CM 8 -32768. 32767. FORMAT "%6.0" AXIS_PTS_REF ldpm_n_dif_pred_fac_tq_add_is /end AXIS_DESCR
 /begin AXIS_DESCR COM_AXIS maf _CNV_A_R_LINEAR_____111_CM 6 0. 1389. FORMAT "%4.0" AXIS_PTS_REF ldpm_maf_fac_tq_add_is /end AXIS_DESCR
/end CHARACTERISTIC
/begin CHARACTERISTIC ip_fac_tq_add_is_bol_cs_opm_1 "Factor for basis torque reserve at idle due to N_DIF_PRED and load for drive-off-support (mode1)" MAP 0xa080a828 _REC_MAP_20_u1_u2_u2 7.96875 _CNV_A_R_LINEAR_____192_CM 0. 7.96875 DISPLAY_IDENTIFIER IP_FAC_TQ_ADD_IS_BOL_CS_OPM_1 FORMAT "%4.2"
 /begin AXIS_DESCR COM_AXIS n_dif_pred_pl_drof _CNV_A_R_LINEAR_____193_CM 8 -32768. 32767. FORMAT "%6.0" AXIS_PTS_REF ldpm_n_dif_pred_fac_tq_add_is /end AXIS_DESCR
 /begin AXIS_DESCR COM_AXIS maf _CNV_A_R_LINEAR_____111_CM 6 0. 1389. FORMAT "%4.0" AXIS_PTS_REF ldpm_maf_fac_tq_add_is /end AXIS_DESCR
/end CHARACTERISTIC
/begin CHARACTERISTIC ip_fac_tq_add_is_bol_opm_2 "Factor for basis torque reserve at idle due to N_DIF_PRED and load without drive (mode2)" MAP 0xa080a918 _REC_MAP_20_u1_u2_u2 7.96875 _CNV_A_R_LINEAR_____192_CM 0. 7.96875 DISPLAY_IDENTIFIER IP_FAC_TQ_ADD_IS_BOL_OPM_2 FORMAT "%4.2"
 /begin AXIS_DESCR COM_AXIS n_dif_pred_pl_drof _CNV_A_R_LINEAR_____193_CM 8 -32768. 32767. FORMAT "%6.0" AXIS_PTS_REF ldpm_n_dif_pred_fac_tq_add_is /end AXIS_DESCR
 /begin AXIS_DESCR COM_AXIS maf _CNV_A_R_LINEAR_____111_CM 6 0. 1389. FORMAT "%4.0" AXIS_PTS_REF ldpm_maf_fac_tq_add_is /end AXIS_DESCR
/end CHARACTERISTIC
/begin CHARACTERISTIC ip_fac_tq_add_is_bol_cs_opm_2 "Factor for basis torque reserve at idle due to N_DIF_PRED and load for drive-off-support (mode2)" MAP 0xa080a858 _REC_MAP_20_u1_u2_u2 7.96875 _CNV_A_R_LINEAR_____192_CM 0. 7.96875 DISPLAY_IDENTIFIER IP_FAC_TQ_ADD_IS_BOL_CS_OPM_2 FORMAT "%4.2"
 /begin AXIS_DESCR COM_AXIS n_dif_pred_pl_drof _CNV_A_R_LINEAR_____193_CM 8 -32768. 32767. FORMAT "%6.0" AXIS_PTS_REF ldpm_n_dif_pred_fac_tq_add_is /end AXIS_DESCR
 /begin AXIS_DESCR COM_AXIS maf _CNV_A_R_LINEAR_____111_CM 6 0. 1389. FORMAT "%4.0" AXIS_PTS_REF ldpm_maf_fac_tq_add_is /end AXIS_DESCR
/end CHARACTERISTIC
/begin CHARACTERISTIC ip_fac_vs_tq_add_is_bol_opm_1 "Factor for IP_FAC_TQ_ADD_IS_BOL_CS_OPM_1 (mode 1)" CURVE 0xa080ac6a _REC_CUR_20_u1_u2 1.9921875 _CNV_A_R_LINEAR_____103_CM 0. 1.9921875 DISPLAY_IDENTIFIER IP_FAC_VS_TQ_ADD_IS_BOL_OPM_1 FORMAT "%5.3"
 /begin AXIS_DESCR COM_AXIS vs_fil _CNV_A_R_LINEAR_____86_CM 4 0. 511.99218 FORMAT "%7.3" AXIS_PTS_REF ldpm_vs_fil_ip_fac_vs_tq_add_is /end AXIS_DESCR
/end CHARACTERISTIC
/begin CHARACTERISTIC ip_fac_vs_tq_add_is_bol_opm_2 "Factor for IP_FAC_TQ_ADD_IS_BOL_CS_OPM_1 (mode 2)" CURVE 0xa080ac6e _REC_CUR_20_u1_u2 1.9921875 _CNV_A_R_LINEAR_____103_CM 0. 1.9921875 DISPLAY_IDENTIFIER IP_FAC_VS_TQ_ADD_IS_BOL_OPM_2 FORMAT "%5.3"
 /begin AXIS_DESCR COM_AXIS vs_fil _CNV_A_R_LINEAR_____86_CM 4 0. 511.99218 FORMAT "%7.3" AXIS_PTS_REF ldpm_vs_fil_ip_fac_vs_tq_add_is /end AXIS_DESCR
/end CHARACTERISTIC
/begin CHARACTERISTIC ip_fac_tq_add_is_bol_dri_opm_1 "Factor for basis torque reserve at idle due to N_DIF_PRED and load with drive (mode 1)" MAP 0xa080a888 _REC_MAP_20_u1_u2_u2 7.96875 _CNV_A_R_LINEAR_____192_CM 0. 7.96875 DISPLAY_IDENTIFIER IP_FAC_TQ_ADD_IS_BOL_DRI_OPM_1 FORMAT "%4.2"
 /begin AXIS_DESCR COM_AXIS n_dif_pred_pl_drof _CNV_A_R_LINEAR_____193_CM 8 -32768. 32767. FORMAT "%6.0" AXIS_PTS_REF ldpm_n_dif_pred_fac_tq_add_is /end AXIS_DESCR
 /begin AXIS_DESCR COM_AXIS maf _CNV_A_R_LINEAR_____111_CM 6 0. 1389. FORMAT "%4.0" AXIS_PTS_REF ldpm_maf_fac_tq_add_is /end AXIS_DESCR
/end CHARACTERISTIC
/begin CHARACTERISTIC ip_fac_tq_add_is_bol_dri_opm_2 "Factor for basis torque reserve at idle due to N_DIF_PRED and load with drive (mode 2)" MAP 0xa080a8b8 _REC_MAP_20_u1_u2_u2 7.96875 _CNV_A_R_LINEAR_____192_CM 0. 7.96875 DISPLAY_IDENTIFIER IP_FAC_TQ_ADD_IS_BOL_DRI_OPM_2 FORMAT "%4.2"
 /begin AXIS_DESCR COM_AXIS n_dif_pred_pl_drof _CNV_A_R_LINEAR_____193_CM 8 -32768. 32767. FORMAT "%6.0" AXIS_PTS_REF ldpm_n_dif_pred_fac_tq_add_is /end AXIS_DESCR
 /begin AXIS_DESCR COM_AXIS maf _CNV_A_R_LINEAR_____111_CM 6 0. 1389. FORMAT "%4.0" AXIS_PTS_REF ldpm_maf_fac_tq_add_is /end AXIS_DESCR
/end CHARACTERISTIC
/begin AXIS_PTS ldp_vlft_min_ip_tq_add_is_cor "" 0xa0809170 NO_INPUT_QUANTITY _REC_AXS_20_u2 65.535 _CNV_A_R_LINEAR_____194_CM 6 0. 65.535 /end AXIS_PTS
/begin AXIS_PTS ldp_map_dip_sp_mmv_ip_tq_add_is "" 0xa0808928 NO_INPUT_QUANTITY _REC_AXS_20_u2 2559.9609375 _CNV_A_R_LINEAR_____195_CM 6 -1280. 1279.9609375 FORMAT "%8.2" /end AXIS_PTS
/begin CHARACTERISTIC ip_tq_add_is_cor_opm_1 "Additive torque reserve at idle at VVT-mode (mode 1)" MAP 0xa0816234 _REC_MAP_20_u2_u2_u2 1023.96875 _CNV_A_R_LINEAR_____31_CM 0. 1023.96875 DISPLAY_IDENTIFIER IP_TQ_ADD_IS_COR_OPM_1 FORMAT "%7.2"
 /begin AXIS_DESCR COM_AXIS NO_INPUT_QUANTITY _CNV_A_R_LINEAR_____194_CM 6 0. 65.535 AXIS_PTS_REF ldp_vlft_min_ip_tq_add_is_cor /end AXIS_DESCR
 /begin AXIS_DESCR COM_AXIS NO_INPUT_QUANTITY _CNV_A_R_LINEAR_____195_CM 6 -1280. 1279.9609375 FORMAT "%8.2" AXIS_PTS_REF ldp_map_dip_sp_mmv_ip_tq_add_is /end AXIS_DESCR
/end CHARACTERISTIC
/begin CHARACTERISTIC c_tq_dif_add_is_tol_opm_1 "Idle speed torque reserve limitation for stabilizing the ISC at high torque reserve in OPM 1" VALUE 0xa080c36e _REC_VAL_20_u2 1023.96875 _CNV_A_R_LINEAR_____31_CM 0. 1023.96875 DISPLAY_IDENTIFIER C_TQ_DIF_ADD_IS_TOL_OPM_1 FORMAT "%7.2" /end CHARACTERISTIC
/begin CHARACTERISTIC c_tq_dif_add_is_tol_opm_2 "Idle speed torque reserve limitation for stabilizing the ISC at high torque reserve in OPM 2" VALUE 0xa080c370 _REC_VAL_20_u2 1023.96875 _CNV_A_R_LINEAR_____31_CM 0. 1023.96875 DISPLAY_IDENTIFIER C_TQ_DIF_ADD_IS_TOL_OPM_2 FORMAT "%7.2" /end CHARACTERISTIC
/begin AXIS_PTS ldpm_n_lgrd_tq_add_is_bol "" 0xa08096dc n _REC_AXS_20_u2 8160. _CNV_A_R_LINEAR_____14_CM 6 0. 8160. FORMAT "%4.0" /end AXIS_PTS
/begin CHARACTERISTIC ip_lgrd_tq_add_is_bol "Gradient for decrementation of the torque reserve at idle" MAP 0xa080ae40 _REC_MAP_20_u1_u2_u2 7.96875 _CNV_A_R_LINEAR_____192_CM 0. 7.96875 DISPLAY_IDENTIFIER IP_LGRD_TQ_ADD_IS_BOL FORMAT "%4.2"
 /begin AXIS_DESCR COM_AXIS n _CNV_A_R_LINEAR_____14_CM 6 0. 8160. FORMAT "%4.0" AXIS_PTS_REF ldpm_n_lgrd_tq_add_is_bol /end AXIS_DESCR
 /begin AXIS_DESCR COM_AXIS maf _CNV_A_R_LINEAR_____111_CM 6 0. 1389. FORMAT "%4.0" AXIS_PTS_REF ldpm_maf_lgrd_tq_add_is_bol /end AXIS_DESCR
/end CHARACTERISTIC
/begin CHARACTERISTIC ip_lgrd_tq_add_is_bol_opm_2 "Gradient for decrementation of the torque reserve at idle for OPM 2" MAP 0xa080ae64 _REC_MAP_20_u1_u2_u2 7.96875 _CNV_A_R_LINEAR_____192_CM 0. 7.96875 DISPLAY_IDENTIFIER IP_LGRD_TQ_ADD_IS_BOL_OPM_2 FORMAT "%4.2"
 /begin AXIS_DESCR COM_AXIS n _CNV_A_R_LINEAR_____14_CM 6 0. 8160. FORMAT "%4.0" AXIS_PTS_REF ldpm_n_lgrd_tq_add_is_bol /end AXIS_DESCR
 /begin AXIS_DESCR COM_AXIS maf _CNV_A_R_LINEAR_____111_CM 6 0. 1389. FORMAT "%4.0" AXIS_PTS_REF ldpm_maf_lgrd_tq_add_is_bol /end AXIS_DESCR
/end CHARACTERISTIC
/begin AXIS_PTS ldpm_n_dif_pred_fac_tq_add_is "" 0xa0809698 n_dif_pred_pl_drof _REC_AXS_20_u2 65535. _CNV_A_R_LINEAR_____193_CM 8 -32768. 32767. FORMAT "%6.0" /end AXIS_PTS
/begin CHARACTERISTIC ip_n_max_tol_st "upper engine speed limit for ST" CURVE 0xa080b0b4 _REC_CUR_20_u1_u1 8160. _CNV_A_R_LINEAR_____10_CM 0. 8160. DISPLAY_IDENTIFIER IP_N_MAX_TOL_ST FORMAT "%4.0"
 /begin AXIS_DESCR COM_AXIS tco _CNV_A_R_LINEAR_____17_CM 9 -48. 142.5 FORMAT "%5.1" AXIS_PTS_REF ldpm_tco_9 /end AXIS_DESCR
/end CHARACTERISTIC
/begin MEASUREMENT cyc_st "Cycle counter during start if the first injection is applied" UBYTE _CNV_A_R_LINEAR_____0_CM 1 100. 0. 255. DISPLAY_IDENTIFIER CYC_ST ECU_ADDRESS 0xd0008b58 FORMAT "%3.0" /end MEASUREMENT
/begin CHARACTERISTIC c_pwm_poil_dr_max_diag_scg "Maximum threshold for SCG diagnosis window" VALUE 0xa080c099 _REC_VAL_20_u1 99.609375 _CNV_A_R_LINEAR_____5_CM 0. 99.609375 DISPLAY_IDENTIFIER C_PWM_POIL_DR_MAX_DIAG_SCG FORMAT "%9.6" /end CHARACTERISTIC
/begin CHARACTERISTIC c_pwm_poil_dr_min_diag_scp "Minimum threshold for SCP diagnosis window" VALUE 0xa080c09b _REC_VAL_20_u1 99.609375 _CNV_A_R_LINEAR_____5_CM 0. 99.609375 DISPLAY_IDENTIFIER C_PWM_POIL_DR_MIN_DIAG_SCP FORMAT "%9.6" /end CHARACTERISTIC
/begin CHARACTERISTIC c_pwm_poil_dr_min_diag_oc "Minimum threshold for OC diagnosis window" VALUE 0xa080c09a _REC_VAL_20_u1 99.609375 _CNV_A_R_LINEAR_____5_CM 0. 99.609375 DISPLAY_IDENTIFIER C_PWM_POIL_DR_MIN_DIAG_OC FORMAT "%9.6" /end CHARACTERISTIC
/begin MEASUREMENT lv_err_poil_dr "Present failure:failure after filtering of diagnosis POIL_DR" UBYTE _CNV_S_2_RANGE__0___1_CM 1 100. 0. 1. DISPLAY_IDENTIFIER LV_ERR_POIL_DR ECU_ADDRESS 0xd0007f94 BIT_MASK 0x1 /end MEASUREMENT
/begin MEASUREMENT cdn_diag_poil_dr "Diagnosis condition for each symptom of POIL_DR" UBYTE _CNV_A_R_LINEAR_____0_CM 1 100. 0. 7. DISPLAY_IDENTIFIER CDN_DIAG_POIL_DR ECU_ADDRESS 0xd00015c8 FORMAT "%3.0" /end MEASUREMENT
/begin CHARACTERISTIC c_v_poil_max_diag "maximum diagnostic value for the oil pressure sensor signal" VALUE 0xa080c3e4 _REC_VAL_20_u2 4.9951171875 _CNV_A_R_LINEAR_____2_CM 0. 4.9951171875 DISPLAY_IDENTIFIER C_V_POIL_MAX_DIAG FORMAT "%5.3" /end CHARACTERISTIC
/begin CHARACTERISTIC c_v_poil_min_diag "minimum diagnostic value for the oil pressure sensor signal" VALUE 0xa080c3e6 _REC_VAL_20_u2 4.9951171875 _CNV_A_R_LINEAR_____2_CM 0. 4.9951171875 DISPLAY_IDENTIFIER C_V_POIL_MIN_DIAG FORMAT "%5.3" /end CHARACTERISTIC
/begin MEASUREMENT lv_err_sens_poil "Oil pressure sensor error present" UBYTE _CNV_S_2_RANGE__0___1_CM 1 100. 0. 1. DISPLAY_IDENTIFIER LV_ERR_SENS_POIL ECU_ADDRESS 0xd0007f93 BIT_MASK 0x1 /end MEASUREMENT
/begin MEASUREMENT lv_ast "Auxiliary function \"After-start\"" UBYTE _CNV_S_2_RANGE__0___1_CM 1 100. 0. 1. DISPLAY_IDENTIFIER LV_AST ECU_ADDRESS 0xd0008c88 BIT_MASK 0x1 /end MEASUREMENT
/begin MEASUREMENT fac_ti_cast_fup "Factor for weighting the influence of fuel pressure on cold post start injection" UBYTE _CNV_A_R_LINEAR_____103_CM 1 100. 0. 1.9921875 DISPLAY_IDENTIFIER FAC_TI_CAST_FUP ECU_ADDRESS 0xd00016a8 FORMAT "%5.3" /end MEASUREMENT
/begin CHARACTERISTIC c_crlc_fac_ti_cast_fup "Low pass filter correlation constant for the weighting factor of fuel pressure" VALUE 0xa080bae5 _REC_VAL_20_u1 0.99609375 _CNV_A_R_LINEAR_____185_CM 0. 0.99609375 DISPLAY_IDENTIFIER C_CRLC_FAC_TI_CAST_FUP FORMAT "%5.3" /end CHARACTERISTIC
/begin MEASUREMENT lv_lam_cyl_sel_adj_ofs_ext_req "flag for fuel pressure setpoint switch" UBYTE _CNV_S_2_RANGE__0___1_CM 1 100. 0. 1. DISPLAY_IDENTIFIER LV_LAM_CYL_SEL_ADJ_OFS_EXT_REQ ECU_ADDRESS 0xd00086c0 BIT_MASK 0x1 /end MEASUREMENT
/begin MEASUREMENT lv_err_ecu_ram "Present error flag ECU_RAM" UBYTE _CNV_S_2_RANGE__0___1_CM 1 100. 0. 1. DISPLAY_IDENTIFIER LV_ERR_ECU_RAM ECU_ADDRESS 0xd0007f7d BIT_MASK 0x1 /end MEASUREMENT
/begin MEASUREMENT lv_err_ecu_cks "ECU_CKS error detected" UBYTE _CNV_S_2_RANGE__0___1_CM 1 100. 0. 1. DISPLAY_IDENTIFIER LV_ERR_ECU_CKS ECU_ADDRESS 0xd0007f14 BIT_MASK 0x1 /end MEASUREMENT
/begin MEASUREMENT lv_err_ecu_nvmy "Present ECU NVMY error" UBYTE _CNV_S_2_RANGE__0___1_CM 1 100. 0. 1. DISPLAY_IDENTIFIER LV_ERR_ECU_NVMY ECU_ADDRESS 0xd0007fc2 BIT_MASK 0x1 /end MEASUREMENT
/begin MEASUREMENT lv_err_cwp_plaus "Plausibility error electrical waterpump" UBYTE _CNV_S_2_RANGE__0___1_CM 1 100. 0. 1. DISPLAY_IDENTIFIER LV_ERR_CWP_PLAUS ECU_ADDRESS 0xd0007fba BIT_MASK 0x1 /end MEASUREMENT
/begin CHARACTERISTIC c_t_cwp_dif_max "Timer Threshold CWP speed monitoring (Timer: T_CWP)" VALUE 0xa080c152 _REC_VAL_20_u1 25.5 _CNV_A_R_LINEAR_____4_CM 0. 25.5 DISPLAY_IDENTIFIER C_T_CWP_DIF_MAX FORMAT "%4.1" /end CHARACTERISTIC
/begin CHARACTERISTIC c_tco_cwp_rel_min_diag "TCO min threshold to enable CWP speed monitoring" VALUE 0xa080c2bf _REC_VAL_20_u1 190.5 _CNV_A_R_LINEAR_____17_CM -48. 142.5 DISPLAY_IDENTIFIER C_TCO_CWP_REL_MIN_DIAG FORMAT "%5.1" /end CHARACTERISTIC
/begin MEASUREMENT state_cwp_int "internal operation state of the CWP" UBYTE _CNV_A_R_LINEAR_____50_CM 1 100. 0. 10. DISPLAY_IDENTIFIER STATE_CWP_INT ECU_ADDRESS 0xd000872e FORMAT "%2.0" /end MEASUREMENT
/begin CHARACTERISTIC c_t_v_cwp_max_diag "timer threshold (for transition condition \"G\")" VALUE 0xa080c290 _REC_VAL_20_u1 25.5 _CNV_A_R_LINEAR_____4_CM 0. 25.5 DISPLAY_IDENTIFIER C_T_V_CWP_MAX_DIAG FORMAT "%4.1" /end CHARACTERISTIC
/begin AXIS_PTS ldp_state_cwp_int "" 0xa0808c98 state_cwp_int _REC_AXS_20_u1 1. _CNV_A_R_LINEAR_____50_CM 11 0. 10. FORMAT "%2.0" /end AXIS_PTS
/begin CHARACTERISTIC id_rel_cwp_pwr "power reduction of CWP" CURVE 0xa0809dcc _REC_CUR_20_u1_u1 99.609375 _CNV_A_R_LINEAR_____5_CM 0. 99.609375 DISPLAY_IDENTIFIER ID_REL_CWP_PWR FORMAT "%4.1"
 /begin AXIS_DESCR COM_AXIS state_cwp_int _CNV_A_R_LINEAR_____50_CM 11 0. 10. FORMAT "%2.0" AXIS_PTS_REF ldp_state_cwp_int /end AXIS_DESCR
/end CHARACTERISTIC
/begin MEASUREMENT rel_cwp_pwr "relativ CWP power" UBYTE _CNV_A_R_LINEAR_____5_CM 1 100. 0. 99.609375 DISPLAY_IDENTIFIER REL_CWP_PWR ECU_ADDRESS 0xd000872d FORMAT "%4.1" /end MEASUREMENT
/begin MEASUREMENT t_cwp_5 "Time delay before the transition to power reduced operation is performed due to electronics temp. too high" UBYTE _CNV_A_R_LINEAR_____4_CM 1 100. 0. 25.5 DISPLAY_IDENTIFIER T_CWP_5 ECU_ADDRESS 0xd000059d FORMAT "%4.1" /end MEASUREMENT
/begin MEASUREMENT n_rel_cwp_dif "Difference of actual waterpump speed range active to setpoint" UBYTE _CNV_A_R_LINEAR_____0_CM 1 100. 0. 255. DISPLAY_IDENTIFIER N_REL_CWP_DIF ECU_ADDRESS 0xd000872c FORMAT "%3.0" /end MEASUREMENT
/begin CHARACTERISTIC c_n_rel_cwp_dif_max "Max- control deviation threshold for ratio speed stages diagnosis" VALUE 0xa080bfaa _REC_VAL_20_u1 255. _CNV_A_R_LINEAR_____0_CM 0. 255. DISPLAY_IDENTIFIER C_N_REL_CWP_DIF_MAX FORMAT "%3.0" /end CHARACTERISTIC
/begin CHARACTERISTIC c_n_rel_cwp_hys "Ratio speed stages hysteresis" VALUE 0xa080bfab _REC_VAL_20_u1 255. _CNV_A_R_LINEAR_____0_CM 0. 255. DISPLAY_IDENTIFIER C_N_REL_CWP_HYS FORMAT "%3.0" /end CHARACTERISTIC
/begin CHARACTERISTIC c_t_cwp_lock_max "Timer Threshold locked active" VALUE 0xa080c153 _REC_VAL_20_u1 25.5 _CNV_A_R_LINEAR_____4_CM 0. 25.5 DISPLAY_IDENTIFIER C_T_CWP_LOCK_MAX FORMAT "%4.1" /end CHARACTERISTIC
/begin CHARACTERISTIC c_t_cwp_temp_high_max "Timer threshold for internal CWP error 'Electronic temperature too high" VALUE 0xa080c154 _REC_VAL_20_u1 25.5 _CNV_A_R_LINEAR_____4_CM 0. 25.5 DISPLAY_IDENTIFIER C_T_CWP_TEMP_HIGH_MAX FORMAT "%4.1" /end CHARACTERISTIC
/begin CHARACTERISTIC c_t_cwp_vcc_plaus_max "Timer threshold for internal CWP error 'Supply voltage too high'" VALUE 0xa080c155 _REC_VAL_20_u1 25.5 _CNV_A_R_LINEAR_____4_CM 0. 25.5 DISPLAY_IDENTIFIER C_T_CWP_VCC_PLAUS_MAX FORMAT "%4.1" /end CHARACTERISTIC
/begin MEASUREMENT lv_cwp_not_plaus "Waterpump speed stages or temperature gradient out of range" UBYTE _CNV_S_2_RANGE__0___1_CM 1 100. 0. 1. DISPLAY_IDENTIFIER LV_CWP_NOT_PLAUS ECU_ADDRESS 0xd000872f BIT_MASK 0x1 /end MEASUREMENT
/begin MEASUREMENT lv_cwp_tmp_off "Temporary shut down of the CWP triggered by internal CWP errors" UBYTE _CNV_S_2_RANGE__0___1_CM 1 100. 0. 1. DISPLAY_IDENTIFIER LV_CWP_TMP_OFF ECU_ADDRESS 0xd0008730 BIT_MASK 0x1 /end MEASUREMENT
/begin MEASUREMENT lv_cwp_off "Shut down of the CWP triggered by internal CWP errors, set after delay time" UBYTE _CNV_S_2_RANGE__0___1_CM 1 100. 0. 1. DISPLAY_IDENTIFIER LV_CWP_OFF ECU_ADDRESS 0xd0008731 BIT_MASK 0x1 /end MEASUREMENT
/begin MEASUREMENT t_cwp_dif_end_diag "Timer for CWP speed monitoring  End Diag detection" UBYTE _CNV_A_R_LINEAR_____4_CM 1 100. 0. 25.5 DISPLAY_IDENTIFIER T_CWP_DIF_END_DIAG ECU_ADDRESS 0xd0000595 FORMAT "%4.1" /end MEASUREMENT
/begin MEASUREMENT t_cwp_lock "Time delay before the error management is triggered by the internal error 'Current consumption too high'" UBYTE _CNV_A_R_LINEAR_____4_CM 1 100. 0. 25.5 DISPLAY_IDENTIFIER T_CWP_LOCK ECU_ADDRESS 0xd0000596 FORMAT "%4.1" /end MEASUREMENT
/begin MEASUREMENT t_cwp_temp_high "Time delay before the error management is triggered by the internal error 'Electronic temp. too high'" UBYTE _CNV_A_R_LINEAR_____4_CM 1 100. 0. 25.5 DISPLAY_IDENTIFIER T_CWP_TEMP_HIGH ECU_ADDRESS 0xd0000597 FORMAT "%4.1" /end MEASUREMENT
/begin MEASUREMENT t_cwp_vcc_plaus "Time delay before the error management is triggered by the internal error 'Supply voltage too high'" UBYTE _CNV_A_R_LINEAR_____4_CM 1 100. 0. 25.5 DISPLAY_IDENTIFIER T_CWP_VCC_PLAUS ECU_ADDRESS 0xd0000598 FORMAT "%4.1" /end MEASUREMENT
/begin MEASUREMENT t_cwp_cdn_diag_int_off "Time delay after the CDN Diag Flag can be set if no error is present --> End Diag Flag set by error Manag." UBYTE _CNV_A_R_LINEAR_____4_CM 1 100. 0. 25.5 DISPLAY_IDENTIFIER T_CWP_CDN_DIAG_INT_OFF ECU_ADDRESS 0xd0000599 FORMAT "%4.1" /end MEASUREMENT
/begin MEASUREMENT t_cwp_dif "Timer for CWP speed monitoring " UBYTE _CNV_A_R_LINEAR_____4_CM 1 100. 0. 25.5 DISPLAY_IDENTIFIER T_CWP_DIF ECU_ADDRESS 0xd0000594 FORMAT "%4.1" /end MEASUREMENT
/begin MEASUREMENT t_cwp_cdn_diag_pwr "Time delay after the CDN Diag Flag can be set if no error is present --> End Diag Flag set by error Manag." UBYTE _CNV_A_R_LINEAR_____4_CM 1 100. 0. 25.5 DISPLAY_IDENTIFIER T_CWP_CDN_DIAG_PWR ECU_ADDRESS 0xd000059a FORMAT "%4.1" /end MEASUREMENT
/begin MEASUREMENT t_cwp_4 "Time delay before the transition to power reduced operation is performed due to voltage supply too low" UBYTE _CNV_A_R_LINEAR_____4_CM 1 100. 0. 25.5 DISPLAY_IDENTIFIER T_CWP_4 ECU_ADDRESS 0xd000059c FORMAT "%4.1" /end MEASUREMENT
/begin CHARACTERISTIC c_temp_el_cwp_max_thd_1 "first power reduction threshold temperature CWP electronics" VALUE 0xa080c30f _REC_VAL_20_u1 255. _CNV_A_R_ENSD_LINEA_399_CM -50. 205. DISPLAY_IDENTIFIER C_TEMP_EL_CWP_MAX_THD_1 FORMAT "%5.0" /end CHARACTERISTIC
/begin CHARACTERISTIC c_temp_el_cwp_max_thd_2 "second power reduction threshold temperature CWP electronics" VALUE 0xa080c310 _REC_VAL_20_u1 255. _CNV_A_R_ENSD_LINEA_399_CM -50. 205. DISPLAY_IDENTIFIER C_TEMP_EL_CWP_MAX_THD_2 FORMAT "%5.0" /end CHARACTERISTIC
/begin CHARACTERISTIC c_temp_el_cwp_hys "Electronics CWP temperature hysteresis" VALUE 0xa080c30e _REC_VAL_20_u1 255. _CNV_A_R_ENSD_LINEA_399_CM -50. 205. DISPLAY_IDENTIFIER C_TEMP_EL_CWP_HYS FORMAT "%5.0" /end CHARACTERISTIC
/begin CHARACTERISTIC c_t_temp_el_cwp_thd_1 "timer threshold (for first transition condition \"E\")" VALUE 0xa080c27b _REC_VAL_20_u1 25.5 _CNV_A_R_LINEAR_____4_CM 0. 25.5 DISPLAY_IDENTIFIER C_T_TEMP_EL_CWP_THD_1 FORMAT "%4.1" /end CHARACTERISTIC
/begin CHARACTERISTIC c_t_temp_el_cwp_thd_2 "timer threshold (for second transition condition \"E\")" VALUE 0xa080c27c _REC_VAL_20_u1 25.5 _CNV_A_R_LINEAR_____4_CM 0. 25.5 DISPLAY_IDENTIFIER C_T_TEMP_EL_CWP_THD_2 FORMAT "%4.1" /end CHARACTERISTIC
/begin CHARACTERISTIC c_v_cwp_min_diag_mon "min threshold voltage CWP to enable CWP speed monitoring" VALUE 0xa080c3c0 _REC_VAL_20_u1 25.5 _CNV_A_R_LINEAR_____425_CM 0. 25.5 DISPLAY_IDENTIFIER C_V_CWP_MIN_DIAG_MON FORMAT "%4.1" /end CHARACTERISTIC
/begin MEASUREMENT lv_err_cwp_pwr "relative CWP power (reduced  power)" UBYTE _CNV_S_2_RANGE__0___1_CM 1 100. 0. 1. DISPLAY_IDENTIFIER LV_ERR_CWP_PWR ECU_ADDRESS 0xd0007fbc BIT_MASK 0x1 /end MEASUREMENT
/begin CHARACTERISTIC lc_swi_cwp_inp "Switch between lv_igk and lv_cdn_vb_min_diag" VALUE 0xa080c5f8 _REC_VAL_20_u1 1. _CNV_A_R_LINEAR_____0_CM 0. 1. DISPLAY_IDENTIFIER LC_SWI_CWP_INP FORMAT "%2.0" /end CHARACTERISTIC
/begin CHARACTERISTIC c_abc_max_cwp_chk_inp "Number of timeouts for antibounce of lv_err_cw_com_plaus" VALUE 0xa080b9f2 _REC_VAL_20_u1 254. _CNV_A_R_LINEAR_____0_CM 1. 255. DISPLAY_IDENTIFIER C_ABC_MAX_CWP_CHK_INP FORMAT "%3.0" /end CHARACTERISTIC
/begin CHARACTERISTIC c_abc_inc_cwp_chk_inp "Antibounce increment for lv_err_cw_com_plaus" VALUE 0xa080b92a _REC_VAL_20_u1 255. _CNV_A_R_LINEAR_____0_CM 0. 255. DISPLAY_IDENTIFIER C_ABC_INC_CWP_CHK_INP FORMAT "%3.0" /end CHARACTERISTIC
/begin CHARACTERISTIC c_n_rel_cwp_sp_thd_min "Minimum CWP speed above the voltage monitoring is activated" VALUE 0xa080bfac _REC_VAL_20_u1 255. _CNV_A_R_LINEAR_____0_CM 0. 255. DISPLAY_IDENTIFIER C_N_REL_CWP_SP_THD_MIN FORMAT "%3.0" /end CHARACTERISTIC
/begin CHARACTERISTIC c_v_cwp_hys "Voltage Hysteresis" VALUE 0xa080c3be _REC_VAL_20_u1 25.5 _CNV_A_R_LINEAR_____425_CM 0. 25.5 DISPLAY_IDENTIFIER C_V_CWP_HYS FORMAT "%4.1" /end CHARACTERISTIC
/begin CHARACTERISTIC c_v_cwp_min_diag_it "min threshold voltage CWP to enable CWP internal state" VALUE 0xa080c3bf _REC_VAL_20_u1 25.5 _CNV_A_R_LINEAR_____425_CM 0. 25.5 DISPLAY_IDENTIFIER C_V_CWP_MIN_DIAG_IT FORMAT "%4.1" /end CHARACTERISTIC
/begin MEASUREMENT lv_err_cwp_int_off "Electrical waterpump internal error" UBYTE _CNV_S_2_RANGE__0___1_CM 1 100. 0. 1. DISPLAY_IDENTIFIER LV_ERR_CWP_INT_OFF ECU_ADDRESS 0xd0007fbb BIT_MASK 0x1 /end MEASUREMENT
/begin MEASUREMENT lv_err_cwp_com_plaus "Plausibility error electrical waterpump communicatoin" UBYTE _CNV_S_2_RANGE__0___1_CM 1 100. 0. 1. DISPLAY_IDENTIFIER LV_ERR_CWP_COM_PLAUS ECU_ADDRESS 0xd0007fbd BIT_MASK 0x1 /end MEASUREMENT
/begin MEASUREMENT lv_clc_2seg "" UBYTE _CNV_S_2_RANGE__0___1_CM 1 100. 0. 1. DISPLAY_IDENTIFIER LV_CLC_2SEG ECU_ADDRESS 0xd0008c1d BIT_MASK 0x1 /end MEASUREMENT
/begin MEASUREMENT lv_clc_2seg_ena "" UBYTE _CNV_S_2_RANGE__0___1_CM 1 100. 0. 1. DISPLAY_IDENTIFIER LV_CLC_2SEG_ENA ECU_ADDRESS 0xd0008c1c BIT_MASK 0x1 /end MEASUREMENT
/begin CHARACTERISTIC c_n_seg_2_ena "" VALUE 0xa080bfb2 _REC_VAL_20_u1 8160. _CNV_A_R_LINEAR_____10_CM 0. 8160. DISPLAY_IDENTIFIER C_N_SEG_2_ENA FORMAT "%4.0" /end CHARACTERISTIC
/begin MEASUREMENT state_diag_gs "Status of GS diagnosis for feedback to gearbox" UBYTE _CNV_A_R_LINEAR_____0_CM 1 100. 0. 255. DISPLAY_IDENTIFIER STATE_DIAG_GS ECU_ADDRESS 0xd0008e44 FORMAT "%3.0" /end MEASUREMENT
/begin MEASUREMENT lv_err_gs "Boolean for error currently present on GS" UBYTE _CNV_S_2_RANGE__0___1_CM 1 100. 0. 1. DISPLAY_IDENTIFIER LV_ERR_GS ECU_ADDRESS 0xd0007fc3 BIT_MASK 0x1 /end MEASUREMENT
/begin CHARACTERISTIC lc_var_gs_eobd "Logical constant for variant EOBD (=1) or US (=0)" VALUE 0xa080c61b _REC_VAL_20_u1 1. _CNV_A_R_LINEAR_____0_CM 0. 1. DISPLAY_IDENTIFIER LC_VAR_GS_EOBD FORMAT "%2.0" /end CHARACTERISTIC
/begin CHARACTERISTIC lc_etcu_frf "Logical constant for storing freeze frame for ETCU ( 1 = FRF stored for ETCU)" VALUE 0xa080c569 _REC_VAL_20_u1 1. _CNV_A_R_LINEAR_____0_CM 0. 1. DISPLAY_IDENTIFIER LC_ETCU_FRF FORMAT "%2.0" /end CHARACTERISTIC
/begin MEASUREMENT lv_err_spi_knk "Present failure SPI-bus diagnosis for Knock sensor" UBYTE _CNV_S_2_RANGE__0___1_CM 1 100. 0. 1. DISPLAY_IDENTIFIER LV_ERR_SPI_KNK ECU_ADDRESS 0xd0007f92 BIT_MASK 0x1 /end MEASUREMENT
/begin MEASUREMENT lv_err_spi_mps "Present failure SPI-bus diagnosis for Multi-powerstage" UBYTE _CNV_S_2_RANGE__0___1_CM 1 100. 0. 1. DISPLAY_IDENTIFIER LV_ERR_SPI_MPS ECU_ADDRESS 0xd0007f91 BIT_MASK 0x1 /end MEASUREMENT
/begin AXIS_PTS ldpm_n_t_n_dif_ofs_pred "" 0xa080970c n _REC_AXS_20_u2 8160. _CNV_A_R_LINEAR_____14_CM 8 0. 8160. FORMAT "%4.0" /end AXIS_PTS
/begin MEASUREMENT lv_ch "Auxiliary Function \" Catalyst Heating Spark\"." UBYTE _CNV_S_2_RANGE__0___1_CM 1 100. 0. 1. DISPLAY_IDENTIFIER LV_CH ECU_ADDRESS 0xd00075fa BIT_MASK 0x1 /end MEASUREMENT
/begin CHARACTERISTIC c_t_max_rest "Time delay after switching on from LV_ST to detect LV_REST" VALUE 0xa080c1fc _REC_VAL_20_u1 25.4 _CNV_A_R_LINEAR_____36_CM 1. 255. DISPLAY_IDENTIFIER C_T_MAX_REST FORMAT "%3.0" /end CHARACTERISTIC
/begin CHARACTERISTIC c_tco_dif_max_rest "Coolant temperature threshold to detect LV_REST" VALUE 0xa080c2c1 _REC_VAL_20_u1 0.6 _CNV_A_R_LINEAR_____25_CM 0. 60. DISPLAY_IDENTIFIER C_TCO_DIF_MAX_REST FORMAT "%4.1" /end CHARACTERISTIC
/begin MEASUREMENT lv_rest "Auxiliary function \"Re-start\"" UBYTE _CNV_S_2_RANGE__0___1_CM 1 100. 0. 1. DISPLAY_IDENTIFIER LV_REST ECU_ADDRESS 0xd0008c02 BIT_MASK 0x1 /end MEASUREMENT
/begin MEASUREMENT cyc_cast "cycle counter at start and after start" UWORD _CNV_A_R_LINEAR_____0_CM 1 100. 0. 65535. DISPLAY_IDENTIFIER CYC_CAST ECU_ADDRESS 0xd000a7c8 FORMAT "%5.0" /end MEASUREMENT
/begin MEASUREMENT t_st_es "Time after transition from LV_ST to LV_ES" UWORD _CNV_A_R_LINEAR_____4_CM 1 100. 0.1 6553.5 DISPLAY_IDENTIFIER T_ST_ES ECU_ADDRESS 0xd0000376 FORMAT "%6.1" /end MEASUREMENT
/begin CHARACTERISTIC c_t_min_ecu_rest "Time threshold to detect new start after start-break off." VALUE 0xa080c220 _REC_VAL_20_u2 6553.400000000001 _CNV_A_R_LINEAR_____4_CM 0.1 6553.5 DISPLAY_IDENTIFIER C_T_MIN_ECU_REST FORMAT "%6.1" /end CHARACTERISTIC
/begin CHARACTERISTIC c_cyc_cast_min_st_es "Min value of CYC_CAST for the detection of  LV_ST_ES" VALUE 0xa080bc20 _REC_VAL_20_u2 65535. _CNV_A_R_LINEAR_____0_CM 0. 65535. DISPLAY_IDENTIFIER C_CYC_CAST_MIN_ST_ES FORMAT "%5.0" /end CHARACTERISTIC
/begin MEASUREMENT lv_st_es "Detection of engine start break off (passive / active)" UBYTE _CNV_S_2_RANGE__0___1_CM 1 100. 0. 1. DISPLAY_IDENTIFIER LV_ST_ES ECU_ADDRESS 0xd0008c03 BIT_MASK 0x1 /end MEASUREMENT
/begin MEASUREMENT lv_stall "Auxiliary function \"Engine Stall detected\"" UBYTE _CNV_S_2_RANGE__0___1_CM 1 100. 0. 1. DISPLAY_IDENTIFIER LV_STALL ECU_ADDRESS 0xd0008c01 BIT_MASK 0x1 /end MEASUREMENT
/begin MEASUREMENT t_ast_rest "After start time for re-start" UWORD _CNV_A_R_LINEAR_____4_CM 1 100. 0. 6553.5 DISPLAY_IDENTIFIER T_AST_REST ECU_ADDRESS 0xd000a7c6 FORMAT "%6.1" /end MEASUREMENT
/begin CHARACTERISTIC c_cyc_cast_max_st_es "Max value of CYC_CAST for the beginning of  incrementation if LV_ST_ES is set" VALUE 0xa080bc1e _REC_VAL_20_u2 65535. _CNV_A_R_LINEAR_____0_CM 0. 65535. DISPLAY_IDENTIFIER C_CYC_CAST_MAX_ST_ES FORMAT "%5.0" /end CHARACTERISTIC
/begin AXIS_PTS ldpm_tco__n_stall "" 0xa08097b8 tco _REC_AXS_20_u1 190.5 _CNV_A_R_LINEAR_____17_CM 9 -48. 142.5 FORMAT "%5.1" /end AXIS_PTS
/begin CHARACTERISTIC ip_n_bol_stall "Minimum engine speed for engine stalling detection" CURVE 0xa080b01c _REC_CUR_20_u2_u1 8160. _CNV_A_R_LINEAR_____14_CM 0. 8160. DISPLAY_IDENTIFIER IP_N_BOL_STALL FORMAT "%4.0"
 /begin AXIS_DESCR COM_AXIS tco _CNV_A_R_LINEAR_____17_CM 9 -48. 142.5 FORMAT "%5.1" AXIS_PTS_REF ldpm_tco__n_stall /end AXIS_DESCR
/end CHARACTERISTIC
/begin CHARACTERISTIC ip_n_tol_stall "Maximum engine speed for engine stalling detection" CURVE 0xa080b19c _REC_CUR_20_u2_u1 8160. _CNV_A_R_LINEAR_____14_CM 0. 8160. DISPLAY_IDENTIFIER IP_N_TOL_STALL FORMAT "%4.0"
 /begin AXIS_DESCR COM_AXIS tco _CNV_A_R_LINEAR_____17_CM 9 -48. 142.5 FORMAT "%5.1" AXIS_PTS_REF ldpm_tco__n_stall /end AXIS_DESCR
/end CHARACTERISTIC
/begin CHARACTERISTIC c_n_max_cdn_stall "Engine speed threshold for deactivation of stalling detection" VALUE 0xa080bf62 _REC_VAL_20_u2 8160. _CNV_A_R_LINEAR_____14_CM 0. 8160. DISPLAY_IDENTIFIER C_N_MAX_CDN_STALL FORMAT "%4.0" /end CHARACTERISTIC
/begin CHARACTERISTIC c_ctr_n_win_stall "Counter of N true events" VALUE 0xa080bbba _REC_VAL_20_u1 255. _CNV_A_R_LINEAR_____0_CM 0. 255. DISPLAY_IDENTIFIER C_CTR_N_WIN_STALL FORMAT "%3.0" /end CHARACTERISTIC
/begin MEASUREMENT ctr_n_win_stall "Number of events inside the stall rpm range" UBYTE _CNV_A_R_LINEAR_____0_CM 1 100. 0. 255. DISPLAY_IDENTIFIER CTR_N_WIN_STALL ECU_ADDRESS 0xd000037c FORMAT "%3.0" /end MEASUREMENT
/begin MEASUREMENT lv_wup_can "Indication for CAT heating ended" UBYTE _CNV_S_2_RANGE__0___1_CM 1 100. 0. 1. DISPLAY_IDENTIFIER LV_WUP_CAN ECU_ADDRESS 0xd0008c04 BIT_MASK 0x1 /end MEASUREMENT
/begin MEASUREMENT t_ast "Time after start" UWORD _CNV_A_R_LINEAR_____4_CM 1 100. 0. 6553.5 DISPLAY_IDENTIFIER T_AST ECU_ADDRESS 0xd000a7c4 FORMAT "%6.1" /end MEASUREMENT
/begin MEASUREMENT t_ast_diag "After start time for common sensor diagnosis" UWORD _CNV_A_R_LINEAR_____19_CM 1 100. 0. 32767.5 DISPLAY_IDENTIFIER T_AST_DIAG ECU_ADDRESS 0xd000a7ca FORMAT "%6.1" /end MEASUREMENT
/begin MEASUREMENT tco_rest "Coolant temperature, stored to detect a re-start" UBYTE _CNV_A_R_LINEAR_____17_CM 1 100. -48. 142.5 DISPLAY_IDENTIFIER TCO_REST ECU_ADDRESS 0xd0008c00 FORMAT "%5.1" /end MEASUREMENT
/begin MEASUREMENT lv_inh_diag_ns_obd_1_1 "Inhibition of NOx sensor OBD I diagnosis" UBYTE _CNV_S_2_RANGE__0___1_CM 1 100. 0. 1. DISPLAY_IDENTIFIER LV_INH_DIAG_NS_OBD_1[1] ECU_ADDRESS 0xd0008944 BIT_MASK 0x1 /end MEASUREMENT
/begin MEASUREMENT lv_inh_diag_ns_obd_1_2 "Inhibition of NOx sensor OBD I diagnosis" UBYTE _CNV_S_2_RANGE__0___1_CM 1 100. 0. 1. DISPLAY_IDENTIFIER LV_INH_DIAG_NS_OBD_1[1] ECU_ADDRESS 0xd0008945 BIT_MASK 0x1 /end MEASUREMENT
/begin CHARACTERISTIC c_n_s_clc_hys "engine speed hysteresis for the deactivation of the stratified mode related modules" VALUE 0xa080bfb1 _REC_VAL_20_u1 408. _CNV_A_R_LINEAR_____10_CM 0. 8160. DISPLAY_IDENTIFIER C_N_S_CLC_HYS FORMAT "%4.0" /end CHARACTERISTIC
/begin CHARACTERISTIC c_n_afl_clc "engine speed limit for the deactivation of the AFL mode related modules" VALUE 0xa080bf14 _REC_VAL_20_u1 408. _CNV_A_R_LINEAR_____10_CM 0. 8160. DISPLAY_IDENTIFIER C_N_AFL_CLC FORMAT "%4.0" /end CHARACTERISTIC
/begin CHARACTERISTIC c_n_afl_clc_hys "engine speed hysteresis for the deactivation of the AFL mode related modules" VALUE 0xa080bf15 _REC_VAL_20_u1 408. _CNV_A_R_LINEAR_____10_CM 0. 8160. DISPLAY_IDENTIFIER C_N_AFL_CLC_HYS FORMAT "%4.0" /end CHARACTERISTIC
/begin MEASUREMENT lv_afl_clc "logical varaible for the deactivation of all AFL mode relevant modules" UBYTE _CNV_S_2_RANGE__0___1_CM 1 100. 0. 1. DISPLAY_IDENTIFIER LV_AFL_CLC ECU_ADDRESS 0xd0008963 BIT_MASK 0x1 /end MEASUREMENT
/begin CHARACTERISTIC c_n_s_clc "engine speed limit for calculation of stratified mode" VALUE 0xa080bfb0 _REC_VAL_20_u1 8160. _CNV_A_R_LINEAR_____10_CM 0. 8160. DISPLAY_IDENTIFIER C_N_S_CLC FORMAT "%4.0" /end CHARACTERISTIC
/begin MEASUREMENT lv_inh_s "Inhibit of stratified mode due to project specific requests." UBYTE _CNV_S_2_RANGE__0___1_CM 1 100. 0. 1. DISPLAY_IDENTIFIER LV_INH_S ECU_ADDRESS 0xd0008960 BIT_MASK 0x1 /end MEASUREMENT
/begin MEASUREMENT lv_inh_afl "Inhibit of AFL mode due to project specific requests." UBYTE _CNV_S_2_RANGE__0___1_CM 1 100. 0. 1. DISPLAY_IDENTIFIER LV_INH_AFL ECU_ADDRESS 0xd0008961 BIT_MASK 0x1 /end MEASUREMENT
/begin MEASUREMENT lv_s_clc "Switch to deactivate calculations for stratified mode" UBYTE _CNV_S_2_RANGE__0___1_CM 1 100. 0. 1. DISPLAY_IDENTIFIER LV_S_CLC ECU_ADDRESS 0xd0008962 BIT_MASK 0x1 /end MEASUREMENT
/begin MEASUREMENT lamb_sp_s_raw "raw value lambda setpoint for stratified mode" UWORD _CNV_A_R_LINEAR_____129_CM 1 100. 0. 31.9990234375 DISPLAY_IDENTIFIER LAMB_SP_S_RAW ECU_ADDRESS 0xd00004dc FORMAT "%7.4" /end MEASUREMENT
/begin CHARACTERISTIC c_crlc_lamb_sp_s "correlation filter constant for LAMB_SP_S filtering" VALUE 0xa080baf2 _REC_VAL_20_u2 0.9999847412109381 _CNV_A_R_LINEAR_____89_CM 0. 0.9999847412109381 DISPLAY_IDENTIFIER C_CRLC_LAMB_SP_S FORMAT "%7.5" /end CHARACTERISTIC
/begin CHARACTERISTIC c_lamb_sp_s_ini "initialization value for LAMB_SP_S after reset" VALUE 0xa080bdf4 _REC_VAL_20_u2 31.9990234375 _CNV_A_R_LINEAR_____129_CM 0. 31.9990234375 DISPLAY_IDENTIFIER C_LAMB_SP_S_INI FORMAT "%7.4" /end CHARACTERISTIC
/begin CHARACTERISTIC c_fac_lamb_afs "air fuel stoichiometric factor (typical value 14.71)" VALUE 0xa080bcda _REC_VAL_20_u2 31.9990234375 _CNV_A_R_LINEAR_____129_CM 0. 31.9990234375 DISPLAY_IDENTIFIER C_FAC_LAMB_AFS FORMAT "%7.4" /end CHARACTERISTIC
/begin CHARACTERISTIC lc_lamb_sp_s_raw_ext "Switch between layer and internal calcualtion of Lamb_SP_S" VALUE 0xa080c5a4 _REC_VAL_20_u1 1. _CNV_A_R_LINEAR_____0_CM 0. 1. DISPLAY_IDENTIFIER LC_LAMB_SP_S_RAW_EXT FORMAT "%1.0" /end CHARACTERISTIC
/begin MEASUREMENT lamb_sp_s "lambda setpoint for stratified mode" UWORD _CNV_A_R_LINEAR_____129_CM 1 100. 0. 31.9990234375 DISPLAY_IDENTIFIER LAMB_SP_S ECU_ADDRESS 0xd000a534 FORMAT "%7.4" /end MEASUREMENT
/begin MEASUREMENT lv_tqi_plaus_hom_afs_req "Request for combustion mode switch to homogeneous stoichiometric due to  torque plausibility check" UBYTE _CNV_S_2_RANGE__0___1_CM 1 100. 0. 1. DISPLAY_IDENTIFIER LV_TQI_PLAUS_HOM_AFS_REQ ECU_ADDRESS 0xd0008964 BIT_MASK 0x1 /end MEASUREMENT
/begin MEASUREMENT lv_tqi_plaus_hom_afs_act "Time duration forced combustion mode switch to HOM_AFS due to torque plausibility check" UBYTE _CNV_S_2_RANGE__0___1_CM 1 100. 0. 1. DISPLAY_IDENTIFIER LV_TQI_PLAUS_HOM_AFS_ACT ECU_ADDRESS 0xd0008965 BIT_MASK 0x1 /end MEASUREMENT
/begin MEASUREMENT t_tqi_plaus_swi "Actual time duration in non HOM_AFS state in case of torque limitation due to torque plausibility check" UBYTE _CNV_A_R_LINEAR_____3_CM 1 100. 0. 2.55 DISPLAY_IDENTIFIER T_TQI_PLAUS_SWI ECU_ADDRESS 0xd0008966 FORMAT "%4.2" /end MEASUREMENT
/begin CHARACTERISTIC c_n_hom_act_thd "Threshold on engine speed for activation torque plausibility testing" VALUE 0xa080bf36 _REC_VAL_20_u1 8160. _CNV_A_R_LINEAR_____10_CM 0. 8160. DISPLAY_IDENTIFIER C_N_HOM_ACT_THD FORMAT "%4.0" /end CHARACTERISTIC
/begin CHARACTERISTIC c_n_hom_act_hys "Hysteresis on engine speed" VALUE 0xa080bf35 _REC_VAL_20_u1 8160. _CNV_A_R_LINEAR_____10_CM 0. 8160. DISPLAY_IDENTIFIER C_N_HOM_ACT_HYS FORMAT "%4.0" /end CHARACTERISTIC
/begin CHARACTERISTIC c_pv_hom_act_hys "Hysteresis on pedal value" VALUE 0xa080c093 _REC_VAL_20_u1 99.609375 _CNV_A_R_LINEAR_____5_CM 0. 99.609375 DISPLAY_IDENTIFIER C_PV_HOM_ACT_HYS FORMAT "%4.1" /end CHARACTERISTIC
/begin CHARACTERISTIC c_fac_tq_hom_act_hys "Hysteresis on torque scaling factor for cruise control" VALUE 0xa080bd0a _REC_VAL_20_u2 1.99996948242188 _CNV_A_R_LINEAR_____9_CM 0. 1.99996948242188 DISPLAY_IDENTIFIER C_FAC_TQ_HOM_ACT_HYS FORMAT "%7.5" /end CHARACTERISTIC
/begin CHARACTERISTIC c_t_max_tqi_plaus_swi "Maximum switching time to HOM_AFS in case of torque plausibility check" VALUE 0xa080c208 _REC_VAL_20_u1 2.55 _CNV_A_R_LINEAR_____3_CM 0. 2.55 DISPLAY_IDENTIFIER C_T_MAX_TQI_PLAUS_SWI FORMAT "%4.2" /end CHARACTERISTIC
/begin MEASUREMENT lv_iga_and_inj_swi_1 "Logical variable controlling ignition and injection  mode (stratified or homofenous)" UBYTE _CNV_S_2_RANGE__0___1_CM 1 100. 0. 1. DISPLAY_IDENTIFIER LV_IGA_AND_INJ_SWI_1 ECU_ADDRESS 0xd00086ed BIT_MASK 0x1 /end MEASUREMENT
/begin MEASUREMENT lv_iga_and_inj_swi_2 "Logical variable controlling ignition and injection  mode (stratified or homofenous)" UBYTE _CNV_S_2_RANGE__0___1_CM 1 100. 0. 1. DISPLAY_IDENTIFIER LV_IGA_AND_INJ_SWI_2 ECU_ADDRESS 0xd00086ee BIT_MASK 0x1 /end MEASUREMENT
/begin MEASUREMENT lv_s_run "flag to activate stratified calculations" UBYTE _CNV_S_2_RANGE__0___1_CM 1 100. 0. 1. DISPLAY_IDENTIFIER LV_S_RUN ECU_ADDRESS 0xd00086e4 BIT_MASK 0x1 /end MEASUREMENT
/begin MEASUREMENT lv_hom_run "flag to activate homogeneous calculations" UBYTE _CNV_S_2_RANGE__0___1_CM 1 100. 0. 1. DISPLAY_IDENTIFIER LV_HOM_RUN ECU_ADDRESS 0xd00086e3 BIT_MASK 0x1 /end MEASUREMENT
/begin MEASUREMENT lv_hom_afs_req "request for AFS mode" UBYTE _CNV_S_2_RANGE__0___1_CM 1 100. 0. 1. DISPLAY_IDENTIFIER LV_HOM_AFS_REQ ECU_ADDRESS 0xd00086e5 BIT_MASK 0x1 /end MEASUREMENT
/begin MEASUREMENT lv_s_act "stratified ignition and injection parameters are applied to the engine" UBYTE _CNV_S_2_RANGE__0___1_CM 1 100. 0. 1. DISPLAY_IDENTIFIER LV_S_ACT ECU_ADDRESS 0xd00086e6 BIT_MASK 0x1 /end MEASUREMENT
/begin MEASUREMENT state_cmb_ctl "states of the combustion management" UBYTE _CNV_S_9_STATE_CMB__520_CM 1 100. 0. 8. DISPLAY_IDENTIFIER STATE_CMB_CTL ECU_ADDRESS 0xd00086e2 /end MEASUREMENT
/begin MEASUREMENT lv_iga_and_inj_swi "logical variable controlling ignition and injection mode (stratified or homogeneous)" UBYTE _CNV_S_2_RANGE__0___1_CM 1 100. 0. 1. DISPLAY_IDENTIFIER LV_IGA_AND_INJ_SWI ECU_ADDRESS 0xd00086e7 BIT_MASK 0x1 /end MEASUREMENT
/begin MEASUREMENT lv_fup_sp_swi "flag for fuel pressure setpoint switch" UBYTE _CNV_S_2_RANGE__0___1_CM 1 100. 0. 1. DISPLAY_IDENTIFIER LV_FUP_SP_SWI ECU_ADDRESS 0xd00086e8 BIT_MASK 0x1 /end MEASUREMENT
/begin MEASUREMENT lv_hom_afl_act "homogeneous air fuel lean mode active" UBYTE _CNV_S_2_RANGE__0___1_CM 1 100. 0. 1. DISPLAY_IDENTIFIER LV_HOM_AFL_ACT ECU_ADDRESS 0xd00086e9 BIT_MASK 0x1 /end MEASUREMENT
/begin MEASUREMENT lv_hom_afs_act "logical variable indicates active homogeneous stoichiometric state" UBYTE _CNV_S_2_RANGE__0___1_CM 1 100. 0. 1. DISPLAY_IDENTIFIER LV_HOM_AFS_ACT ECU_ADDRESS 0xd00086ea BIT_MASK 0x1 /end MEASUREMENT
/begin MEASUREMENT opm_av "Actual engine operation mode" UBYTE _CNV_S_5_STATE_OPM_521_CM 1 100. 0. 8. DISPLAY_IDENTIFIER OPM_AV ECU_ADDRESS 0xd00086e1 /end MEASUREMENT
/begin MEASUREMENT opm_req "Requested engine operation mode (for operation switch manager)" UBYTE _CNV_S_5_STATE_OPM_521_CM 1 100. 0. 8. DISPLAY_IDENTIFIER OPM_REQ ECU_ADDRESS 0xd00086e0 /end MEASUREMENT
/begin MEASUREMENT lv_sp_rate_cyl_egr_swi "Flag for EGR setpoint rate" UBYTE _CNV_S_2_RANGE__0___1_CM 1 100. 0. 1. DISPLAY_IDENTIFIER LV_SP_RATE_CYL_EGR_SWI ECU_ADDRESS 0xd00086ec BIT_MASK 0x1 /end MEASUREMENT
/begin MEASUREMENT lv_hom_act "Homogeneous ignition and injection parameters are applied to the engine" UBYTE _CNV_S_2_RANGE__0___1_CM 1 100. 0. 1. DISPLAY_IDENTIFIER LV_HOM_ACT ECU_ADDRESS 0xd00086eb BIT_MASK 0x1 /end MEASUREMENT
/begin MEASUREMENT lv_s_ena "catalyst heating home" UBYTE _CNV_S_2_RANGE__0___1_CM 1 100. 0. 1. DISPLAY_IDENTIFIER LV_S_ENA ECU_ADDRESS 0xd00086ef BIT_MASK 0x1 /end MEASUREMENT
/begin MEASUREMENT lv_hom_ena "catalyst heating home" UBYTE _CNV_S_2_RANGE__0___1_CM 1 100. 0. 1. DISPLAY_IDENTIFIER LV_HOM_ENA ECU_ADDRESS 0xd00086f0 BIT_MASK 0x1 /end MEASUREMENT
/begin MEASUREMENT lv_mplh_ena "catalyst heating home enable" UBYTE _CNV_S_2_RANGE__0___1_CM 1 100. 0. 1. DISPLAY_IDENTIFIER LV_MPLH_ENA ECU_ADDRESS 0xd00086f1 BIT_MASK 0x1 /end MEASUREMENT
/begin MEASUREMENT lamb_sp_s_ext "lambda setpoint for stratified mode" UWORD _CNV_A_R_LINEAR_____129_CM 1 100. 0. 31.9990234375 DISPLAY_IDENTIFIER LAMB_SP_S_EXT ECU_ADDRESS 0xd000a270 FORMAT "%7.4" /end MEASUREMENT
/begin MEASUREMENT lv_iga_and_inj_swi_homs_1 "Logical variable controlling igintion and injection mode (stratified or homogeneous)" UBYTE _CNV_S_2_RANGE__0___1_CM 1 100. 0. 1. DISPLAY_IDENTIFIER LV_IGA_AND_INJ_SWI_HOMS_1 ECU_ADDRESS 0xd00086f2 BIT_MASK 0x1 /end MEASUREMENT
/begin MEASUREMENT lv_iga_and_inj_swi_homs_2 "Logical variable controlling igintion and injection mode (stratified or homogeneous)" UBYTE _CNV_S_2_RANGE__0___1_CM 1 100. 0. 1. DISPLAY_IDENTIFIER LV_IGA_AND_INJ_SWI_HOMS_2 ECU_ADDRESS 0xd00086f3 BIT_MASK 0x1 /end MEASUREMENT
/begin MEASUREMENT lv_iga_and_inj_swi_homs "Logical variable controlling igintion and injection mode (stratified or homogeneous)" UBYTE _CNV_S_2_RANGE__0___1_CM 1 100. 0. 1. DISPLAY_IDENTIFIER LV_IGA_AND_INJ_SWI_HOMS ECU_ADDRESS 0xd00086f4 BIT_MASK 0x1 /end MEASUREMENT
/begin CHARACTERISTIC lc_req_fsd_eol "Switch for external adjustment of  fuel-system diagnosis" VALUE 0xa080c5d9 _REC_VAL_20_u1 1. _CNV_S_2_RANGE__0___1_CM 0. 1. DISPLAY_IDENTIFIER LC_REQ_FSD_EOL /end CHARACTERISTIC
/begin MEASUREMENT lv_ftl_min_act "Activation conditions for Diagnosis passed" UBYTE _CNV_S_2_RANGE__0___1_CM 1 100. 0. 1. DISPLAY_IDENTIFIER LV_FTL_MIN_ACT ECU_ADDRESS 0xd0000cb0 BIT_MASK 0x1 /end MEASUREMENT
/begin MEASUREMENT lv_err_ftl_min "Fuel tank level low Injection intervention" UBYTE _CNV_S_2_RANGE__0___1_CM 1 100. 0. 1. DISPLAY_IDENTIFIER LV_ERR_FTL_MIN ECU_ADDRESS 0xd0007f07 BIT_MASK 0x1 /end MEASUREMENT
/begin MEASUREMENT ratio_ftl "ratio of counter" UWORD _CNV_A_R_LINEAR_____165_CM 1 100. 0. 1. DISPLAY_IDENTIFIER RATIO_FTL ECU_ADDRESS 0xd0000ca8 FORMAT "%7.5" /end MEASUREMENT
/begin MEASUREMENT ratio_ftl_ini "ratio of initialisation counter" UWORD _CNV_A_R_LINEAR_____165_CM 1 100. 0. 1. DISPLAY_IDENTIFIER RATIO_FTL_INI ECU_ADDRESS 0xd0000caa FORMAT "%7.5" /end MEASUREMENT
/begin MEASUREMENT ctr_er_ftl_min "er counter" UWORD _CNV_A_R_LINEAR_____0_CM 1 100. 0. 65535. DISPLAY_IDENTIFIER CTR_ER_FTL_MIN ECU_ADDRESS 0xd0000cae FORMAT "%5.0" /end MEASUREMENT
/begin MEASUREMENT inh_iv_ftl_min "Bit coded inhbit condition cylinder selective for fuel tank low level" UBYTE _CNV_A_R_LINEAR_____0_CM 1 100. 0. 255. DISPLAY_IDENTIFIER INH_IV_FTL_MIN ECU_ADDRESS 0xd0008e4c FORMAT "%3.0" /end MEASUREMENT
/begin CHARACTERISTIC c_fac_ratio_ftl_ini_min "Correction factor" VALUE 0xa080bcec _REC_VAL_20_u2 655.35 _CNV_A_R_EGCP_LINEA_354_CM 0. 655.35 DISPLAY_IDENTIFIER C_FAC_RATIO_FTL_INI_MIN FORMAT "%6.2" /end CHARACTERISTIC
/begin CHARACTERISTIC c_fac_ratio_ftl_ini_max "Correction factor" VALUE 0xa080bcea _REC_VAL_20_u2 655.35 _CNV_A_R_EGCP_LINEA_354_CM 0. 655.35 DISPLAY_IDENTIFIER C_FAC_RATIO_FTL_INI_MAX FORMAT "%6.2" /end CHARACTERISTIC
/begin CHARACTERISTIC c_ctr_ftl_max "Counter for maximum of increments" VALUE 0xa080bb92 _REC_VAL_20_u2 65535. _CNV_A_R_LINEAR_____0_CM 0. 65535. DISPLAY_IDENTIFIER C_CTR_FTL_MAX FORMAT "%5.0" /end CHARACTERISTIC
/begin CHARACTERISTIC c_inh_iv_ftl_min "Bitmask of inhibit cylinders" VALUE 0xa080bdb6 _REC_VAL_20_u1 255. _CNV_A_R_LINEAR_____0_CM 0. 255. DISPLAY_IDENTIFIER C_INH_IV_FTL_MIN FORMAT "%3.0" /end CHARACTERISTIC
/begin CHARACTERISTIC c_abc_inc_ftl_min "increment" VALUE 0xa080b93c _REC_VAL_20_u1 255. _CNV_A_R_LINEAR_____0_CM 0. 255. DISPLAY_IDENTIFIER C_ABC_INC_FTL_MIN FORMAT "%3.0" /end CHARACTERISTIC
/begin CHARACTERISTIC c_abc_dec_ftl_min "decrement" VALUE 0xa080b8cb _REC_VAL_20_u1 255. _CNV_A_R_LINEAR_____0_CM 0. 255. DISPLAY_IDENTIFIER C_ABC_DEC_FTL_MIN FORMAT "%3.0" /end CHARACTERISTIC
/begin CHARACTERISTIC c_abc_max_ftl_min "maximum" VALUE 0xa080ba04 _REC_VAL_20_u1 255. _CNV_A_R_LINEAR_____0_CM 0. 255. DISPLAY_IDENTIFIER C_ABC_MAX_FTL_MIN FORMAT "%3.0" /end CHARACTERISTIC
/begin CHARACTERISTIC c_lamb_sp_ftl_min "Threshold lambda SP" VALUE 0xa080bdf2 _REC_VAL_20_u2 31.9990234375 _CNV_A_R_LINEAR_____129_CM 0. 31.9990234375 DISPLAY_IDENTIFIER C_LAMB_SP_FTL_MIN FORMAT "%7.4" /end CHARACTERISTIC
/begin CHARACTERISTIC c_ctr_ftl_ratio_max "Maximum of increments for ratio" VALUE 0xa080bb96 _REC_VAL_20_u2 65535. _CNV_A_R_LINEAR_____0_CM 0. 65535. DISPLAY_IDENTIFIER C_CTR_FTL_RATIO_MAX FORMAT "%5.0" /end CHARACTERISTIC
/begin MEASUREMENT lv_fup_avl_diag_tmp "Logical variable indicating fuel pressure falls below a threshold of the FTL diagnosis" UBYTE _CNV_S_2_RANGE__0___1_CM 1 100. 0. 1. DISPLAY_IDENTIFIER LV_FUP_AVL_DIAG_TMP ECU_ADDRESS 0xd0000cb1 BIT_MASK 0x1 /end MEASUREMENT
/begin CHARACTERISTIC c_fup_efp_diag_ftl_min "Fuel pressure of low pressure threshold for FTL diagnosis" VALUE 0xa080bd56 _REC_VAL_20_u2 173888. _CNV_A_R_LINEAR_____173_CM 0. 173888. DISPLAY_IDENTIFIER C_FUP_EFP_DIAG_FTL_MIN FORMAT "%8.1" /end CHARACTERISTIC
/begin CHARACTERISTIC c_fup_diag_ftl_min "Fuel pressure of threshold for FTL diagnosis" VALUE 0xa080bd50 _REC_VAL_20_u2 347776. _CNV_A_R_LINEAR_____171_CM 0. 347776. DISPLAY_IDENTIFIER C_FUP_DIAG_FTL_MIN FORMAT "%6.0" /end CHARACTERISTIC
/begin MEASUREMENT lv_lamb_plaus_ftl_min_diag_tmp "Logical variable indicating an unplausible lambda signal for FTL diagnosis" UBYTE _CNV_S_2_RANGE__0___1_CM 1 100. 0. 1. DISPLAY_IDENTIFIER LV_LAMB_PLAUS_FTL_MIN_DIAG_TMP ECU_ADDRESS 0xd0000cb2 BIT_MASK 0x1 /end MEASUREMENT
/begin MEASUREMENT lv_err_fup_diag_act_hprs "Logical variable indicating the use of error flags for diagnosis condition in High Pressure Sysrem" UBYTE _CNV_S_2_RANGE__0___1_CM 1 100. 0. 1. DISPLAY_IDENTIFIER LV_ERR_FUP_DIAG_ACT_HPRS ECU_ADDRESS 0xd0000cb3 BIT_MASK 0x1 /end MEASUREMENT
/begin MEASUREMENT lv_err_fup_diag_act_lprs "Logical variable indicating the use of error flags for diagnosis condition in Low Pressure Sysrem" UBYTE _CNV_S_2_RANGE__0___1_CM 1 100. 0. 1. DISPLAY_IDENTIFIER LV_ERR_FUP_DIAG_ACT_LPRS ECU_ADDRESS 0xd0000cb4 BIT_MASK 0x1 /end MEASUREMENT
/begin MEASUREMENT ctr_ftl_min_act "Precounter FTL events" UWORD _CNV_A_R_LINEAR_____0_CM 1 100. 0. 65535. DISPLAY_IDENTIFIER CTR_FTL_MIN_ACT ECU_ADDRESS 0xd0000cac FORMAT "%5.0" /end MEASUREMENT
/begin MEASUREMENT state_err_ftl "State defining the source of the error symptom" UBYTE _CNV_A_R_LINEAR_____0_CM 1 100. 0. 255. DISPLAY_IDENTIFIER STATE_ERR_FTL ECU_ADDRESS 0xd0000cb5 FORMAT "%3.0" /end MEASUREMENT
/begin CHARACTERISTIC c_fac_lam_ftl_min "Threshold of limited value of lambda controller output for FTL diagnosis" VALUE 0xa080bcd8 _REC_VAL_20_s2 99.99847412109381 _CNV_A_R_LINEAR_____113_CM -50. 49.9984741210938 DISPLAY_IDENTIFIER C_FAC_LAM_FTL_MIN FORMAT "%5.4" /end CHARACTERISTIC
/begin CHARACTERISTIC c_ftl_diag_ftl_min "Fuel Tank Level threshold for FTL diagnosis" VALUE 0xa080bd36 _REC_VAL_20_u1 127. _CNV_A_R_LINEAR_____75_CM 0. 127. DISPLAY_IDENTIFIER C_FTL_DIAG_FTL_MIN FORMAT "%3.0" /end CHARACTERISTIC
/begin CHARACTERISTIC c_lamb_dif_fil_max "Threshold of lambda difference for FTL diagnosis" VALUE 0xa080bdcc _REC_VAL_20_u2 31.9990234375 _CNV_A_R_LINEAR_____129_CM 0. 31.9990234375 DISPLAY_IDENTIFIER C_LAMB_DIF_FIL_MAX FORMAT "%7.4" /end CHARACTERISTIC
/begin CHARACTERISTIC c_fup_dif_ftl_max "Fuel Pressure Difference Maximum for FTL diagnosis" VALUE 0xa080bd52 _REC_VAL_20_u2 347776. _CNV_A_R_LINEAR_____171_CM 0. 347776. DISPLAY_IDENTIFIER C_FUP_DIF_FTL_MAX FORMAT "%6.0" /end CHARACTERISTIC
/begin CHARACTERISTIC lc_lamb_plaus_ftl_min_diag "Logical constant indicating the non plausible lambda signal for FTL diagnosis" VALUE 0xa080c5a3 _REC_VAL_20_u1 1. _CNV_A_R_LINEAR_____0_CM 0. 1. DISPLAY_IDENTIFIER LC_LAMB_PLAUS_FTL_MIN_DIAG FORMAT "%1.0" /end CHARACTERISTIC
/begin CHARACTERISTIC lc_err_fup_diag_act_hprs "Logical constant indicating the use of error flags for diagnosis condition at High Pressure" VALUE 0xa080c567 _REC_VAL_20_u1 1. _CNV_A_R_LINEAR_____0_CM 0. 1. DISPLAY_IDENTIFIER LC_ERR_FUP_DIAG_ACT_HPRS FORMAT "%1.0" /end CHARACTERISTIC
/begin CHARACTERISTIC lc_err_fup_diag_act_lprs "Logical constant indicating the use of error flags for diagnosis condition at Low Pressure" VALUE 0xa080c568 _REC_VAL_20_u1 1. _CNV_A_R_LINEAR_____0_CM 0. 1. DISPLAY_IDENTIFIER LC_ERR_FUP_DIAG_ACT_LPRS FORMAT "%1.0" /end CHARACTERISTIC
/begin CHARACTERISTIC lc_er_ftl_min_act "Logical constant indicating the use of engine roughness flags for diagnosis condition" VALUE 0xa080c566 _REC_VAL_20_u1 1. _CNV_A_R_LINEAR_____0_CM 0. 1. DISPLAY_IDENTIFIER LC_ER_FTL_MIN_ACT FORMAT "%1.0" /end CHARACTERISTIC
/begin MEASUREMENT lv_err_t_es "Engine off duration error" UBYTE _CNV_S_2_RANGE__0___1_CM 1 100. 0. 1. DISPLAY_IDENTIFIER LV_ERR_T_ES ECU_ADDRESS 0xd0007f45 BIT_MASK 0x1 /end MEASUREMENT
/begin CHARACTERISTIC c_tco_stuck_t_es_diag "TCO-threshold for enabling T_ES-diagnosis independent  of TCO_STUCK-diagnosis" VALUE 0xa080c2e9 _REC_VAL_20_u1 190.5 _CNV_A_R_LINEAR_____17_CM -48. 142.5 DISPLAY_IDENTIFIER C_TCO_STUCK_T_ES_DIAG FORMAT "%5.1" /end CHARACTERISTIC
/begin MEASUREMENT state_rbm_cs "Interface of CS monitor with the Rate-Based Monitoring statistics" UBYTE _CNV_A_R_LINEAR_____0_CM 1 100. 0. 7. DISPLAY_IDENTIFIER STATE_RBM_CS ECU_ADDRESS 0xd0008e08 FORMAT "%1.0" /end MEASUREMENT
/begin CHARACTERISTIC c_abc_inc_tam_can "Antibounce increment TAM_CAN diagnosis" VALUE 0xa080b983 _REC_VAL_20_u1 255. _CNV_A_R_LINEAR_____0_CM 0. 255. DISPLAY_IDENTIFIER C_ABC_INC_TAM_CAN FORMAT "%3.0" /end CHARACTERISTIC
/begin CHARACTERISTIC c_abc_max_tam_can "Antibounce maximum TAM_CAN diagnosis" VALUE 0xa080ba4c _REC_VAL_20_u1 255. _CNV_A_R_LINEAR_____0_CM 0. 255. DISPLAY_IDENTIFIER C_ABC_MAX_TAM_CAN FORMAT "%3.0" /end CHARACTERISTIC
/begin CHARACTERISTIC c_tam_dif_st_end "Minimum TAM difference to detect a moving signal after start" VALUE 0xa080c2ac _REC_VAL_20_u1 190.5 _CNV_A_R_LINEAR_____25_CM 0. 190.5 DISPLAY_IDENTIFIER C_TAM_DIF_ST_END FORMAT "%5.1" /end CHARACTERISTIC
/begin CHARACTERISTIC c_t_es_min_tam_diag "Maximum engine stop time to activate the diagnosis condition" VALUE 0xa080c1b6 _REC_VAL_20_u2 65535. _CNV_A_R_LINEAR_____84_CM 0. 65535. DISPLAY_IDENTIFIER C_T_ES_MIN_TAM_DIAG FORMAT "%5.0" /end CHARACTERISTIC
/begin CHARACTERISTIC c_tam_min_tam_diag "Minimum ambient temperature to activate the diagnosis conditon" VALUE 0xa080c2b7 _REC_VAL_20_u1 190.5 _CNV_A_R_LINEAR_____17_CM -48. 142.5 DISPLAY_IDENTIFIER C_TAM_MIN_TAM_DIAG FORMAT "%6.2" /end CHARACTERISTIC
/begin CHARACTERISTIC c_tam_max_tam_diag "Maximum ambient temperature to activate the diagnosis conditon" VALUE 0xa080c2b3 _REC_VAL_20_u1 190.5 _CNV_A_R_LINEAR_____17_CM -48. 142.5 DISPLAY_IDENTIFIER C_TAM_MAX_TAM_DIAG FORMAT "%6.2" /end CHARACTERISTIC
/begin CHARACTERISTIC c_tam_dif_plaus_min "Minimum TAM difference to detect a moving signal during engine run" VALUE 0xa080c2ab _REC_VAL_20_u1 190.5 _CNV_A_R_LINEAR_____25_CM 0. 190.5 DISPLAY_IDENTIFIER C_TAM_DIF_PLAUS_MIN FORMAT "%5.1" /end CHARACTERISTIC
/begin CHARACTERISTIC c_tam_dif_max_err "Temperature difference to detect a TAM error" VALUE 0xa080c2aa _REC_VAL_20_u1 190.5 _CNV_A_R_LINEAR_____25_CM 0. 190.5 DISPLAY_IDENTIFIER C_TAM_DIF_MAX_ERR FORMAT "%5.1" /end CHARACTERISTIC
/begin CHARACTERISTIC c_t_ast_max_tam_diag "Maximum time after start to deactivate the diagnosis condition" VALUE 0xa080c132 _REC_VAL_20_u2 6553.5 _CNV_A_R_LINEAR_____4_CM 0. 6553.5 DISPLAY_IDENTIFIER C_T_AST_MAX_TAM_DIAG FORMAT "%5.1" /end CHARACTERISTIC
/begin CHARACTERISTIC c_t_tam_dif_max_err "Anti-bounce time to detect a TAM error" VALUE 0xa080c27a _REC_VAL_20_u1 25.5 _CNV_A_R_LINEAR_____4_CM 0. 25.5 DISPLAY_IDENTIFIER C_T_TAM_DIF_MAX_ERR FORMAT "%3.1" /end CHARACTERISTIC
/begin CHARACTERISTIC c_vs_min_vld_tam_err "Minimum vehicle speed to count time period for error validation" VALUE 0xa080c4ef _REC_VAL_20_u1 255. _CNV_A_R_LINEAR_____6_CM 0. 255. DISPLAY_IDENTIFIER C_VS_MIN_VLD_TAM_ERR FORMAT "%3.0" /end CHARACTERISTIC
/begin MEASUREMENT lv_err_tam "Present failure on TIA sensor(s) which might affect temperature TAM" UBYTE _CNV_S_2_RANGE__0___1_CM 1 100. 0. 1. DISPLAY_IDENTIFIER LV_ERR_TAM ECU_ADDRESS 0xd0008a1c BIT_MASK 0x1 /end MEASUREMENT
/begin MEASUREMENT lv_err_tam_can "TAM error send by CAN " UBYTE _CNV_S_2_RANGE__0___1_CM 1 100. 0. 1. DISPLAY_IDENTIFIER LV_ERR_TAM_CAN ECU_ADDRESS 0xd0007fe0 BIT_MASK 0x1 /end MEASUREMENT
/begin MEASUREMENT t_tam_dif_diag "Time for anti-bounce the temperature difference" UBYTE _CNV_A_R_LINEAR_____4_CM 1 100. 0. 25.5 DISPLAY_IDENTIFIER T_TAM_DIF_DIAG ECU_ADDRESS 0xd000163e FORMAT "%4.1" /end MEASUREMENT
/begin CHARACTERISTIC c_t_vs_min_vld_tam_err "Minimum time period of vehicle with speed" VALUE 0xa080c2a2 _REC_VAL_20_u2 6553.5 _CNV_A_R_LINEAR_____4_CM 0. 6553.5 DISPLAY_IDENTIFIER C_T_VS_MIN_VLD_TAM_ERR FORMAT "%5.1" /end CHARACTERISTIC
/begin MEASUREMENT t_vs_min_vld_tam_err "Timer of vehicle speed period" UWORD _CNV_A_R_LINEAR_____4_CM 1 100. 0. 6553.5 DISPLAY_IDENTIFIER T_VS_MIN_VLD_TAM_ERR ECU_ADDRESS 0xd0001638 FORMAT "%5.1" /end MEASUREMENT
/begin MEASUREMENT lv_err_tam_plaus "TAM sensor signal is not plausible" UBYTE _CNV_S_2_RANGE__0___1_CM 1 100. 0. 1. DISPLAY_IDENTIFIER LV_ERR_TAM_PLAUS ECU_ADDRESS 0xd0007fe1 BIT_MASK 0x1 /end MEASUREMENT
/begin MEASUREMENT lv_det_err_tam_plaus "TAM-plaus error is detected but not validated" UBYTE _CNV_S_2_RANGE__0___1_CM 1 100. 0. 1. DISPLAY_IDENTIFIER LV_DET_ERR_TAM_PLAUS ECU_ADDRESS 0xd0001641 BIT_MASK 0x1 /end MEASUREMENT
/begin MEASUREMENT lv_vs_cdn_tam_err "Bit information of status vehicle was driven with speed to validate the diagnosis result" UBYTE _CNV_S_2_RANGE__0___1_CM 1 100. 0. 1. DISPLAY_IDENTIFIER LV_VS_CDN_TAM_ERR ECU_ADDRESS 0xd0001642 BIT_MASK 0x1 /end MEASUREMENT
/begin MEASUREMENT tam_dif_plaus "TAM difference to detect a moving signal" UBYTE _CNV_A_R_LINEAR_____25_CM 1 100. 0. 190.5 DISPLAY_IDENTIFIER TAM_DIF_PLAUS ECU_ADDRESS 0xd000163c FORMAT "%5.1" /end MEASUREMENT
/begin MEASUREMENT tam_dif_diag "TAM difference to detect a TAM error" UBYTE _CNV_A_R_LINEAR_____25_CM 1 100. 0. 190.5 DISPLAY_IDENTIFIER TAM_DIF_DIAG ECU_ADDRESS 0xd000163d FORMAT "%5.1" /end MEASUREMENT
/begin MEASUREMENT tam_dif_max_diag "Maximum reached TAM in diagnosis cycle" UBYTE _CNV_A_R_LINEAR_____17_CM 1 100. -48. 142.5 DISPLAY_IDENTIFIER TAM_DIF_MAX_DIAG ECU_ADDRESS 0xd000163f FORMAT "%6.2" /end MEASUREMENT
/begin MEASUREMENT tam_dif_min_diag "Minimum reached TAM in diagnosis cycle" UBYTE _CNV_A_R_LINEAR_____17_CM 1 100. -48. 142.5 DISPLAY_IDENTIFIER TAM_DIF_MIN_DIAG ECU_ADDRESS 0xd0001640 FORMAT "%6.2" /end MEASUREMENT
/begin MEASUREMENT lv_end_rbm_tam_plaus "End of diagnosis cycle for RBM statistics TAM_PLAUS" UBYTE _CNV_S_2_RANGE__0___1_CM 1 100. 0. 1. DISPLAY_IDENTIFIER LV_END_RBM_TAM_PLAUS ECU_ADDRESS 0xd0008a1d BIT_MASK 0x1 /end MEASUREMENT
/begin MEASUREMENT lv_cdn_rbm_tam_plaus "Diagnosis condition for RBM statistics TAM_PLAUS" UBYTE _CNV_S_2_RANGE__0___1_CM 1 100. 0. 1. DISPLAY_IDENTIFIER LV_CDN_RBM_TAM_PLAUS ECU_ADDRESS 0xd0001643 BIT_MASK 0x1 /end MEASUREMENT
/begin MEASUREMENT lv_cnl_diag_tam_plaus "Irreversible stop of diagnosis TAM_PLAUS" UBYTE _CNV_S_2_RANGE__0___1_CM 1 100. 0. 1. DISPLAY_IDENTIFIER LV_CNL_DIAG_TAM_PLAUS ECU_ADDRESS 0xd0001644 BIT_MASK 0x1 /end MEASUREMENT
/begin CHARACTERISTIC c_tco_2_st_min_tam_diag "Minimum exhaust engine cooling temperature to activate the diagnosis condition" VALUE 0xa080c2bd _REC_VAL_20_u1 190.5 _CNV_A_R_LINEAR_____17_CM -48. 142.5 DISPLAY_IDENTIFIER C_TCO_2_ST_MIN_TAM_DIAG FORMAT "%6.2" /end CHARACTERISTIC
/begin CHARACTERISTIC c_tco_2_tia_dif_max "Maximum deviation between TCO_2 and TIA to start TAM_PLAUS diagnosis" VALUE 0xa080c2be _REC_VAL_20_u1 190.5 _CNV_A_R_LINEAR_____25_CM 0. 190.5 DISPLAY_IDENTIFIER C_TCO_2_TIA_DIF_MAX FORMAT "%5.1" /end CHARACTERISTIC
/begin CHARACTERISTIC c_tco_st_min_tam_diag "Minimum engine cooling temperature to activate the diagnosis condition" VALUE 0xa080c2e4 _REC_VAL_20_u1 190.5 _CNV_A_R_LINEAR_____17_CM -48. 142.5 DISPLAY_IDENTIFIER C_TCO_ST_MIN_TAM_DIAG FORMAT "%6.2" /end CHARACTERISTIC
/begin CHARACTERISTIC c_tco_tia_dif_max "Maximum deviation between TCO and TIA to start TAM_PLAUS diagnosis" VALUE 0xa080c2ec _REC_VAL_20_u1 190.5 _CNV_A_R_LINEAR_____25_CM 0. 190.5 DISPLAY_IDENTIFIER C_TCO_TIA_DIF_MAX FORMAT "%6.2" /end CHARACTERISTIC
/begin AXIS_PTS ldpm_opm_av "" 0xa0809750 opm_av _REC_AXS_20_u1 8. _CNV_A_R_LINEAR_____0_CM 8 0. 8. FORMAT "%1.0" /end AXIS_PTS
/begin AXIS_PTS ldpm_opm_req "" 0xa080975c opm_req _REC_AXS_20_u1 8. _CNV_A_R_LINEAR_____0_CM 8 0. 8. FORMAT "%1.0" /end AXIS_PTS
/begin MEASUREMENT lv_err_ldm "LDM error reversible / irreversible" UBYTE _CNV_S_2_RANGE__0___1_CM 1 100. 0. 1. DISPLAY_IDENTIFIER LV_ERR_LDM ECU_ADDRESS 0xd0007f8e BIT_MASK 0x1 /end MEASUREMENT
/begin MEASUREMENT lv_ldm_off_ecu "Irreversible LDM error" UBYTE _CNV_S_2_RANGE__0___1_CM 1 100. 0. 1. DISPLAY_IDENTIFIER LV_LDM_OFF_ECU ECU_ADDRESS 0xd0008e40 BIT_MASK 0x1 /end MEASUREMENT
/begin MEASUREMENT lv_ldm_ena_plaus_err "Conditions for enabling LDM not plausible" UBYTE _CNV_S_2_RANGE__0___1_CM 1 100. 0. 1. DISPLAY_IDENTIFIER LV_LDM_ENA_PLAUS_ERR ECU_ADDRESS 0xd0008e41 BIT_MASK 0x1 /end MEASUREMENT
/begin MEASUREMENT lv_ldm_brake_plaus_err "Conditions for enabling LDM not plausible" UBYTE _CNV_S_2_RANGE__0___1_CM 1 100. 0. 1. DISPLAY_IDENTIFIER LV_LDM_BRAKE_PLAUS_ERR ECU_ADDRESS 0xd0008e42 BIT_MASK 0x1 /end MEASUREMENT
/begin MEASUREMENT t_ldm_brake_det "Brake delay timer" UBYTE _CNV_A_R_LINEAR_____3_CM 1 100. 0. 2.55 DISPLAY_IDENTIFIER T_LDM_BRAKE_DET ECU_ADDRESS 0xd0001338 FORMAT "%4.2" /end MEASUREMENT
/begin MEASUREMENT lv_ldm_off_ecu_1 "LDM irreversible OFF" UBYTE _CNV_S_2_RANGE__0___1_CM 1 100. 0. 1. DISPLAY_IDENTIFIER LV_LDM_OFF_ECU_1 ECU_ADDRESS 0xd0001339 BIT_MASK 0x1 /end MEASUREMENT
/begin MEASUREMENT lv_ldm_off_ecu_2 "LDM reversible OFF" UBYTE _CNV_S_2_RANGE__0___1_CM 1 100. 0. 1. DISPLAY_IDENTIFIER LV_LDM_OFF_ECU_2 ECU_ADDRESS 0xd000133a BIT_MASK 0x1 /end MEASUREMENT
/begin CHARACTERISTIC c_t_max_brake_det_ldm "Maximum Brake delay timer" VALUE 0xa080c1dd _REC_VAL_20_u1 2.55 _CNV_A_R_LINEAR_____3_CM 0. 2.55 DISPLAY_IDENTIFIER C_T_MAX_BRAKE_DET_LDM FORMAT "%4.2" /end CHARACTERISTIC
/begin CHARACTERISTIC lc_ldm_ena_plaus_err "LC for enabling diagnosis due to plausibility error" VALUE 0xa080c5a5 _REC_VAL_20_u1 1. _CNV_S_2_RANGE__0___1_CM 0. 1. DISPLAY_IDENTIFIER LC_LDM_ENA_PLAUS_ERR BIT_MASK 0x1 /end CHARACTERISTIC
/begin MEASUREMENT lv_inh_diag_vcv[0] "Inhibition bit for the fuel pressure actuator diagnosis" UBYTE _CNV_S_2_RANGE__0___1_CM 1 100. 0. 1. DISPLAY_IDENTIFIER LV_INH_DIAG_VCV[1] ECU_ADDRESS 0xd00088b0 BIT_MASK 0x1 /end MEASUREMENT
/begin MEASUREMENT lv_inh_diag_vcv[1] "Inhibition bit for the fuel pressure actuator diagnosis" UBYTE _CNV_S_2_RANGE__0___1_CM 1 100. 0. 1. DISPLAY_IDENTIFIER LV_INH_DIAG_VCV[2] ECU_ADDRESS 0xd00088b1 BIT_MASK 0x1 /end MEASUREMENT
/begin CHARACTERISTIC c_v_fup_mv_max_diag "Threshold value V_FUP_MV to detect short circuit in signal wire to VB" VALUE 0xa080c3c8 _REC_VAL_20_u2 4.9951171875 _CNV_A_R_LINEAR_____2_CM 0. 4.9951171875 DISPLAY_IDENTIFIER C_V_FUP_MV_MAX_DIAG FORMAT "%5.3" /end CHARACTERISTIC
/begin CHARACTERISTIC c_v_fup_mv_min_diag "Threshold value V_FUP_MV to detect short circuit in signal wire to ground or wire break" VALUE 0xa080c3ca _REC_VAL_20_u2 4.9951171875 _CNV_A_R_LINEAR_____2_CM 0. 4.9951171875 DISPLAY_IDENTIFIER C_V_FUP_MV_MIN_DIAG FORMAT "%5.3" /end CHARACTERISTIC
/begin CHARACTERISTIC c_abc_inc_fup "Increment debounce counter" VALUE 0xa080b93e _REC_VAL_20_u1 255. _CNV_A_R_LINEAR_____0_CM 0. 255. DISPLAY_IDENTIFIER C_ABC_INC_FUP FORMAT "%3.0" /end CHARACTERISTIC
/begin CHARACTERISTIC c_abc_max_fup "Maximum value debounce counter" VALUE 0xa080ba06 _REC_VAL_20_u1 254. _CNV_A_R_LINEAR_____0_CM 1. 255. DISPLAY_IDENTIFIER C_ABC_MAX_FUP FORMAT "%3.0" /end CHARACTERISTIC
/begin CHARACTERISTIC c_n_32_fup_diag_max "Maximum engine speed for FUP diagnosis" VALUE 0xa080befd _REC_VAL_20_u1 8160. _CNV_A_R_LINEAR_____10_CM 0. 8160. DISPLAY_IDENTIFIER C_N_32_FUP_DIAG_MAX FORMAT "%4.0" /end CHARACTERISTIC
/begin MEASUREMENT lv_err_fup_0 "FUP sensor error detected" UBYTE _CNV_S_2_RANGE__0___1_CM 1 100. 0. 1. DISPLAY_IDENTIFIER LV_ERR_FUP_0 ECU_ADDRESS 0xd000802f BIT_MASK 0x1 /end MEASUREMENT
/begin MEASUREMENT lv_err_fup_1 "FUP sensor error detected" UBYTE _CNV_S_2_RANGE__0___1_CM 1 100. 0. 1. DISPLAY_IDENTIFIER LV_ERR_FUP_1 ECU_ADDRESS 0xd0008030 BIT_MASK 0x1 /end MEASUREMENT
/begin MEASUREMENT lv_inh_diag_fup[0] "Inhibition bit for the fuel pressure sensor diagnosis" UBYTE _CNV_S_2_RANGE__0___1_CM 1 100. 0. 1. DISPLAY_IDENTIFIER LV_INH_DIAG_FUP[0] ECU_ADDRESS 0xd00088ac BIT_MASK 0x1 /end MEASUREMENT
/begin MEASUREMENT lv_inh_diag_fup[1] "Inhibition bit for the fuel pressure sensor diagnosis" UBYTE _CNV_S_2_RANGE__0___1_CM 1 100. 0. 1. DISPLAY_IDENTIFIER LV_INH_DIAG_FUP[1] ECU_ADDRESS 0xd00088ad BIT_MASK 0x1 /end MEASUREMENT
/begin MEASUREMENT lv_inh_diag_tam_plaus "Inhibition of TAM plaus diagnosis due to present error" UBYTE _CNV_S_2_RANGE__0___1_CM 1 100. 0. 1. DISPLAY_IDENTIFIER LV_INH_DIAG_TAM_PLAUS ECU_ADDRESS 0xd0008a21 BIT_MASK 0x1 /end MEASUREMENT
/begin MEASUREMENT lv_diag_cdn_tam_plaus "Flag for status \"all TCO / TCO_2 diagnosis cycle are finished\"" UBYTE _CNV_S_2_RANGE__0___1_CM 1 100. 0. 1. DISPLAY_IDENTIFIER LV_DIAG_CDN_TAM_PLAUS ECU_ADDRESS 0xd0008a22 BIT_MASK 0x1 /end MEASUREMENT
/begin MEASUREMENT state_rbm_tam_plaus "Interface of TAM_PLAUS monitor with the Rate-Based Monitoring statistics" UBYTE _CNV_A_R_LINEAR_____0_CM 1 100. 0. 7. DISPLAY_IDENTIFIER STATE_RBM_TAM_PLAUS ECU_ADDRESS 0xd0008a20 FORMAT "%1.0" /end MEASUREMENT
/begin CHARACTERISTIC lc_inh_diag_tam_plaus "Switch to shut off the TAM plaus diagnosis (=1)" VALUE 0xa080c57f _REC_VAL_20_u1 1. _CNV_A_R_LINEAR_____0_CM 0. 1. DISPLAY_IDENTIFIER LC_INH_DIAG_TAM_PLAUS FORMAT "%2.0" /end CHARACTERISTIC
/begin MEASUREMENT lv_err_fup_efp "FUP sensor error detected" UBYTE _CNV_S_2_RANGE__0___1_CM 1 100. 0. 1. DISPLAY_IDENTIFIER LV_ERR_FUP_EFP ECU_ADDRESS 0xd0008032 BIT_MASK 0x1 /end MEASUREMENT
/begin CHARACTERISTIC c_v_fup_efp_mv_max_diag "threshold value V_FUP_EFP to detect short circuit in signal wire to VB" VALUE 0xa080c3c4 _REC_VAL_20_u2 4.9951171875 _CNV_A_R_LINEAR_____2_CM 0. 4.9951171875 DISPLAY_IDENTIFIER C_V_FUP_EFP_MV_MAX_DIAG FORMAT "%5.3" /end CHARACTERISTIC
/begin CHARACTERISTIC c_v_fup_efp_mv_min_diag "threshold value V_FUP_EFP to detect short circuit in signal wire to ground or wire break" VALUE 0xa080c3c6 _REC_VAL_20_u2 4.9951171875 _CNV_A_R_LINEAR_____2_CM 0. 4.9951171875 DISPLAY_IDENTIFIER C_V_FUP_EFP_MV_MIN_DIAG FORMAT "%5.3" /end CHARACTERISTIC
/begin CHARACTERISTIC c_abc_inc_fup_efp "increment debounce counter" VALUE 0xa080b93f _REC_VAL_20_u1 255. _CNV_A_R_LINEAR_____0_CM 0. 255. DISPLAY_IDENTIFIER C_ABC_INC_FUP_EFP FORMAT "%3.0" /end CHARACTERISTIC
/begin CHARACTERISTIC c_abc_max_fup_efp "maximum value debounce counter" VALUE 0xa080ba07 _REC_VAL_20_u1 254. _CNV_A_R_LINEAR_____0_CM 1. 255. DISPLAY_IDENTIFIER C_ABC_MAX_FUP_EFP FORMAT "%3.0" /end CHARACTERISTIC
/begin MEASUREMENT lv_inh_diag_fup_efp "inhibition bit for the fuel pressure sensor diagnosis (low pressure circuit)" UBYTE _CNV_S_2_RANGE__0___1_CM 1 100. 0. 1. DISPLAY_IDENTIFIER LV_INH_DIAG_FUP_EFP ECU_ADDRESS 0xd00088c4 BIT_MASK 0x1 /end MEASUREMENT
/begin CHARACTERISTIC lc_egy_min_diag "Activation of energy spare mode diagnosis" VALUE 0xa080c557 _REC_VAL_20_u1 1. _CNV_S_2_RANGE__0___1_CM 0. 1. DISPLAY_IDENTIFIER LC_EGY_MIN_DIAG /end CHARACTERISTIC
/begin MEASUREMENT lv_err_egy_min "Energy spare mode error flag" UBYTE _CNV_S_2_RANGE__0___1_CM 1 100. 0. 1. DISPLAY_IDENTIFIER LV_ERR_EGY_MIN ECU_ADDRESS 0xd0007fb8 BIT_MASK 0x1 /end MEASUREMENT
/begin CHARACTERISTIC c_rfp_dr_pwm_diag_min_scb "Minimum threshold for SCB diagnosis window recirculation flap driver" VALUE 0xa080c0ac _REC_VAL_20_u2 99.99847412109381 _CNV_A_R_LINEAR_____8_CM 0. 99.99847412109381 DISPLAY_IDENTIFIER C_RFP_DR_PWM_DIAG_MIN_SCB /end CHARACTERISTIC
/begin CHARACTERISTIC c_rfp_dr_pwm_diag_max_scg "Maximum threshold for SCG diagnosis window recirculation flap driver" VALUE 0xa080c0a8 _REC_VAL_20_u2 99.99847412109381 _CNV_A_R_LINEAR_____8_CM 0. 99.99847412109381 DISPLAY_IDENTIFIER C_RFP_DR_PWM_DIAG_MAX_SCG /end CHARACTERISTIC
/begin CHARACTERISTIC c_rfp_dr_pwm_diag_min_oc "Minimum threshold for OC diagnosis window recirculation flap driver" VALUE 0xa080c0aa _REC_VAL_20_u2 99.99847412109381 _CNV_A_R_LINEAR_____8_CM 0. 99.99847412109381 DISPLAY_IDENTIFIER C_RFP_DR_PWM_DIAG_MIN_OC /end CHARACTERISTIC
/begin MEASUREMENT cdn_diag_rfp_dr_1 "Diagnosis condition for each symptom of RFP_DR_1" UBYTE _CNV_A_R_LINEAR_____0_CM 1 100. 0. 255. DISPLAY_IDENTIFIER CDN_DIAG_RFP_DR_1 ECU_ADDRESS 0xd0001604 FORMAT "%3.0" /end MEASUREMENT
/begin MEASUREMENT cdn_diag_rfp_dr_2 "Diagnosis condition for each symptom of RFP_DR_2" UBYTE _CNV_A_R_LINEAR_____0_CM 1 100. 0. 255. DISPLAY_IDENTIFIER CDN_DIAG_RFP_DR_2 ECU_ADDRESS 0xd0001607 FORMAT "%3.0" /end MEASUREMENT
/begin MEASUREMENT lv_err_rfp_dr_1 "recirculation flap driver error detected" UBYTE _CNV_S_2_RANGE__0___1_CM 1 100. 0. 1. DISPLAY_IDENTIFIER LV_ERR_RFP_DR_1 ECU_ADDRESS 0xd0007f1a BIT_MASK 0x1 /end MEASUREMENT
/begin MEASUREMENT lv_err_rfp_dr_2 "recirculation flap driver error detected" UBYTE _CNV_S_2_RANGE__0___1_CM 1 100. 0. 1. DISPLAY_IDENTIFIER LV_ERR_RFP_DR_2 ECU_ADDRESS 0xd0007f1b BIT_MASK 0x1 /end MEASUREMENT
/begin MEASUREMENT lv_inh_diag_rfp_dr_1 "recirculation flap driver diagnosis inhibition activ" UBYTE _CNV_S_2_RANGE__0___1_CM 1 100. 0. 1. DISPLAY_IDENTIFIER LV_INH_DIAG_RFP_DR_1 ECU_ADDRESS 0xd0008e6c BIT_MASK 0x1 /end MEASUREMENT
/begin MEASUREMENT lv_inh_diag_rfp_dr_2 "recirculation flap driver diagnosis inhibition activ" UBYTE _CNV_S_2_RANGE__0___1_CM 1 100. 0. 1. DISPLAY_IDENTIFIER LV_INH_DIAG_RFP_DR_2 ECU_ADDRESS 0xd0008e6d BIT_MASK 0x1 /end MEASUREMENT
/begin MEASUREMENT lv_err_wg_1_dr "waste gate driver error cylinder bank 1 detected" UBYTE _CNV_S_2_RANGE__0___1_CM 1 100. 0. 1. DISPLAY_IDENTIFIER LV_ERR_WG_1_DR ECU_ADDRESS 0xd0007f1c BIT_MASK 0x1 /end MEASUREMENT
/begin MEASUREMENT lv_err_wg_2_dr "waste gate driver error cylinder bank 2 detected" UBYTE _CNV_S_2_RANGE__0___1_CM 1 100. 0. 1. DISPLAY_IDENTIFIER LV_ERR_WG_2_DR ECU_ADDRESS 0xd0007f1d BIT_MASK 0x1 /end MEASUREMENT
/begin MEASUREMENT lv_inh_diag_wg_1_dr "waste gate driver diagnosis inhibition cylinder bank 1" UBYTE _CNV_S_2_RANGE__0___1_CM 1 100. 0. 1. DISPLAY_IDENTIFIER LV_INH_DIAG_WG_1_DR ECU_ADDRESS 0xd0008e70 BIT_MASK 0x1 /end MEASUREMENT
/begin MEASUREMENT lv_inh_diag_wg_2_dr "waste gate driver diagnosis inhibition cylinder bank 2" UBYTE _CNV_S_2_RANGE__0___1_CM 1 100. 0. 1. DISPLAY_IDENTIFIER LV_INH_DIAG_WG_2_DR ECU_ADDRESS 0xd0008e71 BIT_MASK 0x1 /end MEASUREMENT
/begin CHARACTERISTIC c_wg_dr_pwm_diag_max_scg "Maximum threshold for SCG diagnosis window" VALUE 0xa080c506 _REC_VAL_20_u2 99.99847412109381 _CNV_A_R_LINEAR_____8_CM 0. 99.99847412109381 DISPLAY_IDENTIFIER C_WG_DR_PWM_DIAG_MAX_SCG /end CHARACTERISTIC
/begin CHARACTERISTIC c_wg_dr_pwm_diag_min_scb "Minimum threshold for SCB diagnosis window" VALUE 0xa080c50a _REC_VAL_20_u2 99.99847412109381 _CNV_A_R_LINEAR_____8_CM 0. 99.99847412109381 DISPLAY_IDENTIFIER C_WG_DR_PWM_DIAG_MIN_SCB /end CHARACTERISTIC
/begin CHARACTERISTIC c_wg_dr_pwm_diag_min_oc "Minimum threshold for OC diagnosis window" VALUE 0xa080c508 _REC_VAL_20_u2 99.99847412109381 _CNV_A_R_LINEAR_____8_CM 0. 99.99847412109381 DISPLAY_IDENTIFIER C_WG_DR_PWM_DIAG_MIN_OC /end CHARACTERISTIC
/begin MEASUREMENT cdn_diag_wg_1_dr "Diagnosis condition for each symptom of WG_1_DR" UBYTE _CNV_A_R_LINEAR_____0_CM 1 100. 0. 255. DISPLAY_IDENTIFIER CDN_DIAG_WG_1_DR ECU_ADDRESS 0xd0001864 FORMAT "%3.0" /end MEASUREMENT
/begin MEASUREMENT cdn_diag_wg_2_dr "Diagnosis condition for each symptom of WG_2_DR" UBYTE _CNV_A_R_LINEAR_____0_CM 1 100. 0. 255. DISPLAY_IDENTIFIER CDN_DIAG_WG_2_DR ECU_ADDRESS 0xd0001867 FORMAT "%3.0" /end MEASUREMENT
/begin MEASUREMENT state_rbm_t_es "Interface of T_ES  monitor with the Rate-Based Monitoring statistics" UBYTE _CNV_A_R_LINEAR_____0_CM 1 100. 0. 7. DISPLAY_IDENTIFIER STATE_RBM_T_ES ECU_ADDRESS 0xd0008e60 FORMAT "%1.0" /end MEASUREMENT
/begin MEASUREMENT v_put_mv_max_diag "Threshold value of V_PUT_MV to detect Short circuit in signal wire to VB" UWORD _CNV_A_R_LINEAR_____2_CM 1 100. 0. 4.9951171875 DISPLAY_IDENTIFIER V_PUT_MV_MAX_DIAG ECU_ADDRESS 0xd000aabc FORMAT "%5.3" /end MEASUREMENT
/begin CHARACTERISTIC c_v_put_mv_max_diag "Threshold value V_PUT_MV to detect Short circuit in signal wire to VB" VALUE 0xa080c3e8 _REC_VAL_20_u2 4.9951171875 _CNV_A_R_LINEAR_____2_CM 0. 4.9951171875 DISPLAY_IDENTIFIER C_V_PUT_MV_MAX_DIAG FORMAT "%5.3" /end CHARACTERISTIC
/begin CHARACTERISTIC c_v_put_mv_min_diag "Threshold value V_PUT_MV to detect Short circuit in signal wire to earth or wire break" VALUE 0xa080c3ec _REC_VAL_20_u2 4.9951171875 _CNV_A_R_LINEAR_____2_CM 0. 4.9951171875 DISPLAY_IDENTIFIER C_V_PUT_MV_MIN_DIAG FORMAT "%5.3" /end CHARACTERISTIC
/begin CHARACTERISTIC c_v_put_mv_max_diag_es "Threshold value V_PUT_MV to detect Short circuit in signal wire to VB for engine Stop" VALUE 0xa080c3ea _REC_VAL_20_u2 4.9951171875 _CNV_A_R_LINEAR_____2_CM 0. 4.9951171875 DISPLAY_IDENTIFIER C_V_PUT_MV_MAX_DIAG_ES FORMAT "%5.3" /end CHARACTERISTIC
/begin CHARACTERISTIC c_v_put_mv_min_diag_es "Threshold value V_PUT_MV to detect Short circuit in signal wire to earth or wire break for engine Stop" VALUE 0xa080c3ee _REC_VAL_20_u2 4.9951171875 _CNV_A_R_LINEAR_____2_CM 0. 4.9951171875 DISPLAY_IDENTIFIER C_V_PUT_MV_MIN_DIAG_ES FORMAT "%5.3" /end CHARACTERISTIC
/begin MEASUREMENT v_put_mv_min_diag "Threshold value of V_PUT_MV to detect Short circuit in signal wire to earth or wire break" UWORD _CNV_A_R_LINEAR_____2_CM 1 100. 0. 4.9951171875 DISPLAY_IDENTIFIER V_PUT_MV_MIN_DIAG ECU_ADDRESS 0xd000aabe FORMAT "%5.3" /end MEASUREMENT
/begin MEASUREMENT lv_err_put_el_1 "electrical PUT sensor error detected" UBYTE _CNV_S_2_RANGE__0___1_CM 1 100. 0. 1. DISPLAY_IDENTIFIER LV_ERR_PUT_EL[1] ECU_ADDRESS 0xd0007f1e BIT_MASK 0x1 /end MEASUREMENT
/begin MEASUREMENT lv_err_put_el_2 "electrical PUT sensor error detected" UBYTE _CNV_S_2_RANGE__0___1_CM 1 100. 0. 1. DISPLAY_IDENTIFIER LV_ERR_PUT_EL[2] ECU_ADDRESS 0xd0007f1f BIT_MASK 0x1 /end MEASUREMENT
/begin CHARACTERISTIC c_v_teg_sens_diag_min "Minimum voltage threshold for error detection" VALUE 0xa080c410 _REC_VAL_20_u2 4.999847 _CNV_A_R_LINEAR_____172_CM 0. 4.999847 DISPLAY_IDENTIFIER C_V_TEG_SENS_DIAG_MIN FORMAT "%6.4" /end CHARACTERISTIC
/begin CHARACTERISTIC c_v_teg_sens_diag_max "Maximum voltage threshold for error detection" VALUE 0xa080c40e _REC_VAL_20_u2 4.999847 _CNV_A_R_LINEAR_____172_CM 0. 4.999847 DISPLAY_IDENTIFIER C_V_TEG_SENS_DIAG_MAX FORMAT "%6.4" /end CHARACTERISTIC
/begin CHARACTERISTIC c_v_teg_sens_grd_max "Maximum voltage gradient threshold for error detection" VALUE 0xa080c412 _REC_VAL_20_u2 4.999847 _CNV_A_R_LINEAR_____172_CM 0. 4.999847 DISPLAY_IDENTIFIER C_V_TEG_SENS_GRD_MAX FORMAT "%6.4" /end CHARACTERISTIC
/begin CHARACTERISTIC c_vp_teg_sens_act_diag "Exhaust gas temperature sensor signal voltage threshold for activation of diagnosis of TEG sensors" VALUE 0xa080c47e _REC_VAL_20_u2 4.999847 _CNV_A_R_LINEAR_____172_CM 0. 4.999847 DISPLAY_IDENTIFIER C_VP_TEG_SENS_ACT_DIAG FORMAT "%6.4" /end CHARACTERISTIC
/begin CHARACTERISTIC c_t_ast_min_teg_sens_diag "Minimum time delay after start for exhaust gas temperature sensor diagnosis" VALUE 0xa080c138 _REC_VAL_20_u2 65535. _CNV_A_R_LINEAR_____36_CM 0. 65535. DISPLAY_IDENTIFIER C_T_AST_MIN_TEG_SENS_DIAG FORMAT "%5.0" /end CHARACTERISTIC
/begin CHARACTERISTIC c_ctr_min_tq_min_teg_sens_diag "Minimum counter value for temperature sensor diagnosis dependent on TQ" VALUE 0xa080bbb8 _REC_VAL_20_u2 65535. _CNV_A_R_LINEAR_____0_CM 0. 65535. DISPLAY_IDENTIFIER C_CTR_MIN_TQ_MIN_TEG_SENS_DIAG FORMAT "%5.0" /end CHARACTERISTIC
/begin CHARACTERISTIC c_tq_min_teg_sens_diag "calibratable threshold as minimum requested torque for activating diagnosis of exhaust gas temperature sensors" VALUE 0xa080c398 _REC_VAL_20_s2 2047.96875 _CNV_A_R_LINEAR_____31_CM -1024. 1023.96875 DISPLAY_IDENTIFIER C_TQ_MIN_TEG_SENS_DIAG FORMAT "%8.2" /end CHARACTERISTIC
/begin CHARACTERISTIC c_vs_min_teg_sens_diag "Vehicle speed threshold for activating diagnosis of exhaust gas temperature sensors" VALUE 0xa080c4ed _REC_VAL_20_u1 255. _CNV_A_R_LINEAR_____6_CM 0. 255. DISPLAY_IDENTIFIER C_VS_MIN_TEG_SENS_DIAG FORMAT "%3.0" /end CHARACTERISTIC
/begin CHARACTERISTIC c_abc_inc_teg_sens "Debounce counter increment - TEG Diagnosis" VALUE 0xa080b98a _REC_VAL_20_u1 255. _CNV_A_R_LINEAR_____0_CM 0. 255. DISPLAY_IDENTIFIER C_ABC_INC_TEG_SENS FORMAT "%3.0" /end CHARACTERISTIC
/begin CHARACTERISTIC c_abc_max_teg_sens "Debounce counter maximum - TEG Diagnosis" VALUE 0xa080ba53 _REC_VAL_20_u1 254. _CNV_A_R_LINEAR_____0_CM 1. 255. DISPLAY_IDENTIFIER C_ABC_MAX_TEG_SENS FORMAT "%3.0" /end CHARACTERISTIC
/begin MEASUREMENT ctr_tq_min_teg_sens_diag "Counter to control the temperature sensor diagnosis activation and deactivation" UWORD _CNV_A_R_LINEAR_____0_CM 1 100. 0. 65535. DISPLAY_IDENTIFIER CTR_TQ_MIN_TEG_SENS_DIAG ECU_ADDRESS 0xd0001680 FORMAT "%5.0" /end MEASUREMENT
/begin MEASUREMENT lv_err_teg_sens_1 "Temperaturesensor error flag" UBYTE _CNV_S_2_RANGE__0___1_CM 1 100. 0. 1. DISPLAY_IDENTIFIER LV_ERR_TEG_SENS_1 ECU_ADDRESS 0xd0008098 BIT_MASK 0x1 /end MEASUREMENT
/begin MEASUREMENT lv_err_teg_sens_2 "Temperaturesensor error flag" UBYTE _CNV_S_2_RANGE__0___1_CM 1 100. 0. 1. DISPLAY_IDENTIFIER LV_ERR_TEG_SENS_2 ECU_ADDRESS 0xd0008099 BIT_MASK 0x1 /end MEASUREMENT
/begin MEASUREMENT lv_err_prel_teg_sens[0] "Temperaturesensor antibouce flag" UBYTE _CNV_S_2_RANGE__0___1_CM 1 100. 0. 1. DISPLAY_IDENTIFIER LV_ERR_PREL_TEG_SENS[0] ECU_ADDRESS 0xd0001688 BIT_MASK 0x1 /end MEASUREMENT
/begin MEASUREMENT lv_err_prel_teg_sens[1] "Temperaturesensor antibouce flag" UBYTE _CNV_S_2_RANGE__0___1_CM 1 100. 0. 1. DISPLAY_IDENTIFIER LV_ERR_PREL_TEG_SENS[1] ECU_ADDRESS 0xd0001689 BIT_MASK 0x1 /end MEASUREMENT
/begin MEASUREMENT opm_ext_req "Operation mode request from tester" UWORD _CNV_A_R_LINEAR_____0_CM 1 100. 0. 65535. DISPLAY_IDENTIFIER OPM_EXT_REQ ECU_ADDRESS 0xd000a7d0 FORMAT "%5.0" /end MEASUREMENT
/begin MEASUREMENT opm_ext_req_tmp "Operation mode request from tester without EOL request" UWORD _CNV_A_R_LINEAR_____0_CM 1 100. 0. 65535. DISPLAY_IDENTIFIER OPM_EXT_REQ_TMP ECU_ADDRESS 0xd00015cc FORMAT "%5.0" /end MEASUREMENT
/begin CHARACTERISTIC c_opm_ext_req_1 "Constant 1 for operation mode request from tester" VALUE 0xa080c064 _REC_VAL_20_u2 65535. _CNV_A_R_LINEAR_____0_CM 0. 65535. DISPLAY_IDENTIFIER C_OPM_EXT_REQ_1 FORMAT "%5.0" /end CHARACTERISTIC
/begin CHARACTERISTIC c_opm_ext_req_2 "Constant 2 for operation mode request from tester" VALUE 0xa080c066 _REC_VAL_20_u2 65535. _CNV_A_R_LINEAR_____0_CM 0. 65535. DISPLAY_IDENTIFIER C_OPM_EXT_REQ_2 FORMAT "%5.0" /end CHARACTERISTIC
/begin CHARACTERISTIC c_opm_ext_req_3 "Constant 3 for operation mode request from tester" VALUE 0xa080c068 _REC_VAL_20_u2 65535. _CNV_A_R_LINEAR_____0_CM 0. 65535. DISPLAY_IDENTIFIER C_OPM_EXT_REQ_3 FORMAT "%5.0" /end CHARACTERISTIC
/begin CHARACTERISTIC c_opm_ext_req_4 "Constant 4 for operation mode request from tester" VALUE 0xa080c06a _REC_VAL_20_u2 65535. _CNV_A_R_LINEAR_____0_CM 0. 65535. DISPLAY_IDENTIFIER C_OPM_EXT_REQ_4 FORMAT "%5.0" /end CHARACTERISTIC
/begin CHARACTERISTIC c_opm_ext_req_5 "Constant 5 for operation mode request from tester" VALUE 0xa080c06c _REC_VAL_20_u2 65535. _CNV_A_R_LINEAR_____0_CM 0. 65535. DISPLAY_IDENTIFIER C_OPM_EXT_REQ_5 FORMAT "%5.0" /end CHARACTERISTIC
/begin CHARACTERISTIC c_opm_ext_req_6 "Constant 6 for operation mode request from tester" VALUE 0xa080c06e _REC_VAL_20_u2 65535. _CNV_A_R_LINEAR_____0_CM 0. 65535. DISPLAY_IDENTIFIER C_OPM_EXT_REQ_6 FORMAT "%5.0" /end CHARACTERISTIC
/begin CHARACTERISTIC c_opm_ext_req_7 "Constant 7 for operation mode request from tester" VALUE 0xa080c070 _REC_VAL_20_u2 65535. _CNV_A_R_LINEAR_____0_CM 0. 65535. DISPLAY_IDENTIFIER C_OPM_EXT_REQ_7 FORMAT "%5.0" /end CHARACTERISTIC
/begin CHARACTERISTIC c_opm_ext_req_8 "Constant 8 for operation mode request from tester" VALUE 0xa080c072 _REC_VAL_20_u2 65535. _CNV_A_R_LINEAR_____0_CM 0. 65535. DISPLAY_IDENTIFIER C_OPM_EXT_REQ_8 FORMAT "%5.0" /end CHARACTERISTIC
/begin CHARACTERISTIC c_opm_ext_req_vls_eol "Constant  for operation mode request from tester (end of line test)" VALUE 0xa080c074 _REC_VAL_20_u2 65535. _CNV_A_R_LINEAR_____0_CM 0. 65535. DISPLAY_IDENTIFIER C_OPM_EXT_REQ_VLS_EOL FORMAT "%5.0" /end CHARACTERISTIC
/begin MEASUREMENT ang_diag_vcv[0] "Angle before change of LSS control on which the diagnosis-pin voltage is captured by the BSW (delta angle)" UBYTE _CNV_A_R_LINEAR_____546_CM 1 100. 0. 25.5 DISPLAY_IDENTIFIER ANG_DIAG_VCV[0] ECU_ADDRESS 0xd0001840 FORMAT "%4.1" /end MEASUREMENT
/begin MEASUREMENT ang_diag_vcv[1] "Angle before change of LSS control on which the diagnosis-pin voltage is captured by the BSW (delta angle)" UBYTE _CNV_A_R_LINEAR_____546_CM 1 100. 0. 25.5 DISPLAY_IDENTIFIER ANG_DIAG_VCV[1] ECU_ADDRESS 0xd0001841 FORMAT "%4.1" /end MEASUREMENT
/begin CHARACTERISTIC lc_diag_dis_vcv[0] "Boolean to disable the VCV diagnosis (0: active; 1: inactive)" VALUE 0xa080c54a _REC_VAL_20_u1 1. _CNV_A_R_LINEAR_____0_CM 0. 1. DISPLAY_IDENTIFIER LC_DIAG_DIS_VCV[0] FORMAT "%2.0" /end CHARACTERISTIC
/begin CHARACTERISTIC lc_diag_dis_vcv[1] "Boolean to disable the VCV diagnosis (0: active; 1: inactive)" VALUE 0xa080c54b _REC_VAL_20_u1 1. _CNV_A_R_LINEAR_____0_CM 0. 1. DISPLAY_IDENTIFIER LC_DIAG_DIS_VCV[1] FORMAT "%2.0" /end CHARACTERISTIC
/begin MEASUREMENT lv_v_chk_ena_vcv[0] "Check of diagnosis-pin voltages enabled" UBYTE _CNV_S_2_RANGE__0___1_CM 1 100. 0. 1. DISPLAY_IDENTIFIER LV_V_CHK_ENA_VCV[0] ECU_ADDRESS 0xd0008e74 BIT_MASK 0x1 /end MEASUREMENT
/begin MEASUREMENT lv_v_chk_ena_vcv[1] "Check of diagnosis-pin voltages enabled" UBYTE _CNV_S_2_RANGE__0___1_CM 1 100. 0. 1. DISPLAY_IDENTIFIER LV_V_CHK_ENA_VCV[1] ECU_ADDRESS 0xd0008e75 BIT_MASK 0x1 /end MEASUREMENT
/begin MEASUREMENT v_on_min_vcv[0] "Minimum diagnosis-pin voltage at active low side switch (LSS on)" UWORD _CNV_A_R_LINEAR_____172_CM 1 100. 0. 4.999847 DISPLAY_IDENTIFIER V_ON_MIN_VCV[0] ECU_ADDRESS 0xd0001830 FORMAT "%6.4" /end MEASUREMENT
/begin MEASUREMENT v_on_min_vcv[1] "Minimum diagnosis-pin voltage at active low side switch (LSS on)" UWORD _CNV_A_R_LINEAR_____172_CM 1 100. 0. 4.999847 DISPLAY_IDENTIFIER V_ON_MIN_VCV[1] ECU_ADDRESS 0xd0001832 FORMAT "%6.4" /end MEASUREMENT
/begin MEASUREMENT v_on_max_vcv[0] "Maximum diagnosis-pin voltage at active low side switch (LSS on)" UWORD _CNV_A_R_LINEAR_____172_CM 1 100. 0. 4.999847 DISPLAY_IDENTIFIER V_ON_MAX_VCV[0] ECU_ADDRESS 0xd0001834 FORMAT "%6.4" /end MEASUREMENT
/begin MEASUREMENT v_on_max_vcv[1] "Maximum diagnosis-pin voltage at active low side switch (LSS on)" UWORD _CNV_A_R_LINEAR_____172_CM 1 100. 0. 4.999847 DISPLAY_IDENTIFIER V_ON_MAX_VCV[1] ECU_ADDRESS 0xd0001836 FORMAT "%6.4" /end MEASUREMENT
/begin MEASUREMENT v_off_max_vcv[0] "Maximum diagnosis-pin voltage at inactive low side switch (LSS off)" UWORD _CNV_A_R_LINEAR_____172_CM 1 100. 0. 4.999847 DISPLAY_IDENTIFIER V_OFF_MAX_VCV[0] ECU_ADDRESS 0xd000183c FORMAT "%6.4" /end MEASUREMENT
/begin MEASUREMENT v_off_max_vcv[1] "Maximum diagnosis-pin voltage at inactive low side switch (LSS off)" UWORD _CNV_A_R_LINEAR_____172_CM 1 100. 0. 4.999847 DISPLAY_IDENTIFIER V_OFF_MAX_VCV[1] ECU_ADDRESS 0xd000183e FORMAT "%6.4" /end MEASUREMENT
/begin MEASUREMENT lv_err_vcv_fpc_0 "Present failure of VCV (failure after filtering of diagnosis)" UBYTE _CNV_S_2_RANGE__0___1_CM 1 100. 0. 1. DISPLAY_IDENTIFIER LV_ERR_VCV_FPC_0 ECU_ADDRESS 0xd0008031 BIT_MASK 0x1 /end MEASUREMENT
/begin MEASUREMENT lv_err_vcv_fpc_1 "Present failure of VCV (failure after filtering of diagnosis)" UBYTE _CNV_S_2_RANGE__0___1_CM 1 100. 0. 1. DISPLAY_IDENTIFIER LV_ERR_VCV_FPC_1 ECU_ADDRESS 0xd0008035 BIT_MASK 0x1 /end MEASUREMENT
/begin CHARACTERISTIC c_t_diag_vcv "Time before change of LSS control on which the diagnosis-pin voltage is captured by the BSW" VALUE 0xa080c161 _REC_VAL_20_u1 2.55 _CNV_A_R_INJR_LINEA_466_CM 0. 2.55 DISPLAY_IDENTIFIER C_T_DIAG_VCV FORMAT "%4.2" /end CHARACTERISTIC
/begin CHARACTERISTIC c_v_on_vcv_max_diag_scp "Maximum threshold for diagnosis of short circuit to Ubatt (SCP) detection" VALUE 0xa080c3e2 _REC_VAL_20_u2 4.999847 _CNV_A_R_LINEAR_____172_CM 0. 4.999847 DISPLAY_IDENTIFIER C_V_ON_VCV_MAX_DIAG_SCP FORMAT "%6.4" /end CHARACTERISTIC
/begin CHARACTERISTIC c_v_off_vcv_min_diag_scg "Minimum threshold for diagnosis of short circuit to ground (SCG) detection" VALUE 0xa080c3e0 _REC_VAL_20_u2 4.999847 _CNV_A_R_LINEAR_____172_CM 0. 4.999847 DISPLAY_IDENTIFIER C_V_OFF_VCV_MIN_DIAG_SCG FORMAT "%6.4" /end CHARACTERISTIC
/begin CHARACTERISTIC c_v_off_vcv_min_diag_oc "Minimum threshold for diagnosis of open circuit (OC) detection" VALUE 0xa080c3de _REC_VAL_20_u2 4.999847 _CNV_A_R_LINEAR_____172_CM 0. 4.999847 DISPLAY_IDENTIFIER C_V_OFF_VCV_MIN_DIAG_OC FORMAT "%6.4" /end CHARACTERISTIC
/begin CHARACTERISTIC c_v_off_vcv_max_diag_oc "Maximum threshold for diagnosis of open circuit (OC) detection" VALUE 0xa080c3dc _REC_VAL_20_u2 4.999847 _CNV_A_R_LINEAR_____172_CM 0. 4.999847 DISPLAY_IDENTIFIER C_V_OFF_VCV_MAX_DIAG_OC FORMAT "%6.4" /end CHARACTERISTIC
/begin CHARACTERISTIC c_abc_inc_vcv "Antibounce counter increment" VALUE 0xa080b995 _REC_VAL_20_u1 255. _CNV_A_R_LINEAR_____0_CM 0. 255. DISPLAY_IDENTIFIER C_ABC_INC_VCV FORMAT "%3.0" /end CHARACTERISTIC
/begin CHARACTERISTIC c_abc_max_vcv "Maximum value for antibounce counter" VALUE 0xa080ba5e _REC_VAL_20_u1 254. _CNV_A_R_LINEAR_____0_CM 1. 255. DISPLAY_IDENTIFIER C_ABC_MAX_VCV FORMAT "%3.0" /end CHARACTERISTIC
/begin MEASUREMENT v_off_min_vcv[0] "Minimum diagnosis-pin voltage at inactive low side switch (LSS off)" UWORD _CNV_A_R_LINEAR_____172_CM 1 100. 0. 4.999847 DISPLAY_IDENTIFIER V_OFF_MIN_VCV[0] ECU_ADDRESS 0xd0001838 FORMAT "%6.4" /end MEASUREMENT
/begin MEASUREMENT v_off_min_vcv[1] "Minimum diagnosis-pin voltage at inactive low side switch (LSS off)" UWORD _CNV_A_R_LINEAR_____172_CM 1 100. 0. 4.999847 DISPLAY_IDENTIFIER V_OFF_MIN_VCV[1] ECU_ADDRESS 0xd000183a FORMAT "%6.4" /end MEASUREMENT
/begin MEASUREMENT lv_err_vcv "Boolean for error currently present on VCV" UBYTE _CNV_S_2_RANGE__0___1_CM 1 100. 0. 1. DISPLAY_IDENTIFIER LV_ERR_VCV ECU_ADDRESS 0xd0008e76 BIT_MASK 0x1 /end MEASUREMENT
/begin MEASUREMENT lv_tq_isc_i_tq_pste "Logical value for limitation due to PSTE" UBYTE _CNV_S_2_RANGE__0___1_CM 1 100. 0. 1. DISPLAY_IDENTIFIER LV_TQ_ISC_I_TQ_PSTE ECU_ADDRESS 0xd00074b1 BIT_MASK 0x1 /end MEASUREMENT
/begin CHARACTERISTIC ip_tq_i_dt_is_opm_1 "I-component for idle speed controller at closed drive train" CURVE 0xa080245c _REC_CUR_20_u2_u2 7.9998779296875 _CNV_A_R_ENSC_LINEA_936_CM -4. 3.9998779296875 DISPLAY_IDENTIFIER IP_TQ_I_DT_IS_OPM_1 FORMAT "%7.4"
 /begin AXIS_DESCR COM_AXIS n_dif_cor _CNV_A_R_LINEAR_____193_CM 12 -32768. 32767. FORMAT "%6.0" AXIS_PTS_REF ldpm_n_dif_cor_tq_i_dt_is_opm_1 /end AXIS_DESCR
/end CHARACTERISTIC
/begin CHARACTERISTIC ip_tq_i_dt_is_opm_2 "I-component for idle speed controller at closed drive train" CURVE 0xa0802474 _REC_CUR_20_u2_u2 7.9998779296875 _CNV_A_R_ENSC_LINEA_936_CM -4. 3.9998779296875 DISPLAY_IDENTIFIER IP_TQ_I_DT_IS_OPM_2 FORMAT "%7.4"
 /begin AXIS_DESCR COM_AXIS n_dif_cor _CNV_A_R_LINEAR_____193_CM 12 -32768. 32767. FORMAT "%6.0" AXIS_PTS_REF ldpm_n_dif_cor_tq_i_dt_is_opm_2 /end AXIS_DESCR
/end CHARACTERISTIC
/begin AXIS_PTS ldpm_n_dif_cor_tq_i_dt_is_opm_1 "" 0xa08021c8 n_dif_cor _REC_AXS_20_u2 65535. _CNV_A_R_LINEAR_____193_CM 12 -32768. 32767. FORMAT "%6.0" /end AXIS_PTS
/begin AXIS_PTS ldpm_n_dif_cor_tq_i_dt_is_opm_2 "" 0xa08021e4 n_dif_cor _REC_AXS_20_u2 65535. _CNV_A_R_LINEAR_____193_CM 12 -32768. 32767. FORMAT "%6.0" /end AXIS_PTS
/begin CHARACTERISTIC ip_fac_t_ast_i_is_opm_1 "TQ_ADD_I_IS correction after start in operation mode 1" MAP 0xa0802334 _REC_MAP_20_u2_u1_u2 0.999755 _CNV_A_R_LINEAR_____433_CM 0. 0.999755 DISPLAY_IDENTIFIER IP_FAC_T_AST_I_IS_OPM_1 FORMAT "%7.5"
 /begin AXIS_DESCR COM_AXIS tco _CNV_A_R_LINEAR_____17_CM 4 -48. 142.5 FORMAT "%6.2" AXIS_PTS_REF ldpm_tco__fac_n_grd_is_2 /end AXIS_DESCR
 /begin AXIS_DESCR COM_AXIS t_ast _CNV_A_R_LINEAR_____4_CM 8 0. 6553.5 FORMAT "%5.1" AXIS_PTS_REF ldpm_t_ast__fac_n_grd_is /end AXIS_DESCR
/end CHARACTERISTIC
/begin AXIS_PTS ldpm_tco__fac_n_grd_is_2 "" 0xa08022a8 tco _REC_AXS_20_u1 190.5 _CNV_A_R_LINEAR_____17_CM 4 -48. 142.5 FORMAT "%6.2" /end AXIS_PTS
/begin AXIS_PTS ldpm_t_ast__fac_n_grd_is "" 0xa0802290 t_ast _REC_AXS_20_u2 6553.5 _CNV_A_R_LINEAR_____4_CM 8 0. 6553.5 FORMAT "%5.1" /end AXIS_PTS
/begin CHARACTERISTIC ip_fac_t_ast_i_is_opm_2 "TQ_ADD_I_IS correction after start in operation mode 2" MAP 0xa0802374 _REC_MAP_20_u2_u1_u2 0.999755 _CNV_A_R_LINEAR_____433_CM 0. 0.999755 DISPLAY_IDENTIFIER IP_FAC_T_AST_I_IS_OPM_2 FORMAT "%7.5"
 /begin AXIS_DESCR COM_AXIS tco _CNV_A_R_LINEAR_____17_CM 4 -48. 142.5 FORMAT "%6.2" AXIS_PTS_REF ldpm_tco__fac_n_grd_is_2 /end AXIS_DESCR
 /begin AXIS_DESCR COM_AXIS t_ast _CNV_A_R_LINEAR_____4_CM 8 0. 6553.5 FORMAT "%5.1" AXIS_PTS_REF ldpm_t_ast__fac_n_grd_is /end AXIS_DESCR
/end CHARACTERISTIC
/begin CHARACTERISTIC ip_tq_dif_p_d_fast_dt_is_opm_2 "TQ_ADD_I_IS correction after start in operation mode 2" MAP 0xa080ec00 _REC_MAP_20_u2_u2_u1 2047.96875 _CNV_A_R_LINEAR_____87_CM -1024. 1023.96875 DISPLAY_IDENTIFIER IP_TQ_DIF_P_D_FAST_DT_IS_OPM_2 FORMAT "%11.5"
 /begin AXIS_DESCR COM_AXIS n_dif_cor _CNV_A_R_LINEAR_____193_CM 10 -32768. 32767. FORMAT "%6.0" AXIS_PTS_REF ldp_n_dif_cor_ip_tq_p_d_fast_dt /end AXIS_DESCR
 /begin AXIS_DESCR COM_AXIS n_grd_fil_p_d_is _CNV_A_R_LINEAR_____29_CM 8 -4096. 4064. FORMAT "%5.0" AXIS_PTS_REF ldp_n_grd_p_d_ip_tq_p_d_fast_dt /end AXIS_DESCR
/end CHARACTERISTIC
/begin CHARACTERISTIC ip_tq_dif_p_d_fast_is_opm_1 "TQ_ADD_I_IS correction after start in operation mode 2" MAP 0xa080eca0 _REC_MAP_20_u2_u2_u1 2047.96875 _CNV_A_R_LINEAR_____87_CM -1024. 1023.96875 DISPLAY_IDENTIFIER IP_TQ_DIF_P_D_FAST_IS_OPM_1 FORMAT "%11.5"
 /begin AXIS_DESCR COM_AXIS n_dif_cor _CNV_A_R_LINEAR_____193_CM 10 -32768. 32767. FORMAT "%6.0" AXIS_PTS_REF ldpm_n_dif_cor_ip_tq_p_d_fast /end AXIS_DESCR
 /begin AXIS_DESCR COM_AXIS n_grd_fil_p_d_is _CNV_A_R_LINEAR_____29_CM 8 -4096. 4064. FORMAT "%5.0" AXIS_PTS_REF ldpm_n_grd_p_d_ip_tq_p_d_fast /end AXIS_DESCR
/end CHARACTERISTIC
/begin CHARACTERISTIC ip_tq_dif_p_d_fast_is_opm_2 "TQ_ADD_I_IS correction after start in operation mode 2" MAP 0xa080ed40 _REC_MAP_20_u2_u2_u1 2047.96875 _CNV_A_R_LINEAR_____87_CM -1024. 1023.96875 DISPLAY_IDENTIFIER IP_TQ_DIF_P_D_FAST_IS_OPM_2 FORMAT "%11.5"
 /begin AXIS_DESCR COM_AXIS n_dif_cor _CNV_A_R_LINEAR_____193_CM 10 -32768. 32767. FORMAT "%6.0" AXIS_PTS_REF ldpm_n_dif_cor_ip_tq_p_d_fast /end AXIS_DESCR
 /begin AXIS_DESCR COM_AXIS n_grd_fil_p_d_is _CNV_A_R_LINEAR_____29_CM 8 -4096. 4064. FORMAT "%5.0" AXIS_PTS_REF ldpm_n_grd_p_d_ip_tq_p_d_fast /end AXIS_DESCR
/end CHARACTERISTIC
/begin AXIS_PTS ldp_n_dif_cor_ip_tq_p_d_fast_dt "" 0xa0802078 n_dif_cor _REC_AXS_20_u2 65535. _CNV_A_R_LINEAR_____193_CM 10 -32768. 32767. FORMAT "%6.0" /end AXIS_PTS
/begin AXIS_PTS ldpm_n_dif_cor_ip_tq_p_d_fast "" 0xa0802198 n_dif_cor _REC_AXS_20_u2 65535. _CNV_A_R_LINEAR_____193_CM 10 -32768. 32767. FORMAT "%6.0" /end AXIS_PTS
/begin AXIS_PTS ldp_n_grd_p_d_ip_tq_p_d_fast_dt "" 0xa08020e0 n_grd_fil_p_d_is _REC_AXS_20_u1 8160. _CNV_A_R_LINEAR_____29_CM 8 -4096. 4064. FORMAT "%5.0" /end AXIS_PTS
/begin AXIS_PTS ldpm_n_grd_p_d_ip_tq_p_d_fast "" 0xa0802250 n_grd_fil_p_d_is _REC_AXS_20_u1 8160. _CNV_A_R_LINEAR_____29_CM 8 -4096. 4064. FORMAT "%5.0" /end AXIS_PTS
/begin CHARACTERISTIC ip_tq_dif_p_d_fast_dt_is_opm_1 "TQ_ADD_I_IS correction after start in operation mode 2" MAP 0xa080eb60 _REC_MAP_20_u2_u2_u1 2047.96875 _CNV_A_R_LINEAR_____87_CM -1024. 1023.96875 DISPLAY_IDENTIFIER IP_TQ_DIF_P_D_FAST_DT_IS_OPM_1 FORMAT "%11.5"
 /begin AXIS_DESCR COM_AXIS n_dif_cor _CNV_A_R_LINEAR_____193_CM 10 -32768. 32767. FORMAT "%6.0" AXIS_PTS_REF ldp_n_dif_cor_ip_tq_p_d_fast_dt /end AXIS_DESCR
 /begin AXIS_DESCR COM_AXIS n_grd_fil_p_d_is _CNV_A_R_LINEAR_____29_CM 8 -4096. 4064. FORMAT "%5.0" AXIS_PTS_REF ldp_n_grd_p_d_ip_tq_p_d_fast_dt /end AXIS_DESCR
/end CHARACTERISTIC
/begin AXIS_PTS ldp_n_dif_cor_ip_tq_p_d_slow_dt "" 0xa0802090 n_dif_cor _REC_AXS_20_u2 65535. _CNV_A_R_LINEAR_____193_CM 10 -32768. 32767. FORMAT "%6.0" /end AXIS_PTS
/begin AXIS_PTS ldpm_n_dif_cor_ip_tq_p_d_slow "" 0xa08021b0 n_dif_cor _REC_AXS_20_u2 65535. _CNV_A_R_LINEAR_____193_CM 10 -32768. 32767. FORMAT "%6.0" /end AXIS_PTS
/begin AXIS_PTS ldpm_n_grd_p_d_ip_tq_p_d_slow "" 0xa080225c n_grd_fil_p_d_is _REC_AXS_20_u1 8160. _CNV_A_R_LINEAR_____29_CM 8 -4096. 4064. FORMAT "%5.0" /end AXIS_PTS
/begin AXIS_PTS ldp_n_grd_p_d_ip_tq_p_d_slow_dt "" 0xa08020ec n_grd_fil_p_d_is _REC_AXS_20_u1 8160. _CNV_A_R_LINEAR_____29_CM 8 -4096. 4064. FORMAT "%5.0" /end AXIS_PTS
/begin CHARACTERISTIC ip_tq_dif_p_d_slow_dt_is_opm_1 "P  and D component for idle speed controller at closed drivetrain" MAP 0xa080ee40 _REC_MAP_20_u2_u2_u1 2047.96875 _CNV_A_R_LINEAR_____87_CM -1024. 1023.96875 DISPLAY_IDENTIFIER IP_TQ_DIF_P_D_SLOW_DT_IS_OPM_1 FORMAT "%11.5"
 /begin AXIS_DESCR COM_AXIS n_dif_cor _CNV_A_R_LINEAR_____193_CM 10 -32768. 32767. FORMAT "%6.0" AXIS_PTS_REF ldp_n_dif_cor_ip_tq_p_d_slow_dt /end AXIS_DESCR
 /begin AXIS_DESCR COM_AXIS n_grd_fil_p_d_is _CNV_A_R_LINEAR_____29_CM 8 -4096. 4064. FORMAT "%5.0" AXIS_PTS_REF ldp_n_grd_p_d_ip_tq_p_d_slow_dt /end AXIS_DESCR
/end CHARACTERISTIC
/begin CHARACTERISTIC ip_tq_dif_p_d_slow_is_opm_1 "TQ_ADD_I_IS correction after start in operation mode 2" MAP 0xa080ef80 _REC_MAP_20_u2_u2_u1 2047.96875 _CNV_A_R_LINEAR_____87_CM -1024. 1023.96875 DISPLAY_IDENTIFIER IP_TQ_DIF_P_D_SLOW_IS_OPM_1 FORMAT "%11.5"
 /begin AXIS_DESCR COM_AXIS n_dif_cor _CNV_A_R_LINEAR_____193_CM 10 -32768. 32767. FORMAT "%6.0" AXIS_PTS_REF ldpm_n_dif_cor_ip_tq_p_d_slow /end AXIS_DESCR
 /begin AXIS_DESCR COM_AXIS n_grd_fil_p_d_is _CNV_A_R_LINEAR_____29_CM 8 -4096. 4064. FORMAT "%5.0" AXIS_PTS_REF ldpm_n_grd_p_d_ip_tq_p_d_slow /end AXIS_DESCR
/end CHARACTERISTIC
/begin CHARACTERISTIC ip_tq_dif_p_d_slow_dt_is_opm_2 "P  and D component for idle speed controller at closed drivetrain" MAP 0xa080eee0 _REC_MAP_20_u2_u2_u1 2047.96875 _CNV_A_R_LINEAR_____87_CM -1024. 1023.96875 DISPLAY_IDENTIFIER IP_TQ_DIF_P_D_SLOW_DT_IS_OPM_2 FORMAT "%11.5"
 /begin AXIS_DESCR COM_AXIS n_dif_cor _CNV_A_R_LINEAR_____193_CM 10 -32768. 32767. FORMAT "%6.0" AXIS_PTS_REF ldp_n_dif_cor_ip_tq_p_d_slow_dt /end AXIS_DESCR
 /begin AXIS_DESCR COM_AXIS n_grd_fil_p_d_is _CNV_A_R_LINEAR_____29_CM 8 -4096. 4064. FORMAT "%5.0" AXIS_PTS_REF ldp_n_grd_p_d_ip_tq_p_d_slow_dt /end AXIS_DESCR
/end CHARACTERISTIC
/begin CHARACTERISTIC ip_tq_dif_p_d_slow_is_opm_2 "TQ_ADD_I_IS correction after start in operation mode 2" MAP 0xa080f020 _REC_MAP_20_u2_u2_u1 2047.96875 _CNV_A_R_LINEAR_____87_CM -1024. 1023.96875 DISPLAY_IDENTIFIER IP_TQ_DIF_P_D_SLOW_IS_OPM_2 FORMAT "%11.5"
 /begin AXIS_DESCR COM_AXIS n_dif_cor _CNV_A_R_LINEAR_____193_CM 10 -32768. 32767. FORMAT "%6.0" AXIS_PTS_REF ldpm_n_dif_cor_ip_tq_p_d_slow /end AXIS_DESCR
 /begin AXIS_DESCR COM_AXIS n_grd_fil_p_d_is _CNV_A_R_LINEAR_____29_CM 8 -4096. 4064. FORMAT "%5.0" AXIS_PTS_REF ldpm_n_grd_p_d_ip_tq_p_d_slow /end AXIS_DESCR
/end CHARACTERISTIC
/begin CHARACTERISTIC ip_tq_i_is_opm_1 "I-component for idle speed controller at open drive train" MAP 0xa080f120 _REC_MAP_20_u2_u2_u1 7.99987793 _CNV_A_R_LINEAR_____937_CM -4. 3.99987793 DISPLAY_IDENTIFIER IP_TQ_I_IS_OPM_1 FORMAT "%5.4"
 /begin AXIS_DESCR COM_AXIS n_dif_cor _CNV_A_R_LINEAR_____193_CM 12 -32768. 32767. FORMAT "%6.0" AXIS_PTS_REF ldpm_n_dif_cor_tq_i_is_1_opm_1 /end AXIS_DESCR
 /begin AXIS_DESCR COM_AXIS n_grd _CNV_A_R_LINEAR_____29_CM 8 -4096. 4064. FORMAT "%5.0" AXIS_PTS_REF ldpm_n_grd_tq_i_is_1_opm_1 /end AXIS_DESCR
/end CHARACTERISTIC
/begin CHARACTERISTIC ip_tq_i_is_opm_2 "I-component for idle speed controller at open drive train" MAP 0xa080f1e0 _REC_MAP_20_u2_u2_u1 7.99987793 _CNV_A_R_LINEAR_____937_CM -4. 3.99987793 DISPLAY_IDENTIFIER IP_TQ_I_IS_OPM_2 FORMAT "%5.4"
 /begin AXIS_DESCR COM_AXIS n_dif_cor _CNV_A_R_LINEAR_____193_CM 12 -32768. 32767. FORMAT "%6.0" AXIS_PTS_REF ldpm_n_dif_cor_tq_i_is_1_opm_2 /end AXIS_DESCR
 /begin AXIS_DESCR COM_AXIS n_grd _CNV_A_R_LINEAR_____29_CM 8 -4096. 4064. FORMAT "%5.0" AXIS_PTS_REF ldpm_n_grd_tq_i_is_1_opm_2 /end AXIS_DESCR
/end CHARACTERISTIC
/begin AXIS_PTS ldpm_n_dif_cor_tq_i_is_1_opm_1 "" 0xa0802200 n_dif_cor _REC_AXS_20_u2 65535. _CNV_A_R_LINEAR_____193_CM 12 -32768. 32767. FORMAT "%6.0" /end AXIS_PTS
/begin AXIS_PTS ldpm_n_dif_cor_tq_i_is_1_opm_2 "" 0xa080221c n_dif_cor _REC_AXS_20_u2 65535. _CNV_A_R_LINEAR_____193_CM 12 -32768. 32767. FORMAT "%6.0" /end AXIS_PTS
/begin AXIS_PTS ldpm_n_grd_tq_i_is_1_opm_1 "" 0xa0802268 n_grd _REC_AXS_20_u1 8160. _CNV_A_R_LINEAR_____29_CM 8 -4096. 4064. FORMAT "%5.0" /end AXIS_PTS
/begin AXIS_PTS ldpm_n_grd_tq_i_is_1_opm_2 "" 0xa0802274 n_grd _REC_AXS_20_u1 8160. _CNV_A_R_LINEAR_____29_CM 8 -4096. 4064. FORMAT "%5.0" /end AXIS_PTS
/begin COMPU_METHOD _CNV_A_R_LINEAR_____0_CM "" RAT_FUNC "%6.3" "-" COEFFS 0 1. 0. 0 0 1 /end COMPU_METHOD
/begin COMPU_METHOD _CNV_S_2_RANGE__0___1_CM "" TAB_VERB "%6.3" "-" COMPU_TAB_REF _CNV_S_2_RANGE__0___1 /end COMPU_METHOD
/begin COMPU_VTAB _CNV_S_2_RANGE__0___1 "" TAB_VERB 2 0 "0" 1 "1" /end COMPU_VTAB
/begin COMPU_METHOD _CNV_A_R_LINEAR_____2_CM "" RAT_FUNC "%6.3" "V" COEFFS 0 204.8 0. 0 0 1 /end COMPU_METHOD
/begin COMPU_METHOD _CNV_A_R_LINEAR_____3_CM "" RAT_FUNC "%6.3" "s" COEFFS 0 100. 0. 0 0 1 /end COMPU_METHOD
/begin COMPU_METHOD _CNV_A_R_LINEAR_____4_CM "" RAT_FUNC "%6.3" "s" COEFFS 0 10. 0. 0 0 1 /end COMPU_METHOD
/begin COMPU_METHOD _CNV_A_R_LINEAR_____5_CM "" RAT_FUNC "%6.3" "%" COEFFS 0 2.56 0. 0 0 1 /end COMPU_METHOD
/begin COMPU_METHOD _CNV_A_R_LINEAR_____6_CM "" RAT_FUNC "%6.3" "km/h" COEFFS 0 1. 0. 0 0 1 /end COMPU_METHOD
/begin COMPU_METHOD _CNV_S_7_STATE_ECRA_7_CM "" TAB_VERB "%6.3" "-" COMPU_TAB_REF _CNV_S_7_STATE_ECRA_7 /end COMPU_METHOD
/begin COMPU_VTAB _CNV_S_7_STATE_ECRA_7 "" TAB_VERB 7 0 "NO_FB" 1 "DIAG_ABILITY" 2 "EL_ERR_UP" 3 "MEC_ERR_UP" 4 "EL_ERR_DOWN" 5 "EL_ERR_UP_AND_DOWN" 6 "MEC_ERR_UP_AND_EL_ERR_DOWN" /end COMPU_VTAB
/begin COMPU_METHOD _CNV_A_R_LINEAR_____8_CM "" RAT_FUNC "%6.3" "%" COEFFS 0 655.3599999999997 0. 0 0 1 /end COMPU_METHOD
/begin COMPU_METHOD _CNV_A_R_LINEAR_____9_CM "" RAT_FUNC "%6.3" "-" COEFFS 0 32767.99999999992 0. 0 0 1 /end COMPU_METHOD
/begin COMPU_METHOD _CNV_A_R_LINEAR_____10_CM "" RAT_FUNC "%6.3" "rpm" COEFFS 0 3.125e-002 0. 0 0 1 /end COMPU_METHOD
/begin COMPU_METHOD _CNV_A_R_LINEAR_____14_CM "" RAT_FUNC "%6.3" "rpm" COEFFS 0 1. 0. 0 0 1 /end COMPU_METHOD
/begin COMPU_METHOD _CNV_A_R_LINEAR_____17_CM "" RAT_FUNC "%6.3" "°C" COEFFS 0 1.333333333333333 64. 0 0 1 /end COMPU_METHOD
/begin COMPU_METHOD _CNV_A_R_LINEAR_____19_CM "" RAT_FUNC "%6.3" "s" COEFFS 0 2. 0. 0 0 1 /end COMPU_METHOD
/begin COMPU_METHOD _CNV_A_R_LINEAR_____24_CM "" RAT_FUNC "%6.3" "-" COEFFS 0 16384. 0. 0 0 1 /end COMPU_METHOD
/begin COMPU_METHOD _CNV_A_R_LINEAR_____25_CM "" RAT_FUNC "%6.3" "°C" COEFFS 0 1.333333333333333 0. 0 0 1 /end COMPU_METHOD
/begin COMPU_METHOD _CNV_A_R_LINEAR_____26_CM "" RAT_FUNC "%6.3" "°C" COEFFS 0 1. 40. 0 0 1 /end COMPU_METHOD
/begin COMPU_METHOD _CNV_A_R_LINEAR_____28_CM "" RAT_FUNC "%6.3" "-" COEFFS 0 256. 0. 0 0 1 /end COMPU_METHOD
/begin COMPU_METHOD _CNV_A_R_LINEAR_____29_CM "" RAT_FUNC "%6.3" "rpm/s" COEFFS 0 3.125e-002 128. 0 0 1 /end COMPU_METHOD
/begin COMPU_METHOD _CNV_A_R_LINEAR_____30_CM "" RAT_FUNC "%6.3" "rpm/s" COEFFS 0 3.125e-002 0. 0 0 1 /end COMPU_METHOD
/begin COMPU_METHOD _CNV_A_R_LINEAR_____31_CM "" RAT_FUNC "%6.3" "Nm" COEFFS 0 32. 0. 0 0 1 /end COMPU_METHOD
/begin COMPU_METHOD _CNV_A_R_LINEAR_____36_CM "" RAT_FUNC "%6.3" "s" COEFFS 0 1. 0. 0 0 1 /end COMPU_METHOD
/begin COMPU_METHOD _CNV_A_R_LINEAR_____50_CM "" RAT_FUNC "%6.3" "" COEFFS 0 1. 0. 0 0 1 /end COMPU_METHOD
/begin COMPU_METHOD _CNV_A_R_LINEAR_____75_CM "" RAT_FUNC "%6.3" "l" COEFFS 0 1. 0. 0 0 1 /end COMPU_METHOD
/begin COMPU_METHOD _CNV_S_2_RANGE______76_CM "" TAB_VERB "%6.3" "" COMPU_TAB_REF _CNV_S_2_RANGE______76 /end COMPU_METHOD
/begin COMPU_VTAB _CNV_S_2_RANGE______76 "" TAB_VERB 2 0 "0" 1 "1" /end COMPU_VTAB
/begin COMPU_METHOD _CNV_A_R_LINEAR_____84_CM "" RAT_FUNC "%6.3" "min" COEFFS 0 1. 0. 0 0 1 /end COMPU_METHOD
/begin COMPU_METHOD _CNV_A_R_LINEAR_____86_CM "" RAT_FUNC "%6.3" "km/h" COEFFS 0 128.0000018750286 0. 0 0 1 /end COMPU_METHOD
/begin COMPU_METHOD _CNV_A_R_LINEAR_____87_CM "" RAT_FUNC "%6.3" "Nm" COEFFS 0 32. 32768. 0 0 1 /end COMPU_METHOD
/begin COMPU_METHOD _CNV_A_R_LINEAR_____89_CM "" RAT_FUNC "%6.3" "-" COEFFS 0 65535.99999999996 0. 0 0 1 /end COMPU_METHOD
/begin COMPU_METHOD _CNV_A_R_LINEAR_____103_CM "" RAT_FUNC "%6.3" "-" COEFFS 0 128. 0. 0 0 1 /end COMPU_METHOD
/begin COMPU_METHOD _CNV_A_R_LINEAR_____111_CM "" RAT_FUNC "%6.3" "mg/stk" COEFFS 0 47.18142548596112 0. 0 0 1 /end COMPU_METHOD
/begin COMPU_METHOD _CNV_A_R_LINEAR_____113_CM "" RAT_FUNC "%6.3" "%" COEFFS 0 655.3599999999997 -1.455191522836685e-011 0 0 1 /end COMPU_METHOD
/begin COMPU_METHOD _CNV_A_R_LINEAR_____129_CM "" RAT_FUNC "%6.3" "-" COEFFS 0 1024. 0. 0 0 1 /end COMPU_METHOD
/begin COMPU_METHOD _CNV_A_R_LINEAR_____160_CM "" RAT_FUNC "%6.3" "Seg" COEFFS 0 1. 0. 0 0 1 /end COMPU_METHOD
/begin COMPU_METHOD _CNV_S_6_RANGE_STAT_161_CM "" TAB_VERB "%6.3" "" COMPU_TAB_REF _CNV_S_6_RANGE_STAT_161 /end COMPU_METHOD
/begin COMPU_VTAB _CNV_S_6_RANGE_STAT_161 "" TAB_VERB 6 0 "ES" 1 "ST" 2 "IS" 3 "PL" 4 "PU" 5 "PUC" /end COMPU_VTAB
/begin COMPU_METHOD _CNV_A_R_LINEAR_____165_CM "" RAT_FUNC "%6.3" "-" COEFFS 0 65535. 0. 0 0 1 /end COMPU_METHOD
/begin COMPU_METHOD _CNV_A_R_LINEAR_____171_CM "" RAT_FUNC "%6.3" "hPa" COEFFS 0 0.1884402603974972 0. 0 0 1 /end COMPU_METHOD
/begin COMPU_METHOD _CNV_A_R_LINEAR_____172_CM "" RAT_FUNC "%6.3" "V" COEFFS 0 6553.60054017653 0. 0 0 1 /end COMPU_METHOD
/begin COMPU_METHOD _CNV_A_R_LINEAR_____173_CM "" RAT_FUNC "%6.3" "hPa" COEFFS 0 0.3768805207949945 0. 0 0 1 /end COMPU_METHOD
/begin COMPU_METHOD _CNV_A_R_LINEAR_____185_CM "" RAT_FUNC "%6.3" "" COEFFS 0 256. 0. 0 0 1 /end COMPU_METHOD
/begin COMPU_METHOD _CNV_A_R_LINEAR_____191_CM "" RAT_FUNC "%6.3" "s" COEFFS 0 32. 0. 0 0 1 /end COMPU_METHOD
/begin COMPU_METHOD _CNV_A_R_LINEAR_____192_CM "" RAT_FUNC "%6.3" "-" COEFFS 0 32. 0. 0 0 1 /end COMPU_METHOD
/begin COMPU_METHOD _CNV_A_R_LINEAR_____193_CM "" RAT_FUNC "%6.3" "rpm" COEFFS 0 1. 32768. 0 0 1 /end COMPU_METHOD
/begin COMPU_METHOD _CNV_A_R_LINEAR_____194_CM "" RAT_FUNC "%6.3" "mm" COEFFS 0 1000. 0. 0 0 1 /end COMPU_METHOD
/begin COMPU_METHOD _CNV_A_R_LINEAR_____195_CM "" RAT_FUNC "%6.3" "hPa" COEFFS 0 25.6 32768. 0 0 1 /end COMPU_METHOD
/begin COMPU_METHOD _CNV_A_R_EGCP_LINEA_354_CM "" RAT_FUNC "%6.3" "-" COEFFS 0 100. 0. 0 0 1 /end COMPU_METHOD
/begin COMPU_METHOD _CNV_A_R_ENSD_LINEA_399_CM "" RAT_FUNC "%6.3" "°C" COEFFS 0 1. 50. 0 0 1 /end COMPU_METHOD
/begin COMPU_METHOD _CNV_A_R_LINEAR_____425_CM "" RAT_FUNC "%6.3" "V" COEFFS 0 10. 0. 0 0 1 /end COMPU_METHOD
/begin COMPU_METHOD _CNV_A_R_LINEAR_____433_CM "" RAT_FUNC "%6.3" "-" COEFFS 0 65551.06000970239 0. 0 0 1 /end COMPU_METHOD
/begin COMPU_METHOD _CNV_A_R_INJR_LINEA_466_CM "" RAT_FUNC "%6.3" "ms" COEFFS 0 100. 0. 0 0 1 /end COMPU_METHOD
/begin COMPU_METHOD _CNV_S_9_STATE_CMB__520_CM "" TAB_VERB "%6.3" "-" COMPU_TAB_REF _CNV_S_9_STATE_CMB__520 /end COMPU_METHOD
/begin COMPU_VTAB _CNV_S_9_STATE_CMB__520 "" TAB_VERB 9 0 "HOM_AFS" 1 "AFS_TO_AFL" 2 "HOM_AFL" 3 "AFL_TO_AFS" 4 "HOM_TO_S" 5 "BACKS" 6 "S" 7 "S_TO_HOM" 8 "BACKHOM" /end COMPU_VTAB
/begin COMPU_METHOD _CNV_S_5_STATE_OPM_521_CM "" TAB_VERB "%6.3" "-" COMPU_TAB_REF _CNV_S_5_STATE_OPM_521 /end COMPU_METHOD
/begin COMPU_VTAB _CNV_S_5_STATE_OPM_521 "" TAB_VERB 5 0 "NO ACTION" 1 "S" 2 "AFS" 3 "AFL" 8 "LIH" /end COMPU_VTAB
/begin COMPU_METHOD _CNV_A_R_LINEAR_____546_CM "" RAT_FUNC "%6.3" "°CRK" COEFFS 0 10. 0. 0 0 1 /end COMPU_METHOD
/begin COMPU_METHOD _CNV_A_R_ENSC_LINEA_936_CM "" RAT_FUNC "%6.3" "Nm" COEFFS 0 8192. 32768. 0 0 1 /end COMPU_METHOD
/begin COMPU_METHOD _CNV_A_R_LINEAR_____937_CM "" RAT_FUNC "%6.3" "Nm" COEFFS 0 8191.999999679995 32767.99999871998 0 0 1 /end COMPU_METHOD
/begin RECORD_LAYOUT _REC_VAL_20_u1 FNC_VALUES 1 UBYTE COLUMN_DIR DIRECT /end RECORD_LAYOUT
/begin RECORD_LAYOUT _REC_VAL_20_u2 FNC_VALUES 1 UWORD COLUMN_DIR DIRECT /end RECORD_LAYOUT
/begin RECORD_LAYOUT _REC_AXS_20_u1 NO_AXIS_PTS_X 1 UBYTE AXIS_PTS_X 2 UBYTE INDEX_INCR DIRECT /end RECORD_LAYOUT
/begin RECORD_LAYOUT _REC_CUR_20_u1_u1 FNC_VALUES 1 UBYTE COLUMN_DIR DIRECT /end RECORD_LAYOUT
/begin RECORD_LAYOUT _REC_VAL_20_s2 FNC_VALUES 1 SWORD COLUMN_DIR DIRECT /end RECORD_LAYOUT
/begin RECORD_LAYOUT _REC_MAP_20_u2_u2_u1 FNC_VALUES 1 UWORD COLUMN_DIR DIRECT /end RECORD_LAYOUT
/begin RECORD_LAYOUT _REC_AXS_20_u2 NO_AXIS_PTS_X 1 UWORD AXIS_PTS_X 2 UWORD INDEX_INCR DIRECT /end RECORD_LAYOUT
/begin RECORD_LAYOUT _REC_CUR_20_u2_u1 FNC_VALUES 1 UWORD COLUMN_DIR DIRECT /end RECORD_LAYOUT
/begin RECORD_LAYOUT _REC_CUR_20_u2_u2 FNC_VALUES 1 UWORD COLUMN_DIR DIRECT /end RECORD_LAYOUT
/begin RECORD_LAYOUT _REC_VAL_20_s1 FNC_VALUES 1 SBYTE COLUMN_DIR DIRECT /end RECORD_LAYOUT
/begin RECORD_LAYOUT _REC_CUR_20_u1_u2 FNC_VALUES 1 UBYTE COLUMN_DIR DIRECT /end RECORD_LAYOUT
/begin RECORD_LAYOUT _REC_MAP_20_u2_u2_u2 FNC_VALUES 1 UWORD COLUMN_DIR DIRECT /end RECORD_LAYOUT
/begin RECORD_LAYOUT _REC_MAP_20_u2_u1_u2 FNC_VALUES 1 UWORD COLUMN_DIR DIRECT /end RECORD_LAYOUT
/begin RECORD_LAYOUT _REC_MAP_20_u1_u2_u2 FNC_VALUES 1 UBYTE COLUMN_DIR DIRECT /end RECORD_LAYOUT
/begin RECORD_LAYOUT _REC_MAP_20_u1_u1_u1 FNC_VALUES 1 UBYTE COLUMN_DIR DIRECT /end RECORD_LAYOUT
/begin FUNCTION DIA_Electronically_controlled_radiator_shutter_diagnosis "_Electronically controlled radiator shutter diagnosis"
 /begin DEF_CHARACTERISTIC c_t_ecraspwm_fb_min_1 c_t_ecraspwm_fb_min_2 c_t_ecraspwm_fb_min_3 c_t_ecraspwm_fb_min_4 c_t_ecraspwm_fb_min_5 c_t_ecraspwm_fb_min_6 c_t_ecraspwm_fb_max c_t_ecraspwm_fb_max_1 c_t_ecraspwm_fb_max_2 c_t_ecraspwm_fb_max_3 c_t_ecraspwm_fb_max_4 c_t_ecraspwm_fb_max_5 c_t_ecraspwm_fb_max_6 c_abc_inc_ecras_el c_abc_max_ecras_el c_abc_inc_ecras_up_fb c_abc_max_ecras_up_fb c_abc_inc_ecras_down_fb c_abc_max_ecras_down_fb c_t_diag_ecras c_t_ecras_down_det c_t_min_ecras_down_det c_t_max_ecras_down_det c_ctr_ecras_down_det c_ecraspwm_diag_min_scp c_ecraspwm_diag_max_scg c_ecraspwm_diag_min_oc c_abc_ecraspwm_fb c_ecraspwm_min_fb c_t_act_ecraspwm_fb c_vs_max_ecras_diag /end DEF_CHARACTERISTIC
 /begin OUT_MEASUREMENT err_ecraspwm_fb t_ecraspwm_fb cdn_diag_ecras_el lv_err_ecras_el lv_err_ecras lv_err_ecraspwm_fb err_diag_ecraspwm lv_intr_diag_ecras_el lv_ecras_fb_det lv_err_ecras_up_fb lv_err_ecras_down_fb lv_diag_ecras lv_diag_ecras_end lv_edge_ecras_up lv_edge_ecras_down lv_ecras_fb_diag lv_ecras_down_det_rst lv_diag_ecras_err_end lv_var_ecras_down lv_ecras_down_det_set lv_ecras_down_det_act t_diag_ecras t_ecras_down_det t_ecras_down_det_neg t_ecras_down_det_pos ctr_ecras_down_det state_ecras_fb /end OUT_MEASUREMENT
/end FUNCTION
/begin FUNCTION DIA_Upstream_oxygen_sensor_signal_monitoring "_Upstream oxygen sensor signal monitoring" /end FUNCTION
/begin FUNCTION DIA_CAN_diagnosis_for_NOX_control "_CAN diagnosis for NOX control" /end FUNCTION
/begin FUNCTION DIA_NOx_Sensor_Diagnosis___OBD_I "_NOx-Sensor Diagnosis - OBD I" /begin OUT_MEASUREMENT lv_inh_diag_ns_obd_1_1 lv_inh_diag_ns_obd_1_2 /end OUT_MEASUREMENT /end FUNCTION
/begin FUNCTION DIA_Clutch_switch_diagnosis "_Clutch switch diagnosis"
 /begin DEF_CHARACTERISTIC c_maf_cs_diag c_n_32_cs_diag c_vs_cs_diag c_t_min_maf_cs_diag /end DEF_CHARACTERISTIC
 /begin OUT_MEASUREMENT lv_err_cs lv_cs_diag lv_cs_swi t_min_maf_cs_diag state_rbm_cs /end OUT_MEASUREMENT
/end FUNCTION
/begin FUNCTION DIA_ECU_selftest "_ECU-selftest" /begin OUT_MEASUREMENT lv_err_ecu_ram lv_err_ecu_cks lv_err_ecu_nvmy /end OUT_MEASUREMENT /end FUNCTION
/begin FUNCTION DIA_SPI_Bus_diagnosis "_SPI-Bus diagnosis" /begin OUT_MEASUREMENT lv_err_spi_knk lv_err_spi_mps /end OUT_MEASUREMENT /end FUNCTION
/begin FUNCTION DIA_Automatic_gear_shift_signal_diagnosis "_Automatic gear shift signal diagnosis" /begin DEF_CHARACTERISTIC lc_var_gs_eobd lc_etcu_frf /end DEF_CHARACTERISTIC /begin OUT_MEASUREMENT state_diag_gs lv_err_gs /end OUT_MEASUREMENT /end FUNCTION
/begin FUNCTION DIA_Diagnosis_Electrical_Controlled_Waterpump "_Diagnosis Electrical Controlled Waterpump"
 /begin DEF_CHARACTERISTIC c_t_cwp_dif_max c_tco_cwp_rel_min_diag c_t_v_cwp_max_diag ldp_state_cwp_int id_rel_cwp_pwr c_n_rel_cwp_dif_max c_n_rel_cwp_hys c_t_cwp_lock_max c_t_cwp_temp_high_max c_t_cwp_vcc_plaus_max c_temp_el_cwp_max_thd_1 c_temp_el_cwp_max_thd_2 c_temp_el_cwp_hys c_t_temp_el_cwp_thd_1 c_t_temp_el_cwp_thd_2 c_v_cwp_min_diag_mon lc_swi_cwp_inp c_abc_max_cwp_chk_inp c_abc_inc_cwp_chk_inp c_n_rel_cwp_sp_thd_min c_v_cwp_hys c_v_cwp_min_diag_it /end DEF_CHARACTERISTIC
 /begin OUT_MEASUREMENT lv_err_cwp_plaus state_cwp_int rel_cwp_pwr t_cwp_5 n_rel_cwp_dif lv_cwp_not_plaus lv_cwp_tmp_off lv_cwp_off t_cwp_dif_end_diag t_cwp_lock t_cwp_temp_high t_cwp_vcc_plaus t_cwp_cdn_diag_int_off t_cwp_dif t_cwp_cdn_diag_pwr t_cwp_4 lv_err_cwp_pwr lv_err_cwp_int_off lv_err_cwp_com_plaus /end OUT_MEASUREMENT
/end FUNCTION
/begin FUNCTION DIA_IS_Control_Diag "_IS_Control_Diag" /end FUNCTION
/begin FUNCTION DIA_IS_Control_Diag__AI "_IS_Control_Diag__AI" /end FUNCTION
/begin FUNCTION DIA_Fuel_reserve_diagnosis "_DIA Fuel reserve diagnosis"
 /begin DEF_CHARACTERISTIC c_fac_ratio_ftl_ini_min c_fac_ratio_ftl_ini_max c_ctr_ftl_max c_inh_iv_ftl_min c_abc_inc_ftl_min c_abc_dec_ftl_min c_abc_max_ftl_min c_lamb_sp_ftl_min c_ctr_ftl_ratio_max c_fup_efp_diag_ftl_min c_fup_diag_ftl_min c_fac_lam_ftl_min c_ftl_diag_ftl_min c_lamb_dif_fil_max c_fup_dif_ftl_max lc_lamb_plaus_ftl_min_diag lc_err_fup_diag_act_hprs lc_err_fup_diag_act_lprs lc_er_ftl_min_act /end DEF_CHARACTERISTIC
 /begin OUT_MEASUREMENT lv_ftl_min_act lv_err_ftl_min ratio_ftl ratio_ftl_ini ctr_er_ftl_min inh_iv_ftl_min lv_fup_avl_diag_tmp lv_lamb_plaus_ftl_min_diag_tmp lv_err_fup_diag_act_hprs lv_err_fup_diag_act_lprs ctr_ftl_min_act state_err_ftl /end OUT_MEASUREMENT
/end FUNCTION
/begin FUNCTION DIA_Vima_actuator_feedback_diagnosis "_Vima actuator feedback diagnosis" /end FUNCTION
/begin FUNCTION DIA_Ambient_temperature_sensor "_Ambient temperature sensor"
 /begin DEF_CHARACTERISTIC c_abc_inc_tam_can c_abc_max_tam_can c_tam_dif_st_end c_t_es_min_tam_diag c_tam_min_tam_diag c_tam_max_tam_diag c_tam_dif_plaus_min c_tam_dif_max_err c_t_ast_max_tam_diag c_t_tam_dif_max_err c_vs_min_vld_tam_err c_t_vs_min_vld_tam_err c_tco_2_st_min_tam_diag c_tco_2_tia_dif_max c_tco_st_min_tam_diag c_tco_tia_dif_max lc_inh_diag_tam_plaus /end DEF_CHARACTERISTIC
 /begin OUT_MEASUREMENT lv_err_tam lv_err_tam_can t_tam_dif_diag t_vs_min_vld_tam_err lv_err_tam_plaus lv_det_err_tam_plaus lv_vs_cdn_tam_err tam_dif_plaus tam_dif_diag tam_dif_max_diag tam_dif_min_diag lv_end_rbm_tam_plaus lv_cdn_rbm_tam_plaus lv_cnl_diag_tam_plaus lv_inh_diag_tam_plaus lv_diag_cdn_tam_plaus state_rbm_tam_plaus /end OUT_MEASUREMENT
/end FUNCTION
/begin FUNCTION DIA_Engine_Off_Duration_diagnosis "_Engine Off Duration diagnosis" /begin DEF_CHARACTERISTIC c_tco_stuck_t_es_diag /end DEF_CHARACTERISTIC /begin OUT_MEASUREMENT lv_err_t_es state_rbm_t_es /end OUT_MEASUREMENT /end FUNCTION
/begin FUNCTION DIA_LDM_diagnosis__LV_ERR_LDM_ "_LDM diagnosis (LV_ERR_LDM)" /begin DEF_CHARACTERISTIC c_t_max_brake_det_ldm lc_ldm_ena_plaus_err /end DEF_CHARACTERISTIC
 /begin OUT_MEASUREMENT lv_err_ldm lv_ldm_off_ecu lv_ldm_ena_plaus_err lv_ldm_brake_plaus_err t_ldm_brake_det lv_ldm_off_ecu_1 lv_ldm_off_ecu_2 /end OUT_MEASUREMENT
/end FUNCTION
/begin FUNCTION DIA_Fuel_Pressure_Actuator_Diag "_Fuel_Pressure_Actuator_Diag"
 /begin DEF_CHARACTERISTIC lc_diag_dis_vcv[0] lc_diag_dis_vcv[1] c_t_diag_vcv c_v_on_vcv_max_diag_scp c_v_off_vcv_min_diag_scg c_v_off_vcv_min_diag_oc c_v_off_vcv_max_diag_oc c_abc_inc_vcv c_abc_max_vcv /end DEF_CHARACTERISTIC
 /begin OUT_MEASUREMENT ang_diag_vcv[0] ang_diag_vcv[1] lv_v_chk_ena_vcv[0] lv_v_chk_ena_vcv[1] v_on_min_vcv[0] v_on_min_vcv[1] v_on_max_vcv[0] v_on_max_vcv[1] v_off_max_vcv[0] v_off_max_vcv[1] lv_err_vcv_fpc_0 lv_err_vcv_fpc_1 v_off_min_vcv[0] v_off_min_vcv[1] lv_err_vcv /end OUT_MEASUREMENT
/end FUNCTION
/begin FUNCTION DIA_Fuel_Pressure_Sensor_Diag "_Fuel_Pressure_Sensor_Diag"
 /begin DEF_CHARACTERISTIC c_v_fup_mv_max_diag c_v_fup_mv_min_diag c_abc_inc_fup c_abc_max_fup c_n_32_fup_diag_max /end DEF_CHARACTERISTIC
 /begin OUT_MEASUREMENT lv_err_fup_0 lv_err_fup_1 /end OUT_MEASUREMENT
/end FUNCTION
/begin FUNCTION DIA_Fuel_Pressure_Actuator_Diag_AI "_Fuel_Pressure_Actuator_Diag_AI" /begin OUT_MEASUREMENT lv_inh_diag_vcv[0] lv_inh_diag_vcv[1] /end OUT_MEASUREMENT /end FUNCTION
/begin FUNCTION DIA_Fuel_Pressure_Sensor_Diag_AI "_Fuel_Pressure_Sensor_Diag_AI" /begin OUT_MEASUREMENT lv_inh_diag_fup[0] lv_inh_diag_fup[1] /end OUT_MEASUREMENT /end FUNCTION
/begin FUNCTION DIA_FUP_EFP_Sensor_Diag__AI "" /begin OUT_MEASUREMENT lv_inh_diag_fup_efp /end OUT_MEASUREMENT /end FUNCTION
/begin FUNCTION DIA_FUP_EFP_Sensor_Diag ""
 /begin DEF_CHARACTERISTIC c_v_fup_efp_mv_max_diag c_v_fup_efp_mv_min_diag c_abc_inc_fup_efp c_abc_max_fup_efp /end DEF_CHARACTERISTIC
 /begin OUT_MEASUREMENT lv_err_fup_efp /end OUT_MEASUREMENT
/end FUNCTION
/begin FUNCTION Energy_spare_mode_diag "_Energy spare mode diag" /begin DEF_CHARACTERISTIC lc_egy_min_diag /end DEF_CHARACTERISTIC /begin OUT_MEASUREMENT lv_err_egy_min /end OUT_MEASUREMENT /end FUNCTION
/begin FUNCTION DIA_Electric_recirculation_flap_diagnosis "_Electric recirculation flap diagnosis"
 /begin DEF_CHARACTERISTIC c_rfp_dr_pwm_diag_min_scb c_rfp_dr_pwm_diag_max_scg c_rfp_dr_pwm_diag_min_oc /end DEF_CHARACTERISTIC
 /begin OUT_MEASUREMENT cdn_diag_rfp_dr_1 cdn_diag_rfp_dr_2 lv_err_rfp_dr_1 lv_err_rfp_dr_2 lv_inh_diag_rfp_dr_1 lv_inh_diag_rfp_dr_2 /end OUT_MEASUREMENT
/end FUNCTION
/begin FUNCTION DIA_Electric_waste_gate_diagnosis "_Electric waste gate diagnosis"
 /begin DEF_CHARACTERISTIC c_wg_dr_pwm_diag_max_scg c_wg_dr_pwm_diag_min_scb c_wg_dr_pwm_diag_min_oc /end DEF_CHARACTERISTIC
 /begin OUT_MEASUREMENT lv_err_wg_1_dr lv_err_wg_2_dr lv_inh_diag_wg_1_dr lv_inh_diag_wg_2_dr cdn_diag_wg_1_dr cdn_diag_wg_2_dr /end OUT_MEASUREMENT
/end FUNCTION
/begin FUNCTION DIA_PUT_sensor_diagnosis ""
 /begin DEF_CHARACTERISTIC c_v_put_mv_max_diag c_v_put_mv_min_diag c_v_put_mv_max_diag_es c_v_put_mv_min_diag_es /end DEF_CHARACTERISTIC
 /begin OUT_MEASUREMENT v_put_mv_max_diag v_put_mv_min_diag /end OUT_MEASUREMENT
/end FUNCTION
/begin FUNCTION DIA_PUT_Charge_Air_Pressure_Sensor_Diagnosis "" /begin OUT_MEASUREMENT lv_err_put_el_1 lv_err_put_el_2 /end OUT_MEASUREMENT /end FUNCTION
/begin FUNCTION DIA_Oil_pressure_sensor_diagnosis "Oil pressure sensor diagnosis" /begin DEF_CHARACTERISTIC c_v_poil_max_diag c_v_poil_min_diag /end DEF_CHARACTERISTIC /begin OUT_MEASUREMENT lv_err_sens_poil /end OUT_MEASUREMENT /end FUNCTION
/begin FUNCTION DIA_Electrical_diagnosis_of_oil_pressure_actuator "Electrical diagnosis of oil pressure actuator"
 /begin DEF_CHARACTERISTIC c_pwm_poil_dr_max_diag_scg c_pwm_poil_dr_min_diag_scp c_pwm_poil_dr_min_diag_oc /end DEF_CHARACTERISTIC
 /begin OUT_MEASUREMENT lv_err_poil_dr cdn_diag_poil_dr /end OUT_MEASUREMENT
/end FUNCTION
/begin FUNCTION DIA_TEG_sensor_diagnosis "_TEG sensor diagnosis"
 /begin DEF_CHARACTERISTIC c_v_teg_sens_diag_min c_v_teg_sens_diag_max c_v_teg_sens_grd_max c_vp_teg_sens_act_diag c_t_ast_min_teg_sens_diag c_ctr_min_tq_min_teg_sens_diag c_tq_min_teg_sens_diag c_vs_min_teg_sens_diag c_abc_inc_teg_sens c_abc_max_teg_sens /end DEF_CHARACTERISTIC
 /begin OUT_MEASUREMENT ctr_tq_min_teg_sens_diag lv_err_teg_sens_1 lv_err_teg_sens_2 lv_err_prel_teg_sens[0] lv_err_prel_teg_sens[1] /end OUT_MEASUREMENT
/end FUNCTION
/begin FUNCTION C_C_ETC "C_C_ETC"
 /begin SUB_FUNCTION ETC_Throttle_position_setpoint_calculation ETC_Position_controller ETC_Throttle_position_setpoint_selection ETC_Application_incidences_throttle_position_setpoint_selection /end SUB_FUNCTION
/end FUNCTION
/begin FUNCTION ETC_Throttle_position_setpoint_calculation "_Throttle position setpoint calculation" /end FUNCTION
/begin FUNCTION ETC_Position_controller "_Position controller" /end FUNCTION
/begin FUNCTION ETC_Throttle_position_setpoint_selection "_Throttle position setpoint selection" /end FUNCTION
/begin FUNCTION ETC_Application_incidences_throttle_position_setpoint_selection "_Application incidences throttle position setpoint selection" /end FUNCTION
/begin FUNCTION C_5_EOS "C_5_EOS"
 /begin SUB_FUNCTION EOS_General_engine_operating_states EOS_Basic_operating_states__LV_ST__LV_IS__LV_REQ_ISC__LV_PL__LV_PU___LV_PUC EOS_Basic_functions__FL___INF EOS_Auxiliary_start_functions EOS_Combustion_Management EOS_Catalyst_heating_functions EOS_Combustion_switch_request_to_homogeneous_stoichiometric_for_torque_plausibility_check EOS_Runtime_Optimization_by_Recurrence_Switch EOS_Aux_Start_Fct EOS_Combust_State_Manager EOS_Combust_Mode_Switch EOS_Lambda_Test_Stratified_Mode EOS_Operation_mode_request_from_tester /end SUB_FUNCTION
/end FUNCTION
/begin FUNCTION EOS_General_engine_operating_states "_General engine operating states" /begin DEF_CHARACTERISTIC ip_n_max_tol_st /end DEF_CHARACTERISTIC /end FUNCTION
/begin FUNCTION EOS_Basic_operating_states__LV_ST__LV_IS__LV_REQ_ISC__LV_PL__LV_PU___LV_PUC "_Basic operating states: LV_ST, LV_IS, LV_REQ_ISC, LV_PL, LV_PU & LV_PUC"
 /begin DEF_CHARACTERISTIC ip_cyc_cast__tco c_n_max_bol_st c_t_max_pu lc_inh_dt_pu c_t_min_pu_msr c_t_min_pu_rng_l id_n_hys_max_puc__gr_at id_n_hys_max_puc__gr_mt id_n_hys_min_puc__gr_at id_n_hys_min_puc__gr_mt id_n_hys_puc_st__gr_at id_n_hys_puc_st__gr_mt c_cycnr_hys_puc c_cycnr_hys_puc_st c_tco_min_puc_st ip_n_accout_min_puc__tco__gr_mt ip_n_accout_min_puc__tco__gr_at c_n_dif_ast c_t_n_dif_ast ip_n_min_puc__tco__gr_at c_t_min_pu_vs c_vs_min_pu ip_t_min_pu__n__tco ip_n_min_puc_add_ars ip_n_dif_max_is ip_t_min_pu_rng_l__n__tco ip_n_min_puc__tco__gr_mt ip_n_min_puc_add_pste_2 ip_t_min_pu_s ip_t_min_pu_hom c_clc_state_clu_amt c_t_min_pu_vs_cs c_vs_pu_cs_min c_vs_pu_cs_max lc_n_hys_cyl_cut_off_at_conf lc_n_hys_cyl_cut_off_mt_conf lc_inh_puc_nt_req ip_n_min_puc_add /end DEF_CHARACTERISTIC
 /begin OUT_MEASUREMENT lv_es lv_st lv_st_end lv_is lv_pl lv_pu t_pu lv_puc lv_puc_req state_eng lv_iga_min_puc lv_cs_puc t_is /end OUT_MEASUREMENT
/end FUNCTION
/begin FUNCTION EOS_Basic_functions__FL___INF "_Basic functions: FL, INF & REACX"
 /begin DEF_CHARACTERISTIC c_n_max_fl_dly c_n_min_fl_dly c_t_max_fl_dly c_t_ti_dly_fl_2 c_t_ti_dly_fl_at_1 c_t_ti_dly_fl_at_2 c_tco_min_fl c_vs_min_fl c_n_min_fl c_t_min_fl_dly c_t_ti_dly_fl_1 c_n_min_cp_fl c_cl_mmv_thd_fl ip_fac_tq_req_driv_fl ip_load_thd_fl c_fac_tq_req_fl_hys c_load_thd_fl_hys ldp_n_grd_n_max_inf ip_n_max_inf c_n_grd_min /end DEF_CHARACTERISTIC
 /begin OUT_MEASUREMENT lv_fl_raw lv_fl lv_inf /end OUT_MEASUREMENT
/end FUNCTION
/begin FUNCTION EOS_Auxiliary_start_functions "_Auxiliary start functions"
 /begin DEF_CHARACTERISTIC c_crlc_fac_ti_cast_fup c_t_max_rest c_tco_dif_max_rest c_t_min_ecu_rest c_cyc_cast_min_st_es c_cyc_cast_max_st_es ip_n_bol_stall ip_n_tol_stall c_n_max_cdn_stall c_ctr_n_win_stall /end DEF_CHARACTERISTIC
 /begin OUT_MEASUREMENT lv_ast fac_ti_cast_fup lv_rest cyc_cast t_st_es lv_st_es lv_stall t_ast_rest ctr_n_win_stall lv_wup_can t_ast t_ast_diag tco_rest /end OUT_MEASUREMENT
/end FUNCTION
/begin FUNCTION EOS_Combustion_Management "_Combustion_Management" /begin DEF_CHARACTERISTIC c_n_s_clc_hys c_n_afl_clc c_n_afl_clc_hys c_n_s_clc /end DEF_CHARACTERISTIC /begin OUT_MEASUREMENT lv_afl_clc lv_s_clc /end OUT_MEASUREMENT /end FUNCTION
/begin FUNCTION EOS_Catalyst_heating_functions "_Catalyst heating functions" /begin OUT_MEASUREMENT lv_ti_ch lv_ch_n_sp_is lv_wup lv_ch /end OUT_MEASUREMENT /end FUNCTION
/begin FUNCTION EOS_Combustion_switch_request_to_homogeneous_stoichiometric_for_torque_plausibility_check "_Combustion switch request to homogeneous stoichiometric for torque plausibility check"
 /begin DEF_CHARACTERISTIC c_n_hom_act_thd c_n_hom_act_hys c_pv_hom_act_hys c_fac_tq_hom_act_hys c_t_max_tqi_plaus_swi /end DEF_CHARACTERISTIC
 /begin OUT_MEASUREMENT lv_tqi_plaus_hom_afs_req lv_tqi_plaus_hom_afs_act t_tqi_plaus_swi /end OUT_MEASUREMENT
/end FUNCTION
/begin FUNCTION EOS_Runtime_Optimization_by_Recurrence_Switch "_Runtime Optimization by Recurrence Switch" /begin DEF_CHARACTERISTIC c_n_seg_2_ena /end DEF_CHARACTERISTIC /begin OUT_MEASUREMENT lv_clc_2seg lv_clc_2seg_ena /end OUT_MEASUREMENT /end FUNCTION
/begin FUNCTION EOS_Aux_Start_Fct "" /begin OUT_MEASUREMENT cyc_st /end OUT_MEASUREMENT /end FUNCTION
/begin FUNCTION EOS_Combust_State_Manager "_Combust_State_Manager"
 /begin OUT_MEASUREMENT lv_lam_cyl_sel_adj_ofs_ext_req lv_iga_and_inj_swi_1 lv_iga_and_inj_swi_2 lv_s_run lv_hom_run lv_hom_afs_req lv_s_act state_cmb_ctl lv_iga_and_inj_swi lv_fup_sp_swi lv_hom_afl_act lv_hom_afs_act opm_av opm_req lv_sp_rate_cyl_egr_swi lv_hom_act lv_s_ena lv_hom_ena lv_mplh_ena lv_iga_and_inj_swi_homs_1 lv_iga_and_inj_swi_homs_2 lv_iga_and_inj_swi_homs /end OUT_MEASUREMENT
/end FUNCTION
/begin FUNCTION EOS_Combust_Mode_Switch "_Combust_Mode_Switch" /begin OUT_MEASUREMENT lv_inh_s lv_inh_afl /end OUT_MEASUREMENT /end FUNCTION
/begin FUNCTION EOS_Lambda_Test_Stratified_Mode "_Lambda_Test_Stratified_Mode"
 /begin DEF_CHARACTERISTIC c_crlc_lamb_sp_s c_lamb_sp_s_ini c_fac_lamb_afs lc_lamb_sp_s_raw_ext /end DEF_CHARACTERISTIC
 /begin OUT_MEASUREMENT lamb_sp_s_raw lamb_sp_s lamb_sp_s_ext /end OUT_MEASUREMENT
/end FUNCTION
/begin FUNCTION EOS_Operation_mode_request_from_tester "_Operation mode request from tester"
 /begin DEF_CHARACTERISTIC c_opm_ext_req_1 c_opm_ext_req_2 c_opm_ext_req_3 c_opm_ext_req_4 c_opm_ext_req_5 c_opm_ext_req_6 c_opm_ext_req_7 c_opm_ext_req_8 c_opm_ext_req_vls_eol /end DEF_CHARACTERISTIC
 /begin OUT_MEASUREMENT opm_ext_req opm_ext_req_tmp /end OUT_MEASUREMENT
/end FUNCTION
/begin FUNCTION C_8_ISC "C_8_ISC"
 /begin SUB_FUNCTION ISC_Idle_speed_control ISC_Idle_speed_torque_reserve ISC_Application_Incidence_for_Idle_Speed_Control /end SUB_FUNCTION
/end FUNCTION
/begin FUNCTION ISC_Idle_speed_control "_Idle speed control"
 /begin DEF_CHARACTERISTIC ip_tq_i_dt_is_opm_1 ip_tq_i_dt_is_opm_2 ip_fac_t_ast_i_is_opm_1 ip_fac_t_ast_i_is_opm_2 ip_tq_dif_p_d_fast_dt_is_opm_2 ip_tq_dif_p_d_fast_is_opm_1 ip_tq_dif_p_d_fast_is_opm_2 ip_tq_dif_p_d_fast_dt_is_opm_1 ip_tq_dif_p_d_slow_dt_is_opm_1 ip_tq_dif_p_d_slow_is_opm_1 ip_tq_dif_p_d_slow_dt_is_opm_2 ip_tq_dif_p_d_slow_is_opm_2 ip_tq_i_is_opm_1 ip_tq_i_is_opm_2 /end DEF_CHARACTERISTIC
 /begin OUT_MEASUREMENT lv_tq_isc_i_tq_pste /end OUT_MEASUREMENT
/end FUNCTION
/begin FUNCTION ISC_Idle_speed_torque_reserve "_Idle speed torque reserve"
 /begin DEF_CHARACTERISTIC c_tq_add_is_bol_crlc ip_t_n_dif_ofs_pred_opm_2 id_tq_add_is_opm_av id_tq_add_is_opm_req ip_t_n_dif_ofs_pred_opm_1 ip_t_n_dif_ofs_pred_cs_opm_2 ip_t_n_dif_ofs_pred_cs_opm_1 ip_tq_add_is_bol_bas_opm_1 ip_tq_add_is_bol_bas_opm_2 ip_fac_temp_tq_add_is_bas_opm_1 ip_fac_temp_tq_add_is_bas_opm_2 ip_fac_tq_add_is_bol_opm_1 ip_fac_tq_add_is_bol_cs_opm_1 ip_fac_tq_add_is_bol_opm_2 ip_fac_tq_add_is_bol_cs_opm_2 ip_fac_vs_tq_add_is_bol_opm_1 ip_fac_vs_tq_add_is_bol_opm_2 ip_fac_tq_add_is_bol_dri_opm_1 ip_fac_tq_add_is_bol_dri_opm_2 ip_tq_add_is_cor_opm_1 c_tq_dif_add_is_tol_opm_1 c_tq_dif_add_is_tol_opm_2 ip_lgrd_tq_add_is_bol ip_lgrd_tq_add_is_bol_opm_2 /end DEF_CHARACTERISTIC
 /begin OUT_MEASUREMENT tq_add_is_bol tq_dif_add_is_tol tq_add_is_bol_opm_1 tq_add_is_bol_opm_2 tq_add_is_bol_sel lv_tq_add_is_opm_sel_1 lv_tq_add_is_opm_sel_2 lv_tq_add_is_opm_rls n_dif_ofs_pred_opm_1 n_dif_ofs_pred_cs_opm_1 n_dif_ofs_pred_opm_2 n_dif_ofs_pred_cs_opm_2 t_n_dif_ofs_pred_opm_1 t_n_dif_ofs_pred_opm_2 t_n_dif_ofs_pred_cs_opm_2 n_dif_pred_opm_1 n_dif_pred_cs_opm_1 n_dif_pred_opm_2 n_dif_pred_cs_opm_2 t_n_dif_ofs_pred_cs_opm_1 fac_tq_add_is_bol_opm_2 fac_tq_add_is_bol_opm_1 /end OUT_MEASUREMENT
/end FUNCTION
/begin FUNCTION ISC_Application_Incidence_for_Idle_Speed_Control "_Application Incidence for Idle Speed Control" /end FUNCTION
/begin FUNCTION C_B_OBD "C_B_OBD"
 /begin SUB_FUNCTION OBD_Fuel_system_diagnosis OBD_Activation_conditions_for_cat_eff_and_O2_sensor_diag OBD_Cat_Efficiency_Diagnosis__OSC_Method_ OBD_Limited_dynamic_for_catalyst_effiency_and_oxygen_sensor_diagnosis OBD_Tank_leakage_diagnosis_based_on_DMTL OBD_Application_incidence_catalyst_efficiency_diagnosis__OSC_Method_ OBD_Application_incidences_for_fuel_system_diagnosis OBD_Environmental_Data OBD_Failure_class OBD_Diagnostic_Trouble_Code OBD_Functional_Check_CPS OBD_SA_system_diagnosis_through_SAF___determination OBD_Application_incidences_for_SA_system_monitoring_through_SAFM OBD_Application_incidence_environmental_data OBD_Check_filler_cap___conditions_and_failure OBD_Application_incidences_of_tank_leakage_diagnosis OBD_Ambient_pressure_plausibility_diagnosis OBD_Fuel_sys_pres_diag OBD_Fuel_sys_pres_diag_AI OBD_FUP_EFP_Diag OBD_FUP_EFP_Diag__AI /end SUB_FUNCTION
/end FUNCTION
/begin FUNCTION OBD_Fuel_system_diagnosis "_Fuel system diagnosis" /begin DEF_CHARACTERISTIC lc_req_fsd_eol /end DEF_CHARACTERISTIC /end FUNCTION
/begin FUNCTION OBD_Activation_conditions_for_cat_eff_and_O2_sensor_diag "_Activation conditions for cat eff and O2 sensor diag" /end FUNCTION
/begin FUNCTION OBD_Cat_Efficiency_Diagnosis__OSC_Method_ "_Cat Efficiency Diagnosis (OSC Method)" /end FUNCTION
/begin FUNCTION OBD_Limited_dynamic_for_catalyst_effiency_and_oxygen_sensor_diagnosis "_Limited dynamic for catalyst effiency and oxygen sensor diagnosis" /end FUNCTION
/end MODULE
/end PROJECT
