ASAP2_VERSION 1 3
/begin PROJECT _725D601B "725D601B"
/begin HEADER "" VERSION "_725D601B" PROJECT_NO _725D601B /end HEADER
/begin MODULE DIM ""
/begin MOD_COMMON "" BYTE_ORDER MSB_FIRST ALIGNMENT_BYTE 1 ALIGNMENT_WORD 2 ALIGNMENT_LONG 2 ALIGNMENT_FLOAT32_IEEE 4 /end MOD_COMMON
/begin CHARACTERISTIC CDCAAA "Dummy: Tabellenanfang" VAL_BLK 0xFD5D00 KwbUw 65535.00 dez 0.00 65535.00 FORMAT "%8.2" NUMBER 4 /end CHARACTERISTIC
/begin CHARACTERISTIC CDCBM "Codewort CARB: Bezugsmarkengeber" VAL_BLK 0xFD5D38 KwbWU16 65535.00 dez 0.00 65535.00 FORMAT "%8.2" NUMBER 4 /end CHARACTERISTIC
/begin CHARACTERISTIC CDCCARS "Codewort CARB: Can-Schnittstelle, Timeout ARS" VAL_BLK 0xFD5D70 KwbUw 65535.00 dez 0.00 65535.00 FORMAT "%8.2" NUMBER 4 /end CHARACTERISTIC
/begin CHARACTERISTIC CDCCCAS "Codewort CARB: Can-Schnittstelle, Timeout CAS" VAL_BLK 0xFD5D78 KwbWU16 65535.00 dez 0.00 65535.00 FORMAT "%8.2" NUMBER 4 /end CHARACTERISTIC
/begin CHARACTERISTIC CDCCDSC "Codewort CARB: CAN-Schnittstelle, DSC-SG" VAL_BLK 0xFD5D80 KwbUw 65535.00 dez 0.00 65535.00 FORMAT "%8.2" NUMBER 4 /end CHARACTERISTIC
/begin CHARACTERISTIC CDCCEGS "Codewort CARB: CAN-Schnittstelle EGS" VAL_BLK 0xFD5D88 KwbUw 65535.00 dez 0.00 65535.00 FORMAT "%8.2" NUMBER 4 /end CHARACTERISTIC
/begin CHARACTERISTIC CDCCFC "" VAL_BLK 0xFD5D90 KwbWU16 65535.00 dez 0.00 65535.00 FORMAT "%8.2" NUMBER 4 /end CHARACTERISTIC
/begin CHARACTERISTIC CDCCIHKA "Codewort CARB: Can-Schnittstelle, Timeout IHKA" VAL_BLK 0xFD5D98 KwbWU16 65535.00 dez 0.00 65535.00 FORMAT "%8.2" NUMBER 4 /end CHARACTERISTIC
/begin CHARACTERISTIC CDCCINS "Codewort CARB: CAN-Schnittstelle, Timeout Instrument" VAL_BLK 0xFD5DA0 KwbWU16 65535.00 dez 0.00 65535.00 FORMAT "%8.2" NUMBER 4 /end CHARACTERISTIC
/begin CHARACTERISTIC CDCCOD "Tabelle Umweltbedingungen: Steuerger‰t noch nicht codiert" VAL_BLK 0xFD5DA8 KwbWU16 65535.00 dez 0.00 65535.00 FORMAT "%8.2" NUMBER 4 /end CHARACTERISTIC
/begin CHARACTERISTIC CDCCSSG "Codewort CARB: CAN-Schnittstelle SGG-Steuerger‰t" VAL_BLK 0xFD5DB0 KwbUw 65535.00 dez 0.00 65535.00 FORMAT "%8.2" NUMBER 4 /end CHARACTERISTIC
/begin CHARACTERISTIC CDCCSZL "Codewort CARB: CAN-Schnittstelle, Timeout SZL" VAL_BLK 0xFD5DB8 KwbUw 65535.00 dez 0.00 65535.00 FORMAT "%8.2" NUMBER 4 /end CHARACTERISTIC
/begin CHARACTERISTIC CDCDHDMTE "Codewort CARB: DM-TL Heizung (Endstufe)" VAL_BLK 0xFD5DF8 KwbWU16 65535.00 dez 0.00 65535.00 FORMAT "%8.2" NUMBER 4 /end CHARACTERISTIC
/begin CHARACTERISTIC CDCDISA "" VAL_BLK 0xFD5E18 KwbWU16 65535.00 dez 0.00 65535.00 FORMAT "%8.2" NUMBER 4 /end CHARACTERISTIC
/begin CHARACTERISTIC CDCDISAT "" VAL_BLK 0xFD5E20 KwbWU16 65535.00 dez 0.00 65535.00 FORMAT "%8.2" NUMBER 4 /end CHARACTERISTIC
/begin CHARACTERISTIC CDCDK "Codewort CARB:	DK - Potentiometer" VAL_BLK 0xFD5E28 KwbUw 65535.00 dez 0.00 65535.00 FORMAT "%8.2" NUMBER 4 /end CHARACTERISTIC
/begin CHARACTERISTIC CDCDK1P "Codewort CARB: Drosselklappe 1. Poti" VAL_BLK 0xFD5E30 KwbUw 65535.00 dez 0.00 65535.00 FORMAT "%8.2" NUMBER 4 /end CHARACTERISTIC
/begin CHARACTERISTIC CDCDK2P "Codewort CARB: Drosselklappe 2. Poti" VAL_BLK 0xFD5E38 KwbUw 65535.00 dez 0.00 65535.00 FORMAT "%8.2" NUMBER 4 /end CHARACTERISTIC
/begin CHARACTERISTIC CDCDMMVE "Codewort CARB: DM-TL Magnetventil (Endstufe)" VAL_BLK 0xFD5E40 KwbWU16 65535.00 dez 0.00 65535.00 FORMAT "%8.2" NUMBER 4 /end CHARACTERISTIC
/begin CHARACTERISTIC CDCDMPME "Codewort CARB: DM-TL Pumpenmotor (Endstufe)" VAL_BLK 0xFD5E48 KwbWU16 65535.00 dez 0.00 65535.00 FORMAT "%8.2" NUMBER 4 /end CHARACTERISTIC
/begin CHARACTERISTIC CDCDMTK "Codewort CARB: Tankentl¸ftungssystem Feinstleck" VAL_BLK 0xFD5E50 KwbWU16 65535.00 dez 0.00 65535.00 FORMAT "%8.2" NUMBER 4 /end CHARACTERISTIC
/begin CHARACTERISTIC CDCDMTL "Codewort CARB: Tankentl¸ftungssystem Modulfehler (Hardware)" VAL_BLK 0xFD5E60 KwbWU16 65535.00 dez 0.00 65535.00 FORMAT "%8.2" NUMBER 4 /end CHARACTERISTIC
/begin CHARACTERISTIC CDCDPMEE "Codewort CARB: DM-TL Pumpenmotor (Endstufe) aus DECJ" VAL_BLK 0xFD5E68 KwbWU16 65535.00 dez 0.00 65535.00 FORMAT "%8.2" NUMBER 4 /end CHARACTERISTIC
/begin CHARACTERISTIC CDCDVEE "Codewort CARB: DV-E Endstufe" VAL_BLK 0xFD5E90 KwbUw 65535.00 dez 0.00 65535.00 FORMAT "%8.2" NUMBER 4 /end CHARACTERISTIC
/begin CHARACTERISTIC CDCDVEF "Codewort CARB: DV-E Fehler bei Federpr¸fung" VAL_BLK 0xFD5E98 KwbUw 65535.00 dez 0.00 65535.00 FORMAT "%8.2" NUMBER 4 /end CHARACTERISTIC
/begin CHARACTERISTIC CDCDVEFO "" VAL_BLK 0xFD5EA0 KwbUw 65535.00 dez 0.00 65535.00 FORMAT "%8.2" NUMBER 4 /end CHARACTERISTIC
/begin CHARACTERISTIC CDCDVEL "Codewort CARB: DV-E Lageabweichung" VAL_BLK 0xFD5EA8 KwbUw 65535.00 dez 0.00 65535.00 FORMAT "%8.2" NUMBER 4 /end CHARACTERISTIC
/begin CHARACTERISTIC CDCDVEN "Codewort CARB: DV-E Fehler bei Pr¸fung Notluftposition" VAL_BLK 0xFD5EB0 KwbUw 65535.00 dez 0.00 65535.00 FORMAT "%8.2" NUMBER 4 /end CHARACTERISTIC
/begin CHARACTERISTIC CDCDVER "Codewort CARB: DV-E Regelbereich" VAL_BLK 0xFD5EB8 KwbUw 65535.00 dez 0.00 65535.00 FORMAT "%8.2" NUMBER 4 /end CHARACTERISTIC
/begin CHARACTERISTIC CDCDVET "" VAL_BLK 0xFD5ED0 KwbUw 65535.00 dez 0.00 65535.00 FORMAT "%8.2" NUMBER 4 /end CHARACTERISTIC
/begin CHARACTERISTIC CDCDVEU "Codewort CARB: DV-E Fehler beim UMA-Lernen" VAL_BLK 0xFD5ED8 KwbUw 65535.00 dez 0.00 65535.00 FORMAT "%8.2" NUMBER 4 /end CHARACTERISTIC
/begin CHARACTERISTIC CDCDVEUB "" VAL_BLK 0xFD5EE0 KwbUw 65535.00 dez 0.00 65535.00 FORMAT "%8.2" NUMBER 4 /end CHARACTERISTIC
/begin CHARACTERISTIC CDCDVEUW "" VAL_BLK 0xFD5EE8 KwbUw 65535.00 dez 0.00 65535.00 FORMAT "%8.2" NUMBER 4 /end CHARACTERISTIC
/begin CHARACTERISTIC CDCDVEV "Codewort CARB: DV-E Fehler bei Verst‰rkerabgleich" VAL_BLK 0xFD5EF0 KwbUw 65535.00 dez 0.00 65535.00 FORMAT "%8.2" NUMBER 4 /end CHARACTERISTIC
/begin CHARACTERISTIC CDCDYLSU "" VAL_BLK 0xFD5F98 KwbUw 65535.00 dez 0.00 65535.00 FORMAT "%8.2" NUMBER 4 /end CHARACTERISTIC
/begin CHARACTERISTIC CDCDYLSU2 "" VAL_BLK 0xFD5FA0 KwbUw 65535.00 dez 0.00 65535.00 FORMAT "%8.2" NUMBER 4 /end CHARACTERISTIC
/begin CHARACTERISTIC CDCELS "Codewort CARB: Elektrischer E-Box L¸fter" VAL_BLK 0xFD5FF0 KwbWU16 65535.00 dez 0.00 65535.00 FORMAT "%8.2" NUMBER 4 /end CHARACTERISTIC
/begin CHARACTERISTIC CDCEV1 "Codewort CARB: EV von Zyl. 1" VAL_BLK 0xFD6020 KwbWU16 65535.00 dez 0.00 65535.00 FORMAT "%8.2" NUMBER 4 /end CHARACTERISTIC
/begin CHARACTERISTIC CDCEV2 "Codewort CARB: EV von Zyl. 2" VAL_BLK 0xFD6028 KwbWU16 65535.00 dez 0.00 65535.00 FORMAT "%8.2" NUMBER 4 /end CHARACTERISTIC
/begin CHARACTERISTIC CDCEV3 "Codewort CARB: EV von Zyl. 3" VAL_BLK 0xFD6030 KwbWU16 65535.00 dez 0.00 65535.00 FORMAT "%8.2" NUMBER 4 /end CHARACTERISTIC
/begin CHARACTERISTIC CDCEV4 "Codewort CARB: EV von Zyl. 4" VAL_BLK 0xFD6038 KwbWU16 65535.00 dez 0.00 65535.00 FORMAT "%8.2" NUMBER 4 /end CHARACTERISTIC
/begin CHARACTERISTIC CDCEV5 "Codewort CARB: EV von Zyl. 5" VAL_BLK 0xFD6040 KwbWU16 65535.00 dez 0.00 65535.00 FORMAT "%8.2" NUMBER 4 /end CHARACTERISTIC
/begin CHARACTERISTIC CDCEV6 "Codewort CARB: EV von Zyl. 6" VAL_BLK 0xFD6048 KwbWU16 65535.00 dez 0.00 65535.00 FORMAT "%8.2" NUMBER 4 /end CHARACTERISTIC
/begin CHARACTERISTIC CDCEV7 "Codewort CARB: EV von Zyl. 7" VAL_BLK 0xFD6050 KwbWU16 65535.00 dez 0.00 65535.00 FORMAT "%8.2" NUMBER 4 /end CHARACTERISTIC
/begin CHARACTERISTIC CDCEV8 "Codewort CARB: EV von Zyl. 8" VAL_BLK 0xFD6058 KwbWU16 65535.00 dez 0.00 65535.00 FORMAT "%8.2" NUMBER 4 /end CHARACTERISTIC
/begin CHARACTERISTIC CDCFST "Codewort CARB: Tankf¸llstand" VAL_BLK 0xFD60A8 KwbUw 65535.00 dez 0.00 65535.00 FORMAT "%8.2" NUMBER 4 /end CHARACTERISTIC
/begin CHARACTERISTIC CDCGLFE "Codewort CARB: gesteuerte Luftf¸hrung Endstufe" VAL_BLK 0xFD60B0 KwbWU16 65535.00 dez 0.00 65535.00 FORMAT "%8.2" NUMBER 4 /end CHARACTERISTIC
/begin CHARACTERISTIC CDCHELSU "" VAL_BLK 0xFD60B8 KwbUw 65535.00 dez 0.00 65535.00 FORMAT "%8.2" NUMBER 4 /end CHARACTERISTIC
/begin CHARACTERISTIC CDCHELSU2 "" VAL_BLK 0xFD60C0 KwbUw 65535.00 dez 0.00 65535.00 FORMAT "%8.2" NUMBER 4 /end CHARACTERISTIC
/begin CHARACTERISTIC CDCHSH "Codewort CARB:	Lambdasonden-Heizung hinter Katalysator" VAL_BLK 0xFD60C8 KwbUw 65535.00 dez 0.00 65535.00 FORMAT "%8.2" NUMBER 4 /end CHARACTERISTIC
/begin CHARACTERISTIC CDCHSH2 "Codewort CARB:	Lambdasonden-Heizung hinter Katalysator; (Bank2)" VAL_BLK 0xFD60D0 KwbUw 65535.00 dez 0.00 65535.00 FORMAT "%8.2" NUMBER 4 /end CHARACTERISTIC
/begin CHARACTERISTIC CDCHSHE "Codewort CARB: Endstufe Heizung Sonde hinter Kat." VAL_BLK 0xFD60D8 KwbUw 65535.00 dez 0.00 65535.00 FORMAT "%8.2" NUMBER 4 /end CHARACTERISTIC
/begin CHARACTERISTIC CDCHSHE2 "Codewort CARB: Endstufe Heizung Sonde Hinter Kat. Bank 2" VAL_BLK 0xFD60E0 KwbUw 65535.00 dez 0.00 65535.00 FORMAT "%8.2" NUMBER 4 /end CHARACTERISTIC
/begin CHARACTERISTIC CDCHSV "Codewort CARB:	Lambdasonden-Heizung vor Katalysator" VAL_BLK 0xFD60E8 KwbUw 65535.00 dez 0.00 65535.00 FORMAT "%8.2" NUMBER 4 /end CHARACTERISTIC
/begin CHARACTERISTIC CDCHSV2 "Codewort CARB:	Lambdasonden-Heizung vor Katalysator; (Bank2)" VAL_BLK 0xFD60F0 KwbUw 65535.00 dez 0.00 65535.00 FORMAT "%8.2" NUMBER 4 /end CHARACTERISTIC
/begin CHARACTERISTIC CDCHSVE "Codewort CARB: Lambdasonden-Heizung vor Katalysator (Endstufe)" VAL_BLK 0xFD60F8 KwbUw 65535.00 dez 0.00 65535.00 FORMAT "%8.2" NUMBER 4 /end CHARACTERISTIC
/begin CHARACTERISTIC CDCHSVE2 "Codewort CARB: Lambdasonden-Heizung2 vor Katalysator (Endstufe)" VAL_BLK 0xFD6100 KwbUw 65535.00 dez 0.00 65535.00 FORMAT "%8.2" NUMBER 4 /end CHARACTERISTIC
/begin CHARACTERISTIC CDCKPE "Codewort CARB: EKP-Relais Endstufe" VAL_BLK 0xFD6140 KwbWU16 65535.00 dez 0.00 65535.00 FORMAT "%8.2" NUMBER 4 /end CHARACTERISTIC
/begin CHARACTERISTIC CDCLM "Codewort CARB:	LMM/HLM/HFM" VAL_BLK 0xFD61C8 KwbWU16 65535.00 dez 0.00 65535.00 FORMAT "%8.2" NUMBER 4 /end CHARACTERISTIC
/begin CHARACTERISTIC CDCN "Codewort CARB: Drehzahlsignalgeber" VAL_BLK 0xFD62D8 KwbWU16 65535.00 dez 0.00 65535.00 FORMAT "%8.2" NUMBER 4 /end CHARACTERISTIC
/begin CHARACTERISTIC CDCPMBATT "" VAL_BLK 0xFD6340 KwbWU16 65535.00 dez 0.00 65535.00 FORMAT "%8.2" NUMBER 4 /end CHARACTERISTIC
/begin CHARACTERISTIC CDCPMBN "" VAL_BLK 0xFD6348 KwbWU16 65535.00 dez 0.00 65535.00 FORMAT "%8.2" NUMBER 4 /end CHARACTERISTIC
/begin CHARACTERISTIC CDCTESG "Codewort CARB: Tankentl¸ftungssystem Grobleck" VAL_BLK 0xFD63D8 KwbWU16 65535.00 dez 0.00 65535.00 FORMAT "%8.2" NUMBER 4 /end CHARACTERISTIC
/begin CHARACTERISTIC CDCZZZ "Dummy: Tabellenende" VAL_BLK 0xFD64C8 KwbUw 65535.00 dez 0.00 65535.00 FORMAT "%8.2" NUMBER 4 /end CHARACTERISTIC
/begin CHARACTERISTIC CDKAAA "Dummy: Tabellenanfang" VALUE 0xFD64D0 KwUw 65535.00 dez 0.00 65535.00 FORMAT "%8.2" /end CHARACTERISTIC
/begin CHARACTERISTIC CDKBM "Codewort Kunde: Bezugsmarkengeber" VALUE 0xFD64DE KwWU16 65535.00 dez 0.00 65535.00 FORMAT "%8.2" /end CHARACTERISTIC
/begin CHARACTERISTIC CDKCARS "Codewort Kunde: CAN-Timeout ARS- Botschaft" VALUE 0xFD64EC KwUw 65535.00 dez 0.00 65535.00 FORMAT "%8.2" /end CHARACTERISTIC
/begin CHARACTERISTIC CDKCCAS "Codewort Kunde: CAN-Timeout CAS- Botschaft" VALUE 0xFD64EE KwWU16 65535.00 dez 0.00 65535.00 FORMAT "%8.2" /end CHARACTERISTIC
/begin CHARACTERISTIC CDKCDSC "Codewort Kunde: CAN-Schnittstelle DSC-SG" VALUE 0xFD64F0 KwUw 65535.00 dez 0.00 65535.00 FORMAT "%8.2" /end CHARACTERISTIC
/begin CHARACTERISTIC CDKCEGS "Codewort Kunde: CAN-Schnittstelle EGS" VALUE 0xFD64F2 KwUw 65535.00 dez 0.00 65535.00 FORMAT "%8.2" /end CHARACTERISTIC
/begin CHARACTERISTIC CDKCFC "" VALUE 0xFD64F4 KwWU16 65535.00 dez 0.00 65535.00 FORMAT "%8.2" /end CHARACTERISTIC
/begin CHARACTERISTIC CDKCIHKA "Codewort Kunde: CAN-Timeout IHKA- Botschaft" VALUE 0xFD64F6 KwWU16 65535.00 dez 0.00 65535.00 FORMAT "%8.2" /end CHARACTERISTIC
/begin CHARACTERISTIC CDKCINS "Codewort Kunde: CAN- timeout, Instrumente" VALUE 0xFD64F8 KwWU16 65535.00 dez 0.00 65535.00 FORMAT "%8.2" /end CHARACTERISTIC
/begin CHARACTERISTIC CDKCOD "" VALUE 0xFD64FA KwWU16 65535.00 dez 0.00 65535.00 FORMAT "%8.2" /end CHARACTERISTIC
/begin CHARACTERISTIC CDKCSSG "Codewort Kunde: CAN-Schnittstelle SGG-Steuerger‰t" VALUE 0xFD64FC KwUw 65535.00 dez 0.00 65535.00 FORMAT "%8.2" /end CHARACTERISTIC
/begin CHARACTERISTIC CDKCSZL "Codewort Kunde: CAN-Timeout SZL- Botschaft" VALUE 0xFD64FE KwUw 65535.00 dez 0.00 65535.00 FORMAT "%8.2" /end CHARACTERISTIC
/begin CHARACTERISTIC CDKDHDMTE "Codewort Kunde: DMTL- Heizung Endstufe" VALUE 0xFD650E KwWU16 65535.00 dez 0.00 65535.00 FORMAT "%8.2" /end CHARACTERISTIC
/begin CHARACTERISTIC CDKDISA "" VALUE 0xFD6516 KwWU16 65535.00 dez 0.00 65535.00 FORMAT "%8.2" /end CHARACTERISTIC
/begin CHARACTERISTIC CDKDISAT "" VALUE 0xFD6518 KwWU16 65535.00 dez 0.00 65535.00 FORMAT "%8.2" /end CHARACTERISTIC
/begin CHARACTERISTIC CDKDK "Codewort Kunde: DK - Potentiometer" VALUE 0xFD651A KwUw 65535.00 dez 0.00 65535.00 FORMAT "%8.2" /end CHARACTERISTIC
/begin CHARACTERISTIC CDKDK1P "Codewort Kunde: Drosselklappe 1. Poti" VALUE 0xFD651C KwUw 65535.00 dez 0.00 65535.00 FORMAT "%8.2" /end CHARACTERISTIC
/begin CHARACTERISTIC CDKDK2P "Codewort Kunde: Drosselklappenpotentiometer 2" VALUE 0xFD651E KwUw 65535.00 dez 0.00 65535.00 FORMAT "%8.2" /end CHARACTERISTIC
/begin CHARACTERISTIC CDKDMMVE "Codewort Kunde: DMTL- Magnet Ventil Endstufe" VALUE 0xFD6520 KwWU16 65535.00 dez 0.00 65535.00 FORMAT "%8.2" /end CHARACTERISTIC
/begin CHARACTERISTIC CDKDMPME "Codewort Kunde: DMTL- Pumpenmotor" VALUE 0xFD6522 KwWU16 65535.00 dez 0.00 65535.00 FORMAT "%8.2" /end CHARACTERISTIC
/begin CHARACTERISTIC CDKDMTK "Codewort Kunde: Tankentl¸ftungssystem, Feinstleck" VALUE 0xFD6524 KwWU16 65535.00 dez 0.00 65535.00 FORMAT "%8.2" /end CHARACTERISTIC
/begin CHARACTERISTIC CDKDMTL "Codewort Kunde: Tankentl¸ftungssystem, Modulefehler (Hardware)" VALUE 0xFD6528 KwWU16 65535.00 dez 0.00 65535.00 FORMAT "%8.2" /end CHARACTERISTIC
/begin CHARACTERISTIC CDKDPMEE "Codewort Kunde: DM-TL Pumpenmotor (Endst.) aus DECJ" VALUE 0xFD652A KwWU16 65535.00 dez 0.00 65535.00 FORMAT "%8.2" /end CHARACTERISTIC
/begin CHARACTERISTIC CDKDVEE "Codewort Kunde: DV-E Endstufe" VALUE 0xFD6534 KwUw 65535.00 dez 0.00 65535.00 FORMAT "%8.2" /end CHARACTERISTIC
/begin CHARACTERISTIC CDKDVEF "Codewort Kunde: DV-E Fehler bei Federpr¸fung" VALUE 0xFD6536 KwUw 65535.00 dez 0.00 65535.00 FORMAT "%8.2" /end CHARACTERISTIC
/begin CHARACTERISTIC CDKDVEFO "" VALUE 0xFD6538 KwUw 65535.00 dez 0.00 65535.00 FORMAT "%8.2" /end CHARACTERISTIC
/begin CHARACTERISTIC CDKDVEL "Codewort Kunde: DV-E Lageabweichung" VALUE 0xFD653A KwUw 65535.00 dez 0.00 65535.00 FORMAT "%8.2" /end CHARACTERISTIC
/begin CHARACTERISTIC CDKDVEN "Codewort Kunde: DV-E Fehler bei Pr¸fung Notlufposition" VALUE 0xFD653C KwUw 65535.00 dez 0.00 65535.00 FORMAT "%8.2" /end CHARACTERISTIC
/begin CHARACTERISTIC CDKDVER "Codewort Kunde: DV-E Regelbereich" VALUE 0xFD653E KwUw 65535.00 dez 0.00 65535.00 FORMAT "%8.2" /end CHARACTERISTIC
/begin CHARACTERISTIC CDKDVET "" VALUE 0xFD6544 KwUw 65535.00 dez 0.00 65535.00 FORMAT "%8.2" /end CHARACTERISTIC
/begin CHARACTERISTIC CDKDVEU "Codewort Kunde: DV-E Fehler beim UMA-Lernen" VALUE 0xFD6546 KwUw 65535.00 dez 0.00 65535.00 FORMAT "%8.2" /end CHARACTERISTIC
/begin CHARACTERISTIC CDKDVEUB "" VALUE 0xFD6548 KwUw 65535.00 dez 0.00 65535.00 FORMAT "%8.2" /end CHARACTERISTIC
/begin CHARACTERISTIC CDKDVEUW "" VALUE 0xFD654A KwUw 65535.00 dez 0.00 65535.00 FORMAT "%8.2" /end CHARACTERISTIC
/begin CHARACTERISTIC CDKDVEV "Codewort Kunde: DV-E Fehler bei Verst‰rkerabgleich" VALUE 0xFD654C KwUw 65535.00 dez 0.00 65535.00 FORMAT "%8.2" /end CHARACTERISTIC
/begin CHARACTERISTIC CDKDYLSU "" VALUE 0xFD6576 KwUw 65535.00 dez 0.00 65535.00 FORMAT "%8.2" /end CHARACTERISTIC
/begin CHARACTERISTIC CDKDYLSU2 "" VALUE 0xFD6578 KwUw 65535.00 dez 0.00 65535.00 FORMAT "%8.2" /end CHARACTERISTIC
/begin CHARACTERISTIC CDKELS "Codewort Kunde: Elektrischer E-Box L¸fter" VALUE 0xFD658C KwWU16 65535.00 dez 0.00 65535.00 FORMAT "%8.2" /end CHARACTERISTIC
/begin CHARACTERISTIC CDKEV1 "Codewort Kunde: EV von Zyl. 1" VALUE 0xFD6598 KwWU16 65535.00 dez 0.00 65535.00 FORMAT "%8.2" /end CHARACTERISTIC
/begin CHARACTERISTIC CDKEV2 "Codewort Kunde: EV von Zyl. 2" VALUE 0xFD659A KwWU16 65535.00 dez 0.00 65535.00 FORMAT "%8.2" /end CHARACTERISTIC
/begin CHARACTERISTIC CDKEV3 "Codewort Kunde: EV von Zyl. 3" VALUE 0xFD659C KwWU16 65535.00 dez 0.00 65535.00 FORMAT "%8.2" /end CHARACTERISTIC
/begin CHARACTERISTIC CDKEV4 "Codewort Kunde: EV von Zyl. 4" VALUE 0xFD659E KwWU16 65535.00 dez 0.00 65535.00 FORMAT "%8.2" /end CHARACTERISTIC
/begin CHARACTERISTIC CDKEV5 "Codewort Kunde: EV von Zyl. 5" VALUE 0xFD65A0 KwWU16 65535.00 dez 0.00 65535.00 FORMAT "%8.2" /end CHARACTERISTIC
/begin CHARACTERISTIC CDKEV6 "Codewort Kunde: EV von Zyl. 6" VALUE 0xFD65A2 KwWU16 65535.00 dez 0.00 65535.00 FORMAT "%8.2" /end CHARACTERISTIC
/begin CHARACTERISTIC CDKEV7 "Codewort Kunde: EV von Zyl. 7" VALUE 0xFD65A4 KwWU16 65535.00 dez 0.00 65535.00 FORMAT "%8.2" /end CHARACTERISTIC
/begin CHARACTERISTIC CDKEV8 "Codewort Kunde: EV von Zyl. 8" VALUE 0xFD65A6 KwWU16 65535.00 dez 0.00 65535.00 FORMAT "%8.2" /end CHARACTERISTIC
/begin CHARACTERISTIC CDKFST "Codewort Kunde: Tankf¸llstand" VALUE 0xFD65BA KwUw 65535.00 dez 0.00 65535.00 FORMAT "%8.2" /end CHARACTERISTIC
/begin CHARACTERISTIC CDKGLFE "Codewort Kunde: Endstufe gesteuerte Luftf¸hrung" VALUE 0xFD65BC KwWU16 65535.00 dez 0.00 65535.00 FORMAT "%8.2" /end CHARACTERISTIC
/begin CHARACTERISTIC CDKHELSU "" VALUE 0xFD65BE KwUw 65535.00 dez 0.00 65535.00 FORMAT "%8.2" /end CHARACTERISTIC
/begin CHARACTERISTIC CDKHELSU2 "" VALUE 0xFD65C0 KwUw 65535.00 dez 0.00 65535.00 FORMAT "%8.2" /end CHARACTERISTIC
/begin CHARACTERISTIC CDKHSH "Codewort Kunde:Lambdasonden-Heizung hinter Katalysator" VALUE 0xFD65C2 KwUw 65535.00 dez 0.00 65535.00 FORMAT "%8.2" /end CHARACTERISTIC
/begin CHARACTERISTIC CDKHSH2 "Codewort Kunde:	Lambdasonden-Heizung hinter Katalysator, Bank 2" VALUE 0xFD65C4 KwUw 65535.00 dez 0.00 65535.00 FORMAT "%8.2" /end CHARACTERISTIC
/begin CHARACTERISTIC CDKHSHE "Codewort Kunde: Endstufe Heizung Sonde hinter Kat." VALUE 0xFD65C6 KwUw 65535.00 dez 0.00 65535.00 FORMAT "%8.2" /end CHARACTERISTIC
/begin CHARACTERISTIC CDKHSHE2 "Codewort Kunde: Enstufe Heizung Sonde Hinter Kat. Bank 2" VALUE 0xFD65C8 KwUw 65535.00 dez 0.00 65535.00 FORMAT "%8.2" /end CHARACTERISTIC
/begin CHARACTERISTIC CDKHSV "Codewort Kunde: Lambdasonden-Heizung vor Katalysator" VALUE 0xFD65CA KwUw 65535.00 dez 0.00 65535.00 FORMAT "%8.2" /end CHARACTERISTIC
/begin CHARACTERISTIC CDKHSV2 "Codewort Kunde:	Lambdasonden-Heizung vor Katalysator, Bank 2" VALUE 0xFD65CC KwUw 65535.00 dez 0.00 65535.00 FORMAT "%8.2" /end CHARACTERISTIC
/begin CHARACTERISTIC CDKHSVE "Codewort Kunde: Lambdasonden-Heizung vor Katalysator (Endstufe)" VALUE 0xFD65CE KwUw 65535.00 dez 0.00 65535.00 FORMAT "%8.2" /end CHARACTERISTIC
/begin CHARACTERISTIC CDKHSVE2 "Codewort Kunde: Endstufe Heizung Sonde vor Kat. Bank 2" VALUE 0xFD65D0 KwUw 65535.00 dez 0.00 65535.00 FORMAT "%8.2" /end CHARACTERISTIC
/begin CHARACTERISTIC CDKKPE "Codewort Kunde: EKP-Relais Endstufe" VALUE 0xFD65E0 KwWU16 65535.00 dez 0.00 65535.00 FORMAT "%8.2" /end CHARACTERISTIC
/begin CHARACTERISTIC CDKLM "Codewort Kunde:	LMM/HLM/HFM" VALUE 0xFD6602 KwWU16 65535.00 dez 0.00 65535.00 FORMAT "%8.2" /end CHARACTERISTIC
/begin CHARACTERISTIC CDKN "Codewort Kunde: Drehzahlsignalgeber" VALUE 0xFD6646 KwWU16 65535.00 dez 0.00 65535.00 FORMAT "%8.2" /end CHARACTERISTIC
/begin CHARACTERISTIC CDKPMBATT "" VALUE 0xFD6660 KwWU16 65535.00 dez 0.00 65535.00 FORMAT "%8.2" /end CHARACTERISTIC
/begin CHARACTERISTIC CDKPMBN "" VALUE 0xFD6662 KwWU16 65535.00 dez 0.00 65535.00 FORMAT "%8.2" /end CHARACTERISTIC
/begin CHARACTERISTIC CDKTESG "Codewort Kunde:	Tankentl¸ftungssystem Grobleck" VALUE 0xFD6686 KwWU16 65535.00 dez 0.00 65535.00 FORMAT "%8.2" /end CHARACTERISTIC
/begin CHARACTERISTIC CDKZZZ "Dummy: Tabellenendeng" VALUE 0xFD66C2 KwUw 65535.00 dez 0.00 65535.00 FORMAT "%8.2" /end CHARACTERISTIC
/begin CHARACTERISTIC CDTAAA "Dummy: Tabellenanfang" VALUE 0xFD66C4 KwUw 65535.00 dez 0.00 65535.00 FORMAT "%8.2" /end CHARACTERISTIC
/begin CHARACTERISTIC CDTBM "Codewort Tester: Bezugsmarkengeber" VALUE 0xFD66D2 KwWU16 65535.00 dez 0.00 65535.00 FORMAT "%8.2" /end CHARACTERISTIC
/begin CHARACTERISTIC CDTCARS "Codewort Tester: CAN-Schnittstelle, Timeout ARS" VALUE 0xFD66E0 KwUw 65535.00 dez 0.00 65535.00 FORMAT "%8.2" /end CHARACTERISTIC
/begin CHARACTERISTIC CDTCCAS "Codewort Tester: CAN-Schnittstelle, Timeout CAS" VALUE 0xFD66E2 KwWU16 65535.00 dez 0.00 65535.00 FORMAT "%8.2" /end CHARACTERISTIC
/begin CHARACTERISTIC CDTCDSC "Codewort Tester: CAN-Schnittstelle DSC-SG" VALUE 0xFD66E4 KwUw 65535.00 dez 0.00 65535.00 FORMAT "%8.2" /end CHARACTERISTIC
/begin CHARACTERISTIC CDTCEGS "Codewort Tester: CAN-Schnittstelle EGS" VALUE 0xFD66E6 KwUw 65535.00 dez 0.00 65535.00 FORMAT "%8.2" /end CHARACTERISTIC
/begin CHARACTERISTIC CDTCFC "" VALUE 0xFD66E8 KwWU16 65535.00 dez 0.00 65535.00 FORMAT "%8.2" /end CHARACTERISTIC
/begin CHARACTERISTIC CDTCIHKA "Codewort Tester: CAN-Schnittstelle, Timeout IHKA" VALUE 0xFD66EA KwWU16 65535.00 dez 0.00 65535.00 FORMAT "%8.2" /end CHARACTERISTIC
/begin CHARACTERISTIC CDTCINS "Codewort Tester: CAN-Timeout, Instrumente" VALUE 0xFD66EC KwWU16 65535.00 dez 0.00 65535.00 FORMAT "%8.2" /end CHARACTERISTIC
/begin CHARACTERISTIC CDTCOD "Codewort Tester: Steuerger‰t noch nicht codiert" VALUE 0xFD66EE KwWU16 65535.00 dez 0.00 65535.00 FORMAT "%8.2" /end CHARACTERISTIC
/begin CHARACTERISTIC CDTCSSG "Codewort Tester: CAN-Schnittstelle SGG-Steuerger‰t" VALUE 0xFD66F0 KwUw 65535.00 dez 0.00 65535.00 FORMAT "%8.2" /end CHARACTERISTIC
/begin CHARACTERISTIC CDTCSZL "Codewort Tester: CAN-Schnittstelle, Timeout SZL" VALUE 0xFD66F2 KwUw 65535.00 dez 0.00 65535.00 FORMAT "%8.2" /end CHARACTERISTIC
/begin CHARACTERISTIC CDTDHDMTE "Codewort Tester: DM-TL Heizung (Endst.)" VALUE 0xFD6702 KwWU16 65535.00 dez 0.00 65535.00 FORMAT "%8.2" /end CHARACTERISTIC
/begin CHARACTERISTIC CDTDISA "" VALUE 0xFD670A KwWU16 65535.00 dez 0.00 65535.00 FORMAT "%8.2" /end CHARACTERISTIC
/begin CHARACTERISTIC CDTDISAT "" VALUE 0xFD670C KwWU16 65535.00 dez 0.00 65535.00 FORMAT "%8.2" /end CHARACTERISTIC
/begin CHARACTERISTIC CDTDK "Codewort Tester: DK - Potentiometer" VALUE 0xFD670E KwUw 65535.00 dez 0.00 65535.00 FORMAT "%8.2" /end CHARACTERISTIC
/begin CHARACTERISTIC CDTDK1P "Codewort Tester: Drosselklappe 1. Poti" VALUE 0xFD6710 KwUw 65535.00 dez 0.00 65535.00 FORMAT "%8.2" /end CHARACTERISTIC
/begin CHARACTERISTIC CDTDK2P "Codewort Tester: Drosselklappenpotentiometer 2" VALUE 0xFD6712 KwUw 65535.00 dez 0.00 65535.00 FORMAT "%8.2" /end CHARACTERISTIC
/begin CHARACTERISTIC CDTDMMVE "Codewort Tester: DM-TL Magnetventil (Endst.)" VALUE 0xFD6714 KwWU16 65535.00 dez 0.00 65535.00 FORMAT "%8.2" /end CHARACTERISTIC
/begin CHARACTERISTIC CDTDMPME "Codewort Tester: DM-TL Pumpenmotor (Endst.)" VALUE 0xFD6716 KwWU16 65535.00 dez 0.00 65535.00 FORMAT "%8.2" /end CHARACTERISTIC
/begin CHARACTERISTIC CDTDMTK "Codewort Tester: Tankentl¸ftungssystem Feinstleck" VALUE 0xFD6718 KwWU16 65535.00 dez 0.00 65535.00 FORMAT "%8.2" /end CHARACTERISTIC
/begin CHARACTERISTIC CDTDMTL "Codewort Tester: Tankentl¸ftungssystem Modulfehler (Hardware)" VALUE 0xFD671C KwWU16 65535.00 dez 0.00 65535.00 FORMAT "%8.2" /end CHARACTERISTIC
/begin CHARACTERISTIC CDTDPMEE "Codewort Tester: DM-TL Pumpenmotor (Endst.) aus DECJ" VALUE 0xFD671E KwWU16 65535.00 dez 0.00 65535.00 FORMAT "%8.2" /end CHARACTERISTIC
/begin CHARACTERISTIC CDTDVEE "Codewort Tester: DV-E Endstufe" VALUE 0xFD6728 KwUw 65535.00 dez 0.00 65535.00 FORMAT "%8.2" /end CHARACTERISTIC
/begin CHARACTERISTIC CDTDVEF "Codewort Tester: DV-E Fehler bei Federpr¸fung" VALUE 0xFD672A KwUw 65535.00 dez 0.00 65535.00 FORMAT "%8.2" /end CHARACTERISTIC
/begin CHARACTERISTIC CDTDVEFO "" VALUE 0xFD672C KwUw 65535.00 dez 0.00 65535.00 FORMAT "%8.2" /end CHARACTERISTIC
/begin CHARACTERISTIC CDTDVEL "Codewort Tester: DV-E Lageabweichung" VALUE 0xFD672E KwUw 65535.00 dez 0.00 65535.00 FORMAT "%8.2" /end CHARACTERISTIC
/begin CHARACTERISTIC CDTDVEN "Codewort Tester: DV-E Fehler bei Pr¸fung Notlufposition" VALUE 0xFD6730 KwUw 65535.00 dez 0.00 65535.00 FORMAT "%8.2" /end CHARACTERISTIC
/begin CHARACTERISTIC CDTDVER "Codewort Tester: DV-E Regelbereich" VALUE 0xFD6732 KwUw 65535.00 dez 0.00 65535.00 FORMAT "%8.2" /end CHARACTERISTIC
/begin CHARACTERISTIC CDTDVET "" VALUE 0xFD6738 KwUw 65535.00 dez 0.00 65535.00 FORMAT "%8.2" /end CHARACTERISTIC
/begin CHARACTERISTIC CDTDVEU "Codewort Tester: DV-E Fehler beim UMA-Lernen" VALUE 0xFD673A KwUw 65535.00 dez 0.00 65535.00 FORMAT "%8.2" /end CHARACTERISTIC
/begin CHARACTERISTIC CDTDVEUB "" VALUE 0xFD673C KwUw 65535.00 dez 0.00 65535.00 FORMAT "%8.2" /end CHARACTERISTIC
/begin CHARACTERISTIC CDTDVEUW "" VALUE 0xFD673E KwUw 65535.00 dez 0.00 65535.00 FORMAT "%8.2" /end CHARACTERISTIC
/begin CHARACTERISTIC CDTDVEV "Codewort Tester: DV-E Fehler bei Verst‰rkerabgleich" VALUE 0xFD6740 KwUw 65535.00 dez 0.00 65535.00 FORMAT "%8.2" /end CHARACTERISTIC
/begin CHARACTERISTIC CDTDYLSU "" VALUE 0xFD676A KwUw 65535.00 dez 0.00 65535.00 FORMAT "%8.2" /end CHARACTERISTIC
/begin CHARACTERISTIC CDTDYLSU2 "" VALUE 0xFD676C KwUw 65535.00 dez 0.00 65535.00 FORMAT "%8.2" /end CHARACTERISTIC
/begin CHARACTERISTIC CDTELS "Codewort Tester: Elektrischer E-Box L¸fter" VALUE 0xFD6780 KwWU16 65535.00 dez 0.00 65535.00 FORMAT "%8.2" /end CHARACTERISTIC
/begin CHARACTERISTIC CDTEV1 "Codewort Tester: EV von Zyl. 1" VALUE 0xFD678C KwWU16 65535.00 dez 0.00 65535.00 FORMAT "%8.2" /end CHARACTERISTIC
/begin CHARACTERISTIC CDTEV2 "Codewort Tester: EV von Zyl. 2" VALUE 0xFD678E KwWU16 65535.00 dez 0.00 65535.00 FORMAT "%8.2" /end CHARACTERISTIC
/begin CHARACTERISTIC CDTEV3 "Codewort Tester: EV von Zyl. 3" VALUE 0xFD6790 KwWU16 65535.00 dez 0.00 65535.00 FORMAT "%8.2" /end CHARACTERISTIC
/begin CHARACTERISTIC CDTEV4 "Codewort Tester: EV von Zyl. 4" VALUE 0xFD6792 KwWU16 65535.00 dez 0.00 65535.00 FORMAT "%8.2" /end CHARACTERISTIC
/begin CHARACTERISTIC CDTEV5 "Codewort Tester: EV von Zyl. 5" VALUE 0xFD6794 KwWU16 65535.00 dez 0.00 65535.00 FORMAT "%8.2" /end CHARACTERISTIC
/begin CHARACTERISTIC CDTEV6 "Codewort Tester: EV von Zyl. 6" VALUE 0xFD6796 KwWU16 65535.00 dez 0.00 65535.00 FORMAT "%8.2" /end CHARACTERISTIC
/begin CHARACTERISTIC CDTEV7 "Codewort Tester: EV von Zyl. 7" VALUE 0xFD6798 KwWU16 65535.00 dez 0.00 65535.00 FORMAT "%8.2" /end CHARACTERISTIC
/begin CHARACTERISTIC CDTEV8 "Codewort Tester: EV von Zyl. 8" VALUE 0xFD679A KwWU16 65535.00 dez 0.00 65535.00 FORMAT "%8.2" /end CHARACTERISTIC
/begin CHARACTERISTIC CDTFST "Codewort Tester: Tankf¸llstand" VALUE 0xFD67AE KwUw 65535.00 dez 0.00 65535.00 FORMAT "%8.2" /end CHARACTERISTIC
/begin CHARACTERISTIC CDTGLFE "Codewort Tester: Gesteuerte Luftf¸hrung Endstufe" VALUE 0xFD67B0 KwWU16 65535.00 dez 0.00 65535.00 FORMAT "%8.2" /end CHARACTERISTIC
/begin CHARACTERISTIC CDTHELSU "" VALUE 0xFD67B2 KwUw 65535.00 dez 0.00 65535.00 FORMAT "%8.2" /end CHARACTERISTIC
/begin CHARACTERISTIC CDTHELSU2 "" VALUE 0xFD67B4 KwUw 65535.00 dez 0.00 65535.00 FORMAT "%8.2" /end CHARACTERISTIC
/begin CHARACTERISTIC CDTHSH "Codewort Tester: Lambdasonden-Heizung hinter Katalysator" VALUE 0xFD67B6 KwUw 65535.00 dez 0.00 65535.00 FORMAT "%8.2" /end CHARACTERISTIC
/begin CHARACTERISTIC CDTHSH2 "Codewort Tester: Lambdasonden-Heizung hinter Kat., Bank 2" VALUE 0xFD67B8 KwUw 65535.00 dez 0.00 65535.00 FORMAT "%8.2" /end CHARACTERISTIC
/begin CHARACTERISTIC CDTHSHE "Codewort Tester: Endstufe Lambdasonden-Heizung hinter Katalysator" VALUE 0xFD67BA KwUw 65535.00 dez 0.00 65535.00 FORMAT "%8.2" /end CHARACTERISTIC
/begin CHARACTERISTIC CDTHSHE2 "Codewort Tester: Endstufe Lambdasonden-Heizung2 hinter Katalysator" VALUE 0xFD67BC KwUw 65535.00 dez 0.00 65535.00 FORMAT "%8.2" /end CHARACTERISTIC
/begin CHARACTERISTIC CDTHSV "Codewort Tester: Lambdasonden-Heizung vor Katalysator" VALUE 0xFD67BE KwUw 65535.00 dez 0.00 65535.00 FORMAT "%8.2" /end CHARACTERISTIC
/begin CHARACTERISTIC CDTHSV2 "Codewort Tester: Lambdasonden-Heizung vor Kat., Bank 2" VALUE 0xFD67C0 KwUw 65535.00 dez 0.00 65535.00 FORMAT "%8.2" /end CHARACTERISTIC
/begin CHARACTERISTIC CDTHSVE "Codewort Tester: Lambdasonden-Heizung vor Kat. (Endst.)" VALUE 0xFD67C2 KwUw 65535.00 dez 0.00 65535.00 FORMAT "%8.2" /end CHARACTERISTIC
/begin CHARACTERISTIC CDTHSVE2 "Codewort Tester: Endstufe Lambdasonden-Heizung2 vor Katalysator" VALUE 0xFD67C4 KwUw 65535.00 dez 0.00 65535.00 FORMAT "%8.2" /end CHARACTERISTIC
/begin CHARACTERISTIC CDTKPE "Codewort Tester: EKP-Relais Endstufe" VALUE 0xFD67D4 KwWU16 65535.00 dez 0.00 65535.00 FORMAT "%8.2" /end CHARACTERISTIC
/begin CHARACTERISTIC CDTLM "Codewort Tester: LMM/HLM/HFM" VALUE 0xFD67F6 KwWU16 65535.00 dez 0.00 65535.00 FORMAT "%8.2" /end CHARACTERISTIC
/begin CHARACTERISTIC CDTN "Codewort Tester: Drehzahlsignalgeber" VALUE 0xFD683A KwWU16 65535.00 dez 0.00 65535.00 FORMAT "%8.2" /end CHARACTERISTIC
/begin CHARACTERISTIC CDTPMBATT "" VALUE 0xFD6854 KwWU16 65535.00 dez 0.00 65535.00 FORMAT "%8.2" /end CHARACTERISTIC
/begin CHARACTERISTIC CDTPMBN "" VALUE 0xFD6856 KwWU16 65535.00 dez 0.00 65535.00 FORMAT "%8.2" /end CHARACTERISTIC
/begin CHARACTERISTIC CDTTESG "Codewort Tester: Tankentl¸ftungssystem Grobleck" VALUE 0xFD687A KwWU16 65535.00 dez 0.00 65535.00 FORMAT "%8.2" /end CHARACTERISTIC
/begin CHARACTERISTIC CDTZZZ "Dummy: Tabellenende" VALUE 0xFD68B6 KwUw 65535.00 dez 0.00 65535.00 FORMAT "%8.2" /end CHARACTERISTIC
/begin CHARACTERISTIC CLAAAA "Dummy: Tabellenanfang" VALUE 0xFD5723 KwUb 255.0 dez 0.00 255.0 FORMAT "%5.1" /end CHARACTERISTIC
/begin CHARACTERISTIC CLABM "Fehlerklasse: Bezugsmarkengeber" VALUE 0xFD572A KwWU8 255.0 dez 0.00 255.0 FORMAT "%5.1" /end CHARACTERISTIC
/begin CHARACTERISTIC CLACARS "Fehlerklasse: CAN-Timeout ARS-Botschaft" VALUE 0xFD5731 KwUb 255.0 dez 0.00 255.0 FORMAT "%5.1" /end CHARACTERISTIC
/begin CHARACTERISTIC CLACCAS "Fehlerklasse: CAN-Timeout CAS-Botschaft" VALUE 0xFD5732 KwWU8 255.0 dez 0.00 255.0 FORMAT "%5.1" /end CHARACTERISTIC
/begin CHARACTERISTIC CLACDSC "Fehlerklasse: CAN-Timeout DSC-Botschaft" VALUE 0xFD5733 KwUb 255.0 dez 0.00 255.0 FORMAT "%5.1" /end CHARACTERISTIC
/begin CHARACTERISTIC CLACEGS "Fehlerklasse: CAN-EGS-Botschaft" VALUE 0xFD5734 KwUb 255.0 dez 0.00 255.0 FORMAT "%5.1" /end CHARACTERISTIC
/begin CHARACTERISTIC CLACFC "" VALUE 0xFD5735 KwWU8 255.0 dez 0.00 255.0 FORMAT "%5.1" /end CHARACTERISTIC
/begin CHARACTERISTIC CLACIHKA "Fehlerklasse: CAN-Timeout IHKA-Botschaft" VALUE 0xFD5736 KwWU8 255.0 dez 0.00 255.0 FORMAT "%5.1" /end CHARACTERISTIC
/begin CHARACTERISTIC CLACINS "Fehlerklasse: CAN-Timeout Botschaft Kombiinstrument" VALUE 0xFD5737 KwWU8 255.0 dez 0.00 255.0 FORMAT "%5.1" /end CHARACTERISTIC
/begin CHARACTERISTIC CLACOD "Fehlerklasse: Steuerger‰t noch nicht codiert" VALUE 0xFD5738 KwWU8 255.0 dez 0.00 255.0 FORMAT "%5.1" /end CHARACTERISTIC
/begin CHARACTERISTIC CLACSSG "Fehlerklasse: CAN-Schnittstelle SGG-Steuerger‰t" VALUE 0xFD5739 KwUb 255.0 dez 0.00 255.0 FORMAT "%5.1" /end CHARACTERISTIC
/begin CHARACTERISTIC CLACSZL "Fehlerklasse: CAN-Timeout SZL-Botschaft" VALUE 0xFD573A KwUb 255.0 dez 0.00 255.0 FORMAT "%5.1" /end CHARACTERISTIC
/begin CHARACTERISTIC CLADHDMTE "Fehlerklasse: DM-TL Heizung (Endstufe)" VALUE 0xFD5742 KwWU8 255.0 dez 0.00 255.0 FORMAT "%5.1" /end CHARACTERISTIC
/begin CHARACTERISTIC CLADISA "" VALUE 0xFD5746 KwWU8 255.0 dez 0.00 255.0 FORMAT "%5.1" /end CHARACTERISTIC
/begin CHARACTERISTIC CLADISAT "" VALUE 0xFD5747 KwWU8 255.0 dez 0.00 255.0 FORMAT "%5.1" /end CHARACTERISTIC
/begin CHARACTERISTIC CLADK "Fehlerklasse: DK- Potentiometer" VALUE 0xFD5748 KwUb 255.0 dez 0.00 255.0 FORMAT "%5.1" /end CHARACTERISTIC
/begin CHARACTERISTIC CLADK1P "Fehlerklassse: Drosselklappe 1. Poti" VALUE 0xFD5749 KwUb 255.0 dez 0.00 255.0 FORMAT "%5.1" /end CHARACTERISTIC
/begin CHARACTERISTIC CLADK2P "Fehlerklasse: Drosselklappenpotentiometer 2" VALUE 0xFD574A KwUb 255.0 dez 0.00 255.0 FORMAT "%5.1" /end CHARACTERISTIC
/begin CHARACTERISTIC CLADMMVE "Fehlerklasse: DM-TL Magnetventil (Endstufe)" VALUE 0xFD574B KwWU8 255.0 dez 0.00 255.0 FORMAT "%5.1" /end CHARACTERISTIC
/begin CHARACTERISTIC CLADMPME "Fehlerklasse: DM-TL Pumpenmotor (Endstufe)" VALUE 0xFD574C KwWU8 255.0 dez 0.00 255.0 FORMAT "%5.1" /end CHARACTERISTIC
/begin CHARACTERISTIC CLADMTK "Fehlerklasse: Tankdiagnose, Feinstleck" VALUE 0xFD574D KwWU8 255.0 dez 0.00 255.0 FORMAT "%5.1" /end CHARACTERISTIC
/begin CHARACTERISTIC CLADMTL "Fehlerklasse: Tankdiagnose, Modulfehler" VALUE 0xFD574F KwWU8 255.0 dez 0.00 255.0 FORMAT "%5.1" /end CHARACTERISTIC
/begin CHARACTERISTIC CLADPMEE "Fehlerklasse: DM-TL Pumpenmotor (Endstufe) aus DECJ" VALUE 0xFD5750 KwWU8 255.0 dez 0.00 255.0 FORMAT "%5.1" /end CHARACTERISTIC
/begin CHARACTERISTIC CLADVEE "Fehlerklasse: DV-E Endstufe" VALUE 0xFD5755 KwUb 255.0 dez 0.00 255.0 FORMAT "%5.1" /end CHARACTERISTIC
/begin CHARACTERISTIC CLADVEF "Fehlerklasse: DV-E Fehler bei Federpr¸fung" VALUE 0xFD5756 KwUb 255.0 dez 0.00 255.0 FORMAT "%5.1" /end CHARACTERISTIC
/begin CHARACTERISTIC CLADVEFO "" VALUE 0xFD5757 KwUb 255.0 dez 0.00 255.0 FORMAT "%5.1" /end CHARACTERISTIC
/begin CHARACTERISTIC CLADVEL "Fehlerklasse: DV-E Lageabweichung" VALUE 0xFD5758 KwUb 255.0 dez 0.00 255.0 FORMAT "%5.1" /end CHARACTERISTIC
/begin CHARACTERISTIC CLADVEN "Fehlerklasse: DV-E Fehler bei Pr¸fung Notluftposition" VALUE 0xFD5759 KwUb 255.0 dez 0.00 255.0 FORMAT "%5.1" /end CHARACTERISTIC
/begin CHARACTERISTIC CLADVER "Fehlerklasse: DV-E Regelbereich" VALUE 0xFD575A KwUb 255.0 dez 0.00 255.0 FORMAT "%5.1" /end CHARACTERISTIC
/begin CHARACTERISTIC CLADVET "" VALUE 0xFD575D KwUb 255.0 dez 0.00 255.0 FORMAT "%5.1" /end CHARACTERISTIC
/begin CHARACTERISTIC CLADVEU "Fehlerklasse: DV-E Fehler beim UMA-Lernen" VALUE 0xFD575E KwUb 255.0 dez 0.00 255.0 FORMAT "%5.1" /end CHARACTERISTIC
/begin CHARACTERISTIC CLADVEUB "" VALUE 0xFD575F KwUb 255.0 dez 0.00 255.0 FORMAT "%5.1" /end CHARACTERISTIC
/begin CHARACTERISTIC CLADVEUW "" VALUE 0xFD5760 KwUb 255.0 dez 0.00 255.0 FORMAT "%5.1" /end CHARACTERISTIC
/begin CHARACTERISTIC CLADVEV "Fehlerklasse: DV-E Fehler bei Verst‰rkerabgleich" VALUE 0xFD5761 KwUb 255.0 dez 0.00 255.0 FORMAT "%5.1" /end CHARACTERISTIC
/begin CHARACTERISTIC CLADYLSU "" VALUE 0xFD5776 KwUb 255.0 dez 0.00 255.0 FORMAT "%5.1" /end CHARACTERISTIC
/begin CHARACTERISTIC CLADYLSU2 "" VALUE 0xFD5777 KwUb 255.0 dez 0.00 255.0 FORMAT "%5.1" /end CHARACTERISTIC
/begin CHARACTERISTIC CLAELS "Fehlerklasse: Endstufe E-Box L¸fter" VALUE 0xFD5781 KwWU8 255.0 dez 0.00 255.0 FORMAT "%5.1" /end CHARACTERISTIC
/begin CHARACTERISTIC CLAEV1 "Fehlerklasse: EV Endtsufe 1" VALUE 0xFD5787 KwWU8 255.0 dez 0.00 255.0 FORMAT "%5.1" /end CHARACTERISTIC
/begin CHARACTERISTIC CLAEV2 "Fehlerklasse: EV Endstufe 2" VALUE 0xFD5788 KwWU8 255.0 dez 0.00 255.0 FORMAT "%5.1" /end CHARACTERISTIC
/begin CHARACTERISTIC CLAEV3 "Fehlerklasse: EV Endstufe 3" VALUE 0xFD5789 KwWU8 255.0 dez 0.00 255.0 FORMAT "%5.1" /end CHARACTERISTIC
/begin CHARACTERISTIC CLAEV4 "Fehlerklasse: EV Endstufe 4" VALUE 0xFD578A KwWU8 255.0 dez 0.00 255.0 FORMAT "%5.1" /end CHARACTERISTIC
/begin CHARACTERISTIC CLAEV5 "Fehlerklasse: EV Endstufe 5" VALUE 0xFD578B KwWU8 255.0 dez 0.00 255.0 FORMAT "%5.1" /end CHARACTERISTIC
/begin CHARACTERISTIC CLAEV6 "Fehlerklasse: EV Endstufe 6" VALUE 0xFD578C KwWU8 255.0 dez 0.00 255.0 FORMAT "%5.1" /end CHARACTERISTIC
/begin CHARACTERISTIC CLAEV7 "Fehlerklasse: EV Endstufe 7" VALUE 0xFD578D KwWU8 255.0 dez 0.00 255.0 FORMAT "%5.1" /end CHARACTERISTIC
/begin CHARACTERISTIC CLAEV8 "Fehlerklasse: EV Endstufe 8" VALUE 0xFD578E KwWU8 255.0 dez 0.00 255.0 FORMAT "%5.1" /end CHARACTERISTIC
/begin CHARACTERISTIC CLAFST "Fehlerklasse: Tankf¸llstandssensor" VALUE 0xFD5798 KwUb 255.0 dez 0.00 255.0 FORMAT "%5.1" /end CHARACTERISTIC
/begin CHARACTERISTIC CLAGLFE "Fehlerklasse: Gesteuerte Luftf¸hrung Endstufe" VALUE 0xFD5799 KwWU8 255.0 dez 0.00 255.0 FORMAT "%5.1" /end CHARACTERISTIC
/begin CHARACTERISTIC CLAHELSU "" VALUE 0xFD579A KwUb 255.0 dez 0.00 255.0 FORMAT "%5.1" /end CHARACTERISTIC
/begin CHARACTERISTIC CLAHELSU2 "" VALUE 0xFD579B KwUb 255.0 dez 0.00 255.0 FORMAT "%5.1" /end CHARACTERISTIC
/begin CHARACTERISTIC CLAHSH "Fehlerklasse: Heizung Lambdasonde hinter Kat" VALUE 0xFD579C KwUb 255.0 dez 0.00 255.0 FORMAT "%5.1" /end CHARACTERISTIC
/begin CHARACTERISTIC CLAHSH2 "Fehlerklasse: Heizung Lambdasonde 2 hinter Kat" VALUE 0xFD579D KwUb 255.0 dez 0.00 255.0 FORMAT "%5.1" /end CHARACTERISTIC
/begin CHARACTERISTIC CLAHSHE "Fehlerklasse: Endstufe Heizung Lambdasonde hinter Kat" VALUE 0xFD579E KwUb 255.0 dez 0.00 255.0 FORMAT "%5.1" /end CHARACTERISTIC
/begin CHARACTERISTIC CLAHSHE2 "Fehlerklasse: Endstufe Heizung Lambdasonde 2 hinter Kat" VALUE 0xFD579F KwUb 255.0 dez 0.00 255.0 FORMAT "%5.1" /end CHARACTERISTIC
/begin CHARACTERISTIC CLAHSV "Fehlerklasse: Heizung Lambdasonde vor Kat" VALUE 0xFD57A0 KwUb 255.0 dez 0.00 255.0 FORMAT "%5.1" /end CHARACTERISTIC
/begin CHARACTERISTIC CLAHSV2 "Fehlerklasse: Heizung Lambdasonde 2 vor Kat" VALUE 0xFD57A1 KwUb 255.0 dez 0.00 255.0 FORMAT "%5.1" /end CHARACTERISTIC
/begin CHARACTERISTIC CLAHSVE "Fehlerklasse: Endstufe Heizung Lambdasonde vor Kat" VALUE 0xFD57A2 KwUb 255.0 dez 0.00 255.0 FORMAT "%5.1" /end CHARACTERISTIC
/begin CHARACTERISTIC CLAHSVE2 "Fehlerklasse: Endstufe Heizung Lambdasonde 2 vor Kat" VALUE 0xFD57A3 KwUb 255.0 dez 0.00 255.0 FORMAT "%5.1" /end CHARACTERISTIC
/begin CHARACTERISTIC CLAKPE "Fehlerklasse: EKP-Relais Endstufe" VALUE 0xFD57AB KwWU8 255.0 dez 0.00 255.0 FORMAT "%5.1" /end CHARACTERISTIC
/begin CHARACTERISTIC CLALM "Fehlerklasse: Hauptf¸llungssignal" VALUE 0xFD57BC KwWU8 255.0 dez 0.00 255.0 FORMAT "%5.1" /end CHARACTERISTIC
/begin CHARACTERISTIC CLAN "Fehlerklasse: Drehzahlgeber" VALUE 0xFD57DE KwWU8 255.0 dez 0.00 255.0 FORMAT "%5.1" /end CHARACTERISTIC
/begin CHARACTERISTIC CLAPMBATT "" VALUE 0xFD57EB KwWU8 255.0 dez 0.00 255.0 FORMAT "%5.1" /end CHARACTERISTIC
/begin CHARACTERISTIC CLAPMBN "" VALUE 0xFD57EC KwWU8 255.0 dez 0.00 255.0 FORMAT "%5.1" /end CHARACTERISTIC
/begin CHARACTERISTIC CLATESG "Fehlerklasse: Tankdiagnose, Grobleck" VALUE 0xFD57FE KwWU8 255.0 dez 0.00 255.0 FORMAT "%5.1" /end CHARACTERISTIC
/begin CHARACTERISTIC CLAZZZ "Dummy: Tabellenende" VALUE 0xFD581C KwUb 255.0 dez 0.00 255.0 FORMAT "%5.1" /end CHARACTERISTIC
/begin CHARACTERISTIC FFTAAA "Dummy: Tabellenanfang" VAL_BLK 0xFD581D KwbUb 255.0 dez 0.00 255.0 FORMAT "%5.1" NUMBER 4 /end CHARACTERISTIC
/begin CHARACTERISTIC FFTBM "Freeze Frame Tabelle: Bezugsmarkengeber" VAL_BLK 0xFD5839 KwbWU8 255.0 dez 0.00 255.0 FORMAT "%5.1" NUMBER 4 /end CHARACTERISTIC
/begin CHARACTERISTIC FFTCARS "Freeze Frame Tabelle: CAN-Timeout ARS-Botschaft" VAL_BLK 0xFD5855 KwbUb 255.0 dez 0.00 255.0 FORMAT "%5.1" NUMBER 4 /end CHARACTERISTIC
/begin CHARACTERISTIC FFTCCAS "Freeze Frame Tabelle: CAN-Timeout SZL-Botschaft" VAL_BLK 0xFD5859 KwbWU8 255.0 dez 0.00 255.0 FORMAT "%5.1" NUMBER 4 /end CHARACTERISTIC
/begin CHARACTERISTIC FFTCDSC "Freeze Frame Tabelle: CAN-SG DSC" VAL_BLK 0xFD585D KwbUb 255.0 dez 0.00 255.0 FORMAT "%5.1" NUMBER 4 /end CHARACTERISTIC
/begin CHARACTERISTIC FFTCEGS "Freeze Frame Tabelle: CAN-EGS-Botschaft" VAL_BLK 0xFD5861 KwbUb 255.0 dez 0.00 255.0 FORMAT "%5.1" NUMBER 4 /end CHARACTERISTIC
/begin CHARACTERISTIC FFTCFC "" VAL_BLK 0xFD5865 KwbWU8 255.0 dez 0.00 255.0 FORMAT "%5.1" NUMBER 4 /end CHARACTERISTIC
/begin CHARACTERISTIC FFTCIHKA "Freeze Frame Tabelle: CAN-Timeout IHKA-Botschaft" VAL_BLK 0xFD5869 KwbWU8 255.0 dez 0.00 255.0 FORMAT "%5.1" NUMBER 4 /end CHARACTERISTIC
/begin CHARACTERISTIC FFTCINS "Freeze Frame Tabelle: CAN-Timeout Instr.-Botschaft" VAL_BLK 0xFD586D KwbWU8 255.0 dez 0.00 255.0 FORMAT "%5.1" NUMBER 4 /end CHARACTERISTIC
/begin CHARACTERISTIC FFTCOD "Tabelle Umweltbedingungen: Steuerger‰t noch nicht codiert" VAL_BLK 0xFD5871 KwbWU8 255.0 dez 0.00 255.0 FORMAT "%5.1" NUMBER 4 /end CHARACTERISTIC
/begin CHARACTERISTIC FFTCSSG "Freeze Frame Tabelle: CAN-Schnittstelle SGG-Steuerger‰t" VAL_BLK 0xFD5875 KwbUb 255.0 dez 0.00 255.0 FORMAT "%5.1" NUMBER 4 /end CHARACTERISTIC
/begin CHARACTERISTIC FFTCSZL "Freeze Frame Tabelle: CAN-Timeout SZL-Botschaft" VAL_BLK 0xFD5879 KwbUb 255.0 dez 0.00 255.0 FORMAT "%5.1" NUMBER 4 /end CHARACTERISTIC
/begin CHARACTERISTIC FFTDHDMTE "Freeze Frame Tabelle: DM-TL Heizung (Endstufe)" VAL_BLK 0xFD5899 KwbWU8 255.0 dez 0.00 255.0 FORMAT "%5.1" NUMBER 4 /end CHARACTERISTIC
/begin CHARACTERISTIC FFTDISA "" VAL_BLK 0xFD58A9 KwbWU8 255.0 dez 0.00 255.0 FORMAT "%5.1" NUMBER 4 /end CHARACTERISTIC
/begin CHARACTERISTIC FFTDISAT "" VAL_BLK 0xFD58AD KwbWU8 255.0 dez 0.00 255.0 FORMAT "%5.1" NUMBER 4 /end CHARACTERISTIC
/begin CHARACTERISTIC FFTDK "Freeze Frame Tabelle: DK- Potentiometer" VAL_BLK 0xFD58B1 KwbUb 255.0 dez 0.00 255.0 FORMAT "%5.1" NUMBER 4 /end CHARACTERISTIC
/begin CHARACTERISTIC FFTDK1P "Freeze Frame Tabelle: Drosselklappe 1. Poti" VAL_BLK 0xFD58B5 KwbUb 255.0 dez 0.00 255.0 FORMAT "%5.1" NUMBER 4 /end CHARACTERISTIC
/begin CHARACTERISTIC FFTDK2P "Freeze Frame Tabelle: Drosselklappenpotentiometer 2" VAL_BLK 0xFD58B9 KwbUb 255.0 dez 0.00 255.0 FORMAT "%5.1" NUMBER 4 /end CHARACTERISTIC
/begin CHARACTERISTIC FFTDMMVE "Freeze Frame Tabelle: DM-TL Magnetventil (Endstufe)" VAL_BLK 0xFD58BD KwbWU8 255.0 dez 0.00 255.0 FORMAT "%5.1" NUMBER 4 /end CHARACTERISTIC
/begin CHARACTERISTIC FFTDMPME "Freeze Frame Tabelle: DM-TL Pumpenmotor (Endstufe)" VAL_BLK 0xFD58C1 KwbWU8 255.0 dez 0.00 255.0 FORMAT "%5.1" NUMBER 4 /end CHARACTERISTIC
/begin CHARACTERISTIC FFTDMTK "Freeze Frame Tabelle: Tankdiagnose, Feinstleck" VAL_BLK 0xFD58C5 KwbWU8 255.0 dez 0.00 255.0 FORMAT "%5.1" NUMBER 4 /end CHARACTERISTIC
/begin CHARACTERISTIC FFTDMTL "Freeze Frame Tabelle: Tankdiagnose, Modulfehler (Hardware)" VAL_BLK 0xFD58CD KwbWU8 255.0 dez 0.00 255.0 FORMAT "%5.1" NUMBER 4 /end CHARACTERISTIC
/begin CHARACTERISTIC FFTDPMEE "Freeze Frame Tabelle: DM-TL Pumpenmotor (Endstufe) aus DECJ" VAL_BLK 0xFD58D1 KwbWU8 255.0 dez 0.00 255.0 FORMAT "%5.1" NUMBER 4 /end CHARACTERISTIC
/begin CHARACTERISTIC FFTDVEE "Freeze Frame Tabelle: DV-E Endstufe" VAL_BLK 0xFD58E5 KwbUb 255.0 dez 0.00 255.0 FORMAT "%5.1" NUMBER 4 /end CHARACTERISTIC
/begin CHARACTERISTIC FFTDVEF "Freeze Frame Tabelle: DV-E Fehler bei Federpr¸fung" VAL_BLK 0xFD58E9 KwbUb 255.0 dez 0.00 255.0 FORMAT "%5.1" NUMBER 4 /end CHARACTERISTIC
/begin CHARACTERISTIC FFTDVEFO "" VAL_BLK 0xFD58ED KwbUb 255.0 dez 0.00 255.0 FORMAT "%5.1" NUMBER 4 /end CHARACTERISTIC
/begin CHARACTERISTIC FFTDVEL "Freeze Frame Tabelle: DV-E Lageabweichung" VAL_BLK 0xFD58F1 KwbUb 255.0 dez 0.00 255.0 FORMAT "%5.1" NUMBER 4 /end CHARACTERISTIC
/begin CHARACTERISTIC FFTDVEN "Freeze Frame Tabelle: DV-E Fehler bei Pr¸fung Notluftposition" VAL_BLK 0xFD58F5 KwbUb 255.0 dez 0.00 255.0 FORMAT "%5.1" NUMBER 4 /end CHARACTERISTIC
/begin CHARACTERISTIC FFTDVER "Freeze Frame Tabelle: DV-E Regelbereich" VAL_BLK 0xFD58F9 KwbUb 255.0 dez 0.00 255.0 FORMAT "%5.1" NUMBER 4 /end CHARACTERISTIC
/begin CHARACTERISTIC FFTDVET "" VAL_BLK 0xFD5905 KwbUb 255.0 dez 0.00 255.0 FORMAT "%5.1" NUMBER 4 /end CHARACTERISTIC
/begin CHARACTERISTIC FFTDVEU "Freeze Frame Tabelle: DV-E Fehler beim UMA-Lernen" VAL_BLK 0xFD5909 KwbUb 255.0 dez 0.00 255.0 FORMAT "%5.1" NUMBER 4 /end CHARACTERISTIC
/begin CHARACTERISTIC FFTDVEUB "" VAL_BLK 0xFD590D KwbUb 255.0 dez 0.00 255.0 FORMAT "%5.1" NUMBER 4 /end CHARACTERISTIC
/begin CHARACTERISTIC FFTDVEUW "" VAL_BLK 0xFD5911 KwbUb 255.0 dez 0.00 255.0 FORMAT "%5.1" NUMBER 4 /end CHARACTERISTIC
/begin CHARACTERISTIC FFTDVEV "Freeze Frame Tabelle: DV-E Fehler bei Verst‰rkerabgleich" VAL_BLK 0xFD5915 KwbUb 255.0 dez 0.00 255.0 FORMAT "%5.1" NUMBER 4 /end CHARACTERISTIC
/begin CHARACTERISTIC FFTDYLSU "" VAL_BLK 0xFD5969 KwbUb 255.0 dez 0.00 255.0 FORMAT "%5.1" NUMBER 4 /end CHARACTERISTIC
/begin CHARACTERISTIC FFTDYLSU2 "" VAL_BLK 0xFD596D KwbUb 255.0 dez 0.00 255.0 FORMAT "%5.1" NUMBER 4 /end CHARACTERISTIC
/begin CHARACTERISTIC FFTELS "Freeze Frame Tabelle: Endstufe E-Box l¸fter" VAL_BLK 0xFD5995 KwbWU8 255.0 dez 0.00 255.0 FORMAT "%5.1" NUMBER 4 /end CHARACTERISTIC
/begin CHARACTERISTIC FFTEV1 "Freeze Frame Tabelle: EV Endstufe 1" VAL_BLK 0xFD59AD KwbWU8 255.0 dez 0.00 255.0 FORMAT "%5.1" NUMBER 4 /end CHARACTERISTIC
/begin CHARACTERISTIC FFTEV2 "Freeze Frame Tabelle: EV Endstufe 2" VAL_BLK 0xFD59B1 KwbWU8 255.0 dez 0.00 255.0 FORMAT "%5.1" NUMBER 4 /end CHARACTERISTIC
/begin CHARACTERISTIC FFTEV3 "Freeze Frame Tabelle: EV Endstufe 3" VAL_BLK 0xFD59B5 KwbWU8 255.0 dez 0.00 255.0 FORMAT "%5.1" NUMBER 4 /end CHARACTERISTIC
/begin CHARACTERISTIC FFTEV4 "Freeze Frame Tabelle: EV Endstufe 4" VAL_BLK 0xFD59B9 KwbWU8 255.0 dez 0.00 255.0 FORMAT "%5.1" NUMBER 4 /end CHARACTERISTIC
/begin CHARACTERISTIC FFTEV5 "Freeze Frame Tabelle: EV Endstufe 5" VAL_BLK 0xFD59BD KwbWU8 255.0 dez 0.00 255.0 FORMAT "%5.1" NUMBER 4 /end CHARACTERISTIC
/begin CHARACTERISTIC FFTEV6 "Freeze frame Tabelle: EV Endstufe 6" VAL_BLK 0xFD59C1 KwbWU8 255.0 dez 0.00 255.0 FORMAT "%5.1" NUMBER 4 /end CHARACTERISTIC
/begin CHARACTERISTIC FFTEV7 "Freeze Frame Tabelle: EV Endstufe 7" VAL_BLK 0xFD59C5 KwbWU8 255.0 dez 0.00 255.0 FORMAT "%5.1" NUMBER 4 /end CHARACTERISTIC
/begin CHARACTERISTIC FFTEV8 "Freeze Frame Tabelle: EV Endstufe 8" VAL_BLK 0xFD59C9 KwbWU8 255.0 dez 0.00 255.0 FORMAT "%5.1" NUMBER 4 /end CHARACTERISTIC
/begin CHARACTERISTIC FFTFST "Freeze Frame Tabelle: Tankf¸llstand" VAL_BLK 0xFD59F1 KwbUb 255.0 dez 0.00 255.0 FORMAT "%5.1" NUMBER 4 /end CHARACTERISTIC
/begin CHARACTERISTIC FFTGLFE "Freeze Frame Tabelle: gesteuerte Luftf¸hrung Endstufe" VAL_BLK 0xFD59F5 KwbWU8 255.0 dez 0.00 255.0 FORMAT "%5.1" NUMBER 4 /end CHARACTERISTIC
/begin CHARACTERISTIC FFTHELSU "" VAL_BLK 0xFD59F9 KwbUb 255.0 dez 0.00 255.0 FORMAT "%5.1" NUMBER 4 /end CHARACTERISTIC
/begin CHARACTERISTIC FFTHELSU2 "" VAL_BLK 0xFD59FD KwbUb 255.0 dez 0.00 255.0 FORMAT "%5.1" NUMBER 4 /end CHARACTERISTIC
/begin CHARACTERISTIC FFTHSH "Tabelle Umweltbedingungen Heizung Lambdasonde hinter Kat" VAL_BLK 0xFD5A01 KwbUb 255.0 dez 0.00 255.0 FORMAT "%5.1" NUMBER 4 /end CHARACTERISTIC
/begin CHARACTERISTIC FFTHSH2 "Tabelle Umweltbedingungen Heizung Lambdasonde hinter Kat Bank2" VAL_BLK 0xFD5A05 KwbUb 255.0 dez 0.00 255.0 FORMAT "%5.1" NUMBER 4 /end CHARACTERISTIC
/begin CHARACTERISTIC FFTHSHE "Freeze Frame Tabelle: Endstufe Heizung Lambdasonde hinter Kat" VAL_BLK 0xFD5A09 KwbUb 255.0 dez 0.00 255.0 FORMAT "%5.1" NUMBER 4 /end CHARACTERISTIC
/begin CHARACTERISTIC FFTHSHE2 "Freeze Frame Tabelle: Endstufe Heizung Sonde hinter Kat. Bank 2" VAL_BLK 0xFD5A0D KwbUb 255.0 dez 0.00 255.0 FORMAT "%5.1" NUMBER 4 /end CHARACTERISTIC
/begin CHARACTERISTIC FFTHSV "Tabelle Umweltbedingungen Heizung Lambdasonde vor Kat" VAL_BLK 0xFD5A11 KwbUb 255.0 dez 0.00 255.0 FORMAT "%5.1" NUMBER 4 /end CHARACTERISTIC
/begin CHARACTERISTIC FFTHSV2 "Tabelle Umweltbedingungen Heizung Lambdasonde vor Kat Bank2" VAL_BLK 0xFD5A15 KwbUb 255.0 dez 0.00 255.0 FORMAT "%5.1" NUMBER 4 /end CHARACTERISTIC
/begin CHARACTERISTIC FFTHSVE "Tabelle Umweltbedingungen Endstufe Heizung Lambdasonde vor Kat" VAL_BLK 0xFD5A19 KwbUb 255.0 dez 0.00 255.0 FORMAT "%5.1" NUMBER 4 /end CHARACTERISTIC
/begin CHARACTERISTIC FFTHSVE2 "Freeze Frame Tabelle: Endstufe Heizung Lambdasonde 2 vor Kat." VAL_BLK 0xFD5A1D KwbUb 255.0 dez 0.00 255.0 FORMAT "%5.1" NUMBER 4 /end CHARACTERISTIC
/begin CHARACTERISTIC FFTKPE "Freeze Frame Tabelle: EKP-Relais Endstufe" VAL_BLK 0xFD5A3D KwbWU8 255.0 dez 0.00 255.0 FORMAT "%5.1" NUMBER 4 /end CHARACTERISTIC
/begin CHARACTERISTIC FFTLM "Freeze Frame Tabelle: Hauptf¸llungssensor" VAL_BLK 0xFD5A81 KwbWU8 255.0 dez 0.00 255.0 FORMAT "%5.1" NUMBER 4 /end CHARACTERISTIC
/begin CHARACTERISTIC FFTN "Freeze Frame Tabelle: Drehzahlgeber" VAL_BLK 0xFD5B09 KwbWU8 255.0 dez 0.00 255.0 FORMAT "%5.1" NUMBER 4 /end CHARACTERISTIC
/begin CHARACTERISTIC FFTPMBATT "" VAL_BLK 0xFD5B3D KwbWU8 255.0 dez 0.00 255.0 FORMAT "%5.1" NUMBER 4 /end CHARACTERISTIC
/begin CHARACTERISTIC FFTPMBN "" VAL_BLK 0xFD5B41 KwbWU8 255.0 dez 0.00 255.0 FORMAT "%5.1" NUMBER 4 /end CHARACTERISTIC
/begin CHARACTERISTIC FFTTESG "Freeze Frame Tabelle: Tankdiagnose, Grobleck" VAL_BLK 0xFD5B89 KwbWU8 255.0 dez 0.00 255.0 FORMAT "%5.1" NUMBER 4 /end CHARACTERISTIC
/begin CHARACTERISTIC FFTZZZ "Dummy: Tabellenende" VAL_BLK 0xFD5C01 KwbUb 255.0 dez 0.00 255.0 FORMAT "%5.1" NUMBER 4 /end CHARACTERISTIC
/begin CHARACTERISTIC TSFAAA "Dummy: Tabellenanfang" VALUE 0xFD5C05 KwUb 255.0 dez 0.00 255.0 FORMAT "%5.1" /end CHARACTERISTIC
/begin CHARACTERISTIC TSFBM "Fehlersummenzeit: Bezugsmarkengeber" VALUE 0xFD5C0C KwWU8 255.0 dez 0.00 255.0 FORMAT "%5.1" /end CHARACTERISTIC
/begin CHARACTERISTIC TSFCARS "Fehlersummenzeit: CAN-Schnittstelle, Timeout ARS" VALUE 0xFD5C13 KwUb 255.0 dez 0.00 255.0 FORMAT "%5.1" /end CHARACTERISTIC
/begin CHARACTERISTIC TSFCCAS "Fehlersummenzeit: CAN-Schnittstelle, Timeout CAS" VALUE 0xFD5C14 KwWU8 255.0 dez 0.00 255.0 FORMAT "%5.1" /end CHARACTERISTIC
/begin CHARACTERISTIC TSFCDSC "Fehlersummenzeit: CAN-Schnittstelle, DSC-SG" VALUE 0xFD5C15 KwUb 255.0 dez 0.00 255.0 FORMAT "%5.1" /end CHARACTERISTIC
/begin CHARACTERISTIC TSFCEGS "Fehlersummenzeit: CAN-Schnittstelle EGS" VALUE 0xFD5C16 KwUb 255.0 dez 0.00 255.0 FORMAT "%5.1" /end CHARACTERISTIC
/begin CHARACTERISTIC TSFCFC "" VALUE 0xFD5C17 KwWU8 255.0 dez 0.00 255.0 FORMAT "%5.1" /end CHARACTERISTIC
/begin CHARACTERISTIC TSFCIHKA "Fehlersummenzeit: CAN-Schnittstelle, Timeout IHKA" VALUE 0xFD5C18 KwWU8 255.0 dez 0.00 255.0 FORMAT "%5.1" /end CHARACTERISTIC
/begin CHARACTERISTIC TSFCINS "Fehlersummenzeit: CAN-Schnittstelle, Timeout Instrument" VALUE 0xFD5C19 KwWU8 255.0 dez 0.00 255.0 FORMAT "%5.1" /end CHARACTERISTIC
/begin CHARACTERISTIC TSFCOD "Fehlersummenzeit: Steuerger‰t noch nicht codiert" VALUE 0xFD5C1A KwWU8 255.0 dez 0.00 255.0 FORMAT "%5.1" /end CHARACTERISTIC
/begin CHARACTERISTIC TSFCSSG "Fehlersummenzeit:  CAN-Schnittstelle SGG-Steuerger‰t" VALUE 0xFD5C1B KwUb 255.0 dez 0.00 255.0 FORMAT "%5.1" /end CHARACTERISTIC
/begin CHARACTERISTIC TSFCSZL "Fehlersummenzeit: CAN-Schnittstelle, Timeout SZL" VALUE 0xFD5C1C KwUb 255.0 dez 0.00 255.0 FORMAT "%5.1" /end CHARACTERISTIC
/begin CHARACTERISTIC TSFDHDMTE "Fehlersummenzeit: DM-TL Heizung (Endstufe)" VALUE 0xFD5C24 KwWU8 255.0 dez 0.00 255.0 FORMAT "%5.1" /end CHARACTERISTIC
/begin CHARACTERISTIC TSFDISA "" VALUE 0xFD5C28 KwWU8 255.0 dez 0.00 255.0 FORMAT "%5.1" /end CHARACTERISTIC
/begin CHARACTERISTIC TSFDISAT "" VALUE 0xFD5C29 KwWU8 255.0 dez 0.00 255.0 FORMAT "%5.1" /end CHARACTERISTIC
/begin CHARACTERISTIC TSFDK "Fehlersummenzeit: DK - Potentiometer" VALUE 0xFD5C2A KwUb 255.0 dez 0.00 255.0 FORMAT "%5.1" /end CHARACTERISTIC
/begin CHARACTERISTIC TSFDK1P "Fehlersummenzeit: Drosselklappe 1. Poti" VALUE 0xFD5C2B KwUb 255.0 dez 0.00 255.0 FORMAT "%5.1" /end CHARACTERISTIC
/begin CHARACTERISTIC TSFDK2P "Fehlersummenzeit: Drosselklappenpotentiometer 2" VALUE 0xFD5C2C KwUb 255.0 dez 0.00 255.0 FORMAT "%5.1" /end CHARACTERISTIC
/begin CHARACTERISTIC TSFDMMVE "Fehlersummenzeit: DM-TL Magnetventil (Endstufe)" VALUE 0xFD5C2D KwWU8 255.0 dez 0.00 255.0 FORMAT "%5.1" /end CHARACTERISTIC
/begin CHARACTERISTIC TSFDMPME "Fehlersummenzeit: DM-TL Pumpenmotor (Endstufe)" VALUE 0xFD5C2E KwWU8 255.0 dez 0.00 255.0 FORMAT "%5.1" /end CHARACTERISTIC
/begin CHARACTERISTIC TSFDMTK "Fehlersummenzeit: Tankentl¸ftungssystem, Feinstleck" VALUE 0xFD5C2F KwWU8 255.0 dez 0.00 255.0 FORMAT "%5.1" /end CHARACTERISTIC
/begin CHARACTERISTIC TSFDMTL "Fehlersummenzeit: Tankentl¸ftungssystem, Modulfehler (Hardware)" VALUE 0xFD5C31 KwWU8 255.0 dez 0.00 255.0 FORMAT "%5.1" /end CHARACTERISTIC
/begin CHARACTERISTIC TSFDPMEE "Fehlersummenzeit: DM-TL Pumpenmotor (Endstufe) aus DECJ" VALUE 0xFD5C32 KwWU8 255.0 dez 0.00 255.0 FORMAT "%5.1" /end CHARACTERISTIC
/begin CHARACTERISTIC TSFDVEE "Fehlersummenzeit: DV-E Endstufe" VALUE 0xFD5C37 KwUb 255.0 dez 0.00 255.0 FORMAT "%5.1" /end CHARACTERISTIC
/begin CHARACTERISTIC TSFDVEF "Fehlersummenzeit: DV-E Fehler bei Federpr¸fung" VALUE 0xFD5C38 KwUb 255.0 dez 0.00 255.0 FORMAT "%5.1" /end CHARACTERISTIC
/begin CHARACTERISTIC TSFDVEFO "" VALUE 0xFD5C39 KwUb 255.0 dez 0.00 255.0 FORMAT "%5.1" /end CHARACTERISTIC
/begin CHARACTERISTIC TSFDVEL "Fehlersummenzeit: DV-E Lageabweichung" VALUE 0xFD5C3A KwUb 255.0 dez 0.00 255.0 FORMAT "%5.1" /end CHARACTERISTIC
/begin CHARACTERISTIC TSFDVEN "Fehlersummenzeit: DV-E Fehler bei Pr¸fung Notluftposition" VALUE 0xFD5C3B KwUb 255.0 dez 0.00 255.0 FORMAT "%5.1" /end CHARACTERISTIC
/begin CHARACTERISTIC TSFDVER "Fehlersummenzeit: DV-E Regelbereich" VALUE 0xFD5C3C KwUb 255.0 dez 0.00 255.0 FORMAT "%5.1" /end CHARACTERISTIC
/begin CHARACTERISTIC TSFDVET "" VALUE 0xFD5C3F KwUb 255.0 dez 0.00 255.0 FORMAT "%5.1" /end CHARACTERISTIC
/begin CHARACTERISTIC TSFDVEU "Fehlersummenzeit: DV-E Fehler beim UMA-Lernen" VALUE 0xFD5C40 KwUb 255.0 dez 0.00 255.0 FORMAT "%5.1" /end CHARACTERISTIC
/begin CHARACTERISTIC TSFDVEUB "" VALUE 0xFD5C41 KwUb 255.0 dez 0.00 255.0 FORMAT "%5.1" /end CHARACTERISTIC
/begin CHARACTERISTIC TSFDVEUW "" VALUE 0xFD5C42 KwUb 255.0 dez 0.00 255.0 FORMAT "%5.1" /end CHARACTERISTIC
/begin CHARACTERISTIC TSFDVEV "Fehlersummenzeit: DV-E Fehler bei Verst‰rkerabgleich" VALUE 0xFD5C43 KwUb 255.0 dez 0.00 255.0 FORMAT "%5.1" /end CHARACTERISTIC
/begin CHARACTERISTIC TSFDYLSU "" VALUE 0xFD5C58 KwUb 255.0 dez 0.00 255.0 FORMAT "%5.1" /end CHARACTERISTIC
/begin CHARACTERISTIC TSFDYLSU2 "" VALUE 0xFD5C59 KwUb 255.0 dez 0.00 255.0 FORMAT "%5.1" /end CHARACTERISTIC
/begin CHARACTERISTIC TSFELS "Fehlersummenzeit: Endstufe E-Box L¸fter" VALUE 0xFD5C63 KwWU8 255.0 dez 0.00 255.0 FORMAT "%5.1" /end CHARACTERISTIC
/begin CHARACTERISTIC TSFEV1 "Fehlersummenzeit: EV von Zyl. 1" VALUE 0xFD5C69 KwWU8 255.0 dez 0.00 255.0 FORMAT "%5.1" /end CHARACTERISTIC
/begin CHARACTERISTIC TSFEV2 "Fehlersummenzeit: EV von Zyl. 2" VALUE 0xFD5C6A KwWU8 255.0 dez 0.00 255.0 FORMAT "%5.1" /end CHARACTERISTIC
/begin CHARACTERISTIC TSFEV3 "Fehlersummenzeit: EV von Zyl. 3" VALUE 0xFD5C6B KwWU8 255.0 dez 0.00 255.0 FORMAT "%5.1" /end CHARACTERISTIC
/begin CHARACTERISTIC TSFEV4 "Fehlersummenzeit: EV von Zyl. 4" VALUE 0xFD5C6C KwWU8 255.0 dez 0.00 255.0 FORMAT "%5.1" /end CHARACTERISTIC
/begin CHARACTERISTIC TSFEV5 "Fehlersummenzeit: EV von Zyl. 5" VALUE 0xFD5C6D KwWU8 255.0 dez 0.00 255.0 FORMAT "%5.1" /end CHARACTERISTIC
/begin CHARACTERISTIC TSFEV6 "Fehlersummenzeit: EV von Zyl. 6" VALUE 0xFD5C6E KwWU8 255.0 dez 0.00 255.0 FORMAT "%5.1" /end CHARACTERISTIC
/begin CHARACTERISTIC TSFEV7 "Fehlersummenzeit: EV von Zyl. 7" VALUE 0xFD5C6F KwWU8 255.0 dez 0.00 255.0 FORMAT "%5.1" /end CHARACTERISTIC
/begin CHARACTERISTIC TSFEV8 "Fehlersummenzeit: EV von Zyl. 8" VALUE 0xFD5C70 KwWU8 255.0 dez 0.00 255.0 FORMAT "%5.1" /end CHARACTERISTIC
/begin CHARACTERISTIC TSFFST "Fehlersummenzeit: Tankf¸llstand" VALUE 0xFD5C7A KwUb 255.0 dez 0.00 255.0 FORMAT "%5.1" /end CHARACTERISTIC
/begin CHARACTERISTIC TSFGLFE "Fehlersummenzeit: gesteuerte Luftf¸hrung Endstufe" VALUE 0xFD5C7B KwWU8 255.0 dez 0.00 255.0 FORMAT "%5.1" /end CHARACTERISTIC
/begin CHARACTERISTIC TSFHELSU "" VALUE 0xFD5C7C KwUb 255.0 dez 0.00 255.0 FORMAT "%5.1" /end CHARACTERISTIC
/begin CHARACTERISTIC TSFHELSU2 "" VALUE 0xFD5C7D KwUb 255.0 dez 0.00 255.0 FORMAT "%5.1" /end CHARACTERISTIC
/begin CHARACTERISTIC TSFHSH "Fehlersummenzeit: Lambdasonden-Heizung hinter Katalysator" VALUE 0xFD5C7E KwUb 255.0 dez 0.00 255.0 FORMAT "%5.1" /end CHARACTERISTIC
/begin CHARACTERISTIC TSFHSH2 "Fehlersummenzeit: Lambdasonden-Heizung hinter Katalysator, Bank 2" VALUE 0xFD5C7F KwUb 255.0 dez 0.00 255.0 FORMAT "%5.1" /end CHARACTERISTIC
/begin CHARACTERISTIC TSFHSHE "Fehlersummenzeit: Endstufe Heizung Sonde hinter Kat." VALUE 0xFD5C80 KwUb 255.0 dez 0.00 255.0 FORMAT "%5.1" /end CHARACTERISTIC
/begin CHARACTERISTIC TSFHSHE2 "Fehlersummenzeit: Endstufe Heizung Sonde hinter Kat. Bank 2" VALUE 0xFD5C81 KwUb 255.0 dez 0.00 255.0 FORMAT "%5.1" /end CHARACTERISTIC
/begin CHARACTERISTIC TSFHSV "Fehlersummenzeit: Lambdasonden-Heizung vor Katalysator" VALUE 0xFD5C82 KwUb 255.0 dez 0.00 255.0 FORMAT "%5.1" /end CHARACTERISTIC
/begin CHARACTERISTIC TSFHSV2 "Fehlersummenzeit: Lambdasonden-Heizung vor Katalysator, Bank 2" VALUE 0xFD5C83 KwUb 255.0 dez 0.00 255.0 FORMAT "%5.1" /end CHARACTERISTIC
/begin CHARACTERISTIC TSFHSVE "Fehlersummenzeit: Lambdasonden-Heizung vor Katalysator (Endstufe)" VALUE 0xFD5C84 KwUb 255.0 dez 0.00 255.0 FORMAT "%5.1" /end CHARACTERISTIC
/begin CHARACTERISTIC TSFHSVE2 "Fehlersummenzeit: Endstufe Lambdasonden-Heizung vor Katalysator, Bank 2" VALUE 0xFD5C85 KwUb 255.0 dez 0.00 255.0 FORMAT "%5.1" /end CHARACTERISTIC
/begin CHARACTERISTIC TSFKPE "Fehlersummenzeit: EKP-Relais Endstufe" VALUE 0xFD5C8D KwWU8 255.0 dez 0.00 255.0 FORMAT "%5.1" /end CHARACTERISTIC
/begin CHARACTERISTIC TSFLM "Fehlersummenzeit: LMM/HLM/HFM" VALUE 0xFD5C9E KwWU8 255.0 dez 0.00 255.0 FORMAT "%5.1" /end CHARACTERISTIC
/begin CHARACTERISTIC TSFN "Fehlersummenzeit: Drehzahlgeber" VALUE 0xFD5CC0 KwWU8 255.0 dez 0.00 255.0 FORMAT "%5.1" /end CHARACTERISTIC
/begin CHARACTERISTIC TSFPMBATT "" VALUE 0xFD5CCD KwWU8 255.0 dez 0.00 255.0 FORMAT "%5.1" /end CHARACTERISTIC
/begin CHARACTERISTIC TSFPMBN "" VALUE 0xFD5CCE KwWU8 255.0 dez 0.00 255.0 FORMAT "%5.1" /end CHARACTERISTIC
/begin CHARACTERISTIC TSFTESG "Fehlersummenzeit: Tankentl¸ftungssystem Grobleck" VALUE 0xFD5CE0 KwWU8 255.0 dez 0.00 255.0 FORMAT "%5.1" /end CHARACTERISTIC
/begin CHARACTERISTIC TSFZZZ "Dummy: Tabellenende" VALUE 0xFD5CFE KwUb 255.0 dez 0.00 255.0 FORMAT "%5.1" /end CHARACTERISTIC
/begin MEASUREMENT B_bebm "Bedingung Bandende-Funktionsanforderung Bezugsmarke erkannt" UWORD B_TRUE 1 100 0 1 BIT_MASK 0x20 FORMAT "%13.11" ECU_ADDRESS 0x3FE3BC /end MEASUREMENT
/begin MEASUREMENT B_becars "Bedingung Bandende-Funktionsanforderung: CAN-Schnittstelle ARS" UWORD B_TRUE 1 100 0 1 BIT_MASK 0x20 FORMAT "%13.11" ECU_ADDRESS 0x3FE3CA /end MEASUREMENT
/begin MEASUREMENT B_beccas "Bedingung Bandende-Funktionsanforderung: CAN-Schnittstelle CAS" UWORD B_TRUE 1 100 0 1 BIT_MASK 0x20 FORMAT "%13.11" ECU_ADDRESS 0x3FE3CC /end MEASUREMENT
/begin MEASUREMENT B_becdsc "Bedingung Bandende-Funktionsanforderung: CAN-Schnittstelle DSC" UWORD B_TRUE 1 100 0 1 BIT_MASK 0x20 FORMAT "%13.11" ECU_ADDRESS 0x3FE3CE /end MEASUREMENT
/begin MEASUREMENT B_becegs "Bedingung Bandende-Funktionsanforderung: CAN-Schnittstelle EGS" UWORD B_TRUE 1 100 0 1 BIT_MASK 0x20 FORMAT "%13.11" ECU_ADDRESS 0x3FE3D0 /end MEASUREMENT
/begin MEASUREMENT B_becfc "Bedingung Bandende-Funktionsanforderung Check Filler Cap" UWORD B_TRUE 1 100 0 1 BIT_MASK 0x20 FORMAT "%13.11" ECU_ADDRESS 0x3FE3D2 /end MEASUREMENT
/begin MEASUREMENT B_becihka "Bedingung Bandende-Funktionsanforderung: CAN-Schnittstelle IHKA" UWORD B_TRUE 1 100 0 1 BIT_MASK 0x20 FORMAT "%13.11" ECU_ADDRESS 0x3FE3D4 /end MEASUREMENT
/begin MEASUREMENT B_becins "Bedingung Bandende Funktionsanforderung : Botschaft Kombi" UWORD B_TRUE 1 100 0 1 BIT_MASK 0x20 FORMAT "%13.11" ECU_ADDRESS 0x3FE3D6 /end MEASUREMENT
/begin MEASUREMENT B_becod "Bedingung Bandende-Test" UWORD B_TRUE 1 100 0 1 BIT_MASK 0x20 FORMAT "%13.11" ECU_ADDRESS 0x3FE3D8 /end MEASUREMENT
/begin MEASUREMENT B_becssg "Bedingung Bandende-Funktionsanforderung: CAN-Schnittstelle SGG-Steuerger‰t" UWORD B_TRUE 1 100 0 1 BIT_MASK 0x20 FORMAT "%13.11" ECU_ADDRESS 0x3FE3DA /end MEASUREMENT
/begin MEASUREMENT B_becszl "Bedingung Bandende-Funktionsanforderung: CAN-Schnittstelle SZL" UWORD B_TRUE 1 100 0 1 BIT_MASK 0x20 FORMAT "%13.11" ECU_ADDRESS 0x3FE3DC /end MEASUREMENT
/begin MEASUREMENT B_bedhdmte "Bedingung Bandende-Funktionsanfordeung DM-TL Heizung" UWORD B_TRUE 1 100 0 1 BIT_MASK 0x20 FORMAT "%13.11" ECU_ADDRESS 0x3FE3EC /end MEASUREMENT
/begin MEASUREMENT B_bedisa "Pruefung am Bandende" UWORD B_TRUE 1 100 0 1 BIT_MASK 0x20 FORMAT "%13.11" ECU_ADDRESS 0x3FE3F4 /end MEASUREMENT
/begin MEASUREMENT B_bedisat "" UWORD B_TRUE 1 100 0 1 BIT_MASK 0x20 FORMAT "%13.11" ECU_ADDRESS 0x3FE3F6 /end MEASUREMENT
/begin MEASUREMENT B_bedk "Bedingung Bandende-Funktionsanforderung Drosselklappe" UWORD B_TRUE 1 100 0 1 BIT_MASK 0x20 FORMAT "%13.11" ECU_ADDRESS 0x3FE3F8 /end MEASUREMENT
/begin MEASUREMENT B_bedk1p "Nicht benutzt" UWORD B_TRUE 1 100 0 1 BIT_MASK 0x20 FORMAT "%13.11" ECU_ADDRESS 0x3FE3FA /end MEASUREMENT
/begin MEASUREMENT B_bedk2p "Nicht benutzt" UWORD B_TRUE 1 100 0 1 BIT_MASK 0x20 FORMAT "%13.11" ECU_ADDRESS 0x3FE3FC /end MEASUREMENT
/begin MEASUREMENT B_bedmmve "Bedingung Bandende-Funktionsanfordeung DM-TL Magnetventil" UWORD B_TRUE 1 100 0 1 BIT_MASK 0x20 FORMAT "%13.11" ECU_ADDRESS 0x3FE3FE /end MEASUREMENT
/begin MEASUREMENT B_bedmpme "Bedingung Bandende-Funktionsanfordeung DM-TL Pumpenmotor" UWORD B_TRUE 1 100 0 1 BIT_MASK 0x20 FORMAT "%13.11" ECU_ADDRESS 0x3FE400 /end MEASUREMENT
/begin MEASUREMENT B_bedmtk "Bedingung Bandende-Funktionsanforderung DMTK" UWORD B_TRUE 1 100 0 1 BIT_MASK 0x20 FORMAT "%13.11" ECU_ADDRESS 0x3FE402 /end MEASUREMENT
/begin MEASUREMENT B_bedmtl "Bedingung Bandende-Funktionsanforderung DMTL" UWORD B_TRUE 1 100 0 1 BIT_MASK 0x20 FORMAT "%13.11" ECU_ADDRESS 0x3FE406 /end MEASUREMENT
/begin MEASUREMENT B_bedpmee "Bedingung Bandende-Funktionsanfordeung DM-TL Pumpe" UWORD B_TRUE 1 100 0 1 BIT_MASK 0x20 FORMAT "%13.11" ECU_ADDRESS 0x3FE408 /end MEASUREMENT
/begin MEASUREMENT B_bedvee "Nicht benutzt" UWORD B_TRUE 1 100 0 1 BIT_MASK 0x20 FORMAT "%13.11" ECU_ADDRESS 0x3FE412 /end MEASUREMENT
/begin MEASUREMENT B_bedvef "Nicht benutzt" UWORD B_TRUE 1 100 0 1 BIT_MASK 0x20 FORMAT "%13.11" ECU_ADDRESS 0x3FE414 /end MEASUREMENT
/begin MEASUREMENT B_bedvefo "Nicht benutzt" UWORD B_TRUE 1 100 0 1 BIT_MASK 0x20 FORMAT "%13.11" ECU_ADDRESS 0x3FE416 /end MEASUREMENT
/begin MEASUREMENT B_bedvel "Nicht benutzt" UWORD B_TRUE 1 100 0 1 BIT_MASK 0x20 FORMAT "%13.11" ECU_ADDRESS 0x3FE418 /end MEASUREMENT
/begin MEASUREMENT B_bedven "Nicht benutzt" UWORD B_TRUE 1 100 0 1 BIT_MASK 0x20 FORMAT "%13.11" ECU_ADDRESS 0x3FE41A /end MEASUREMENT
/begin MEASUREMENT B_bedver "Nicht benutzt" UWORD B_TRUE 1 100 0 1 BIT_MASK 0x20 FORMAT "%13.11" ECU_ADDRESS 0x3FE41C /end MEASUREMENT
/begin MEASUREMENT B_bedvet "Nicht benutzt" UWORD B_TRUE 1 100 0 1 BIT_MASK 0x20 FORMAT "%13.11" ECU_ADDRESS 0x3FE422 /end MEASUREMENT
/begin MEASUREMENT B_bedveu "Nicht benutzt" UWORD B_TRUE 1 100 0 1 BIT_MASK 0x20 FORMAT "%13.11" ECU_ADDRESS 0x3FE424 /end MEASUREMENT
/begin MEASUREMENT B_bedveub "Nicht benutzt" UWORD B_TRUE 1 100 0 1 BIT_MASK 0x20 FORMAT "%13.11" ECU_ADDRESS 0x3FE426 /end MEASUREMENT
/begin MEASUREMENT B_bedveuw "Nicht benutzt" UWORD B_TRUE 1 100 0 1 BIT_MASK 0x20 FORMAT "%13.11" ECU_ADDRESS 0x3FE428 /end MEASUREMENT
/begin MEASUREMENT B_bedvev "Nicht benutzt" UWORD B_TRUE 1 100 0 1 BIT_MASK 0x20 FORMAT "%13.11" ECU_ADDRESS 0x3FE42A /end MEASUREMENT
/begin MEASUREMENT B_bedylsu "Bedingung: Bandendefunktionanford. f¸r DDYLSU" UWORD B_TRUE 1 100 0 1 BIT_MASK 0x20 FORMAT "%13.11" ECU_ADDRESS 0x3FE454 /end MEASUREMENT
/begin MEASUREMENT B_bedylsu2 "Bedingung: Bandendefunktionanford. f¸r DDYLSU, Bank 2" UWORD B_TRUE 1 100 0 1 BIT_MASK 0x20 FORMAT "%13.11" ECU_ADDRESS 0x3FE456 /end MEASUREMENT
/begin MEASUREMENT B_beels "Bedingung Bandendeanforderung f¸r Fehler Endstufe E-Box-L¸fter" UWORD B_TRUE 1 100 0 1 BIT_MASK 0x20 FORMAT "%13.11" ECU_ADDRESS 0x3FE46A /end MEASUREMENT
/begin MEASUREMENT B_beev1 "Bedingung Bandendeanforderung  f¸r Fehler Endstufe EV1" UWORD B_TRUE 1 100 0 1 BIT_MASK 0x20 FORMAT "%13.11" ECU_ADDRESS 0x3FE476 /end MEASUREMENT
/begin MEASUREMENT B_beev2 "Bedingung Bandendeanforderung  f¸r Fehler Endstufe EV2" UWORD B_TRUE 1 100 0 1 BIT_MASK 0x20 FORMAT "%13.11" ECU_ADDRESS 0x3FE478 /end MEASUREMENT
/begin MEASUREMENT B_beev3 "Bedingung Bandendeanforderung  f¸r Fehler Endstufe EV3" UWORD B_TRUE 1 100 0 1 BIT_MASK 0x20 FORMAT "%13.11" ECU_ADDRESS 0x3FE47A /end MEASUREMENT
/begin MEASUREMENT B_beev4 "Bedingung Bandendeanforderung  f¸r Fehler Endstufe EV4" UWORD B_TRUE 1 100 0 1 BIT_MASK 0x20 FORMAT "%13.11" ECU_ADDRESS 0x3FE47C /end MEASUREMENT
/begin MEASUREMENT B_beev5 "Bedingung Bandendeanforderung  f¸r Fehler Endstufe EV5" UWORD B_TRUE 1 100 0 1 BIT_MASK 0x20 FORMAT "%13.11" ECU_ADDRESS 0x3FE47E /end MEASUREMENT
/begin MEASUREMENT B_beev6 "Bedingung Bandendeanforderung  f¸r Fehler Endstufe EV6" UWORD B_TRUE 1 100 0 1 BIT_MASK 0x20 FORMAT "%13.11" ECU_ADDRESS 0x3FE480 /end MEASUREMENT
/begin MEASUREMENT B_beev7 "Bedingung Bandendeanforderung  f¸r Fehler Endstufe EV7" UWORD B_TRUE 1 100 0 1 BIT_MASK 0x20 FORMAT "%13.11" ECU_ADDRESS 0x3FE482 /end MEASUREMENT
/begin MEASUREMENT B_beev8 "Bedingung Bandendeanforderung  f¸r Fehler Endstufe EV8" UWORD B_TRUE 1 100 0 1 BIT_MASK 0x20 FORMAT "%13.11" ECU_ADDRESS 0x3FE484 /end MEASUREMENT
/begin MEASUREMENT B_befst "Bedingung: Bandendeanforderung f¸r Fehler FST" UWORD B_TRUE 1 100 0 1 BIT_MASK 0x20 FORMAT "%13.11" ECU_ADDRESS 0x3FE498 /end MEASUREMENT
/begin MEASUREMENT B_beglfe "Bedingung Bandendeanforderung f¸r Fehler GLF Endstufe" UWORD B_TRUE 1 100 0 1 BIT_MASK 0x20 FORMAT "%13.11" ECU_ADDRESS 0x3FE49A /end MEASUREMENT
/begin MEASUREMENT B_behelsu "Bedingung: Bandendefunktionanford. f¸r DHELSU" UWORD B_TRUE 1 100 0 1 BIT_MASK 0x20 FORMAT "%13.11" ECU_ADDRESS 0x3FE49C /end MEASUREMENT
/begin MEASUREMENT B_behelsu2 "Bedingung: Bandendefunktionanford. f¸r DHELSU" UWORD B_TRUE 1 100 0 1 BIT_MASK 0x20 FORMAT "%13.11" ECU_ADDRESS 0x3FE49E /end MEASUREMENT
/begin MEASUREMENT B_behsh "Bedingung: Bandendefunktionanford. f¸r %DHLS" UWORD B_TRUE 1 100 0 1 BIT_MASK 0x20 FORMAT "%13.11" ECU_ADDRESS 0x3FE4A0 /end MEASUREMENT
/begin MEASUREMENT B_behsh2 "Bedingung: Bandendefunktionanford. f¸r %DHLS Bank 2" UWORD B_TRUE 1 100 0 1 BIT_MASK 0x20 FORMAT "%13.11" ECU_ADDRESS 0x3FE4A2 /end MEASUREMENT
/begin MEASUREMENT B_behshe "Bedingung Bandende-Funktionsanforderung Endstufe Sondenheizung nach Kat" UWORD B_TRUE 1 100 0 1 BIT_MASK 0x20 FORMAT "%13.11" ECU_ADDRESS 0x3FE4A4 /end MEASUREMENT
/begin MEASUREMENT B_behshe2 "Bedingung Bandende-Funktionsanforderung Endstufe Sondenheizung nach Kat Bank 2" UWORD B_TRUE 1 100 0 1 BIT_MASK 0x20 FORMAT "%13.11" ECU_ADDRESS 0x3FE4A6 /end MEASUREMENT
/begin MEASUREMENT B_behsv "Bedingung: Bandendefunktionanford. f¸r %DHRLSU" UWORD B_TRUE 1 100 0 1 BIT_MASK 0x20 FORMAT "%13.11" ECU_ADDRESS 0x3FE4A8 /end MEASUREMENT
/begin MEASUREMENT B_behsv2 "Bedingung: Bandendefunktionanford. f¸r %DHRLSU, Bank 2" UWORD B_TRUE 1 100 0 1 BIT_MASK 0x20 FORMAT "%13.11" ECU_ADDRESS 0x3FE4AA /end MEASUREMENT
/begin MEASUREMENT B_behsve "Bedingung: Bandendefunktionanford. f¸r DHRLSUE" UWORD B_TRUE 1 100 0 1 BIT_MASK 0x20 FORMAT "%13.11" ECU_ADDRESS 0x3FE4AC /end MEASUREMENT
/begin MEASUREMENT B_behsve2 "Bedingung: Bandendefunktionanford. f¸r DHRLSUE, Bank 2" UWORD B_TRUE 1 100 0 1 BIT_MASK 0x20 FORMAT "%13.11" ECU_ADDRESS 0x3FE4AE /end MEASUREMENT
/begin MEASUREMENT B_bekpe "Bedingung Bandendeanforderung f¸r Fehler Endstufe EKP" UWORD B_TRUE 1 100 0 1 BIT_MASK 0x20 FORMAT "%13.11" ECU_ADDRESS 0x3FE4BE /end MEASUREMENT
/begin MEASUREMENT B_belm "Bedingung Bandende-Funktionsanforderung Luftmassensensor (HFM/DSS)" UWORD B_TRUE 1 100 0 1 BIT_MASK 0x20 FORMAT "%13.11" ECU_ADDRESS 0x3FE4E0 /end MEASUREMENT
/begin MEASUREMENT B_ben "" UWORD B_TRUE 1 100 0 1 BIT_MASK 0x20 FORMAT "%13.11" ECU_ADDRESS 0x3FE524 /end MEASUREMENT
/begin MEASUREMENT B_bepmbatt "" UWORD B_TRUE 1 100 0 1 BIT_MASK 0x20 FORMAT "%13.11" ECU_ADDRESS 0x3FE53E /end MEASUREMENT
/begin MEASUREMENT B_bepmbn "Bedingung, Bandende Funktionsanforderung PM Bordnetz" UWORD B_TRUE 1 100 0 1 BIT_MASK 0x20 FORMAT "%13.11" ECU_ADDRESS 0x3FE540 /end MEASUREMENT
/begin MEASUREMENT B_betesg "Bedingung: Bandendetest f¸r Groblecktest" UWORD B_TRUE 1 100 0 1 BIT_MASK 0x20 FORMAT "%13.11" ECU_ADDRESS 0x3FE564 /end MEASUREMENT
/begin MEASUREMENT B_bkbm "Bedingung Ersatzwert aktiv: Bezugsmarke" UWORD B_TRUE 1 100 0 1 BIT_MASK 0x40 FORMAT "%13.11" ECU_ADDRESS 0x3FE3BC /end MEASUREMENT
/begin MEASUREMENT B_bkcars "Bedingung Ersatzwert aktiv: CAN-Schnittstelle ARS" UWORD B_TRUE 1 100 0 1 BIT_MASK 0x40 FORMAT "%13.11" ECU_ADDRESS 0x3FE3CA /end MEASUREMENT
/begin MEASUREMENT B_bkccas "Bedingung Ersatzwert aktiv: CAN-Schnittstelle CAS" UWORD B_TRUE 1 100 0 1 BIT_MASK 0x40 FORMAT "%13.11" ECU_ADDRESS 0x3FE3CC /end MEASUREMENT
/begin MEASUREMENT B_bkcdsc "Bedingung Backup : CAN-Schnittstelle, DSC-SG" UWORD B_TRUE 1 100 0 1 BIT_MASK 0x40 FORMAT "%13.11" ECU_ADDRESS 0x3FE3CE /end MEASUREMENT
/begin MEASUREMENT B_bkcegs "Bedingung: CAN-Schnittstelle EGS" UWORD B_TRUE 1 100 0 1 BIT_MASK 0x40 FORMAT "%13.11" ECU_ADDRESS 0x3FE3D0 /end MEASUREMENT
/begin MEASUREMENT B_bkcfc "Bedingung Ersatzwert aktiv Check Filler Cap" UWORD B_TRUE 1 100 0 1 BIT_MASK 0x40 FORMAT "%13.11" ECU_ADDRESS 0x3FE3D2 /end MEASUREMENT
/begin MEASUREMENT B_bkcihka "Bedingung Backup : CAN-Schnittstelle, IHKA-SG" UWORD B_TRUE 1 100 0 1 BIT_MASK 0x40 FORMAT "%13.11" ECU_ADDRESS 0x3FE3D4 /end MEASUREMENT
/begin MEASUREMENT B_bkcins "Bedingung: CAN-Schnittstelle, Timeout Instrument" UWORD B_TRUE 1 100 0 1 BIT_MASK 0x40 FORMAT "%13.11" ECU_ADDRESS 0x3FE3D6 /end MEASUREMENT
/begin MEASUREMENT B_bkcod "Bedingung: Ersatzwert aktiv" UWORD B_TRUE 1 100 0 1 BIT_MASK 0x40 FORMAT "%13.11" ECU_ADDRESS 0x3FE3D8 /end MEASUREMENT
/begin MEASUREMENT B_bkcssg "Bedingung Ersatzwert aktiv: CAN-Schnittstelle SGG-Steuerger‰t" UWORD B_TRUE 1 100 0 1 BIT_MASK 0x40 FORMAT "%13.11" ECU_ADDRESS 0x3FE3DA /end MEASUREMENT
/begin MEASUREMENT B_bkcszl "Bedingung Ersatzwert aktiv: CAN-Schnittstelle SZL" UWORD B_TRUE 1 100 0 1 BIT_MASK 0x40 FORMAT "%13.11" ECU_ADDRESS 0x3FE3DC /end MEASUREMENT
/begin MEASUREMENT B_bkdhdmte "Bedingung Ersatzwert aktiv, DM-TL Heizungsendstufe" UWORD B_TRUE 1 100 0 1 BIT_MASK 0x40 FORMAT "%13.11" ECU_ADDRESS 0x3FE3EC /end MEASUREMENT
/begin MEASUREMENT B_bkdisa "Diagnose verwendet Ersatzwert" UWORD B_TRUE 1 100 0 1 BIT_MASK 0x40 FORMAT "%13.11" ECU_ADDRESS 0x3FE3F4 /end MEASUREMENT
/begin MEASUREMENT B_bkdisat "" UWORD B_TRUE 1 100 0 1 BIT_MASK 0x40 FORMAT "%13.11" ECU_ADDRESS 0x3FE3F6 /end MEASUREMENT
/begin MEASUREMENT B_bkdk "Bedingung Eratzwert aktiv: Fehler Drosselklappenpoti lˆschen" UWORD B_TRUE 1 100 0 1 BIT_MASK 0x40 FORMAT "%13.11" ECU_ADDRESS 0x3FE3F8 /end MEASUREMENT
/begin MEASUREMENT B_bkdk1p "Bedingung Ersatzwert aktiv: Drosselklappe 1.Poti" UWORD B_TRUE 1 100 0 1 BIT_MASK 0x40 FORMAT "%13.11" ECU_ADDRESS 0x3FE3FA /end MEASUREMENT
/begin MEASUREMENT B_bkdk2p "Bedingung Ersatzwert aktiv: Drosselklappe 2.Poti" UWORD B_TRUE 1 100 0 1 BIT_MASK 0x40 FORMAT "%13.11" ECU_ADDRESS 0x3FE3FC /end MEASUREMENT
/begin MEASUREMENT B_bkdmmve "Bedingung Ersatzwert aktiv, DM-TL Magnetventilendstufe" UWORD B_TRUE 1 100 0 1 BIT_MASK 0x40 FORMAT "%13.11" ECU_ADDRESS 0x3FE3FE /end MEASUREMENT
/begin MEASUREMENT B_bkdmpme "Bedingung Ersatzwert aktiv, DM-TL Pumpenmotorendstufe" UWORD B_TRUE 1 100 0 1 BIT_MASK 0x40 FORMAT "%13.11" ECU_ADDRESS 0x3FE400 /end MEASUREMENT
/begin MEASUREMENT B_bkdmtk "Bedingung Ersatzwert aktiv DMTK" UWORD B_TRUE 1 100 0 1 BIT_MASK 0x40 FORMAT "%13.11" ECU_ADDRESS 0x3FE402 /end MEASUREMENT
/begin MEASUREMENT B_bkdmtl "Ersatzwert f¸r DMTL aktiv" UWORD B_TRUE 1 100 0 1 BIT_MASK 0x40 FORMAT "%13.11" ECU_ADDRESS 0x3FE406 /end MEASUREMENT
/begin MEASUREMENT B_bkdpmee "Bedingung Ersatzwert aktiv, DM-TL Pumpenendstufe" UWORD B_TRUE 1 100 0 1 BIT_MASK 0x40 FORMAT "%13.11" ECU_ADDRESS 0x3FE408 /end MEASUREMENT
/begin MEASUREMENT B_bkdvee "Bedingung: DV-E Endstufe" UWORD B_TRUE 1 100 0 1 BIT_MASK 0x40 FORMAT "%13.11" ECU_ADDRESS 0x3FE412 /end MEASUREMENT
/begin MEASUREMENT B_bkdvef "Bedingung: DV-E Fehler bei Federpr¸fung" UWORD B_TRUE 1 100 0 1 BIT_MASK 0x40 FORMAT "%13.11" ECU_ADDRESS 0x3FE414 /end MEASUREMENT
/begin MEASUREMENT B_bkdvefo "Nicht benutzt" UWORD B_TRUE 1 100 0 1 BIT_MASK 0x40 FORMAT "%13.11" ECU_ADDRESS 0x3FE416 /end MEASUREMENT
/begin MEASUREMENT B_bkdvel "Bedingung: DV-E Lageabweichung" UWORD B_TRUE 1 100 0 1 BIT_MASK 0x40 FORMAT "%13.11" ECU_ADDRESS 0x3FE418 /end MEASUREMENT
/begin MEASUREMENT B_bkdven "Ersatzwert aktiv: DV-E Notluftposition" UWORD B_TRUE 1 100 0 1 BIT_MASK 0x40 FORMAT "%13.11" ECU_ADDRESS 0x3FE41A /end MEASUREMENT
/begin MEASUREMENT B_bkdver "Bedingung: DV-E Regelbereich" UWORD B_TRUE 1 100 0 1 BIT_MASK 0x40 FORMAT "%13.11" ECU_ADDRESS 0x3FE41C /end MEASUREMENT
/begin MEASUREMENT B_bkdvet "Nicht benutzt" UWORD B_TRUE 1 100 0 1 BIT_MASK 0x40 FORMAT "%13.11" ECU_ADDRESS 0x3FE422 /end MEASUREMENT
/begin MEASUREMENT B_bkdveu "Ersatzwert aktiv: DV-E UMA-Lernen" UWORD B_TRUE 1 100 0 1 BIT_MASK 0x40 FORMAT "%13.11" ECU_ADDRESS 0x3FE424 /end MEASUREMENT
/begin MEASUREMENT B_bkdveub "Nicht benutzt" UWORD B_TRUE 1 100 0 1 BIT_MASK 0x40 FORMAT "%13.11" ECU_ADDRESS 0x3FE426 /end MEASUREMENT
/begin MEASUREMENT B_bkdveuw "Bedingung Ersatzwert aktiv: Fehler bei UMA-Wiederlernen" UWORD B_TRUE 1 100 0 1 BIT_MASK 0x40 FORMAT "%13.11" ECU_ADDRESS 0x3FE428 /end MEASUREMENT
/begin MEASUREMENT B_bkdvev "Ersatzwert aktiv: DV-E Verst‰rkerabgleich" UWORD B_TRUE 1 100 0 1 BIT_MASK 0x40 FORMAT "%13.11" ECU_ADDRESS 0x3FE42A /end MEASUREMENT
/begin MEASUREMENT B_bkdylsu "Bedingung Ersatzwert aktiv: Dynamikdiagnose LSU" UWORD B_TRUE 1 100 0 1 BIT_MASK 0x40 FORMAT "%13.11" ECU_ADDRESS 0x3FE454 /end MEASUREMENT
/begin MEASUREMENT B_bkdylsu2 "Bedingung Ersatzwert aktiv: Dynamikdiagnose LSU, Bank 2" UWORD B_TRUE 1 100 0 1 BIT_MASK 0x40 FORMAT "%13.11" ECU_ADDRESS 0x3FE456 /end MEASUREMENT
/begin MEASUREMENT B_bkels "Bedingung Ersatzwert aktiv E-Box-L¸fter" UWORD B_TRUE 1 100 0 1 BIT_MASK 0x40 FORMAT "%13.11" ECU_ADDRESS 0x3FE46A /end MEASUREMENT
/begin MEASUREMENT B_bkev1 "Bedingung: Einspritzventil 1 aktiv" UWORD B_TRUE 1 100 0 1 BIT_MASK 0x40 FORMAT "%13.11" ECU_ADDRESS 0x3FE476 /end MEASUREMENT
/begin MEASUREMENT B_bkev2 "Bedingung: Einspritzventil 2 aktiv" UWORD B_TRUE 1 100 0 1 BIT_MASK 0x40 FORMAT "%13.11" ECU_ADDRESS 0x3FE478 /end MEASUREMENT
/begin MEASUREMENT B_bkev3 "Bedingung: Einspritzventil 3 aktiv" UWORD B_TRUE 1 100 0 1 BIT_MASK 0x40 FORMAT "%13.11" ECU_ADDRESS 0x3FE47A /end MEASUREMENT
/begin MEASUREMENT B_bkev4 "Bedingung: Einspritzventil 4 aktiv" UWORD B_TRUE 1 100 0 1 BIT_MASK 0x40 FORMAT "%13.11" ECU_ADDRESS 0x3FE47C /end MEASUREMENT
/begin MEASUREMENT B_bkev5 "Bedingung: Einspritzventil 5 aktiv" UWORD B_TRUE 1 100 0 1 BIT_MASK 0x40 FORMAT "%13.11" ECU_ADDRESS 0x3FE47E /end MEASUREMENT
/begin MEASUREMENT B_bkev6 "Bedingung: Einspritzventil 6 aktiv" UWORD B_TRUE 1 100 0 1 BIT_MASK 0x40 FORMAT "%13.11" ECU_ADDRESS 0x3FE480 /end MEASUREMENT
/begin MEASUREMENT B_bkev7 "Bedingung: Einspritzventil 7 aktiv" UWORD B_TRUE 1 100 0 1 BIT_MASK 0x40 FORMAT "%13.11" ECU_ADDRESS 0x3FE482 /end MEASUREMENT
/begin MEASUREMENT B_bkev8 "Bedingung: Einspritzventil 8 aktiv" UWORD B_TRUE 1 100 0 1 BIT_MASK 0x40 FORMAT "%13.11" ECU_ADDRESS 0x3FE484 /end MEASUREMENT
/begin MEASUREMENT B_bkfst "Bedingung: Ersatzwert aktiv, Tankf¸llstandsgeber" UWORD B_TRUE 1 100 0 1 BIT_MASK 0x40 FORMAT "%13.11" ECU_ADDRESS 0x3FE498 /end MEASUREMENT
/begin MEASUREMENT B_bkglfe "Bedingung Ersatzwert aktiv GLF Endstufe" UWORD B_TRUE 1 100 0 1 BIT_MASK 0x40 FORMAT "%13.11" ECU_ADDRESS 0x3FE49A /end MEASUREMENT
/begin MEASUREMENT B_bkhelsu "Bedingung Ersatzwert aktiv: Heizereinkopplungsdiagnose" UWORD B_TRUE 1 100 0 1 BIT_MASK 0x40 FORMAT "%13.11" ECU_ADDRESS 0x3FE49C /end MEASUREMENT
/begin MEASUREMENT B_bkhelsu2 "Bedingung Ersatzwert aktiv: Heizereinkopplungsdiagnose" UWORD B_TRUE 1 100 0 1 BIT_MASK 0x40 FORMAT "%13.11" ECU_ADDRESS 0x3FE49E /end MEASUREMENT
/begin MEASUREMENT B_bkhsh "Bedingung: Lambdasondenheizung hinter Kat. aktiv" UWORD B_TRUE 1 100 0 1 BIT_MASK 0x40 FORMAT "%13.11" ECU_ADDRESS 0x3FE4A0 /end MEASUREMENT
/begin MEASUREMENT B_bkhsh2 "Bedingung: Lambdasondenheizung hinter Kat. aktiv, Bank 2" UWORD B_TRUE 1 100 0 1 BIT_MASK 0x40 FORMAT "%13.11" ECU_ADDRESS 0x3FE4A2 /end MEASUREMENT
/begin MEASUREMENT B_bkhshe "Bedingung: Lambdasondenheizung hinter Kat. Endstufe" UWORD B_TRUE 1 100 0 1 BIT_MASK 0x40 FORMAT "%13.11" ECU_ADDRESS 0x3FE4A4 /end MEASUREMENT
/begin MEASUREMENT B_bkhshe2 "Bedingung: Lambdasondenheizung hinter Kat. Bank 2 Endstufe" UWORD B_TRUE 1 100 0 1 BIT_MASK 0x40 FORMAT "%13.11" ECU_ADDRESS 0x3FE4A6 /end MEASUREMENT
/begin MEASUREMENT B_bkhsv "Bedingung:Lambdasondenheizung vor Kat. aktiv" UWORD B_TRUE 1 100 0 1 BIT_MASK 0x40 FORMAT "%13.11" ECU_ADDRESS 0x3FE4A8 /end MEASUREMENT
/begin MEASUREMENT B_bkhsv2 "Bedingung:Lambdasondenheizung vor Kat. aktiv, Bank 2" UWORD B_TRUE 1 100 0 1 BIT_MASK 0x40 FORMAT "%13.11" ECU_ADDRESS 0x3FE4AA /end MEASUREMENT
/begin MEASUREMENT B_bkhsve "Bedingung Ersatzwert aktiv: Heizer der LSU" UWORD B_TRUE 1 100 0 1 BIT_MASK 0x40 FORMAT "%13.11" ECU_ADDRESS 0x3FE4AC /end MEASUREMENT
/begin MEASUREMENT B_bkhsve2 "Bedingung Ersatzwert aktiv: Heizer der LSU, Bank 2" UWORD B_TRUE 1 100 0 1 BIT_MASK 0x40 FORMAT "%13.11" ECU_ADDRESS 0x3FE4AE /end MEASUREMENT
/begin MEASUREMENT B_bkkpe "Bedingung Ersatzwert f¸r EKP-Relais Endstufe" UWORD B_TRUE 1 100 0 1 BIT_MASK 0x40 FORMAT "%13.11" ECU_ADDRESS 0x3FE4BE /end MEASUREMENT
/begin MEASUREMENT B_bklm "Bedingung: Hauptlastsensor aktiv" UWORD B_TRUE 1 100 0 1 BIT_MASK 0x40 FORMAT "%13.11" ECU_ADDRESS 0x3FE4E0 /end MEASUREMENT
/begin MEASUREMENT B_bkn "Bedingung: Drehzahlsignalgeber aktiv" UWORD B_TRUE 1 100 0 1 BIT_MASK 0x40 FORMAT "%13.11" ECU_ADDRESS 0x3FE524 /end MEASUREMENT
/begin MEASUREMENT B_bkpmbatt "" UWORD B_TRUE 1 100 0 1 BIT_MASK 0x40 FORMAT "%13.11" ECU_ADDRESS 0x3FE53E /end MEASUREMENT
/begin MEASUREMENT B_bkpmbn "Bedingung, Ersatzwert aktiv PM Bordnetz" UWORD B_TRUE 1 100 0 1 BIT_MASK 0x40 FORMAT "%13.11" ECU_ADDRESS 0x3FE540 /end MEASUREMENT
/begin MEASUREMENT B_bktesg "Bedingung Ersatzwert aktiv Tankdiagnose Grobleck" UWORD B_TRUE 1 100 0 1 BIT_MASK 0x40 FORMAT "%13.11" ECU_ADDRESS 0x3FE564 /end MEASUREMENT
/begin MEASUREMENT B_clbm "Bedingung Fehlerpfad Bezugsmarkengeber lˆschen" UWORD B_TRUE 1 100 0 1 BIT_MASK 0x80 FORMAT "%13.11" ECU_ADDRESS 0x3FE3BC /end MEASUREMENT
/begin MEASUREMENT B_clcars "Bedingung Fehlerpfad CARS lˆschen" UWORD B_TRUE 1 100 0 1 BIT_MASK 0x80 FORMAT "%13.11" ECU_ADDRESS 0x3FE3CA /end MEASUREMENT
/begin MEASUREMENT B_clccas "Bedingung Fehlerpfad CCAS lˆschen" UWORD B_TRUE 1 100 0 1 BIT_MASK 0x80 FORMAT "%13.11" ECU_ADDRESS 0x3FE3CC /end MEASUREMENT
/begin MEASUREMENT B_clcdsc "Bedingung Fehlerpfad CDSC lˆschen" UWORD B_TRUE 1 100 0 1 BIT_MASK 0x80 FORMAT "%13.11" ECU_ADDRESS 0x3FE3CE /end MEASUREMENT
/begin MEASUREMENT B_clcegs "Bedingung Fehlerpfad EGS lˆschen" UWORD B_TRUE 1 100 0 1 BIT_MASK 0x80 FORMAT "%13.11" ECU_ADDRESS 0x3FE3D0 /end MEASUREMENT
/begin MEASUREMENT B_clcfc "Bedingung Fehlerflag offener Tankdeckel lˆschen" UWORD B_TRUE 1 100 0 1 BIT_MASK 0x80 FORMAT "%13.11" ECU_ADDRESS 0x3FE3D2 /end MEASUREMENT
/begin MEASUREMENT B_clcihka "Bedingung Fehlerpfad CIHKA lˆschen" UWORD B_TRUE 1 100 0 1 BIT_MASK 0x80 FORMAT "%13.11" ECU_ADDRESS 0x3FE3D4 /end MEASUREMENT
/begin MEASUREMENT B_clcins "Bedingung Fehlerpfad CINS lˆschen" UWORD B_TRUE 1 100 0 1 BIT_MASK 0x80 FORMAT "%13.11" ECU_ADDRESS 0x3FE3D6 /end MEASUREMENT
/begin MEASUREMENT B_clcod "Bedingung Fehlerpfad E_COD lˆschen" UWORD B_TRUE 1 100 0 1 BIT_MASK 0x80 FORMAT "%13.11" ECU_ADDRESS 0x3FE3D8 /end MEASUREMENT
/begin MEASUREMENT B_clcssg "Bedingung Fehlerpfad CSSG lˆschen" UWORD B_TRUE 1 100 0 1 BIT_MASK 0x80 FORMAT "%13.11" ECU_ADDRESS 0x3FE3DA /end MEASUREMENT
/begin MEASUREMENT B_clcszl "Bedingung Fehlerpfad CSZL  lˆschen" UWORD B_TRUE 1 100 0 1 BIT_MASK 0x80 FORMAT "%13.11" ECU_ADDRESS 0x3FE3DC /end MEASUREMENT
/begin MEASUREMENT B_cldhdmte "Bedingung Fehlerpfad DHDMTE lˆschen" UWORD B_TRUE 1 100 0 1 BIT_MASK 0x80 FORMAT "%13.11" ECU_ADDRESS 0x3FE3EC /end MEASUREMENT
/begin MEASUREMENT B_cldisa "" UWORD B_TRUE 1 100 0 1 BIT_MASK 0x80 FORMAT "%13.11" ECU_ADDRESS 0x3FE3F4 /end MEASUREMENT
/begin MEASUREMENT B_cldisat "" UWORD B_TRUE 1 100 0 1 BIT_MASK 0x80 FORMAT "%13.11" ECU_ADDRESS 0x3FE3F6 /end MEASUREMENT
/begin MEASUREMENT B_cldk "Bedingung Fehlerpfad DK (Drosselklappen-Poti) lˆschen" UWORD B_TRUE 1 100 0 1 BIT_MASK 0x80 FORMAT "%13.11" ECU_ADDRESS 0x3FE3F8 /end MEASUREMENT
/begin MEASUREMENT B_cldk1p "Bedingung Fehlerpfad DK1P (Drosselklappen-Poti 1) lˆschen" UWORD B_TRUE 1 100 0 1 BIT_MASK 0x80 FORMAT "%13.11" ECU_ADDRESS 0x3FE3FA /end MEASUREMENT
/begin MEASUREMENT B_cldk2p "Bedingung Fehlerpfad DK2P (Drosselklappen-Poti 2) lˆschen" UWORD B_TRUE 1 100 0 1 BIT_MASK 0x80 FORMAT "%13.11" ECU_ADDRESS 0x3FE3FC /end MEASUREMENT
/begin MEASUREMENT B_cldmmve "Bedingung Fehlerpfad DMMVE lˆschen" UWORD B_TRUE 1 100 0 1 BIT_MASK 0x80 FORMAT "%13.11" ECU_ADDRESS 0x3FE3FE /end MEASUREMENT
/begin MEASUREMENT B_cldmpme "Bedingung Fehlerpfad DMPME lˆschen" UWORD B_TRUE 1 100 0 1 BIT_MASK 0x80 FORMAT "%13.11" ECU_ADDRESS 0x3FE400 /end MEASUREMENT
/begin MEASUREMENT B_cldmtk "Bedingung Fehlerflag Feinstleck lˆschen" UWORD B_TRUE 1 100 0 1 BIT_MASK 0x80 FORMAT "%13.11" ECU_ADDRESS 0x3FE402 /end MEASUREMENT
/begin MEASUREMENT B_cldmtl "Bedingung Fehlerflag DMTL-Modul lˆschen" UWORD B_TRUE 1 100 0 1 BIT_MASK 0x80 FORMAT "%13.11" ECU_ADDRESS 0x3FE406 /end MEASUREMENT
/begin MEASUREMENT B_cldpmee "Bedingung Fehlerpfad DPMEE lˆschen" UWORD B_TRUE 1 100 0 1 BIT_MASK 0x80 FORMAT "%13.11" ECU_ADDRESS 0x3FE408 /end MEASUREMENT
/begin MEASUREMENT B_cldvee "Flag f¸r Lˆschmaﬂnahmen: DV-E Endstufe" UWORD B_TRUE 1 100 0 1 BIT_MASK 0x80 FORMAT "%13.11" ECU_ADDRESS 0x3FE412 /end MEASUREMENT
/begin MEASUREMENT B_cldvef "Flag f¸r Lˆschung: DV-E Fehler bei Federpr¸fung" UWORD B_TRUE 1 100 0 1 BIT_MASK 0x80 FORMAT "%13.11" ECU_ADDRESS 0x3FE414 /end MEASUREMENT
/begin MEASUREMENT B_cldvefo "Flag f¸r Lˆschung: Fehler bei Federpr¸fung ""÷ffnen""" UWORD B_TRUE 1 100 0 1 BIT_MASK 0x80 FORMAT "%13.11" ECU_ADDRESS 0x3FE416 /end MEASUREMENT
/begin MEASUREMENT B_cldvel "Flag f¸r Lˆschmaﬂnahmen: DV-E Lageabweichung" UWORD B_TRUE 1 100 0 1 BIT_MASK 0x80 FORMAT "%13.11" ECU_ADDRESS 0x3FE418 /end MEASUREMENT
/begin MEASUREMENT B_cldven "Flag f¸r Lˆschung: DV-E Fehler bei Pr¸fung Notluftposition" UWORD B_TRUE 1 100 0 1 BIT_MASK 0x80 FORMAT "%13.11" ECU_ADDRESS 0x3FE41A /end MEASUREMENT
/begin MEASUREMENT B_cldver "Flag f¸r Lˆschmaﬂnahmen: DV-E Regelabweichung" UWORD B_TRUE 1 100 0 1 BIT_MASK 0x80 FORMAT "%13.11" ECU_ADDRESS 0x3FE41C /end MEASUREMENT
/begin MEASUREMENT B_cldvet "Flag f¸r Lˆschung: DV-E-Tauscherkennung ohne Adaption" UWORD B_TRUE 1 100 0 1 BIT_MASK 0x80 FORMAT "%13.11" ECU_ADDRESS 0x3FE422 /end MEASUREMENT
/begin MEASUREMENT B_cldveu "Flag f¸r Lˆschung: DV-E Fehler beim UMA-Lernen" UWORD B_TRUE 1 100 0 1 BIT_MASK 0x80 FORMAT "%13.11" ECU_ADDRESS 0x3FE424 /end MEASUREMENT
/begin MEASUREMENT B_cldveub "Flag f¸r Lˆschung: DV-E-Adaption Abbruch wg. Umweltbedingung" UWORD B_TRUE 1 100 0 1 BIT_MASK 0x80 FORMAT "%13.11" ECU_ADDRESS 0x3FE426 /end MEASUREMENT
/begin MEASUREMENT B_cldveuw "Flag f¸r Lˆschung: Fehler bei UMA-Wiederlernen" UWORD B_TRUE 1 100 0 1 BIT_MASK 0x80 FORMAT "%13.11" ECU_ADDRESS 0x3FE428 /end MEASUREMENT
/begin MEASUREMENT B_cldvev "Flag f¸r Lˆschung: DV-E Fehler bei Verst‰rkerabgleich" UWORD B_TRUE 1 100 0 1 BIT_MASK 0x80 FORMAT "%13.11" ECU_ADDRESS 0x3FE42A /end MEASUREMENT
/begin MEASUREMENT B_cldylsu "Fehlerpfad in DDYLSU lˆschen." UWORD B_TRUE 1 100 0 1 BIT_MASK 0x80 FORMAT "%13.11" ECU_ADDRESS 0x3FE454 /end MEASUREMENT
/begin MEASUREMENT B_cldylsu2 "Fehlerpfad in DDYLSU lˆschen, Bank 2" UWORD B_TRUE 1 100 0 1 BIT_MASK 0x80 FORMAT "%13.11" ECU_ADDRESS 0x3FE456 /end MEASUREMENT
/begin MEASUREMENT B_clels "Bedingung Fehlerpfad ELS lˆschen" UWORD B_TRUE 1 100 0 1 BIT_MASK 0x80 FORMAT "%13.11" ECU_ADDRESS 0x3FE46A /end MEASUREMENT
/begin MEASUREMENT B_clev1 "Bedingung Fehlerpfad EV 1 lˆschen" UWORD B_TRUE 1 100 0 1 BIT_MASK 0x80 FORMAT "%13.11" ECU_ADDRESS 0x3FE476 /end MEASUREMENT
/begin MEASUREMENT B_clev2 "Bedingung Fehlerpfad EV 2 lˆschen" UWORD B_TRUE 1 100 0 1 BIT_MASK 0x80 FORMAT "%13.11" ECU_ADDRESS 0x3FE478 /end MEASUREMENT
/begin MEASUREMENT B_clev3 "Bedingung Fehlerpfad EV 3 lˆschen" UWORD B_TRUE 1 100 0 1 BIT_MASK 0x80 FORMAT "%13.11" ECU_ADDRESS 0x3FE47A /end MEASUREMENT
/begin MEASUREMENT B_clev4 "Bedingung Fehlerpfad EV 4 lˆschen" UWORD B_TRUE 1 100 0 1 BIT_MASK 0x80 FORMAT "%13.11" ECU_ADDRESS 0x3FE47C /end MEASUREMENT
/begin MEASUREMENT B_clev5 "Bedingung Fehlerpfad EV 5 lˆschen" UWORD B_TRUE 1 100 0 1 BIT_MASK 0x80 FORMAT "%13.11" ECU_ADDRESS 0x3FE47E /end MEASUREMENT
/begin MEASUREMENT B_clev6 "Bedingung Fehlerpfad EV 6 lˆschen" UWORD B_TRUE 1 100 0 1 BIT_MASK 0x80 FORMAT "%13.11" ECU_ADDRESS 0x3FE480 /end MEASUREMENT
/begin MEASUREMENT B_clev7 "Bedingung Fehlerpfad EV 7 lˆschen" UWORD B_TRUE 1 100 0 1 BIT_MASK 0x80 FORMAT "%13.11" ECU_ADDRESS 0x3FE482 /end MEASUREMENT
/begin MEASUREMENT B_clev8 "Bedingung Fehlerpfad EV 8 lˆschen" UWORD B_TRUE 1 100 0 1 BIT_MASK 0x80 FORMAT "%13.11" ECU_ADDRESS 0x3FE484 /end MEASUREMENT
/begin MEASUREMENT B_clfst "Fehlerpfad in GGFST lˆschen" UWORD B_TRUE 1 100 0 1 BIT_MASK 0x80 FORMAT "%13.11" ECU_ADDRESS 0x3FE498 /end MEASUREMENT
/begin MEASUREMENT B_clglfe "Bedingung Fehlerpfad GLF Endstufe lˆschen" UWORD B_TRUE 1 100 0 1 BIT_MASK 0x80 FORMAT "%13.11" ECU_ADDRESS 0x3FE49A /end MEASUREMENT
/begin MEASUREMENT B_clhelsu "Bedingung Fehlerflag ""Heizereinkopplung LSU"" lˆschen" UWORD B_TRUE 1 100 0 1 BIT_MASK 0x80 FORMAT "%13.11" ECU_ADDRESS 0x3FE49C /end MEASUREMENT
/begin MEASUREMENT B_clhelsu2 "Bedingung Fehlerflag ""Heizereinkopplung LSU"" lˆschen, Bank 2" UWORD B_TRUE 1 100 0 1 BIT_MASK 0x80 FORMAT "%13.11" ECU_ADDRESS 0x3FE49E /end MEASUREMENT
/begin MEASUREMENT B_clhsh "Bedingung Fehlerpfad DHLSHK lˆschen" UWORD B_TRUE 1 100 0 1 BIT_MASK 0x80 FORMAT "%13.11" ECU_ADDRESS 0x3FE4A0 /end MEASUREMENT
/begin MEASUREMENT B_clhsh2 "Bedingung Fehlerpfad DHLSHK2 lˆschen" UWORD B_TRUE 1 100 0 1 BIT_MASK 0x80 FORMAT "%13.11" ECU_ADDRESS 0x3FE4A2 /end MEASUREMENT
/begin MEASUREMENT B_clhshe "Bedingung Fehlerpfad DHLSHK lˆschen (Endstufe)" UWORD B_TRUE 1 100 0 1 BIT_MASK 0x80 FORMAT "%13.11" ECU_ADDRESS 0x3FE4A4 /end MEASUREMENT
/begin MEASUREMENT B_clhshe2 "Bedingung Fehlerpfad DHLSHK2 lˆschen (Endstufe)" UWORD B_TRUE 1 100 0 1 BIT_MASK 0x80 FORMAT "%13.11" ECU_ADDRESS 0x3FE4A6 /end MEASUREMENT
/begin MEASUREMENT B_clhsv "Bedingung Fehlerpfad DHLSVK lˆschen" UWORD B_TRUE 1 100 0 1 BIT_MASK 0x80 FORMAT "%13.11" ECU_ADDRESS 0x3FE4A8 /end MEASUREMENT
/begin MEASUREMENT B_clhsv2 "Bedingung Fehlerpfad DHLSVK2 lˆschen" UWORD B_TRUE 1 100 0 1 BIT_MASK 0x80 FORMAT "%13.11" ECU_ADDRESS 0x3FE4AA /end MEASUREMENT
/begin MEASUREMENT B_clhsve "Bedingung Fehlerpfad DHLSVK lˆschen (Endstufe)" UWORD B_TRUE 1 100 0 1 BIT_MASK 0x80 FORMAT "%13.11" ECU_ADDRESS 0x3FE4AC /end MEASUREMENT
/begin MEASUREMENT B_clhsve2 "Bedingung Fehlerpfad DHLSVK2 lˆschen (Endstufe)" UWORD B_TRUE 1 100 0 1 BIT_MASK 0x80 FORMAT "%13.11" ECU_ADDRESS 0x3FE4AE /end MEASUREMENT
/begin MEASUREMENT B_clkpe "Bedingung Fehlerpfad EKP-Relais Endstufe lˆschen" UWORD B_TRUE 1 100 0 1 BIT_MASK 0x80 FORMAT "%13.11" ECU_ADDRESS 0x3FE4BE /end MEASUREMENT
/begin MEASUREMENT B_cllm "Bedingung: Fehlerpfad Hauptf¸llungssensor lˆschen" UWORD B_TRUE 1 100 0 1 BIT_MASK 0x80 FORMAT "%13.11" ECU_ADDRESS 0x3FE4E0 /end MEASUREMENT
/begin MEASUREMENT B_cln "Bedingung Fehlerpfad Drehzahlgeber lˆschen" UWORD B_TRUE 1 100 0 1 BIT_MASK 0x80 FORMAT "%13.11" ECU_ADDRESS 0x3FE524 /end MEASUREMENT
/begin MEASUREMENT B_clpmbatt "" UWORD B_TRUE 1 100 0 1 BIT_MASK 0x80 FORMAT "%13.11" ECU_ADDRESS 0x3FE53E /end MEASUREMENT
/begin MEASUREMENT B_clpmbn "Fehlerpfad lˆschen f¸r PM Bordnetz" UWORD B_TRUE 1 100 0 1 BIT_MASK 0x80 FORMAT "%13.11" ECU_ADDRESS 0x3FE540 /end MEASUREMENT
/begin MEASUREMENT B_cltesg "Bedingung Fehlerflag ""Grobleckfehler"" lˆschen" UWORD B_TRUE 1 100 0 1 BIT_MASK 0x80 FORMAT "%13.11" ECU_ADDRESS 0x3FE564 /end MEASUREMENT
/begin MEASUREMENT B_ftbm "" UWORD B_TRUE 1 100 0 1 BIT_MASK 0x10 FORMAT "%13.11" ECU_ADDRESS 0x3FE3BC /end MEASUREMENT
/begin MEASUREMENT B_ftcars "Bedingung Fehlereintrag durch Tester: CAN-Schnittstelle ARS" UWORD B_TRUE 1 100 0 1 BIT_MASK 0x10 FORMAT "%13.11" ECU_ADDRESS 0x3FE3CA /end MEASUREMENT
/begin MEASUREMENT B_ftccas "Bedingung Fehlereintrag durch Tester: CAN-Schnittstelle CAS" UWORD B_TRUE 1 100 0 1 BIT_MASK 0x10 FORMAT "%13.11" ECU_ADDRESS 0x3FE3CC /end MEASUREMENT
/begin MEASUREMENT B_ftcdsc "Bedingung Fehlereintrag durch Tester: CAN-Schnittstelle DSC" UWORD B_TRUE 1 100 0 1 BIT_MASK 0x10 FORMAT "%13.11" ECU_ADDRESS 0x3FE3CE /end MEASUREMENT
/begin MEASUREMENT B_ftcegs "Bedingung Fehlereintrag durch Tester: CAN-Schnittstelle EGS" UWORD B_TRUE 1 100 0 1 BIT_MASK 0x10 FORMAT "%13.11" ECU_ADDRESS 0x3FE3D0 /end MEASUREMENT
/begin MEASUREMENT B_ftcfc "Bedingung Fehlereintrag durch Tester Check Filler Cap" UWORD B_TRUE 1 100 0 1 BIT_MASK 0x10 FORMAT "%13.11" ECU_ADDRESS 0x3FE3D2 /end MEASUREMENT
/begin MEASUREMENT B_ftcihka "Bedingung Fehlereintrag durch Tester: CAN-Schnittstelle IHKA" UWORD B_TRUE 1 100 0 1 BIT_MASK 0x10 FORMAT "%13.11" ECU_ADDRESS 0x3FE3D4 /end MEASUREMENT
/begin MEASUREMENT B_ftcins "Bedingung Fehlereintrag durch Tester : Botschaft Kombi" UWORD B_TRUE 1 100 0 1 BIT_MASK 0x10 FORMAT "%13.11" ECU_ADDRESS 0x3FE3D6 /end MEASUREMENT
/begin MEASUREMENT B_ftcod "Bedingung: Fehlereintrag durch Tester" UWORD B_TRUE 1 100 0 1 BIT_MASK 0x10 FORMAT "%13.11" ECU_ADDRESS 0x3FE3D8 /end MEASUREMENT
/begin MEASUREMENT B_ftcssg "Bedingung Fehlereintrag durch Tester: CAN-Schnittstelle SGG-Steuerger‰t" UWORD B_TRUE 1 100 0 1 BIT_MASK 0x10 FORMAT "%13.11" ECU_ADDRESS 0x3FE3DA /end MEASUREMENT
/begin MEASUREMENT B_ftcszl "Bedingung Fehlereintrag durch Tester: CAN-Schnittstelle SZL" UWORD B_TRUE 1 100 0 1 BIT_MASK 0x10 FORMAT "%13.11" ECU_ADDRESS 0x3FE3DC /end MEASUREMENT
/begin MEASUREMENT B_ftdhdmte "Bedingung Fehlereintrag durch Tester DM-TL Heizung" UWORD B_TRUE 1 100 0 1 BIT_MASK 0x10 FORMAT "%13.11" ECU_ADDRESS 0x3FE3EC /end MEASUREMENT
/begin MEASUREMENT B_ftdisa "Pruefung durch Kundendiensttester" UWORD B_TRUE 1 100 0 1 BIT_MASK 0x10 FORMAT "%13.11" ECU_ADDRESS 0x3FE3F4 /end MEASUREMENT
/begin MEASUREMENT B_ftdisat "" UWORD B_TRUE 1 100 0 1 BIT_MASK 0x10 FORMAT "%13.11" ECU_ADDRESS 0x3FE3F6 /end MEASUREMENT
/begin MEASUREMENT B_ftdk "Condition fault entry by tester for DK" UWORD B_TRUE 1 100 0 1 BIT_MASK 0x10 FORMAT "%13.11" ECU_ADDRESS 0x3FE3F8 /end MEASUREMENT
/begin MEASUREMENT B_ftdk1p "Nicht benutzt" UWORD B_TRUE 1 100 0 1 BIT_MASK 0x10 FORMAT "%13.11" ECU_ADDRESS 0x3FE3FA /end MEASUREMENT
/begin MEASUREMENT B_ftdk2p "Nicht benutzt" UWORD B_TRUE 1 100 0 1 BIT_MASK 0x10 FORMAT "%13.11" ECU_ADDRESS 0x3FE3FC /end MEASUREMENT
/begin MEASUREMENT B_ftdmmve "Bedingung Fehlereintrag durch Tester DM-TL Magnetventil" UWORD B_TRUE 1 100 0 1 BIT_MASK 0x10 FORMAT "%13.11" ECU_ADDRESS 0x3FE3FE /end MEASUREMENT
/begin MEASUREMENT B_ftdmpme "Bedingung Fehlereintrag durch Tester DM-TL Pumpenmotor" UWORD B_TRUE 1 100 0 1 BIT_MASK 0x10 FORMAT "%13.11" ECU_ADDRESS 0x3FE400 /end MEASUREMENT
/begin MEASUREMENT B_ftdmtk "Bedingung Fehlereintrag durch Tester DMTK" UWORD B_TRUE 1 100 0 1 BIT_MASK 0x10 FORMAT "%13.11" ECU_ADDRESS 0x3FE402 /end MEASUREMENT
/begin MEASUREMENT B_ftdmtl "Bedingung Fehlereintrag durch Tester DMTL" UWORD B_TRUE 1 100 0 1 BIT_MASK 0x10 FORMAT "%13.11" ECU_ADDRESS 0x3FE406 /end MEASUREMENT
/begin MEASUREMENT B_ftdpmee "Bedingung Fehlereintrag durch Tester DM-TL Pumpe" UWORD B_TRUE 1 100 0 1 BIT_MASK 0x10 FORMAT "%13.11" ECU_ADDRESS 0x3FE408 /end MEASUREMENT
/begin MEASUREMENT B_ftdvee "Nicht benutzt" UWORD B_TRUE 1 100 0 1 BIT_MASK 0x10 FORMAT "%13.11" ECU_ADDRESS 0x3FE412 /end MEASUREMENT
/begin MEASUREMENT B_ftdvef "Nicht benutzt" UWORD B_TRUE 1 100 0 1 BIT_MASK 0x10 FORMAT "%13.11" ECU_ADDRESS 0x3FE414 /end MEASUREMENT
/begin MEASUREMENT B_ftdvefo "Nicht benutzt" UWORD B_TRUE 1 100 0 1 BIT_MASK 0x10 FORMAT "%13.11" ECU_ADDRESS 0x3FE416 /end MEASUREMENT
/begin MEASUREMENT B_ftdvel "Nicht benutzt" UWORD B_TRUE 1 100 0 1 BIT_MASK 0x10 FORMAT "%13.11" ECU_ADDRESS 0x3FE418 /end MEASUREMENT
/begin MEASUREMENT B_ftdven "Nicht benutzt" UWORD B_TRUE 1 100 0 1 BIT_MASK 0x10 FORMAT "%13.11" ECU_ADDRESS 0x3FE41A /end MEASUREMENT
/begin MEASUREMENT B_ftdver "Nicht benutzt" UWORD B_TRUE 1 100 0 1 BIT_MASK 0x10 FORMAT "%13.11" ECU_ADDRESS 0x3FE41C /end MEASUREMENT
/begin MEASUREMENT B_ftdvet "Nicht benutzt" UWORD B_TRUE 1 100 0 1 BIT_MASK 0x10 FORMAT "%13.11" ECU_ADDRESS 0x3FE422 /end MEASUREMENT
/begin MEASUREMENT B_ftdveu "Nicht benutzt" UWORD B_TRUE 1 100 0 1 BIT_MASK 0x10 FORMAT "%13.11" ECU_ADDRESS 0x3FE424 /end MEASUREMENT
/begin MEASUREMENT B_ftdveub "Nicht benutzt" UWORD B_TRUE 1 100 0 1 BIT_MASK 0x10 FORMAT "%13.11" ECU_ADDRESS 0x3FE426 /end MEASUREMENT
/begin MEASUREMENT B_ftdveuw "Nicht benutzt" UWORD B_TRUE 1 100 0 1 BIT_MASK 0x10 FORMAT "%13.11" ECU_ADDRESS 0x3FE428 /end MEASUREMENT
/begin MEASUREMENT B_ftdvev "Nicht benutzt" UWORD B_TRUE 1 100 0 1 BIT_MASK 0x10 FORMAT "%13.11" ECU_ADDRESS 0x3FE42A /end MEASUREMENT
/begin MEASUREMENT B_ftdylsu "Bedingung Fehlereintrag durch Tester f¸r Dynamikdiagnose LSU" UWORD B_TRUE 1 100 0 1 BIT_MASK 0x10 FORMAT "%13.11" ECU_ADDRESS 0x3FE454 /end MEASUREMENT
/begin MEASUREMENT B_ftdylsu2 "Bedingung Fehlereintrag durch Tester f¸r Dynamikdiagnose LSU, Bank 2" UWORD B_TRUE 1 100 0 1 BIT_MASK 0x10 FORMAT "%13.11" ECU_ADDRESS 0x3FE456 /end MEASUREMENT
/begin MEASUREMENT B_ftels "Bedingung: Fehlereintrag durch Tester f¸r E-Box-L¸fter" UWORD B_TRUE 1 100 0 1 BIT_MASK 0x10 FORMAT "%13.11" ECU_ADDRESS 0x3FE46A /end MEASUREMENT
/begin MEASUREMENT B_ftev1 "Bedingung: Fehlereintrag durch Tester f¸r Endstufendiagnose EV1" UWORD B_TRUE 1 100 0 1 BIT_MASK 0x10 FORMAT "%13.11" ECU_ADDRESS 0x3FE476 /end MEASUREMENT
/begin MEASUREMENT B_ftev2 "Bedingung: Fehlereintrag durch Tester f¸r Endstufendiagnose EV2" UWORD B_TRUE 1 100 0 1 BIT_MASK 0x10 FORMAT "%13.11" ECU_ADDRESS 0x3FE478 /end MEASUREMENT
/begin MEASUREMENT B_ftev3 "Bedingung: Fehlereintrag durch Tester f¸r Endstufendiagnose EV3" UWORD B_TRUE 1 100 0 1 BIT_MASK 0x10 FORMAT "%13.11" ECU_ADDRESS 0x3FE47A /end MEASUREMENT
/begin MEASUREMENT B_ftev4 "Bedingung: Fehlereintrag durch Tester f¸r Endstufendiagnose EV4" UWORD B_TRUE 1 100 0 1 BIT_MASK 0x10 FORMAT "%13.11" ECU_ADDRESS 0x3FE47C /end MEASUREMENT
/begin MEASUREMENT B_ftev5 "Bedingung: Fehlereintrag durch Tester f¸r Endstufendiagnose EV5" UWORD B_TRUE 1 100 0 1 BIT_MASK 0x10 FORMAT "%13.11" ECU_ADDRESS 0x3FE47E /end MEASUREMENT
/begin MEASUREMENT B_ftev6 "Bedingung: Fehlereintrag durch Tester f¸r Endstufendiagnose EV6" UWORD B_TRUE 1 100 0 1 BIT_MASK 0x10 FORMAT "%13.11" ECU_ADDRESS 0x3FE480 /end MEASUREMENT
/begin MEASUREMENT B_ftev7 "Bedingung: Fehlereintrag durch Tester f¸r Endstufendiagnose EV7" UWORD B_TRUE 1 100 0 1 BIT_MASK 0x10 FORMAT "%13.11" ECU_ADDRESS 0x3FE482 /end MEASUREMENT
/begin MEASUREMENT B_ftev8 "Bedingung: Fehlereintrag durch Tester f¸r Endstufendiagnose EV8" UWORD B_TRUE 1 100 0 1 BIT_MASK 0x10 FORMAT "%13.11" ECU_ADDRESS 0x3FE484 /end MEASUREMENT
/begin MEASUREMENT B_ftfst "Bedingung: Fehlereintrag durch Tester FST" UWORD B_TRUE 1 100 0 1 BIT_MASK 0x10 FORMAT "%13.11" ECU_ADDRESS 0x3FE498 /end MEASUREMENT
/begin MEASUREMENT B_ftglfe "Bedingung: Fehlereintrag durch Tester f¸r GLF Endstufe" UWORD B_TRUE 1 100 0 1 BIT_MASK 0x10 FORMAT "%13.11" ECU_ADDRESS 0x3FE49A /end MEASUREMENT
/begin MEASUREMENT B_fthelsu "Bedingung Fehlereintrag durch Tester: Heizereinkopplung" UWORD B_TRUE 1 100 0 1 BIT_MASK 0x10 FORMAT "%13.11" ECU_ADDRESS 0x3FE49C /end MEASUREMENT
/begin MEASUREMENT B_fthelsu2 "Bedingung Fehlereintrag durch Tester: Heizereinkopplung" UWORD B_TRUE 1 100 0 1 BIT_MASK 0x10 FORMAT "%13.11" ECU_ADDRESS 0x3FE49E /end MEASUREMENT
/begin MEASUREMENT B_fthsh "Bedingung Fehlereintrag durch Tester f¸r Lambdasonden-Heizung hinter Kat" UWORD B_TRUE 1 100 0 1 BIT_MASK 0x10 FORMAT "%13.11" ECU_ADDRESS 0x3FE4A0 /end MEASUREMENT
/begin MEASUREMENT B_fthsh2 "Bedingung Fehlereintrag durch Tester f¸r Lambdasonden-Heizung 2 hinter Kat" UWORD B_TRUE 1 100 0 1 BIT_MASK 0x10 FORMAT "%13.11" ECU_ADDRESS 0x3FE4A2 /end MEASUREMENT
/begin MEASUREMENT B_fthshe "Bedingung Fehlereintrag durch Tester f¸r Endstufe LS-Heizung hinter Kat" UWORD B_TRUE 1 100 0 1 BIT_MASK 0x10 FORMAT "%13.11" ECU_ADDRESS 0x3FE4A4 /end MEASUREMENT
/begin MEASUREMENT B_fthshe2 "Bedingung Fehlereintrag durch Tester f¸r Endstufe LS-Heizung hinter Kat, Bank 2" UWORD B_TRUE 1 100 0 1 BIT_MASK 0x10 FORMAT "%13.11" ECU_ADDRESS 0x3FE4A6 /end MEASUREMENT
/begin MEASUREMENT B_fthsv "Bedingung Fehlereintrag durch Tester f¸r LSU-Heizung" UWORD B_TRUE 1 100 0 1 BIT_MASK 0x10 FORMAT "%13.11" ECU_ADDRESS 0x3FE4A8 /end MEASUREMENT
/begin MEASUREMENT B_fthsv2 "Bedingung Fehlereintrag durch Tester f¸r LSU-Heizung, Bank 2" UWORD B_TRUE 1 100 0 1 BIT_MASK 0x10 FORMAT "%13.11" ECU_ADDRESS 0x3FE4AA /end MEASUREMENT
/begin MEASUREMENT B_fthsve "Bedingung Fehlereintrag durch Tester f¸r Heizer der LSU" UWORD B_TRUE 1 100 0 1 BIT_MASK 0x10 FORMAT "%13.11" ECU_ADDRESS 0x3FE4AC /end MEASUREMENT
/begin MEASUREMENT B_fthsve2 "Bedingung Fehlereintrag durch Tester f¸r Heizer der LSU, Bank 2" UWORD B_TRUE 1 100 0 1 BIT_MASK 0x10 FORMAT "%13.11" ECU_ADDRESS 0x3FE4AE /end MEASUREMENT
/begin MEASUREMENT B_ftkpe "Bedingung: Fehlereintrag durch Tester f¸r Endstufendiagnose EKP" UWORD B_TRUE 1 100 0 1 BIT_MASK 0x10 FORMAT "%13.11" ECU_ADDRESS 0x3FE4BE /end MEASUREMENT
/begin MEASUREMENT B_ftlm "Bedingung: Fehlereintrag durch Tester f¸r Luftmassensensor (HFM/DSS/DK)" UWORD B_TRUE 1 100 0 1 BIT_MASK 0x10 FORMAT "%13.11" ECU_ADDRESS 0x3FE4E0 /end MEASUREMENT
/begin MEASUREMENT B_ftn "" UWORD B_TRUE 1 100 0 1 BIT_MASK 0x10 FORMAT "%13.11" ECU_ADDRESS 0x3FE524 /end MEASUREMENT
/begin MEASUREMENT B_ftpmbatt "" UWORD B_TRUE 1 100 0 1 BIT_MASK 0x10 FORMAT "%13.11" ECU_ADDRESS 0x3FE53E /end MEASUREMENT
/begin MEASUREMENT B_ftpmbn "Bedingung, Fehlereintrag durch Tester, PM Bordnetz" UWORD B_TRUE 1 100 0 1 BIT_MASK 0x10 FORMAT "%13.11" ECU_ADDRESS 0x3FE540 /end MEASUREMENT
/begin MEASUREMENT B_fttesg "Bedingung: Fehlereintrag durch Tester f¸r Grobleck" UWORD B_TRUE 1 100 0 1 BIT_MASK 0x10 FORMAT "%13.11" ECU_ADDRESS 0x3FE564 /end MEASUREMENT
/begin MEASUREMENT B_mnbm "Fehlertyp: h‰ufige Korrektur bei einem Zahn zuwenig" UWORD B_TRUE 1 100 0 1 BIT_MASK 0x200 FORMAT "%13.11" ECU_ADDRESS 0x3FE3BC /end MEASUREMENT
/begin MEASUREMENT B_mncars "Aktivit‰tsfehler CAN- ARS-Botschaft" UWORD B_TRUE 1 100 0 1 BIT_MASK 0x200 FORMAT "%13.11" ECU_ADDRESS 0x3FE3CA /end MEASUREMENT
/begin MEASUREMENT B_mnccas "Bedingung: min-Fehler CAN-CAS-Botschaft" UWORD B_TRUE 1 100 0 1 BIT_MASK 0x200 FORMAT "%13.11" ECU_ADDRESS 0x3FE3CC /end MEASUREMENT
/begin MEASUREMENT B_mncdsc "Fehlertyp min.: CAN-Schnittstelle DSC-SG" UWORD B_TRUE 1 100 0 1 BIT_MASK 0x200 FORMAT "%13.11" ECU_ADDRESS 0x3FE3CE /end MEASUREMENT
/begin MEASUREMENT B_mncegs "Fehlertyp min.: CAN-Schnittstelle EGS" UWORD B_TRUE 1 100 0 1 BIT_MASK 0x200 FORMAT "%13.11" ECU_ADDRESS 0x3FE3D0 /end MEASUREMENT
/begin MEASUREMENT B_mncfc "Fehlertyp ""Minimalwert erkannt"" bei Check Filler Cap" UWORD B_TRUE 1 100 0 1 BIT_MASK 0x200 FORMAT "%13.11" ECU_ADDRESS 0x3FE3D2 /end MEASUREMENT
/begin MEASUREMENT B_mncihka "Fehlertyp min.: CAN-Schnittstelle IHKA-SG" UWORD B_TRUE 1 100 0 1 BIT_MASK 0x200 FORMAT "%13.11" ECU_ADDRESS 0x3FE3D4 /end MEASUREMENT
/begin MEASUREMENT B_mncins "Fehlertyp min.: CAN-Schnittstelle, Timeout Instrument" UWORD B_TRUE 1 100 0 1 BIT_MASK 0x200 FORMAT "%13.11" ECU_ADDRESS 0x3FE3D6 /end MEASUREMENT
/begin MEASUREMENT B_mncod "Fehlertyp Min: Steuerger‰t noch nicht codiert" UWORD B_TRUE 1 100 0 1 BIT_MASK 0x200 FORMAT "%13.11" ECU_ADDRESS 0x3FE3D8 /end MEASUREMENT
/begin MEASUREMENT B_mncssg "Min-Fehler CAN  SSG-Botschaft" UWORD B_TRUE 1 100 0 1 BIT_MASK 0x200 FORMAT "%13.11" ECU_ADDRESS 0x3FE3DA /end MEASUREMENT
/begin MEASUREMENT B_mncszl "Bedingung: min-Fehler CAN-SZL Botschaft" UWORD B_TRUE 1 100 0 1 BIT_MASK 0x200 FORMAT "%13.11" ECU_ADDRESS 0x3FE3DC /end MEASUREMENT
/begin MEASUREMENT B_mndhdmte "Fehlerart: Kurzschluﬂ Masse DM-TL Heizung (Endstufe)" UWORD B_TRUE 1 100 0 1 BIT_MASK 0x200 FORMAT "%13.11" ECU_ADDRESS 0x3FE3EC /end MEASUREMENT
/begin MEASUREMENT B_mndisa "Minimalwert unterschritten" UWORD B_TRUE 1 100 0 1 BIT_MASK 0x200 FORMAT "%13.11" ECU_ADDRESS 0x3FE3F4 /end MEASUREMENT
/begin MEASUREMENT B_mndisat "" UWORD B_TRUE 1 100 0 1 BIT_MASK 0x200 FORMAT "%13.11" ECU_ADDRESS 0x3FE3F6 /end MEASUREMENT
/begin MEASUREMENT B_mndk "Fehlertype: Kurzschluﬂ nach Masse Drosselklappenpoti" UWORD B_TRUE 1 100 0 1 BIT_MASK 0x200 FORMAT "%13.11" ECU_ADDRESS 0x3FE3F8 /end MEASUREMENT
/begin MEASUREMENT B_mndk1p "Fehlertyp min.: Drosselklappe 1. Poti" UWORD B_TRUE 1 100 0 1 BIT_MASK 0x200 FORMAT "%13.11" ECU_ADDRESS 0x3FE3FA /end MEASUREMENT
/begin MEASUREMENT B_mndk2p "Fehlertyp min.: Drosselklappe 2. Poti" UWORD B_TRUE 1 100 0 1 BIT_MASK 0x200 FORMAT "%13.11" ECU_ADDRESS 0x3FE3FC /end MEASUREMENT
/begin MEASUREMENT B_mndmmve "Fehlerart: Kurzschluﬂ Masse DM-TL Magnetventil (Endstufe)" UWORD B_TRUE 1 100 0 1 BIT_MASK 0x200 FORMAT "%13.11" ECU_ADDRESS 0x3FE3FE /end MEASUREMENT
/begin MEASUREMENT B_mndmpme "Fehlerart: Kurzschluﬂ Masse DM-TL Pumpenmotor (Endstufe)" UWORD B_TRUE 1 100 0 1 BIT_MASK 0x200 FORMAT "%13.11" ECU_ADDRESS 0x3FE400 /end MEASUREMENT
/begin MEASUREMENT B_mndmtk "Fehlertyp 'Minimalwert' erkannt (Kleinstleck)" UWORD B_TRUE 1 100 0 1 BIT_MASK 0x200 FORMAT "%13.11" ECU_ADDRESS 0x3FE402 /end MEASUREMENT
/begin MEASUREMENT B_mndmtl "Fehlertyp 'Minimalwert' erkannt (DMTL-Modul)" UWORD B_TRUE 1 100 0 1 BIT_MASK 0x200 FORMAT "%13.11" ECU_ADDRESS 0x3FE406 /end MEASUREMENT
/begin MEASUREMENT B_mndpmee "Fehlerart: Kurzschluﬂ Masse DM-TL Pumpenmotor (Endstufe)" UWORD B_TRUE 1 100 0 1 BIT_MASK 0x200 FORMAT "%13.11" ECU_ADDRESS 0x3FE408 /end MEASUREMENT
/begin MEASUREMENT B_mndvee "Fehlerzyp min.: DV-E Endstufe" UWORD B_TRUE 1 100 0 1 BIT_MASK 0x200 FORMAT "%13.11" ECU_ADDRESS 0x3FE412 /end MEASUREMENT
/begin MEASUREMENT B_mndvef "Fehlertyp min.: DV-E Fehler bei Pr¸fung der ˆffnenden Feder" UWORD B_TRUE 1 100 0 1 BIT_MASK 0x200 FORMAT "%13.11" ECU_ADDRESS 0x3FE414 /end MEASUREMENT
/begin MEASUREMENT B_mndvefo "Fehlertyp min.: Fehler bei Federpr¸fung ""÷ffnen""" UWORD B_TRUE 1 100 0 1 BIT_MASK 0x200 FORMAT "%13.11" ECU_ADDRESS 0x3FE416 /end MEASUREMENT
/begin MEASUREMENT B_mndvel "Fehlertyp min.: DV-E Lageabweichung" UWORD B_TRUE 1 100 0 1 BIT_MASK 0x200 FORMAT "%13.11" ECU_ADDRESS 0x3FE418 /end MEASUREMENT
/begin MEASUREMENT B_mndven "Fehlertyp min.: DV-E Fehler bei Pr¸fung Notluftposition" UWORD B_TRUE 1 100 0 1 BIT_MASK 0x200 FORMAT "%13.11" ECU_ADDRESS 0x3FE41A /end MEASUREMENT
/begin MEASUREMENT B_mndver "Fehlerzyp min.: DV-E Regelbereich, kurzfristig ¸berschritten" UWORD B_TRUE 1 100 0 1 BIT_MASK 0x200 FORMAT "%13.11" ECU_ADDRESS 0x3FE41C /end MEASUREMENT
/begin MEASUREMENT B_mndvet "Nicht benutzt" UWORD B_TRUE 1 100 0 1 BIT_MASK 0x200 FORMAT "%13.11" ECU_ADDRESS 0x3FE422 /end MEASUREMENT
/begin MEASUREMENT B_mndveu "Fehlertyp min.: DV-E Fehler beim UMA-Lernen" UWORD B_TRUE 1 100 0 1 BIT_MASK 0x200 FORMAT "%13.11" ECU_ADDRESS 0x3FE424 /end MEASUREMENT
/begin MEASUREMENT B_mndveub "Fehlertyp min.: DV-E-Adaption Abbruch wg. Umweltbed/Unterspng" UWORD B_TRUE 1 100 0 1 BIT_MASK 0x200 FORMAT "%13.11" ECU_ADDRESS 0x3FE426 /end MEASUREMENT
/begin MEASUREMENT B_mndveuw "Nicht benutzt" UWORD B_TRUE 1 100 0 1 BIT_MASK 0x200 FORMAT "%13.11" ECU_ADDRESS 0x3FE428 /end MEASUREMENT
/begin MEASUREMENT B_mndvev "Fehlertyp min.: DV-E Fehler bei Verst‰rkerabgleich" UWORD B_TRUE 1 100 0 1 BIT_MASK 0x200 FORMAT "%13.11" ECU_ADDRESS 0x3FE42A /end MEASUREMENT
/begin MEASUREMENT B_mndylsu "Fehlerart: Min-Fehler, Dynamikdiagnose LSU" UWORD B_TRUE 1 100 0 1 BIT_MASK 0x200 FORMAT "%13.11" ECU_ADDRESS 0x3FE454 /end MEASUREMENT
/begin MEASUREMENT B_mndylsu2 "Fehlerart: Min-Fehler, Dynamikdiagnose LSU, Bank 2" UWORD B_TRUE 1 100 0 1 BIT_MASK 0x200 FORMAT "%13.11" ECU_ADDRESS 0x3FE456 /end MEASUREMENT
/begin MEASUREMENT B_mnels "Fehlertype: Kurzschluﬂ nach Masse Endstufe E-Box L¸fter" UWORD B_TRUE 1 100 0 1 BIT_MASK 0x200 FORMAT "%13.11" ECU_ADDRESS 0x3FE46A /end MEASUREMENT
/begin MEASUREMENT B_mnev1 "Fehlerart: Kurzschluﬂ Masse an Endstufe EV1" UWORD B_TRUE 1 100 0 1 BIT_MASK 0x200 FORMAT "%13.11" ECU_ADDRESS 0x3FE476 /end MEASUREMENT
/begin MEASUREMENT B_mnev2 "Fehlerart: Kurzschluﬂ Masse an Endstufe EV2" UWORD B_TRUE 1 100 0 1 BIT_MASK 0x200 FORMAT "%13.11" ECU_ADDRESS 0x3FE478 /end MEASUREMENT
/begin MEASUREMENT B_mnev3 "Fehlerart: Kurzschluﬂ Masse an Endstufe EV3" UWORD B_TRUE 1 100 0 1 BIT_MASK 0x200 FORMAT "%13.11" ECU_ADDRESS 0x3FE47A /end MEASUREMENT
/begin MEASUREMENT B_mnev4 "Fehlerart: Kurzschluﬂ Masse an Endstufe EV4" UWORD B_TRUE 1 100 0 1 BIT_MASK 0x200 FORMAT "%13.11" ECU_ADDRESS 0x3FE47C /end MEASUREMENT
/begin MEASUREMENT B_mnev5 "Fehlerart: Kurzschluﬂ Masse an Endstufe EV5" UWORD B_TRUE 1 100 0 1 BIT_MASK 0x200 FORMAT "%13.11" ECU_ADDRESS 0x3FE47E /end MEASUREMENT
/begin MEASUREMENT B_mnev6 "Fehlerart: Kurzschluﬂ Masse an Endstufe EV6" UWORD B_TRUE 1 100 0 1 BIT_MASK 0x200 FORMAT "%13.11" ECU_ADDRESS 0x3FE480 /end MEASUREMENT
/begin MEASUREMENT B_mnev7 "Fehlerart: Kurzschluﬂ Masse an Endstufe EV7" UWORD B_TRUE 1 100 0 1 BIT_MASK 0x200 FORMAT "%13.11" ECU_ADDRESS 0x3FE482 /end MEASUREMENT
/begin MEASUREMENT B_mnev8 "Fehlerart: Kurzschluﬂ Masse an Endstufe EV8" UWORD B_TRUE 1 100 0 1 BIT_MASK 0x200 FORMAT "%13.11" ECU_ADDRESS 0x3FE484 /end MEASUREMENT
/begin MEASUREMENT B_mnfst "Fehlertyp: Kurzschluﬂ nach Masse Tankf¸llstandssensor" UWORD B_TRUE 1 100 0 1 BIT_MASK 0x200 FORMAT "%13.11" ECU_ADDRESS 0x3FE498 /end MEASUREMENT
/begin MEASUREMENT B_mnglfe "Fehlerart: Kurzschluﬂ Masse GLF Endstufe" UWORD B_TRUE 1 100 0 1 BIT_MASK 0x200 FORMAT "%13.11" ECU_ADDRESS 0x3FE49A /end MEASUREMENT
/begin MEASUREMENT B_mnhelsu "Fehlerart: min-Fehler der Heizereinkopplungsdiagnose" UWORD B_TRUE 1 100 0 1 BIT_MASK 0x200 FORMAT "%13.11" ECU_ADDRESS 0x3FE49C /end MEASUREMENT
/begin MEASUREMENT B_mnhelsu2 "Fehlerart: min-Fehler der Heizereinkopplungsdiagnose" UWORD B_TRUE 1 100 0 1 BIT_MASK 0x200 FORMAT "%13.11" ECU_ADDRESS 0x3FE49E /end MEASUREMENT
/begin MEASUREMENT B_mnhsh "Kurzschluﬂ Heizung Lambdasonde hinter Kat nach Masse" UWORD B_TRUE 1 100 0 1 BIT_MASK 0x200 FORMAT "%13.11" ECU_ADDRESS 0x3FE4A0 /end MEASUREMENT
/begin MEASUREMENT B_mnhsh2 "Kurzschluﬂ Heizung Lambdasonde2 hinter Kat nach Masse" UWORD B_TRUE 1 100 0 1 BIT_MASK 0x200 FORMAT "%13.11" ECU_ADDRESS 0x3FE4A2 /end MEASUREMENT
/begin MEASUREMENT B_mnhshe "Kurzschluﬂ Heizung Lambdasonde hinter Kat nach Masse (Endstufe)" UWORD B_TRUE 1 100 0 1 BIT_MASK 0x200 FORMAT "%13.11" ECU_ADDRESS 0x3FE4A4 /end MEASUREMENT
/begin MEASUREMENT B_mnhshe2 "Kurzschluﬂ Heizung Lambdasonde2 hinter Kat nach Masse (Endstufe)" UWORD B_TRUE 1 100 0 1 BIT_MASK 0x200 FORMAT "%13.11" ECU_ADDRESS 0x3FE4A6 /end MEASUREMENT
/begin MEASUREMENT B_mnhsv "Kurzschluﬂ Heizung Lambdasonde vor Kat nach Masse" UWORD B_TRUE 1 100 0 1 BIT_MASK 0x200 FORMAT "%13.11" ECU_ADDRESS 0x3FE4A8 /end MEASUREMENT
/begin MEASUREMENT B_mnhsv2 "Kurzschluﬂ Heizung Lambdasonde2 vor Kat nach Masse" UWORD B_TRUE 1 100 0 1 BIT_MASK 0x200 FORMAT "%13.11" ECU_ADDRESS 0x3FE4AA /end MEASUREMENT
/begin MEASUREMENT B_mnhsve "Kurzschluﬂ Heizung Lambdasonde vor Kat nach Masse (Endstufe)" UWORD B_TRUE 1 100 0 1 BIT_MASK 0x200 FORMAT "%13.11" ECU_ADDRESS 0x3FE4AC /end MEASUREMENT
/begin MEASUREMENT B_mnhsve2 "Kurzschluﬂ Heizung Lambdasonde2 vor Kat nach Masse (Endstufe)" UWORD B_TRUE 1 100 0 1 BIT_MASK 0x200 FORMAT "%13.11" ECU_ADDRESS 0x3FE4AE /end MEASUREMENT
/begin MEASUREMENT B_mnkpe "Bedingung f¸r Fehlertyp Kurzschluﬂ nach Masse f¸r EKP-Relais Endstufe erkannt" UWORD B_TRUE 1 100 0 1 BIT_MASK 0x200 FORMAT "%13.11" ECU_ADDRESS 0x3FE4BE /end MEASUREMENT
/begin MEASUREMENT B_mnlm "Bedingung: min-Fehler Hauptf¸llungssensor" UWORD B_TRUE 1 100 0 1 BIT_MASK 0x200 FORMAT "%13.11" ECU_ADDRESS 0x3FE4E0 /end MEASUREMENT
/begin MEASUREMENT B_mnn "Fehlerart: Synchronisationsmarke h‰ufig nicht gefunden" UWORD B_TRUE 1 100 0 1 BIT_MASK 0x200 FORMAT "%13.11" ECU_ADDRESS 0x3FE524 /end MEASUREMENT
/begin MEASUREMENT B_mnpmbatt "" UWORD B_TRUE 1 100 0 1 BIT_MASK 0x200 FORMAT "%13.11" ECU_ADDRESS 0x3FE53E /end MEASUREMENT
/begin MEASUREMENT B_mnpmbn "Minimalfehler, PM Bordnetz" UWORD B_TRUE 1 100 0 1 BIT_MASK 0x200 FORMAT "%13.11" ECU_ADDRESS 0x3FE540 /end MEASUREMENT
/begin MEASUREMENT B_mntesg "Fehlertyp 'Minimalwert' erkannt (Grobleck)" UWORD B_TRUE 1 100 0 1 BIT_MASK 0x200 FORMAT "%13.11" ECU_ADDRESS 0x3FE564 /end MEASUREMENT
/begin MEASUREMENT B_mxbm "Fehlertyp: h‰ufige Korrektur bei einem Zahn zuviel" UWORD B_TRUE 1 100 0 1 BIT_MASK 0x100 FORMAT "%13.11" ECU_ADDRESS 0x3FE3BC /end MEASUREMENT
/begin MEASUREMENT B_mxcars "Maxfehler CAN-ARS" UWORD B_TRUE 1 100 0 1 BIT_MASK 0x100 FORMAT "%13.11" ECU_ADDRESS 0x3FE3CA /end MEASUREMENT
/begin MEASUREMENT B_mxccas "Maxfehler CAN-CAS-Botschaft" UWORD B_TRUE 1 100 0 1 BIT_MASK 0x100 FORMAT "%13.11" ECU_ADDRESS 0x3FE3CC /end MEASUREMENT
/begin MEASUREMENT B_mxcdsc "Fehlertyp max.: CAN-Schnittstelle, DSC-SG" UWORD B_TRUE 1 100 0 1 BIT_MASK 0x100 FORMAT "%13.11" ECU_ADDRESS 0x3FE3CE /end MEASUREMENT
/begin MEASUREMENT B_mxcegs "Fehlertyp max.: CAN-Schnittstelle EGS" UWORD B_TRUE 1 100 0 1 BIT_MASK 0x100 FORMAT "%13.11" ECU_ADDRESS 0x3FE3D0 /end MEASUREMENT
/begin MEASUREMENT B_mxcfc "Fehlertyp ""Maximalwert erkannt"" bei Check Filler Cap" UWORD B_TRUE 1 100 0 1 BIT_MASK 0x100 FORMAT "%13.11" ECU_ADDRESS 0x3FE3D2 /end MEASUREMENT
/begin MEASUREMENT B_mxcihka "Fehlertyp max.: CAN-Schnittstelle, IHKA-SG" UWORD B_TRUE 1 100 0 1 BIT_MASK 0x100 FORMAT "%13.11" ECU_ADDRESS 0x3FE3D4 /end MEASUREMENT
/begin MEASUREMENT B_mxcins "Fehlertyp max.: CAN-Schnittstelle, Timeout Instrument" UWORD B_TRUE 1 100 0 1 BIT_MASK 0x100 FORMAT "%13.11" ECU_ADDRESS 0x3FE3D6 /end MEASUREMENT
/begin MEASUREMENT B_mxcod "Fehlertyp Max: Steuerger‰t noch nicht codiert" UWORD B_TRUE 1 100 0 1 BIT_MASK 0x100 FORMAT "%13.11" ECU_ADDRESS 0x3FE3D8 /end MEASUREMENT
/begin MEASUREMENT B_mxcssg "Max-Fehler CAN  SSG-Botschaft" UWORD B_TRUE 1 100 0 1 BIT_MASK 0x100 FORMAT "%13.11" ECU_ADDRESS 0x3FE3DA /end MEASUREMENT
/begin MEASUREMENT B_mxcszl "Fehlertyp: Maximalwertueberschreitung" UWORD B_TRUE 1 100 0 1 BIT_MASK 0x100 FORMAT "%13.11" ECU_ADDRESS 0x3FE3DC /end MEASUREMENT
/begin MEASUREMENT B_mxdhdmte "Fehlerart: Kurzschluﬂ Ubat DM-TL Heizung (Endstufe)" UWORD B_TRUE 1 100 0 1 BIT_MASK 0x100 FORMAT "%13.11" ECU_ADDRESS 0x3FE3EC /end MEASUREMENT
/begin MEASUREMENT B_mxdisa "Maximalwert ueberschritten" UWORD B_TRUE 1 100 0 1 BIT_MASK 0x100 FORMAT "%13.11" ECU_ADDRESS 0x3FE3F4 /end MEASUREMENT
/begin MEASUREMENT B_mxdisat "" UWORD B_TRUE 1 100 0 1 BIT_MASK 0x100 FORMAT "%13.11" ECU_ADDRESS 0x3FE3F6 /end MEASUREMENT
/begin MEASUREMENT B_mxdk "Fehlertype: Kurzschluﬂ nach Ubat Drosselklappenpoti" UWORD B_TRUE 1 100 0 1 BIT_MASK 0x100 FORMAT "%13.11" ECU_ADDRESS 0x3FE3F8 /end MEASUREMENT
/begin MEASUREMENT B_mxdk1p "Fehlertyp max.: Drosselklappe 1. Poti" UWORD B_TRUE 1 100 0 1 BIT_MASK 0x100 FORMAT "%13.11" ECU_ADDRESS 0x3FE3FA /end MEASUREMENT
/begin MEASUREMENT B_mxdk2p "Fehlertyp max.: Drosselklappe 2. Poti" UWORD B_TRUE 1 100 0 1 BIT_MASK 0x100 FORMAT "%13.11" ECU_ADDRESS 0x3FE3FC /end MEASUREMENT
/begin MEASUREMENT B_mxdmmve "Fehlerart: Kurzschluﬂ Ubat DM-TL Magnetventil (Endstufe)" UWORD B_TRUE 1 100 0 1 BIT_MASK 0x100 FORMAT "%13.11" ECU_ADDRESS 0x3FE3FE /end MEASUREMENT
/begin MEASUREMENT B_mxdmpme "Fehlerart: Kurzschluﬂ Ubat DM-TL Pumpenmotor (Endstufe)" UWORD B_TRUE 1 100 0 1 BIT_MASK 0x100 FORMAT "%13.11" ECU_ADDRESS 0x3FE400 /end MEASUREMENT
/begin MEASUREMENT B_mxdmtk "Fehlertyp 'Maximalwert' erkannt (Grobleck)" UWORD B_TRUE 1 100 0 1 BIT_MASK 0x100 FORMAT "%13.11" ECU_ADDRESS 0x3FE402 /end MEASUREMENT
/begin MEASUREMENT B_mxdmtl "Fehlertyp 'Maximalwert' erkannt (DMTL-Modul)" UWORD B_TRUE 1 100 0 1 BIT_MASK 0x100 FORMAT "%13.11" ECU_ADDRESS 0x3FE406 /end MEASUREMENT
/begin MEASUREMENT B_mxdpmee "Fehlerart: Kurzschluﬂ Ubat DM-TL Pumpenmotor (Endstufe)" UWORD B_TRUE 1 100 0 1 BIT_MASK 0x100 FORMAT "%13.11" ECU_ADDRESS 0x3FE408 /end MEASUREMENT
/begin MEASUREMENT B_mxdvee "Fehlertyp max.: DV-E Endstufe" UWORD B_TRUE 1 100 0 1 BIT_MASK 0x100 FORMAT "%13.11" ECU_ADDRESS 0x3FE412 /end MEASUREMENT
/begin MEASUREMENT B_mxdvef "Fehlertyp max.: DV-E Fehler bei Pr¸fung der R¸ckstellfeder" UWORD B_TRUE 1 100 0 1 BIT_MASK 0x100 FORMAT "%13.11" ECU_ADDRESS 0x3FE414 /end MEASUREMENT
/begin MEASUREMENT B_mxdvefo "Fehlertyp max.: Fehler bei Federpr¸fung ""÷ffnen""" UWORD B_TRUE 1 100 0 1 BIT_MASK 0x100 FORMAT "%13.11" ECU_ADDRESS 0x3FE416 /end MEASUREMENT
/begin MEASUREMENT B_mxdvel "Fehlerzyp max.: DV-E Lageabweichung" UWORD B_TRUE 1 100 0 1 BIT_MASK 0x100 FORMAT "%13.11" ECU_ADDRESS 0x3FE418 /end MEASUREMENT
/begin MEASUREMENT B_mxdven "Fehlertyp max.: DV-E Fehler bei Pr¸fung Notluftposition" UWORD B_TRUE 1 100 0 1 BIT_MASK 0x100 FORMAT "%13.11" ECU_ADDRESS 0x3FE41A /end MEASUREMENT
/begin MEASUREMENT B_mxdver "Fehlertyp max.: DV-E Regelbereich, langfristig verletzt" UWORD B_TRUE 1 100 0 1 BIT_MASK 0x100 FORMAT "%13.11" ECU_ADDRESS 0x3FE41C /end MEASUREMENT
/begin MEASUREMENT B_mxdvet "Nicht benutzt" UWORD B_TRUE 1 100 0 1 BIT_MASK 0x100 FORMAT "%13.11" ECU_ADDRESS 0x3FE422 /end MEASUREMENT
/begin MEASUREMENT B_mxdveu "Fehlertyp max.: DV-E Fehler beim UMA-Lernen" UWORD B_TRUE 1 100 0 1 BIT_MASK 0x100 FORMAT "%13.11" ECU_ADDRESS 0x3FE424 /end MEASUREMENT
/begin MEASUREMENT B_mxdveub "Fehlertyp max.: DV-E-Adaption Abbruch wg. Umweltbedingung" UWORD B_TRUE 1 100 0 1 BIT_MASK 0x100 FORMAT "%13.11" ECU_ADDRESS 0x3FE426 /end MEASUREMENT
/begin MEASUREMENT B_mxdveuw "Nicht benutzt" UWORD B_TRUE 1 100 0 1 BIT_MASK 0x100 FORMAT "%13.11" ECU_ADDRESS 0x3FE428 /end MEASUREMENT
/begin MEASUREMENT B_mxdvev "Fehlertyp max.: DV-E Fehler bei Verst‰rkerabgleich" UWORD B_TRUE 1 100 0 1 BIT_MASK 0x100 FORMAT "%13.11" ECU_ADDRESS 0x3FE42A /end MEASUREMENT
/begin MEASUREMENT B_mxdylsu "Fehlerart: Max-Fehler, Dynamikdiagnose LSU," UWORD B_TRUE 1 100 0 1 BIT_MASK 0x100 FORMAT "%13.11" ECU_ADDRESS 0x3FE454 /end MEASUREMENT
/begin MEASUREMENT B_mxdylsu2 "Fehlerart: Max-Fehler, Dynamikdiagnose LSU, Bank 2" UWORD B_TRUE 1 100 0 1 BIT_MASK 0x100 FORMAT "%13.11" ECU_ADDRESS 0x3FE456 /end MEASUREMENT
/begin MEASUREMENT B_mxels "Fehlertype: Kurzschluﬂ nach Ubatt Endstufe E-Box L¸fter" UWORD B_TRUE 1 100 0 1 BIT_MASK 0x100 FORMAT "%13.11" ECU_ADDRESS 0x3FE46A /end MEASUREMENT
/begin MEASUREMENT B_mxev1 "Fehlerart: Kurzschluﬂ UBat an Endstufe EV1" UWORD B_TRUE 1 100 0 1 BIT_MASK 0x100 FORMAT "%13.11" ECU_ADDRESS 0x3FE476 /end MEASUREMENT
/begin MEASUREMENT B_mxev2 "Fehlerart: Kurzschluﬂ UBat an Endstufe EV2" UWORD B_TRUE 1 100 0 1 BIT_MASK 0x100 FORMAT "%13.11" ECU_ADDRESS 0x3FE478 /end MEASUREMENT
/begin MEASUREMENT B_mxev3 "Fehlerart: Kurzschluﬂ UBat an Endstufe EV3" UWORD B_TRUE 1 100 0 1 BIT_MASK 0x100 FORMAT "%13.11" ECU_ADDRESS 0x3FE47A /end MEASUREMENT
/begin MEASUREMENT B_mxev4 "Fehlerart: Kurzschluﬂ UBat an Endstufe EV4" UWORD B_TRUE 1 100 0 1 BIT_MASK 0x100 FORMAT "%13.11" ECU_ADDRESS 0x3FE47C /end MEASUREMENT
/begin MEASUREMENT B_mxev5 "Fehlerart: Kurzschluﬂ UBat an Endstufe EV5" UWORD B_TRUE 1 100 0 1 BIT_MASK 0x100 FORMAT "%13.11" ECU_ADDRESS 0x3FE47E /end MEASUREMENT
/begin MEASUREMENT B_mxev6 "Fehlerart: Kurzschluﬂ UBat an Endstufe EV6" UWORD B_TRUE 1 100 0 1 BIT_MASK 0x100 FORMAT "%13.11" ECU_ADDRESS 0x3FE480 /end MEASUREMENT
/begin MEASUREMENT B_mxev7 "Fehlerart: Kurzschluﬂ UBat an Endstufe EV7" UWORD B_TRUE 1 100 0 1 BIT_MASK 0x100 FORMAT "%13.11" ECU_ADDRESS 0x3FE482 /end MEASUREMENT
/begin MEASUREMENT B_mxev8 "Fehlerart: Kurzschluﬂ UBat an Endstufe EV8" UWORD B_TRUE 1 100 0 1 BIT_MASK 0x100 FORMAT "%13.11" ECU_ADDRESS 0x3FE484 /end MEASUREMENT
/begin MEASUREMENT B_mxfst "Fehlertyp: Kurzschluﬂ nach Ubatt Tankf¸llstandssensor" UWORD B_TRUE 1 100 0 1 BIT_MASK 0x100 FORMAT "%13.11" ECU_ADDRESS 0x3FE498 /end MEASUREMENT
/begin MEASUREMENT B_mxglfe "Fehlerart: Kurzschluﬂ nach UBat GLF Endstufe" UWORD B_TRUE 1 100 0 1 BIT_MASK 0x100 FORMAT "%13.11" ECU_ADDRESS 0x3FE49A /end MEASUREMENT
/begin MEASUREMENT B_mxhelsu "Fehlerart: max-Fehler der Heizereinkopplungsdiagnose" UWORD B_TRUE 1 100 0 1 BIT_MASK 0x100 FORMAT "%13.11" ECU_ADDRESS 0x3FE49C /end MEASUREMENT
/begin MEASUREMENT B_mxhelsu2 "Fehlerart: max-Fehler der Heizereinkopplungsdiagnose" UWORD B_TRUE 1 100 0 1 BIT_MASK 0x100 FORMAT "%13.11" ECU_ADDRESS 0x3FE49E /end MEASUREMENT
/begin MEASUREMENT B_mxhsh "Kurzschluﬂ Heizung Lambdasonde hinter Kat nach UB" UWORD B_TRUE 1 100 0 1 BIT_MASK 0x100 FORMAT "%13.11" ECU_ADDRESS 0x3FE4A0 /end MEASUREMENT
/begin MEASUREMENT B_mxhsh2 "Kurzschluﬂ Heizung Lambdasonde2 hinter Kat nach UB" UWORD B_TRUE 1 100 0 1 BIT_MASK 0x100 FORMAT "%13.11" ECU_ADDRESS 0x3FE4A2 /end MEASUREMENT
/begin MEASUREMENT B_mxhshe "Kurzschluﬂ Heizung Lambdasonde hinter Kat nach UB (Endstufe)" UWORD B_TRUE 1 100 0 1 BIT_MASK 0x100 FORMAT "%13.11" ECU_ADDRESS 0x3FE4A4 /end MEASUREMENT
/begin MEASUREMENT B_mxhshe2 "Kurzschluﬂ Heizung Lambdasonde2 hinter Kat nach UB (Endstufe)" UWORD B_TRUE 1 100 0 1 BIT_MASK 0x100 FORMAT "%13.11" ECU_ADDRESS 0x3FE4A6 /end MEASUREMENT
/begin MEASUREMENT B_mxhsv "Kurzschluﬂ Heizung Lambdasonde vor Kat nach UB" UWORD B_TRUE 1 100 0 1 BIT_MASK 0x100 FORMAT "%13.11" ECU_ADDRESS 0x3FE4A8 /end MEASUREMENT
/begin MEASUREMENT B_mxhsv2 "Kurzschluﬂ Heizung Lambdasonde2 vor Kat nach UB" UWORD B_TRUE 1 100 0 1 BIT_MASK 0x100 FORMAT "%13.11" ECU_ADDRESS 0x3FE4AA /end MEASUREMENT
/begin MEASUREMENT B_mxhsve "Kurzschluﬂ Heizung Lambdasonde vor Kat nach UB (Endstufe)" UWORD B_TRUE 1 100 0 1 BIT_MASK 0x100 FORMAT "%13.11" ECU_ADDRESS 0x3FE4AC /end MEASUREMENT
/begin MEASUREMENT B_mxhsve2 "Kurzschluﬂ Heizung Lambdasonde2 vor Kat nach UB (Endstufe)" UWORD B_TRUE 1 100 0 1 BIT_MASK 0x100 FORMAT "%13.11" ECU_ADDRESS 0x3FE4AE /end MEASUREMENT
/begin MEASUREMENT B_mxkpe "Fehlertyp Kurzschluﬂ nach Ubat f¸r EKP-Relais Endstufe erkannt" UWORD B_TRUE 1 100 0 1 BIT_MASK 0x100 FORMAT "%13.11" ECU_ADDRESS 0x3FE4BE /end MEASUREMENT
/begin MEASUREMENT B_mxlm "Bedingung: max-Fehler Hauptf¸llungssensor" UWORD B_TRUE 1 100 0 1 BIT_MASK 0x100 FORMAT "%13.11" ECU_ADDRESS 0x3FE4E0 /end MEASUREMENT
/begin MEASUREMENT B_mxn "Fehlerart: h‰ufiger L¸ckenverlust beim L¸ckencheck" UWORD B_TRUE 1 100 0 1 BIT_MASK 0x100 FORMAT "%13.11" ECU_ADDRESS 0x3FE524 /end MEASUREMENT
/begin MEASUREMENT B_mxpmbatt "" UWORD B_TRUE 1 100 0 1 BIT_MASK 0x100 FORMAT "%13.11" ECU_ADDRESS 0x3FE53E /end MEASUREMENT
/begin MEASUREMENT B_mxpmbn "Maximalfehler, PM Bordnetz" UWORD B_TRUE 1 100 0 1 BIT_MASK 0x100 FORMAT "%13.11" ECU_ADDRESS 0x3FE540 /end MEASUREMENT
/begin MEASUREMENT B_mxtesg "Fehlertyp 'Maximalwert' erkannt (Grobleck)" UWORD B_TRUE 1 100 0 1 BIT_MASK 0x100 FORMAT "%13.11" ECU_ADDRESS 0x3FE564 /end MEASUREMENT
/begin MEASUREMENT B_npbm "Fehlertyp: Bezugsmarkenfehler beim L¸ckencheck" UWORD B_TRUE 1 100 0 1 BIT_MASK 0x800 FORMAT "%13.11" ECU_ADDRESS 0x3FE3BC /end MEASUREMENT
/begin MEASUREMENT B_npcars "Plausfehler der ARS-Botschaft" UWORD B_TRUE 1 100 0 1 BIT_MASK 0x800 FORMAT "%13.11" ECU_ADDRESS 0x3FE3CA /end MEASUREMENT
/begin MEASUREMENT B_npccas "Plausfehler CAN-CAS-Botschaft" UWORD B_TRUE 1 100 0 1 BIT_MASK 0x800 FORMAT "%13.11" ECU_ADDRESS 0x3FE3CC /end MEASUREMENT
/begin MEASUREMENT B_npcdsc "Fehlertyp: CAN-Schnittstelle, DSC-SG" UWORD B_TRUE 1 100 0 1 BIT_MASK 0x800 FORMAT "%13.11" ECU_ADDRESS 0x3FE3CE /end MEASUREMENT
/begin MEASUREMENT B_npcegs "Fehlerart Plausfehler :CAN-Schnittstelle EGS" UWORD B_TRUE 1 100 0 1 BIT_MASK 0x800 FORMAT "%13.11" ECU_ADDRESS 0x3FE3D0 /end MEASUREMENT
/begin MEASUREMENT B_npcfc "Fehlertyp ""unplausibles Pr¸fresultat"" bei Check Filler Cap" UWORD B_TRUE 1 100 0 1 BIT_MASK 0x800 FORMAT "%13.11" ECU_ADDRESS 0x3FE3D2 /end MEASUREMENT
/begin MEASUREMENT B_npcihka "Fehlertyp: CAN-Schnittstelle, IHKA-SG" UWORD B_TRUE 1 100 0 1 BIT_MASK 0x800 FORMAT "%13.11" ECU_ADDRESS 0x3FE3D4 /end MEASUREMENT
/begin MEASUREMENT B_npcins "Fehlerart:CAN-Schnittstelle, Timeout Instrument" UWORD B_TRUE 1 100 0 1 BIT_MASK 0x800 FORMAT "%13.11" ECU_ADDRESS 0x3FE3D6 /end MEASUREMENT
/begin MEASUREMENT B_npcod "Fehlerart: Plausibilit‰tsfehler Steuerger‰t noch nicht codiert" UWORD B_TRUE 1 100 0 1 BIT_MASK 0x800 FORMAT "%13.11" ECU_ADDRESS 0x3FE3D8 /end MEASUREMENT
/begin MEASUREMENT B_npcssg "Plaus-Fehler CAN  SSG-Botschaft" UWORD B_TRUE 1 100 0 1 BIT_MASK 0x800 FORMAT "%13.11" ECU_ADDRESS 0x3FE3DA /end MEASUREMENT
/begin MEASUREMENT B_npcszl "Bedingung: Plausfehler CAN-SZL-Botschaft" UWORD B_TRUE 1 100 0 1 BIT_MASK 0x800 FORMAT "%13.11" ECU_ADDRESS 0x3FE3DC /end MEASUREMENT
/begin MEASUREMENT B_npdhdmte "Fehlertyp 'unplausibles Pr¸fresultat' erkannt (Endstufe DM-TL Heizung)" UWORD B_TRUE 1 100 0 1 BIT_MASK 0x800 FORMAT "%13.11" ECU_ADDRESS 0x3FE3EC /end MEASUREMENT
/begin MEASUREMENT B_npdisa "Pruefresultat nicht plausibel" UWORD B_TRUE 1 100 0 1 BIT_MASK 0x800 FORMAT "%13.11" ECU_ADDRESS 0x3FE3F4 /end MEASUREMENT
/begin MEASUREMENT B_npdisat "" UWORD B_TRUE 1 100 0 1 BIT_MASK 0x800 FORMAT "%13.11" ECU_ADDRESS 0x3FE3F6 /end MEASUREMENT
/begin MEASUREMENT B_npdk "Bedingung unplausible Potisignale von der Drosselklappe" UWORD B_TRUE 1 100 0 1 BIT_MASK 0x800 FORMAT "%13.11" ECU_ADDRESS 0x3FE3F8 /end MEASUREMENT
/begin MEASUREMENT B_npdk1p "Fehlertyp unplaus.: Drosselklappe 1. Poti" UWORD B_TRUE 1 100 0 1 BIT_MASK 0x800 FORMAT "%13.11" ECU_ADDRESS 0x3FE3FA /end MEASUREMENT
/begin MEASUREMENT B_npdk2p "Fehlertyp unplaus.: Drosselklappe 2. Poti" UWORD B_TRUE 1 100 0 1 BIT_MASK 0x800 FORMAT "%13.11" ECU_ADDRESS 0x3FE3FC /end MEASUREMENT
/begin MEASUREMENT B_npdmmve "Fehlertyp 'unplausibles Pr¸fresultat' erkannt (Endstufe DM-TL Magnetventil)" UWORD B_TRUE 1 100 0 1 BIT_MASK 0x800 FORMAT "%13.11" ECU_ADDRESS 0x3FE3FE /end MEASUREMENT
/begin MEASUREMENT B_npdmpme "Fehlertyp 'unplausibles Pr¸fresultat' erkannt (Endstufe DM-TL Pumpenmotor)" UWORD B_TRUE 1 100 0 1 BIT_MASK 0x800 FORMAT "%13.11" ECU_ADDRESS 0x3FE400 /end MEASUREMENT
/begin MEASUREMENT B_npdmtk "Fehlertyp 'unplausibles Pr¸fresultat' erkannt (DMTK  Modul)" UWORD B_TRUE 1 100 0 1 BIT_MASK 0x800 FORMAT "%13.11" ECU_ADDRESS 0x3FE402 /end MEASUREMENT
/begin MEASUREMENT B_npdmtl "Fehlertyp 'unplausibles Pr¸fresultat' erkannt (DM-TL Modul)" UWORD B_TRUE 1 100 0 1 BIT_MASK 0x800 FORMAT "%13.11" ECU_ADDRESS 0x3FE406 /end MEASUREMENT
/begin MEASUREMENT B_npdpmee "Fehlertyp 'unplausibles Pr¸fresultat' erkannt (Endstufe DM-TL Pumpe)" UWORD B_TRUE 1 100 0 1 BIT_MASK 0x800 FORMAT "%13.11" ECU_ADDRESS 0x3FE408 /end MEASUREMENT
/begin MEASUREMENT B_npdvee "Fehlerzyp unplaus.: DV-E Endstufe" UWORD B_TRUE 1 100 0 1 BIT_MASK 0x800 FORMAT "%13.11" ECU_ADDRESS 0x3FE412 /end MEASUREMENT
/begin MEASUREMENT B_npdvef "Fehlertyp unplaus.: DV-E Fehler bei Federpr¸fung" UWORD B_TRUE 1 100 0 1 BIT_MASK 0x800 FORMAT "%13.11" ECU_ADDRESS 0x3FE414 /end MEASUREMENT
/begin MEASUREMENT B_npdvefo "Nicht benutzt" UWORD B_TRUE 1 100 0 1 BIT_MASK 0x800 FORMAT "%13.11" ECU_ADDRESS 0x3FE416 /end MEASUREMENT
/begin MEASUREMENT B_npdvel "Fehlerzyp unplaus.: DV-E Lageabweichung" UWORD B_TRUE 1 100 0 1 BIT_MASK 0x800 FORMAT "%13.11" ECU_ADDRESS 0x3FE418 /end MEASUREMENT
/begin MEASUREMENT B_npdven "Fehlertyp unplaus.: DV-E Fehler bei Pr¸fung Notluftposition" UWORD B_TRUE 1 100 0 1 BIT_MASK 0x800 FORMAT "%13.11" ECU_ADDRESS 0x3FE41A /end MEASUREMENT
/begin MEASUREMENT B_npdver "Fehlerzyp unplaus.: DV-E Regelbereich" UWORD B_TRUE 1 100 0 1 BIT_MASK 0x800 FORMAT "%13.11" ECU_ADDRESS 0x3FE41C /end MEASUREMENT
/begin MEASUREMENT B_npdvet "Fehlertyp ""unplausibel"": DV-E-Tauscherkennung ohne Adaption" UWORD B_TRUE 1 100 0 1 BIT_MASK 0x800 FORMAT "%13.11" ECU_ADDRESS 0x3FE422 /end MEASUREMENT
/begin MEASUREMENT B_npdveu "Fehlertyp unplaus.: DV-E Fehler beim UMA-Lernen" UWORD B_TRUE 1 100 0 1 BIT_MASK 0x800 FORMAT "%13.11" ECU_ADDRESS 0x3FE424 /end MEASUREMENT
/begin MEASUREMENT B_npdveub "Nicht benutzt" UWORD B_TRUE 1 100 0 1 BIT_MASK 0x800 FORMAT "%13.11" ECU_ADDRESS 0x3FE426 /end MEASUREMENT
/begin MEASUREMENT B_npdveuw "Fehlertyp ""unplausibel"" bei UMA-Wiederlernen" UWORD B_TRUE 1 100 0 1 BIT_MASK 0x800 FORMAT "%13.11" ECU_ADDRESS 0x3FE428 /end MEASUREMENT
/begin MEASUREMENT B_npdvev "Fehlertyp unplaus.: DV-E Fehler bei Verst‰rkerabgleich" UWORD B_TRUE 1 100 0 1 BIT_MASK 0x800 FORMAT "%13.11" ECU_ADDRESS 0x3FE42A /end MEASUREMENT
/begin MEASUREMENT B_npdylsu "Fehlerart: Plaus-Fehler, Dynamikdiagnose LSU" UWORD B_TRUE 1 100 0 1 BIT_MASK 0x800 FORMAT "%13.11" ECU_ADDRESS 0x3FE454 /end MEASUREMENT
/begin MEASUREMENT B_npdylsu2 "Fehlerart: Plaus-Fehler, Dynamikdiagnose LSU, Bank 2" UWORD B_TRUE 1 100 0 1 BIT_MASK 0x800 FORMAT "%13.11" ECU_ADDRESS 0x3FE456 /end MEASUREMENT
/begin MEASUREMENT B_npels "Fehlertyp unplaus.: E-Box-L¸fter" UWORD B_TRUE 1 100 0 1 BIT_MASK 0x800 FORMAT "%13.11" ECU_ADDRESS 0x3FE46A /end MEASUREMENT
/begin MEASUREMENT B_npev1 "Fehlerart: Zustand nicht plausibel EV1" UWORD B_TRUE 1 100 0 1 BIT_MASK 0x800 FORMAT "%13.11" ECU_ADDRESS 0x3FE476 /end MEASUREMENT
/begin MEASUREMENT B_npev2 "Fehlerart: Zustand nicht plausibel EV2" UWORD B_TRUE 1 100 0 1 BIT_MASK 0x800 FORMAT "%13.11" ECU_ADDRESS 0x3FE478 /end MEASUREMENT
/begin MEASUREMENT B_npev3 "Fehlerart: Zustand nicht plausibel EV3" UWORD B_TRUE 1 100 0 1 BIT_MASK 0x800 FORMAT "%13.11" ECU_ADDRESS 0x3FE47A /end MEASUREMENT
/begin MEASUREMENT B_npev4 "Fehlerart: Zustand nicht plausibel EV4" UWORD B_TRUE 1 100 0 1 BIT_MASK 0x800 FORMAT "%13.11" ECU_ADDRESS 0x3FE47C /end MEASUREMENT
/begin MEASUREMENT B_npev5 "Fehlerart: Zustand nicht plausibel EV5" UWORD B_TRUE 1 100 0 1 BIT_MASK 0x800 FORMAT "%13.11" ECU_ADDRESS 0x3FE47E /end MEASUREMENT
/begin MEASUREMENT B_npev6 "Fehlerart: Zustand nicht plausibel EV6" UWORD B_TRUE 1 100 0 1 BIT_MASK 0x800 FORMAT "%13.11" ECU_ADDRESS 0x3FE480 /end MEASUREMENT
/begin MEASUREMENT B_npev7 "Fehlerart: Zustand nicht plausibel EV7" UWORD B_TRUE 1 100 0 1 BIT_MASK 0x800 FORMAT "%13.11" ECU_ADDRESS 0x3FE482 /end MEASUREMENT
/begin MEASUREMENT B_npev8 "Fehlerart: Zustand nicht plausibel EV8" UWORD B_TRUE 1 100 0 1 BIT_MASK 0x800 FORMAT "%13.11" ECU_ADDRESS 0x3FE484 /end MEASUREMENT
/begin MEASUREMENT B_npfst "Fehlertyp: Fuellstandssensor-Signal nicht plausibel" UWORD B_TRUE 1 100 0 1 BIT_MASK 0x800 FORMAT "%13.11" ECU_ADDRESS 0x3FE498 /end MEASUREMENT
/begin MEASUREMENT B_npglfe "Fehlerart: Endstufe GLF unplausibel" UWORD B_TRUE 1 100 0 1 BIT_MASK 0x800 FORMAT "%13.11" ECU_ADDRESS 0x3FE49A /end MEASUREMENT
/begin MEASUREMENT B_nphelsu "Fehlerart: Plausibilit‰tsfehler der Heizereinkopplungsdiagnoe" UWORD B_TRUE 1 100 0 1 BIT_MASK 0x800 FORMAT "%13.11" ECU_ADDRESS 0x3FE49C /end MEASUREMENT
/begin MEASUREMENT B_nphelsu2 "Fehlerart: Plausibilit‰tsfehler der Heizereinkopplungsdiagnoe, Bank 2" UWORD B_TRUE 1 100 0 1 BIT_MASK 0x800 FORMAT "%13.11" ECU_ADDRESS 0x3FE49E /end MEASUREMENT
/begin MEASUREMENT B_nphsh "Nernstwiderstand Sonde hinter Kat zu groﬂ" UWORD B_TRUE 1 100 0 1 BIT_MASK 0x800 FORMAT "%13.11" ECU_ADDRESS 0x3FE4A0 /end MEASUREMENT
/begin MEASUREMENT B_nphsh2 "Nernstwiderstand Sonde 2 hinter Kat zu groﬂ" UWORD B_TRUE 1 100 0 1 BIT_MASK 0x800 FORMAT "%13.11" ECU_ADDRESS 0x3FE4A2 /end MEASUREMENT
/begin MEASUREMENT B_nphshe "Nicht plausibler Fehler: Lambda-Sonden Heizung hinter Kat. (Endstufe)" UWORD B_TRUE 1 100 0 1 BIT_MASK 0x800 FORMAT "%13.11" ECU_ADDRESS 0x3FE4A4 /end MEASUREMENT
/begin MEASUREMENT B_nphshe2 "Nicht plausibler Fehler: Lambda-Sonden Heizung 2 hinter Kat. (Endstufe)" UWORD B_TRUE 1 100 0 1 BIT_MASK 0x800 FORMAT "%13.11" ECU_ADDRESS 0x3FE4A6 /end MEASUREMENT
/begin MEASUREMENT B_nphsv "Nernstwiderstand Sonde vor Kat zu groﬂ" UWORD B_TRUE 1 100 0 1 BIT_MASK 0x800 FORMAT "%13.11" ECU_ADDRESS 0x3FE4A8 /end MEASUREMENT
/begin MEASUREMENT B_nphsv2 "Nernstwiderstand Sonde 2 vor Kat zu groﬂ" UWORD B_TRUE 1 100 0 1 BIT_MASK 0x800 FORMAT "%13.11" ECU_ADDRESS 0x3FE4AA /end MEASUREMENT
/begin MEASUREMENT B_nphsve "Fehlerart: Signal der Heizerzuleitung ist unplausibel (Endstufe)" UWORD B_TRUE 1 100 0 1 BIT_MASK 0x800 FORMAT "%13.11" ECU_ADDRESS 0x3FE4AC /end MEASUREMENT
/begin MEASUREMENT B_nphsve2 "Fehlerart: Signal der Heizerzuleitung ist unplausibel, Bank 2 (Endstufe)" UWORD B_TRUE 1 100 0 1 BIT_MASK 0x800 FORMAT "%13.11" ECU_ADDRESS 0x3FE4AE /end MEASUREMENT
/begin MEASUREMENT B_npkpe "Bedingung f¸r Fehlertyp 'Wert unplausibel' f¸r EKP-Relais Endstufe erkannt" UWORD B_TRUE 1 100 0 1 BIT_MASK 0x800 FORMAT "%13.11" ECU_ADDRESS 0x3FE4BE /end MEASUREMENT
/begin MEASUREMENT B_nplm "Bedingung Plausfehler Hauptf¸llungssensor" UWORD B_TRUE 1 100 0 1 BIT_MASK 0x800 FORMAT "%13.11" ECU_ADDRESS 0x3FE4E0 /end MEASUREMENT
/begin MEASUREMENT B_npn "Fehlerart: h‰ufiger Bezugsmarkenfehler beim L¸ckencheck" UWORD B_TRUE 1 100 0 1 BIT_MASK 0x800 FORMAT "%13.11" ECU_ADDRESS 0x3FE524 /end MEASUREMENT
/begin MEASUREMENT B_nppmbatt "" UWORD B_TRUE 1 100 0 1 BIT_MASK 0x800 FORMAT "%13.11" ECU_ADDRESS 0x3FE53E /end MEASUREMENT
/begin MEASUREMENT B_nppmbn "Nicht-Plausibel Fehler, PM Bordnetz" UWORD B_TRUE 1 100 0 1 BIT_MASK 0x800 FORMAT "%13.11" ECU_ADDRESS 0x3FE540 /end MEASUREMENT
/begin MEASUREMENT B_nptesg "Fehlertyp 'unplausibles Pr¸fresultat' erkannt (Grobleck)" UWORD B_TRUE 1 100 0 1 BIT_MASK 0x800 FORMAT "%13.11" ECU_ADDRESS 0x3FE564 /end MEASUREMENT
/begin MEASUREMENT B_sibm "Fehlertyp: keine Bezugsmarke im Start gefunden" UWORD B_TRUE 1 100 0 1 BIT_MASK 0x400 FORMAT "%13.11" ECU_ADDRESS 0x3FE3BC /end MEASUREMENT
/begin MEASUREMENT B_sicars "Signalfehler CAN-Timeout ARS-Botschaft" UWORD B_TRUE 1 100 0 1 BIT_MASK 0x400 FORMAT "%13.11" ECU_ADDRESS 0x3FE3CA /end MEASUREMENT
/begin MEASUREMENT B_siccas "Signalfehler CAN-Timeout CAS-Botschaft" UWORD B_TRUE 1 100 0 1 BIT_MASK 0x400 FORMAT "%13.11" ECU_ADDRESS 0x3FE3CC /end MEASUREMENT
/begin MEASUREMENT B_sicdsc "Signalfehler CAN-Timeout DSC-Botschaften" UWORD B_TRUE 1 100 0 1 BIT_MASK 0x400 FORMAT "%13.11" ECU_ADDRESS 0x3FE3CE /end MEASUREMENT
/begin MEASUREMENT B_sicegs "Signalfehler CAN-Timeout EGS-Botschaften" UWORD B_TRUE 1 100 0 1 BIT_MASK 0x400 FORMAT "%13.11" ECU_ADDRESS 0x3FE3D0 /end MEASUREMENT
/begin MEASUREMENT B_sicfc "Fehlertyp ""Signalfehler"" bei Check Filler Cap" UWORD B_TRUE 1 100 0 1 BIT_MASK 0x400 FORMAT "%13.11" ECU_ADDRESS 0x3FE3D2 /end MEASUREMENT
/begin MEASUREMENT B_sicihka "Signalfehler CAN-Timeout IHKA-Botschaft" UWORD B_TRUE 1 100 0 1 BIT_MASK 0x400 FORMAT "%13.11" ECU_ADDRESS 0x3FE3D4 /end MEASUREMENT
/begin MEASUREMENT B_sicins "Signalfehler CAN-Timeout Botschaft Kombi-Instruments" UWORD B_TRUE 1 100 0 1 BIT_MASK 0x400 FORMAT "%13.11" ECU_ADDRESS 0x3FE3D6 /end MEASUREMENT
/begin MEASUREMENT B_sicod "Fehlertyp Sig.: Steuerger‰t noch nicht codiert" UWORD B_TRUE 1 100 0 1 BIT_MASK 0x400 FORMAT "%13.11" ECU_ADDRESS 0x3FE3D8 /end MEASUREMENT
/begin MEASUREMENT B_sicssg "Signalfehler CAN-Timeout SSG-Botschaft" UWORD B_TRUE 1 100 0 1 BIT_MASK 0x400 FORMAT "%13.11" ECU_ADDRESS 0x3FE3DA /end MEASUREMENT
/begin MEASUREMENT B_sicszl "Signalfehler CAN-Timeout SZL-Botschaft" UWORD B_TRUE 1 100 0 1 BIT_MASK 0x400 FORMAT "%13.11" ECU_ADDRESS 0x3FE3DC /end MEASUREMENT
/begin MEASUREMENT B_sidhdmte "Fehlerart: Leitungsabfall DM-TL Heizung (Endstufe)" UWORD B_TRUE 1 100 0 1 BIT_MASK 0x400 FORMAT "%13.11" ECU_ADDRESS 0x3FE3EC /end MEASUREMENT
/begin MEASUREMENT B_sidisa "Signal inaktiv" UWORD B_TRUE 1 100 0 1 BIT_MASK 0x400 FORMAT "%13.11" ECU_ADDRESS 0x3FE3F4 /end MEASUREMENT
/begin MEASUREMENT B_sidisat "" UWORD B_TRUE 1 100 0 1 BIT_MASK 0x400 FORMAT "%13.11" ECU_ADDRESS 0x3FE3F6 /end MEASUREMENT
/begin MEASUREMENT B_sidk "Fehlertyp signal: Drosselklappenpoti" UWORD B_TRUE 1 100 0 1 BIT_MASK 0x400 FORMAT "%13.11" ECU_ADDRESS 0x3FE3F8 /end MEASUREMENT
/begin MEASUREMENT B_sidk1p "Fehlendes Signal: Drosselklappe 1. Poti" UWORD B_TRUE 1 100 0 1 BIT_MASK 0x400 FORMAT "%13.11" ECU_ADDRESS 0x3FE3FA /end MEASUREMENT
/begin MEASUREMENT B_sidk2p "Fehlendes Signal: Drosselklappe 2. Poti" UWORD B_TRUE 1 100 0 1 BIT_MASK 0x400 FORMAT "%13.11" ECU_ADDRESS 0x3FE3FC /end MEASUREMENT
/begin MEASUREMENT B_sidmmve "Fehlerart: Leitungsabfall DM-TL Magnetventil (Endstufe)" UWORD B_TRUE 1 100 0 1 BIT_MASK 0x400 FORMAT "%13.11" ECU_ADDRESS 0x3FE3FE /end MEASUREMENT
/begin MEASUREMENT B_sidmpme "Fehlerart: Leitungsabfall DM-TL Pumpenmotor (Endstufe)" UWORD B_TRUE 1 100 0 1 BIT_MASK 0x400 FORMAT "%13.11" ECU_ADDRESS 0x3FE400 /end MEASUREMENT
/begin MEASUREMENT B_sidmtk "Fehlertyp 'Signalfehler' erkannt (DMTK)" UWORD B_TRUE 1 100 0 1 BIT_MASK 0x400 FORMAT "%13.11" ECU_ADDRESS 0x3FE402 /end MEASUREMENT
/begin MEASUREMENT B_sidmtl "Fehlertyp 'Signalfehler' erkannt (DMTL-Modul)" UWORD B_TRUE 1 100 0 1 BIT_MASK 0x400 FORMAT "%13.11" ECU_ADDRESS 0x3FE406 /end MEASUREMENT
/begin MEASUREMENT B_sidpmee "Fehlerart: Leitungsabfall DM-TL Pumpenmotor (Endstufe)" UWORD B_TRUE 1 100 0 1 BIT_MASK 0x400 FORMAT "%13.11" ECU_ADDRESS 0x3FE408 /end MEASUREMENT
/begin MEASUREMENT B_sidvee "Fehlertyp sig.: DV-E Endstufe" UWORD B_TRUE 1 100 0 1 BIT_MASK 0x400 FORMAT "%13.11" ECU_ADDRESS 0x3FE412 /end MEASUREMENT
/begin MEASUREMENT B_sidvef "Fehlertyp sig.: DV-E Fehler bei Federpr¸fung" UWORD B_TRUE 1 100 0 1 BIT_MASK 0x400 FORMAT "%13.11" ECU_ADDRESS 0x3FE414 /end MEASUREMENT
/begin MEASUREMENT B_sidvefo "Nicht benutzt" UWORD B_TRUE 1 100 0 1 BIT_MASK 0x400 FORMAT "%13.11" ECU_ADDRESS 0x3FE416 /end MEASUREMENT
/begin MEASUREMENT B_sidvel "Fehlertyp sig.: DV-E Lageabweichung" UWORD B_TRUE 1 100 0 1 BIT_MASK 0x400 FORMAT "%13.11" ECU_ADDRESS 0x3FE418 /end MEASUREMENT
/begin MEASUREMENT B_sidven "Fehlertyp sig.: DV-E Fehler bei Pr¸fung Notluftposition" UWORD B_TRUE 1 100 0 1 BIT_MASK 0x400 FORMAT "%13.11" ECU_ADDRESS 0x3FE41A /end MEASUREMENT
/begin MEASUREMENT B_sidver "Fehlertyp sig.: DV-E Regelbereich" UWORD B_TRUE 1 100 0 1 BIT_MASK 0x400 FORMAT "%13.11" ECU_ADDRESS 0x3FE41C /end MEASUREMENT
/begin MEASUREMENT B_sidvet "Nicht benutzt" UWORD B_TRUE 1 100 0 1 BIT_MASK 0x400 FORMAT "%13.11" ECU_ADDRESS 0x3FE422 /end MEASUREMENT
/begin MEASUREMENT B_sidveu "Fehlertyp sig.: DV-E Fehler beim UMA-Lernen" UWORD B_TRUE 1 100 0 1 BIT_MASK 0x400 FORMAT "%13.11" ECU_ADDRESS 0x3FE424 /end MEASUREMENT
/begin MEASUREMENT B_sidveub "Nicht benutzt" UWORD B_TRUE 1 100 0 1 BIT_MASK 0x400 FORMAT "%13.11" ECU_ADDRESS 0x3FE426 /end MEASUREMENT
/begin MEASUREMENT B_sidveuw "Nicht benutzt" UWORD B_TRUE 1 100 0 1 BIT_MASK 0x400 FORMAT "%13.11" ECU_ADDRESS 0x3FE428 /end MEASUREMENT
/begin MEASUREMENT B_sidvev "Fehlertyp sig.: DV-E Fehler bei Verst‰rkerabgleich" UWORD B_TRUE 1 100 0 1 BIT_MASK 0x400 FORMAT "%13.11" ECU_ADDRESS 0x3FE42A /end MEASUREMENT
/begin MEASUREMENT B_sidylsu "Fehlerart: Sig-Fehler, Dynamikdiagnose LSU," UWORD B_TRUE 1 100 0 1 BIT_MASK 0x400 FORMAT "%13.11" ECU_ADDRESS 0x3FE454 /end MEASUREMENT
/begin MEASUREMENT B_sidylsu2 "Fehlerart: Sig-Fehler, Dynamikdiagnose LSU, Bank 2" UWORD B_TRUE 1 100 0 1 BIT_MASK 0x400 FORMAT "%13.11" ECU_ADDRESS 0x3FE456 /end MEASUREMENT
/begin MEASUREMENT B_siels "Fehlertype: Leitungsabfall Endstufe E-Box L¸fter" UWORD B_TRUE 1 100 0 1 BIT_MASK 0x400 FORMAT "%13.11" ECU_ADDRESS 0x3FE46A /end MEASUREMENT
/begin MEASUREMENT B_siev1 "Fehlerart: Unterbrechung an Endstufe EV1" UWORD B_TRUE 1 100 0 1 BIT_MASK 0x400 FORMAT "%13.11" ECU_ADDRESS 0x3FE476 /end MEASUREMENT
/begin MEASUREMENT B_siev2 "Fehlerart: Unterbrechung an Endstufe EV2" UWORD B_TRUE 1 100 0 1 BIT_MASK 0x400 FORMAT "%13.11" ECU_ADDRESS 0x3FE478 /end MEASUREMENT
/begin MEASUREMENT B_siev3 "Fehlerart: Unterbrechung an Endstufe EV3" UWORD B_TRUE 1 100 0 1 BIT_MASK 0x400 FORMAT "%13.11" ECU_ADDRESS 0x3FE47A /end MEASUREMENT
/begin MEASUREMENT B_siev4 "Fehlerart: Unterbrechung an Endstufe EV4" UWORD B_TRUE 1 100 0 1 BIT_MASK 0x400 FORMAT "%13.11" ECU_ADDRESS 0x3FE47C /end MEASUREMENT
/begin MEASUREMENT B_siev5 "Fehlerart: Unterbrechung an Endstufe EV5" UWORD B_TRUE 1 100 0 1 BIT_MASK 0x400 FORMAT "%13.11" ECU_ADDRESS 0x3FE47E /end MEASUREMENT
/begin MEASUREMENT B_siev6 "Fehlerart: Unterbrechung an Endstufe EV6" UWORD B_TRUE 1 100 0 1 BIT_MASK 0x400 FORMAT "%13.11" ECU_ADDRESS 0x3FE480 /end MEASUREMENT
/begin MEASUREMENT B_siev7 "Fehlerart: Unterbrechung an Endstufe EV7" UWORD B_TRUE 1 100 0 1 BIT_MASK 0x400 FORMAT "%13.11" ECU_ADDRESS 0x3FE482 /end MEASUREMENT
/begin MEASUREMENT B_siev8 "Fehlerart: Unterbrechung an Endstufe EV8" UWORD B_TRUE 1 100 0 1 BIT_MASK 0x400 FORMAT "%13.11" ECU_ADDRESS 0x3FE484 /end MEASUREMENT
/begin MEASUREMENT B_sifst "Fehlertyp: Fuellstandssensor - Signal nicht in Ordnung" UWORD B_TRUE 1 100 0 1 BIT_MASK 0x400 FORMAT "%13.11" ECU_ADDRESS 0x3FE498 /end MEASUREMENT
/begin MEASUREMENT B_siglfe "Fehlerart: Leitungsabfall GLF Endstufe" UWORD B_TRUE 1 100 0 1 BIT_MASK 0x400 FORMAT "%13.11" ECU_ADDRESS 0x3FE49A /end MEASUREMENT
/begin MEASUREMENT B_sihelsu "Fehlerart: Signalfehler der Heizereinkopplungsdiagnose" UWORD B_TRUE 1 100 0 1 BIT_MASK 0x400 FORMAT "%13.11" ECU_ADDRESS 0x3FE49C /end MEASUREMENT
/begin MEASUREMENT B_sihelsu2 "Fehlerart: Signalfehler der Heizereinkopplungsdiagnose" UWORD B_TRUE 1 100 0 1 BIT_MASK 0x400 FORMAT "%13.11" ECU_ADDRESS 0x3FE49E /end MEASUREMENT
/begin MEASUREMENT B_sihsh "Lastabfall Sondenheizung hinter Kat" UWORD B_TRUE 1 100 0 1 BIT_MASK 0x400 FORMAT "%13.11" ECU_ADDRESS 0x3FE4A0 /end MEASUREMENT
/begin MEASUREMENT B_sihsh2 "Lastabfall Sondenheizung2 hinter Kat" UWORD B_TRUE 1 100 0 1 BIT_MASK 0x400 FORMAT "%13.11" ECU_ADDRESS 0x3FE4A2 /end MEASUREMENT
/begin MEASUREMENT B_sihshe "Lastabfall Sondenheizung hinter Kat (Endstufe)" UWORD B_TRUE 1 100 0 1 BIT_MASK 0x400 FORMAT "%13.11" ECU_ADDRESS 0x3FE4A4 /end MEASUREMENT
/begin MEASUREMENT B_sihshe2 "Lastabfall Sondenheizung2 hinter Kat (Endstufe)" UWORD B_TRUE 1 100 0 1 BIT_MASK 0x400 FORMAT "%13.11" ECU_ADDRESS 0x3FE4A6 /end MEASUREMENT
/begin MEASUREMENT B_sihsv "Lastabfall Sondenheizung vor Kat" UWORD B_TRUE 1 100 0 1 BIT_MASK 0x400 FORMAT "%13.11" ECU_ADDRESS 0x3FE4A8 /end MEASUREMENT
/begin MEASUREMENT B_sihsv2 "Lastabfall Sondenheizung2 vor Kat" UWORD B_TRUE 1 100 0 1 BIT_MASK 0x400 FORMAT "%13.11" ECU_ADDRESS 0x3FE4AA /end MEASUREMENT
/begin MEASUREMENT B_sihsve "Lastabfall Sondenheizung vor Kat (Endstufe)" UWORD B_TRUE 1 100 0 1 BIT_MASK 0x400 FORMAT "%13.11" ECU_ADDRESS 0x3FE4AC /end MEASUREMENT
/begin MEASUREMENT B_sihsve2 "Lastabfall Sondenheizung2 vor Kat (Endstufe)" UWORD B_TRUE 1 100 0 1 BIT_MASK 0x400 FORMAT "%13.11" ECU_ADDRESS 0x3FE4AE /end MEASUREMENT
/begin MEASUREMENT B_sikpe "Bedingung f¸r Fehlertyp Leitungsabfall f¸r EKP-Relais Endstufe erkannt" UWORD B_TRUE 1 100 0 1 BIT_MASK 0x400 FORMAT "%13.11" ECU_ADDRESS 0x3FE4BE /end MEASUREMENT
/begin MEASUREMENT B_silm "Bedingung Signalfehler Hauptf¸llungssensor" UWORD B_TRUE 1 100 0 1 BIT_MASK 0x400 FORMAT "%13.11" ECU_ADDRESS 0x3FE4E0 /end MEASUREMENT
/begin MEASUREMENT B_sin "Fehlertyp: kein Drehzahlsignal vorhanden" UWORD B_TRUE 1 100 0 1 BIT_MASK 0x400 FORMAT "%13.11" ECU_ADDRESS 0x3FE524 /end MEASUREMENT
/begin MEASUREMENT B_sipmbatt "" UWORD B_TRUE 1 100 0 1 BIT_MASK 0x400 FORMAT "%13.11" ECU_ADDRESS 0x3FE53E /end MEASUREMENT
/begin MEASUREMENT B_sipmbn "Signalfehler, PM Bordnetz" UWORD B_TRUE 1 100 0 1 BIT_MASK 0x400 FORMAT "%13.11" ECU_ADDRESS 0x3FE540 /end MEASUREMENT
/begin MEASUREMENT B_sitesg "Fehlerart: Grobleck" UWORD B_TRUE 1 100 0 1 BIT_MASK 0x400 FORMAT "%13.11" ECU_ADDRESS 0x3FE564 /end MEASUREMENT
/begin MEASUREMENT E_bm "Errorflag: Bezugsmarkengeber" UWORD B_TRUE 1 100 0 1 BIT_MASK 0x1 FORMAT "%13.11" ECU_ADDRESS 0x3FE3BC /end MEASUREMENT
/begin MEASUREMENT E_cars "Errorflag: CAN-Schnittstelle, Timeout ARS" UWORD B_TRUE 1 100 0 1 BIT_MASK 0x1 FORMAT "%13.11" ECU_ADDRESS 0x3FE3CA /end MEASUREMENT
/begin MEASUREMENT E_ccas "Errorflag: CAN-Schnittstelle, Timeout CAS" UWORD B_TRUE 1 100 0 1 BIT_MASK 0x1 FORMAT "%13.11" ECU_ADDRESS 0x3FE3CC /end MEASUREMENT
/begin MEASUREMENT E_cdsc "Errorflag: CAN-Schnittstelle DSC-SG" UWORD B_TRUE 1 100 0 1 BIT_MASK 0x1 FORMAT "%13.11" ECU_ADDRESS 0x3FE3CE /end MEASUREMENT
/begin MEASUREMENT E_cegs "Errorflag: CAN-Kopplung zum EGS" UWORD B_TRUE 1 100 0 1 BIT_MASK 0x1 FORMAT "%13.11" ECU_ADDRESS 0x3FE3D0 /end MEASUREMENT
/begin MEASUREMENT E_cfc "Errorflag Tankdeckel offen" UWORD B_TRUE 1 100 0 1 BIT_MASK 0x1 FORMAT "%13.11" ECU_ADDRESS 0x3FE3D2 /end MEASUREMENT
/begin MEASUREMENT E_cihka "Errorflag: CAN-Schnittstelle, Timeout IHKA" UWORD B_TRUE 1 100 0 1 BIT_MASK 0x1 FORMAT "%13.11" ECU_ADDRESS 0x3FE3D4 /end MEASUREMENT
/begin MEASUREMENT E_cins "Errorflag: CAN-Schnittstelle, Timeout Instrument" UWORD B_TRUE 1 100 0 1 BIT_MASK 0x1 FORMAT "%13.11" ECU_ADDRESS 0x3FE3D6 /end MEASUREMENT
/begin MEASUREMENT E_cod "Errorflag: Steuerger‰t noch nicht codiert" UWORD B_TRUE 1 100 0 1 BIT_MASK 0x1 FORMAT "%13.11" ECU_ADDRESS 0x3FE3D8 /end MEASUREMENT
/begin MEASUREMENT E_cssg "Errorflag: CAN-Schnittstelle,  SGG-Steuerger‰t" UWORD B_TRUE 1 100 0 1 BIT_MASK 0x1 FORMAT "%13.11" ECU_ADDRESS 0x3FE3DA /end MEASUREMENT
/begin MEASUREMENT E_cszl "Errorflag: CAN-Schnittstelle, Timeout SZL" UWORD B_TRUE 1 100 0 1 BIT_MASK 0x1 FORMAT "%13.11" ECU_ADDRESS 0x3FE3DC /end MEASUREMENT
/begin MEASUREMENT E_dhdmte "Errorflag: DM-TL Heizung (Endstufe)" UWORD B_TRUE 1 100 0 1 BIT_MASK 0x1 FORMAT "%13.11" ECU_ADDRESS 0x3FE3EC /end MEASUREMENT
/begin MEASUREMENT E_disa "Fehlerflag aus DDISA" UWORD B_TRUE 1 100 0 1 BIT_MASK 0x1 FORMAT "%13.11" ECU_ADDRESS 0x3FE3F4 /end MEASUREMENT
/begin MEASUREMENT E_disat "" UWORD B_TRUE 1 100 0 1 BIT_MASK 0x1 FORMAT "%13.11" ECU_ADDRESS 0x3FE3F6 /end MEASUREMENT
/begin MEASUREMENT E_dk "Errorflag: DK - Potentiometer" UWORD B_TRUE 1 100 0 1 BIT_MASK 0x1 FORMAT "%13.11" ECU_ADDRESS 0x3FE3F8 /end MEASUREMENT
/begin MEASUREMENT E_dk1p "Errorflag: Drosselklappe 1. Poti" UWORD B_TRUE 1 100 0 1 BIT_MASK 0x1 FORMAT "%13.11" ECU_ADDRESS 0x3FE3FA /end MEASUREMENT
/begin MEASUREMENT E_dk2p "Errorflag: Drosselklappe 2. Poti" UWORD B_TRUE 1 100 0 1 BIT_MASK 0x1 FORMAT "%13.11" ECU_ADDRESS 0x3FE3FC /end MEASUREMENT
/begin MEASUREMENT E_dmmve "Errorflag: DM-TL Magnetventil (Endstufe)" UWORD B_TRUE 1 100 0 1 BIT_MASK 0x1 FORMAT "%13.11" ECU_ADDRESS 0x3FE3FE /end MEASUREMENT
/begin MEASUREMENT E_dmpme "Errorflag: DM-TL Pumpenmotor (Endstufe)" UWORD B_TRUE 1 100 0 1 BIT_MASK 0x1 FORMAT "%13.11" ECU_ADDRESS 0x3FE400 /end MEASUREMENT
/begin MEASUREMENT E_dmtk "Errorflag: Tankentl¸ftungssystem Grob- oder Feinleck" UWORD B_TRUE 1 100 0 1 BIT_MASK 0x1 FORMAT "%13.11" ECU_ADDRESS 0x3FE402 /end MEASUREMENT
/begin MEASUREMENT E_dmtl "Errorflag: DMTL-Modul" UWORD B_TRUE 1 100 0 1 BIT_MASK 0x1 FORMAT "%13.11" ECU_ADDRESS 0x3FE406 /end MEASUREMENT
/begin MEASUREMENT E_dpmee "Errorflag: DM-TL Pumpenmotor (Endstufe)" UWORD B_TRUE 1 100 0 1 BIT_MASK 0x1 FORMAT "%13.11" ECU_ADDRESS 0x3FE408 /end MEASUREMENT
/begin MEASUREMENT E_dvee "Errorflag: DV-E Endstufe" UWORD B_TRUE 1 100 0 1 BIT_MASK 0x1 FORMAT "%13.11" ECU_ADDRESS 0x3FE412 /end MEASUREMENT
/begin MEASUREMENT E_dvef "Errorflag: DV-E Fehler bei Federpr¸fung" UWORD B_TRUE 1 100 0 1 BIT_MASK 0x1 FORMAT "%13.11" ECU_ADDRESS 0x3FE414 /end MEASUREMENT
/begin MEASUREMENT E_dvefo "Errorflag: DV-E-Fehler bei Federpr¸fung ""÷ffnen""" UWORD B_TRUE 1 100 0 1 BIT_MASK 0x1 FORMAT "%13.11" ECU_ADDRESS 0x3FE416 /end MEASUREMENT
/begin MEASUREMENT E_dvel "Errorflag: DV-E Lageabweichung" UWORD B_TRUE 1 100 0 1 BIT_MASK 0x1 FORMAT "%13.11" ECU_ADDRESS 0x3FE418 /end MEASUREMENT
/begin MEASUREMENT E_dven "Errorflag: DV-E Fehler bei Pr¸fung Notluftposition" UWORD B_TRUE 1 100 0 1 BIT_MASK 0x1 FORMAT "%13.11" ECU_ADDRESS 0x3FE41A /end MEASUREMENT
/begin MEASUREMENT E_dver "Errorflag: DV-E Regelbereich" UWORD B_TRUE 1 100 0 1 BIT_MASK 0x1 FORMAT "%13.11" ECU_ADDRESS 0x3FE41C /end MEASUREMENT
/begin MEASUREMENT E_dvet "Errorflag: DV-E-Tauscherkennung ohne Adaption" UWORD B_TRUE 1 100 0 1 BIT_MASK 0x1 FORMAT "%13.11" ECU_ADDRESS 0x3FE422 /end MEASUREMENT
/begin MEASUREMENT E_dveu "Errorflag: DV-E Fehler beim UMA-Lernen" UWORD B_TRUE 1 100 0 1 BIT_MASK 0x1 FORMAT "%13.11" ECU_ADDRESS 0x3FE424 /end MEASUREMENT
/begin MEASUREMENT E_dveub "Errorflag: DV-E-Adaption Abbruch wg. Umweltbedingung" UWORD B_TRUE 1 100 0 1 BIT_MASK 0x1 FORMAT "%13.11" ECU_ADDRESS 0x3FE426 /end MEASUREMENT
/begin MEASUREMENT E_dveuw "Errorflag: Fehler bei UMA-Wiederlernen" UWORD B_TRUE 1 100 0 1 BIT_MASK 0x1 FORMAT "%13.11" ECU_ADDRESS 0x3FE428 /end MEASUREMENT
/begin MEASUREMENT E_dvev "Errorflag: DV-E Fehler bei Verst‰rkerabgleich" UWORD B_TRUE 1 100 0 1 BIT_MASK 0x1 FORMAT "%13.11" ECU_ADDRESS 0x3FE42A /end MEASUREMENT
/begin MEASUREMENT E_dylsu "Errorflag: LSU dynamisch zu langsam" UWORD B_TRUE 1 100 0 1 BIT_MASK 0x1 FORMAT "%13.11" ECU_ADDRESS 0x3FE454 /end MEASUREMENT
/begin MEASUREMENT E_dylsu2 "Errorflag: LSU dynamisch zu langsam, Bank 2" UWORD B_TRUE 1 100 0 1 BIT_MASK 0x1 FORMAT "%13.11" ECU_ADDRESS 0x3FE456 /end MEASUREMENT
/begin MEASUREMENT E_els "Errorflag: Endstufe E-Box L¸fter" UWORD B_TRUE 1 100 0 1 BIT_MASK 0x1 FORMAT "%13.11" ECU_ADDRESS 0x3FE46A /end MEASUREMENT
/begin MEASUREMENT E_ev1 "Errorflag: EV von Zyl. 1" UWORD B_TRUE 1 100 0 1 BIT_MASK 0x1 FORMAT "%13.11" ECU_ADDRESS 0x3FE476 /end MEASUREMENT
/begin MEASUREMENT E_ev2 "Errorflag: EV von Zyl. 2" UWORD B_TRUE 1 100 0 1 BIT_MASK 0x1 FORMAT "%13.11" ECU_ADDRESS 0x3FE478 /end MEASUREMENT
/begin MEASUREMENT E_ev3 "Errorflag: EV von Zyl. 3" UWORD B_TRUE 1 100 0 1 BIT_MASK 0x1 FORMAT "%13.11" ECU_ADDRESS 0x3FE47A /end MEASUREMENT
/begin MEASUREMENT E_ev4 "Errorflag: EV von Zyl. 4" UWORD B_TRUE 1 100 0 1 BIT_MASK 0x1 FORMAT "%13.11" ECU_ADDRESS 0x3FE47C /end MEASUREMENT
/begin MEASUREMENT E_ev5 "Errorflag: EV von Zyl. 5" UWORD B_TRUE 1 100 0 1 BIT_MASK 0x1 FORMAT "%13.11" ECU_ADDRESS 0x3FE47E /end MEASUREMENT
/begin MEASUREMENT E_ev6 "Errorflag: EV von Zyl. 6" UWORD B_TRUE 1 100 0 1 BIT_MASK 0x1 FORMAT "%13.11" ECU_ADDRESS 0x3FE480 /end MEASUREMENT
/begin MEASUREMENT E_ev7 "Errorflag: EV von Zyl. 7" UWORD B_TRUE 1 100 0 1 BIT_MASK 0x1 FORMAT "%13.11" ECU_ADDRESS 0x3FE482 /end MEASUREMENT
/begin MEASUREMENT E_ev8 "Errorflag: EV von Zyl. 8" UWORD B_TRUE 1 100 0 1 BIT_MASK 0x1 FORMAT "%13.11" ECU_ADDRESS 0x3FE484 /end MEASUREMENT
/begin MEASUREMENT E_fst "Errorflag: Tankf¸llstand" UWORD B_TRUE 1 100 0 1 BIT_MASK 0x1 FORMAT "%13.11" ECU_ADDRESS 0x3FE498 /end MEASUREMENT
/begin MEASUREMENT E_glfe "Error Flag: Endstufe gesteuerte Luftf¸hrung (GLF)" UWORD B_TRUE 1 100 0 1 BIT_MASK 0x1 FORMAT "%13.11" ECU_ADDRESS 0x3FE49A /end MEASUREMENT
/begin MEASUREMENT E_helsu "Errorflag: Heizung LSU" UWORD B_TRUE 1 100 0 1 BIT_MASK 0x1 FORMAT "%13.11" ECU_ADDRESS 0x3FE49C /end MEASUREMENT
/begin MEASUREMENT E_helsu2 "Errorflag: Heizung LSU (Bank2)" UWORD B_TRUE 1 100 0 1 BIT_MASK 0x1 FORMAT "%13.11" ECU_ADDRESS 0x3FE49E /end MEASUREMENT
/begin MEASUREMENT E_hsh "Errorflag: Lambdasonden-Heizung hinter Katalysator" UWORD B_TRUE 1 100 0 1 BIT_MASK 0x1 FORMAT "%13.11" ECU_ADDRESS 0x3FE4A0 /end MEASUREMENT
/begin MEASUREMENT E_hsh2 "Errorflag: Lambdasonden-Heizung hinter Katalysator Bank 2" UWORD B_TRUE 1 100 0 1 BIT_MASK 0x1 FORMAT "%13.11" ECU_ADDRESS 0x3FE4A2 /end MEASUREMENT
/begin MEASUREMENT E_hshe "Errorflag: Lambdasonden-Heizung hinter Katalysator (Endstufe)" UWORD B_TRUE 1 100 0 1 BIT_MASK 0x1 FORMAT "%13.11" ECU_ADDRESS 0x3FE4A4 /end MEASUREMENT
/begin MEASUREMENT E_hshe2 "Errorflag: Lambdasonden-Heizung hinter Katalysator Bank 2 (Endstufe)" UWORD B_TRUE 1 100 0 1 BIT_MASK 0x1 FORMAT "%13.11" ECU_ADDRESS 0x3FE4A6 /end MEASUREMENT
/begin MEASUREMENT E_hsv "Errorflag: Lambdasonden-Heizung vor Katalysator" UWORD B_TRUE 1 100 0 1 BIT_MASK 0x1 FORMAT "%13.11" ECU_ADDRESS 0x3FE4A8 /end MEASUREMENT
/begin MEASUREMENT E_hsv2 "Errorflag: Lambdasonden-Heizung vor Katalysator Bank 2" UWORD B_TRUE 1 100 0 1 BIT_MASK 0x1 FORMAT "%13.11" ECU_ADDRESS 0x3FE4AA /end MEASUREMENT
/begin MEASUREMENT E_hsve "Errorflag: Lambdasonden-Heizung vor Katalysator (Endstufe)" UWORD B_TRUE 1 100 0 1 BIT_MASK 0x1 FORMAT "%13.11" ECU_ADDRESS 0x3FE4AC /end MEASUREMENT
/begin MEASUREMENT E_hsve2 "Errorflag: Lambdasonden-Heizung vor Katalysator Bank 2 (Endstufe)" UWORD B_TRUE 1 100 0 1 BIT_MASK 0x1 FORMAT "%13.11" ECU_ADDRESS 0x3FE4AE /end MEASUREMENT
/begin MEASUREMENT E_kpe "Errorflag: EKP-Relais Endstufe" UWORD B_TRUE 1 100 0 1 BIT_MASK 0x1 FORMAT "%13.11" ECU_ADDRESS 0x3FE4BE /end MEASUREMENT
/begin MEASUREMENT E_lm "Errorflag: Hauptlastsensor" UWORD B_TRUE 1 100 0 1 BIT_MASK 0x1 FORMAT "%13.11" ECU_ADDRESS 0x3FE4E0 /end MEASUREMENT
/begin MEASUREMENT E_n "Errorflag: Drehzahlsignalgeber" UWORD B_TRUE 1 100 0 1 BIT_MASK 0x1 FORMAT "%13.11" ECU_ADDRESS 0x3FE524 /end MEASUREMENT
/begin MEASUREMENT E_pmbatt "" UWORD B_TRUE 1 100 0 1 BIT_MASK 0x1 FORMAT "%13.11" ECU_ADDRESS 0x3FE53E /end MEASUREMENT
/begin MEASUREMENT E_pmbn "Fehlerflag, PM Bordnetz" UWORD B_TRUE 1 100 0 1 BIT_MASK 0x1 FORMAT "%13.11" ECU_ADDRESS 0x3FE540 /end MEASUREMENT
/begin MEASUREMENT E_tesg "Errorflag: Tankentl¸ftungssystem Grobleck" UWORD B_TRUE 1 100 0 1 BIT_MASK 0x1 FORMAT "%13.11" ECU_ADDRESS 0x3FE564 /end MEASUREMENT
/begin MEASUREMENT sfpaaa "Status Fehlerpfad: Tabellenanfang" UWORD dez 1 100 0 65535 FORMAT "%8.2" ECU_ADDRESS 0x3FE3AE /end MEASUREMENT
/begin MEASUREMENT sfpbm "Status Fehlerpfad: Bezugsmarkengeber" UWORD dez 1 100 0 65535 FORMAT "%8.2" ECU_ADDRESS 0x3FE3BC /end MEASUREMENT
/begin MEASUREMENT sfpcars "Status Fehlerpfad: Diagnose CAN-Timeout ARS-Schnittstelle" UWORD dez 1 100 0 65535 FORMAT "%8.2" ECU_ADDRESS 0x3FE3CA /end MEASUREMENT
/begin MEASUREMENT sfpccas "Status Fehlerpfad: Diagnose CAN-Timeout CAS-Schnittstelle" UWORD dez 1 100 0 65535 FORMAT "%8.2" ECU_ADDRESS 0x3FE3CC /end MEASUREMENT
/begin MEASUREMENT sfpcdsc "Status Fehlerpfad: Diagnose CAN-Timeout DSC-Schnittstelle" UWORD dez 1 100 0 65535 FORMAT "%8.2" ECU_ADDRESS 0x3FE3CE /end MEASUREMENT
/begin MEASUREMENT sfpcegs "Status Fehlerpfad: Diagnose CAN-Timeout EGS-Schnittstelle" UWORD dez 1 100 0 65535 FORMAT "%8.2" ECU_ADDRESS 0x3FE3D0 /end MEASUREMENT
/begin MEASUREMENT sfpcfc "Status Fehlerpfad: Check Filler Cap - offener Tankdeckel" UWORD dez 1 100 0 65535 FORMAT "%8.2" ECU_ADDRESS 0x3FE3D2 /end MEASUREMENT
/begin MEASUREMENT sfpcihka "Status Fehlerpfad: Diagnose CAN-Timeout IHKA-Schnittstelle" UWORD dez 1 100 0 65535 FORMAT "%8.2" ECU_ADDRESS 0x3FE3D4 /end MEASUREMENT
/begin MEASUREMENT sfpcins "Status Fehlerpfad: Diagnose CAN-Timeout Kombiinstr." UWORD dez 1 100 0 65535 FORMAT "%8.2" ECU_ADDRESS 0x3FE3D6 /end MEASUREMENT
/begin MEASUREMENT sfpcod "Status Fehlerpfad: Steuerger‰t noch nicht codiert" UWORD default 1 100 0 65535 FORMAT "%8.2" ECU_ADDRESS 0x3FE3D8 /end MEASUREMENT
/begin MEASUREMENT sfpcssg "Status Fehlerpfad: Diagnose CAN-Schnittstelle  SGG-Steuerger‰t" UWORD default 1 100 0 65535 FORMAT "%8.2" ECU_ADDRESS 0x3FE3DA /end MEASUREMENT
/begin MEASUREMENT sfpcszl "Status Fehlerpfad: Diagnose CAN-Timeout SZL-Schnittstelle" UWORD dez 1 100 0 65535 FORMAT "%8.2" ECU_ADDRESS 0x3FE3DC /end MEASUREMENT
/begin MEASUREMENT sfpdhdmte "Status Fehlerpfad ES-Diagnose DMTL-Heizung" UWORD dez 1 100 0 65535 FORMAT "%8.2" ECU_ADDRESS 0x3FE3EC /end MEASUREMENT
/begin MEASUREMENT sfpdisa "Status des Fehlerpfades" UWORD dez 1 100 0 65535 FORMAT "%8.2" ECU_ADDRESS 0x3FE3F4 /end MEASUREMENT
/begin MEASUREMENT sfpdisat "" UWORD dez 1 100 0 65535 FORMAT "%8.2" ECU_ADDRESS 0x3FE3F6 /end MEASUREMENT
/begin MEASUREMENT sfpdk "Status Fehlerpfad DK: Drosselklappe" UWORD dez 1 100 0 65535 FORMAT "%8.2" ECU_ADDRESS 0x3FE3F8 /end MEASUREMENT
/begin MEASUREMENT sfpdk1p "Status Fehlerpfad DK1P: Drosselklappe 1. Poti" UWORD dez 1 100 0 65535 FORMAT "%8.2" ECU_ADDRESS 0x3FE3FA /end MEASUREMENT
/begin MEASUREMENT sfpdk2p "Status Fehlerpfad DK2P: Drosselklappe 2. Poti" UWORD dez 1 100 0 65535 FORMAT "%8.2" ECU_ADDRESS 0x3FE3FC /end MEASUREMENT
/begin MEASUREMENT sfpdmmve "Status Fehlerpfad ES-Diagnose DMTL-Ventil" UWORD dez 1 100 0 65535 FORMAT "%8.2" ECU_ADDRESS 0x3FE3FE /end MEASUREMENT
/begin MEASUREMENT sfpdmpme "Status Fehlerpfad ES-Diagnose DMTL-Pumpenmotor" UWORD dez 1 100 0 65535 FORMAT "%8.2" ECU_ADDRESS 0x3FE400 /end MEASUREMENT
/begin MEASUREMENT sfpdmtk "Status Fehlerpfad: Modul DMTK" UWORD dez 1 100 0 65535 FORMAT "%8.2" ECU_ADDRESS 0x3FE402 /end MEASUREMENT
/begin MEASUREMENT sfpdmtl "Status Fehlerpfad: Modul DM-TL" UWORD dez 1 100 0 65535 FORMAT "%8.2" ECU_ADDRESS 0x3FE406 /end MEASUREMENT
/begin MEASUREMENT sfpdpmee "Status Fehlerpfad ES-Diagnose DMTL Pumpe" UWORD dez 1 100 0 65535 FORMAT "%8.2" ECU_ADDRESS 0x3FE408 /end MEASUREMENT
/begin MEASUREMENT sfpdvee "Statuswort: DV-E Endstufe" UWORD dez 1 100 0 65535 FORMAT "%8.2" ECU_ADDRESS 0x3FE412 /end MEASUREMENT
/begin MEASUREMENT sfpdvef "Statuswort: DV-E Fehler bei Federpr¸fung" UWORD dez 1 100 0 65535 FORMAT "%8.2" ECU_ADDRESS 0x3FE414 /end MEASUREMENT
/begin MEASUREMENT sfpdvefo "Status Fehlerpfad: DV-E-Fehler bei Federpr¸fung ""÷ffnen""" UWORD dez 1 100 0 65535 FORMAT "%8.2" ECU_ADDRESS 0x3FE416 /end MEASUREMENT
/begin MEASUREMENT sfpdvel "Statuswort: DV-E Lageabweichung" UWORD dez 1 100 0 65535 FORMAT "%8.2" ECU_ADDRESS 0x3FE418 /end MEASUREMENT
/begin MEASUREMENT sfpdven "Statuswort: DV-E Fehler bei Pr¸fung Notluftposition" UWORD dez 1 100 0 65535 FORMAT "%8.2" ECU_ADDRESS 0x3FE41A /end MEASUREMENT
/begin MEASUREMENT sfpdver "Statuswort: DV-E Regelbereich" UWORD dez 1 100 0 65535 FORMAT "%8.2" ECU_ADDRESS 0x3FE41C /end MEASUREMENT
/begin MEASUREMENT sfpdvet "Status Fehlerpfad: DV-E-Tauchserkennung ohne Adaption" UWORD dez 1 100 0 65535 FORMAT "%8.2" ECU_ADDRESS 0x3FE422 /end MEASUREMENT
/begin MEASUREMENT sfpdveu "Statuswort: DV-E Fehler beim UMA-Lernen" UWORD dez 1 100 0 65535 FORMAT "%8.2" ECU_ADDRESS 0x3FE424 /end MEASUREMENT
/begin MEASUREMENT sfpdveub "Status Fehlerpfad: DV-E-Adaption Abbruch wg. Umweltbedingung" UWORD dez 1 100 0 65535 FORMAT "%8.2" ECU_ADDRESS 0x3FE426 /end MEASUREMENT
/begin MEASUREMENT sfpdveuw "Status Fehlerpfad: UMA-Wiederlernen" UWORD dez 1 100 0 65535 FORMAT "%8.2" ECU_ADDRESS 0x3FE428 /end MEASUREMENT
/begin MEASUREMENT sfpdvev "Statuswort: DV-E Fehler bei Verst‰rkerabgleich" UWORD dez 1 100 0 65535 FORMAT "%8.2" ECU_ADDRESS 0x3FE42A /end MEASUREMENT
/begin MEASUREMENT sfpdylsu "Status Fehlerpfad E_dylsu" UWORD default 1 100 0 65535 FORMAT "%8.2" ECU_ADDRESS 0x3FE454 /end MEASUREMENT
/begin MEASUREMENT sfpdylsu2 "Status Fehlerpfad E_dylsu, Bank 2" UWORD default 1 100 0 65535 FORMAT "%8.2" ECU_ADDRESS 0x3FE456 /end MEASUREMENT
/begin MEASUREMENT sfpels "Status Fehlerpfad: E-Box-L¸fter" UWORD dez 1 100 0 65535 FORMAT "%8.2" ECU_ADDRESS 0x3FE46A /end MEASUREMENT
/begin MEASUREMENT sfpev1 "Status Fehlerpfad: EV1" UWORD dez 1 100 0 65535 FORMAT "%8.2" ECU_ADDRESS 0x3FE476 /end MEASUREMENT
/begin MEASUREMENT sfpev2 "Status Fehlerpfad: EV2" UWORD dez 1 100 0 65535 FORMAT "%8.2" ECU_ADDRESS 0x3FE478 /end MEASUREMENT
/begin MEASUREMENT sfpev3 "Status Fehlerpfad: EV3" UWORD dez 1 100 0 65535 FORMAT "%8.2" ECU_ADDRESS 0x3FE47A /end MEASUREMENT
/begin MEASUREMENT sfpev4 "Status Fehlerpfad: EV4" UWORD dez 1 100 0 65535 FORMAT "%8.2" ECU_ADDRESS 0x3FE47C /end MEASUREMENT
/begin MEASUREMENT sfpev5 "Status Fehlerpfad: EV5" UWORD dez 1 100 0 65535 FORMAT "%8.2" ECU_ADDRESS 0x3FE47E /end MEASUREMENT
/begin MEASUREMENT sfpev6 "Status Fehlerpfad: EV6" UWORD dez 1 100 0 65535 FORMAT "%8.2" ECU_ADDRESS 0x3FE480 /end MEASUREMENT
/begin MEASUREMENT sfpev7 "Status Fehlerpfad: EV7" UWORD dez 1 100 0 65535 FORMAT "%8.2" ECU_ADDRESS 0x3FE482 /end MEASUREMENT
/begin MEASUREMENT sfpev8 "Status Fehlerpfad: EV8" UWORD dez 1 100 0 65535 FORMAT "%8.2" ECU_ADDRESS 0x3FE484 /end MEASUREMENT
/begin MEASUREMENT sfpfst "Status Fehlerpfad: Tankf¸llstandssensor" UWORD default 1 100 0 65535 FORMAT "%8.2" ECU_ADDRESS 0x3FE498 /end MEASUREMENT
/begin MEASUREMENT sfpglfe "Status Fehlerpfad: Endstufe gesteuerte Luftf¸hrung" UWORD dez 1 100 0 65535 FORMAT "%8.2" ECU_ADDRESS 0x3FE49A /end MEASUREMENT
/begin MEASUREMENT sfphelsu "Status Fehlerpfad E_helsu" UWORD default 1 100 0 65535 FORMAT "%8.2" ECU_ADDRESS 0x3FE49C /end MEASUREMENT
/begin MEASUREMENT sfphelsu2 "Status Fehlerpfad E_helsu" UWORD default 1 100 0 65535 FORMAT "%8.2" ECU_ADDRESS 0x3FE49E /end MEASUREMENT
/begin MEASUREMENT sfphsh "Status Fehlerpfad: Heizung Lambdasonde hinter Kat" UWORD dez 1 100 0 65535 FORMAT "%8.2" ECU_ADDRESS 0x3FE4A0 /end MEASUREMENT
/begin MEASUREMENT sfphsh2 "Status Fehlerpfad: Heizung Lambdasonde 2 hinter Kat" UWORD dez 1 100 0 65535 FORMAT "%8.2" ECU_ADDRESS 0x3FE4A2 /end MEASUREMENT
/begin MEASUREMENT sfphshe "Status Fehlerpfad: Endstufe Heizung Lambdasonde hinter Kat" UWORD default 1 100 0 65535 FORMAT "%8.2" ECU_ADDRESS 0x3FE4A4 /end MEASUREMENT
/begin MEASUREMENT sfphshe2 "Status Fehlerpfad: Endstufe Heizung Lambdasonde 2 hinter Kat" UWORD default 1 100 0 65535 FORMAT "%8.2" ECU_ADDRESS 0x3FE4A6 /end MEASUREMENT
/begin MEASUREMENT sfphsv "Status Fehlerpfad: Heizung Lambdasonde vor Kat" UWORD default 1 100 0 65535 FORMAT "%8.2" ECU_ADDRESS 0x3FE4A8 /end MEASUREMENT
/begin MEASUREMENT sfphsv2 "Status Fehlerpfad: Heizung Lambdasonde 2 vor Kat" UWORD default 1 100 0 65535 FORMAT "%8.2" ECU_ADDRESS 0x3FE4AA /end MEASUREMENT
/begin MEASUREMENT sfphsve "Status Fehlerpfad: Endstufe Heizung Lambdasonde vor Kat" UWORD default 1 100 0 65535 FORMAT "%8.2" ECU_ADDRESS 0x3FE4AC /end MEASUREMENT
/begin MEASUREMENT sfphsve2 "Status Fehlerpfad: Endstufe Heizung Lambdasonde 2 vor Kat" UWORD default 1 100 0 65535 FORMAT "%8.2" ECU_ADDRESS 0x3FE4AE /end MEASUREMENT
/begin MEASUREMENT sfpkpe "Status Fehlerpfad: EKP-Relais Endstufe" UWORD dez 1 100 0 65535 FORMAT "%8.2" ECU_ADDRESS 0x3FE4BE /end MEASUREMENT
/begin MEASUREMENT sfplm "Status Fehlerpfad: Hauptf¸llungssensor" UWORD dez 1 100 0 65535 FORMAT "%8.2" ECU_ADDRESS 0x3FE4E0 /end MEASUREMENT
/begin MEASUREMENT sfpn "Status Fehlerpfad: Drehzahlgeber" UWORD dez 1 100 0 65535 FORMAT "%8.2" ECU_ADDRESS 0x3FE524 /end MEASUREMENT
/begin MEASUREMENT sfppmbatt "" UWORD dez 1 100 0 65535 FORMAT "%8.2" ECU_ADDRESS 0x3FE53E /end MEASUREMENT
/begin MEASUREMENT sfppmbn "Status Fehlerpfad, PM Bordnetz unplausibel" UWORD dez 1 100 0 65535 FORMAT "%8.2" ECU_ADDRESS 0x3FE540 /end MEASUREMENT
/begin MEASUREMENT sfptesg "Status Fehlerpfad: Tankdiagnose, Grobleck" UWORD dez 1 100 0 65535 FORMAT "%8.2" ECU_ADDRESS 0x3FE564 /end MEASUREMENT
/begin MEASUREMENT sfpzzz "Dummy: Tabellenende" UWORD dez 1 100 0 65535 FORMAT "%8.2" ECU_ADDRESS 0x3FE5A0 /end MEASUREMENT
/begin MEASUREMENT TYP_bm "" UWORD B_TRUE 1 100 0 1 BIT_MASK 0xf00 FORMAT "%13.11" ECU_ADDRESS 0x3FE3BC /end MEASUREMENT
/begin MEASUREMENT TYP_cars "" UWORD B_TRUE 1 100 0 1 BIT_MASK 0xf00 FORMAT "%13.11" ECU_ADDRESS 0x3FE3CA /end MEASUREMENT
/begin MEASUREMENT TYP_ccas "" UWORD B_TRUE 1 100 0 1 BIT_MASK 0xf00 FORMAT "%13.11" ECU_ADDRESS 0x3FE3CC /end MEASUREMENT
/begin MEASUREMENT TYP_cdsc "" UWORD B_TRUE 1 100 0 1 BIT_MASK 0xf00 FORMAT "%13.11" ECU_ADDRESS 0x3FE3CE /end MEASUREMENT
/begin MEASUREMENT TYP_cegs "" UWORD B_TRUE 1 100 0 1 BIT_MASK 0xf00 FORMAT "%13.11" ECU_ADDRESS 0x3FE3D0 /end MEASUREMENT
/begin MEASUREMENT TYP_cfc "" UWORD B_TRUE 1 100 0 1 BIT_MASK 0xf00 FORMAT "%13.11" ECU_ADDRESS 0x3FE3D2 /end MEASUREMENT
/begin MEASUREMENT TYP_cihka "" UWORD B_TRUE 1 100 0 1 BIT_MASK 0xf00 FORMAT "%13.11" ECU_ADDRESS 0x3FE3D4 /end MEASUREMENT
/begin MEASUREMENT TYP_cins "" UWORD B_TRUE 1 100 0 1 BIT_MASK 0xf00 FORMAT "%13.11" ECU_ADDRESS 0x3FE3D6 /end MEASUREMENT
/begin MEASUREMENT TYP_cod "" UWORD B_TRUE 1 100 0 1 BIT_MASK 0xf00 FORMAT "%13.11" ECU_ADDRESS 0x3FE3D8 /end MEASUREMENT
/begin MEASUREMENT TYP_cssg "" UWORD B_TRUE 1 100 0 1 BIT_MASK 0xf00 FORMAT "%13.11" ECU_ADDRESS 0x3FE3DA /end MEASUREMENT
/begin MEASUREMENT TYP_cszl "" UWORD B_TRUE 1 100 0 1 BIT_MASK 0xf00 FORMAT "%13.11" ECU_ADDRESS 0x3FE3DC /end MEASUREMENT
/begin MEASUREMENT TYP_dhdmte "" UWORD B_TRUE 1 100 0 1 BIT_MASK 0xf00 FORMAT "%13.11" ECU_ADDRESS 0x3FE3EC /end MEASUREMENT
/begin MEASUREMENT TYP_disa "" UWORD B_TRUE 1 100 0 1 BIT_MASK 0xf00 FORMAT "%13.11" ECU_ADDRESS 0x3FE3F4 /end MEASUREMENT
/begin MEASUREMENT TYP_disat "" UWORD B_TRUE 1 100 0 1 BIT_MASK 0xf00 FORMAT "%13.11" ECU_ADDRESS 0x3FE3F6 /end MEASUREMENT
/begin MEASUREMENT TYP_dk "" UWORD B_TRUE 1 100 0 1 BIT_MASK 0xf00 FORMAT "%13.11" ECU_ADDRESS 0x3FE3F8 /end MEASUREMENT
/begin MEASUREMENT TYP_dk1p "" UWORD B_TRUE 1 100 0 1 BIT_MASK 0xf00 FORMAT "%13.11" ECU_ADDRESS 0x3FE3FA /end MEASUREMENT
/begin MEASUREMENT TYP_dk2p "" UWORD B_TRUE 1 100 0 1 BIT_MASK 0xf00 FORMAT "%13.11" ECU_ADDRESS 0x3FE3FC /end MEASUREMENT
/begin MEASUREMENT TYP_dmmve "" UWORD B_TRUE 1 100 0 1 BIT_MASK 0xf00 FORMAT "%13.11" ECU_ADDRESS 0x3FE3FE /end MEASUREMENT
/begin MEASUREMENT TYP_dmpme "" UWORD B_TRUE 1 100 0 1 BIT_MASK 0xf00 FORMAT "%13.11" ECU_ADDRESS 0x3FE400 /end MEASUREMENT
/begin MEASUREMENT TYP_dmtk "" UWORD B_TRUE 1 100 0 1 BIT_MASK 0xf00 FORMAT "%13.11" ECU_ADDRESS 0x3FE402 /end MEASUREMENT
/begin MEASUREMENT TYP_dmtl "" UWORD B_TRUE 1 100 0 1 BIT_MASK 0xf00 FORMAT "%13.11" ECU_ADDRESS 0x3FE406 /end MEASUREMENT
/begin MEASUREMENT TYP_dpmee "" UWORD B_TRUE 1 100 0 1 BIT_MASK 0xf00 FORMAT "%13.11" ECU_ADDRESS 0x3FE408 /end MEASUREMENT
/begin MEASUREMENT TYP_dvee "Fehlertyp: DV-E Endstufe" UWORD B_TRUE 1 100 0 1 BIT_MASK 0xf00 FORMAT "%13.11" ECU_ADDRESS 0x3FE412 /end MEASUREMENT
/begin MEASUREMENT TYP_dvef "Fehlertyp: DV-E Fehler bei Federpr¸fung" UWORD B_TRUE 1 100 0 1 BIT_MASK 0xf00 FORMAT "%13.11" ECU_ADDRESS 0x3FE414 /end MEASUREMENT
/begin MEASUREMENT TYP_dvefo "" UWORD B_TRUE 1 100 0 1 BIT_MASK 0xf00 FORMAT "%13.11" ECU_ADDRESS 0x3FE416 /end MEASUREMENT
/begin MEASUREMENT TYP_dvel "Fehlertyp: DV-E Lageabweichung" UWORD B_TRUE 1 100 0 1 BIT_MASK 0xf00 FORMAT "%13.11" ECU_ADDRESS 0x3FE418 /end MEASUREMENT
/begin MEASUREMENT TYP_dven "Fehlertyp: DV-E Fehler bei Pr¸fung Notluftposition" UWORD B_TRUE 1 100 0 1 BIT_MASK 0xf00 FORMAT "%13.11" ECU_ADDRESS 0x3FE41A /end MEASUREMENT
/begin MEASUREMENT TYP_dver "Fehlertyp: DV-E Regelbereich" UWORD B_TRUE 1 100 0 1 BIT_MASK 0xf00 FORMAT "%13.11" ECU_ADDRESS 0x3FE41C /end MEASUREMENT
/begin MEASUREMENT TYP_dvet "" UWORD B_TRUE 1 100 0 1 BIT_MASK 0xf00 FORMAT "%13.11" ECU_ADDRESS 0x3FE422 /end MEASUREMENT
/begin MEASUREMENT TYP_dveu "Fehlertyp: DV-E Fehler beim UMA-Lernen" UWORD B_TRUE 1 100 0 1 BIT_MASK 0xf00 FORMAT "%13.11" ECU_ADDRESS 0x3FE424 /end MEASUREMENT
/begin MEASUREMENT TYP_dveub "" UWORD B_TRUE 1 100 0 1 BIT_MASK 0xf00 FORMAT "%13.11" ECU_ADDRESS 0x3FE426 /end MEASUREMENT
/begin MEASUREMENT TYP_dveuw "" UWORD B_TRUE 1 100 0 1 BIT_MASK 0xf00 FORMAT "%13.11" ECU_ADDRESS 0x3FE428 /end MEASUREMENT
/begin MEASUREMENT TYP_dvev "Fehlertyp: DV-E Fehler bei Verst‰rkerabgleich" UWORD B_TRUE 1 100 0 1 BIT_MASK 0xf00 FORMAT "%13.11" ECU_ADDRESS 0x3FE42A /end MEASUREMENT
/begin MEASUREMENT TYP_dylsu "" UWORD B_TRUE 1 100 0 1 BIT_MASK 0xf00 FORMAT "%13.11" ECU_ADDRESS 0x3FE454 /end MEASUREMENT
/begin MEASUREMENT TYP_dylsu2 "" UWORD B_TRUE 1 100 0 1 BIT_MASK 0xf00 FORMAT "%13.11" ECU_ADDRESS 0x3FE456 /end MEASUREMENT
/begin MEASUREMENT TYP_els "" UWORD B_TRUE 1 100 0 1 BIT_MASK 0xf00 FORMAT "%13.11" ECU_ADDRESS 0x3FE46A /end MEASUREMENT
/begin MEASUREMENT TYP_ev1 "" UWORD B_TRUE 1 100 0 1 BIT_MASK 0xf00 FORMAT "%13.11" ECU_ADDRESS 0x3FE476 /end MEASUREMENT
/begin MEASUREMENT TYP_ev2 "" UWORD B_TRUE 1 100 0 1 BIT_MASK 0xf00 FORMAT "%13.11" ECU_ADDRESS 0x3FE478 /end MEASUREMENT
/begin MEASUREMENT TYP_ev3 "" UWORD B_TRUE 1 100 0 1 BIT_MASK 0xf00 FORMAT "%13.11" ECU_ADDRESS 0x3FE47A /end MEASUREMENT
/begin MEASUREMENT TYP_ev4 "" UWORD B_TRUE 1 100 0 1 BIT_MASK 0xf00 FORMAT "%13.11" ECU_ADDRESS 0x3FE47C /end MEASUREMENT
/begin MEASUREMENT TYP_ev5 "" UWORD B_TRUE 1 100 0 1 BIT_MASK 0xf00 FORMAT "%13.11" ECU_ADDRESS 0x3FE47E /end MEASUREMENT
/begin MEASUREMENT TYP_ev6 "" UWORD B_TRUE 1 100 0 1 BIT_MASK 0xf00 FORMAT "%13.11" ECU_ADDRESS 0x3FE480 /end MEASUREMENT
/begin MEASUREMENT TYP_ev7 "" UWORD B_TRUE 1 100 0 1 BIT_MASK 0xf00 FORMAT "%13.11" ECU_ADDRESS 0x3FE482 /end MEASUREMENT
/begin MEASUREMENT TYP_ev8 "" UWORD B_TRUE 1 100 0 1 BIT_MASK 0xf00 FORMAT "%13.11" ECU_ADDRESS 0x3FE484 /end MEASUREMENT
/begin MEASUREMENT TYP_fst "" UWORD B_TRUE 1 100 0 1 BIT_MASK 0xf00 FORMAT "%13.11" ECU_ADDRESS 0x3FE498 /end MEASUREMENT
/begin MEASUREMENT TYP_glfe "" UWORD B_TRUE 1 100 0 1 BIT_MASK 0xf00 FORMAT "%13.11" ECU_ADDRESS 0x3FE49A /end MEASUREMENT
/begin MEASUREMENT TYP_helsu "" UWORD B_TRUE 1 100 0 1 BIT_MASK 0xf00 FORMAT "%13.11" ECU_ADDRESS 0x3FE49C /end MEASUREMENT
/begin MEASUREMENT TYP_helsu2 "" UWORD B_TRUE 1 100 0 1 BIT_MASK 0xf00 FORMAT "%13.11" ECU_ADDRESS 0x3FE49E /end MEASUREMENT
/begin MEASUREMENT TYP_hsh "Fehlertyp: Heizung Lambdasonde 1 hinter Kat" UWORD B_TRUE 1 100 0 1 BIT_MASK 0xf00 FORMAT "%13.11" ECU_ADDRESS 0x3FE4A0 /end MEASUREMENT
/begin MEASUREMENT TYP_hsh2 "Fehlertyp: Heizung Lambdasonde 2 hinter Kat" UWORD B_TRUE 1 100 0 1 BIT_MASK 0xf00 FORMAT "%13.11" ECU_ADDRESS 0x3FE4A2 /end MEASUREMENT
/begin MEASUREMENT TYP_hshe "Fehlertyp: Endstufe Heizung Lambdasonde 1 hinter Kat" UWORD B_TRUE 1 100 0 1 BIT_MASK 0xf00 FORMAT "%13.11" ECU_ADDRESS 0x3FE4A4 /end MEASUREMENT
/begin MEASUREMENT TYP_hshe2 "Fehlertyp: Endstufe Heizung Lambdasonde 2 hinter Kat" UWORD B_TRUE 1 100 0 1 BIT_MASK 0xf00 FORMAT "%13.11" ECU_ADDRESS 0x3FE4A6 /end MEASUREMENT
/begin MEASUREMENT TYP_hsv "Fehlertyp: Heizung Lambdasonde 1 vor Kat" UWORD B_TRUE 1 100 0 1 BIT_MASK 0xf00 FORMAT "%13.11" ECU_ADDRESS 0x3FE4A8 /end MEASUREMENT
/begin MEASUREMENT TYP_hsv2 "Fehlertyp: Heizung Lambdasonde 2 vor Kat" UWORD B_TRUE 1 100 0 1 BIT_MASK 0xf00 FORMAT "%13.11" ECU_ADDRESS 0x3FE4AA /end MEASUREMENT
/begin MEASUREMENT TYP_hsve "Fehlertyp: Endstufe Heizung Lambdasonde 1 vor Kat" UWORD B_TRUE 1 100 0 1 BIT_MASK 0xf00 FORMAT "%13.11" ECU_ADDRESS 0x3FE4AC /end MEASUREMENT
/begin MEASUREMENT TYP_hsve2 "Fehlertyp: Endstufe Heizung Lambdasonde 2 vor Kat" UWORD B_TRUE 1 100 0 1 BIT_MASK 0xf00 FORMAT "%13.11" ECU_ADDRESS 0x3FE4AE /end MEASUREMENT
/begin MEASUREMENT TYP_kpe "Fehlertyp: EKP-Relais Endstufe" UWORD B_TRUE 1 100 0 1 BIT_MASK 0xf00 FORMAT "%13.11" ECU_ADDRESS 0x3FE4BE /end MEASUREMENT
/begin MEASUREMENT TYP_lm "" UWORD B_TRUE 1 100 0 1 BIT_MASK 0xf00 FORMAT "%13.11" ECU_ADDRESS 0x3FE4E0 /end MEASUREMENT
/begin MEASUREMENT TYP_n "" UWORD B_TRUE 1 100 0 1 BIT_MASK 0xf00 FORMAT "%13.11" ECU_ADDRESS 0x3FE524 /end MEASUREMENT
/begin MEASUREMENT TYP_pmbatt "" UWORD B_TRUE 1 100 0 1 BIT_MASK 0xf00 FORMAT "%13.11" ECU_ADDRESS 0x3FE53E /end MEASUREMENT
/begin MEASUREMENT TYP_pmbn "" UWORD B_TRUE 1 100 0 1 BIT_MASK 0xf00 FORMAT "%13.11" ECU_ADDRESS 0x3FE540 /end MEASUREMENT
/begin MEASUREMENT TYP_tesg "Fehlertyp: Tankdiagnose, Grobleck" UWORD B_TRUE 1 100 0 1 BIT_MASK 0xf00 FORMAT "%13.11" ECU_ADDRESS 0x3FE564 /end MEASUREMENT
/begin MEASUREMENT Z_bm "Zyklusflag: Bezugsmarkengeber" UWORD B_TRUE 1 100 0 1 BIT_MASK 0x2 FORMAT "%13.11" ECU_ADDRESS 0x3FE3BC /end MEASUREMENT
/begin MEASUREMENT Z_cars "Zyklusflag: CAN-Schnittstelle, Timeout ARS" UWORD B_TRUE 1 100 0 1 BIT_MASK 0x2 FORMAT "%13.11" ECU_ADDRESS 0x3FE3CA /end MEASUREMENT
/begin MEASUREMENT Z_ccas "Zyklusflag: CAN-Schnittstelle, Timeout CAS" UWORD B_TRUE 1 100 0 1 BIT_MASK 0x2 FORMAT "%13.11" ECU_ADDRESS 0x3FE3CC /end MEASUREMENT
/begin MEASUREMENT Z_cdsc "Zyklusflag: CAN-Schnittstelle DSC-SG" UWORD B_TRUE 1 100 0 1 BIT_MASK 0x2 FORMAT "%13.11" ECU_ADDRESS 0x3FE3CE /end MEASUREMENT
/begin MEASUREMENT Z_cegs "Zyklusflag:  CAN-‹bertragung Motronic<> Getriebe gestˆrt" UWORD B_TRUE 1 100 0 1 BIT_MASK 0x2 FORMAT "%13.11" ECU_ADDRESS 0x3FE3D0 /end MEASUREMENT
/begin MEASUREMENT Z_cfc "Zyklusflag Tankdeckel offen" UWORD B_TRUE 1 100 0 1 BIT_MASK 0x2 FORMAT "%13.11" ECU_ADDRESS 0x3FE3D2 /end MEASUREMENT
/begin MEASUREMENT Z_cihka "Zyklusflag: CAN-Schnittstelle, Timeout IHKA" UWORD B_TRUE 1 100 0 1 BIT_MASK 0x2 FORMAT "%13.11" ECU_ADDRESS 0x3FE3D4 /end MEASUREMENT
/begin MEASUREMENT Z_cins "Zyklusflag: CAN-Schnittstelle, Timeout Instrument" UWORD B_TRUE 1 100 0 1 BIT_MASK 0x2 FORMAT "%13.11" ECU_ADDRESS 0x3FE3D6 /end MEASUREMENT
/begin MEASUREMENT Z_cod "Zyklusflag: Steuerger‰t noch nicht codiert" UWORD B_TRUE 1 100 0 1 BIT_MASK 0x2 FORMAT "%13.11" ECU_ADDRESS 0x3FE3D8 /end MEASUREMENT
/begin MEASUREMENT Z_cssg "Zyklusflag: CAN-Schnittstelle,  SGG-Steuerger‰t" UWORD B_TRUE 1 100 0 1 BIT_MASK 0x2 FORMAT "%13.11" ECU_ADDRESS 0x3FE3DA /end MEASUREMENT
/begin MEASUREMENT Z_cszl "Zyklusflag: CAN-Schnittstelle, Timeout SZL" UWORD B_TRUE 1 100 0 1 BIT_MASK 0x2 FORMAT "%13.11" ECU_ADDRESS 0x3FE3DC /end MEASUREMENT
/begin MEASUREMENT Z_dhdmte "Zyklusflag: DM-TL Heizung (Endstufe)" UWORD B_TRUE 1 100 0 1 BIT_MASK 0x2 FORMAT "%13.11" ECU_ADDRESS 0x3FE3EC /end MEASUREMENT
/begin MEASUREMENT Z_disa "Zyklus-Bit" UWORD B_TRUE 1 100 0 1 BIT_MASK 0x2 FORMAT "%13.11" ECU_ADDRESS 0x3FE3F4 /end MEASUREMENT
/begin MEASUREMENT Z_disat "" UWORD B_TRUE 1 100 0 1 BIT_MASK 0x2 FORMAT "%13.11" ECU_ADDRESS 0x3FE3F6 /end MEASUREMENT
/begin MEASUREMENT Z_dk "Zyklusflag:	DK - Potentiometer" UWORD B_TRUE 1 100 0 1 BIT_MASK 0x2 FORMAT "%13.11" ECU_ADDRESS 0x3FE3F8 /end MEASUREMENT
/begin MEASUREMENT Z_dk1p "Zyklusflag: Drosselklappe 1. Poti" UWORD B_TRUE 1 100 0 1 BIT_MASK 0x2 FORMAT "%13.11" ECU_ADDRESS 0x3FE3FA /end MEASUREMENT
/begin MEASUREMENT Z_dk2p "Zyklusflag: Drosselklappe 2. Poti" UWORD B_TRUE 1 100 0 1 BIT_MASK 0x2 FORMAT "%13.11" ECU_ADDRESS 0x3FE3FC /end MEASUREMENT
/begin MEASUREMENT Z_dmmve "Zyklusflag: DM-TL Magnetventil (Endstufe)" UWORD B_TRUE 1 100 0 1 BIT_MASK 0x2 FORMAT "%13.11" ECU_ADDRESS 0x3FE3FE /end MEASUREMENT
/begin MEASUREMENT Z_dmpme "Zyklusflag: DM-TL Pumpenmotor (Endstufe)" UWORD B_TRUE 1 100 0 1 BIT_MASK 0x2 FORMAT "%13.11" ECU_ADDRESS 0x3FE400 /end MEASUREMENT
/begin MEASUREMENT Z_dmtk "Zyklusflag: Tankentl¸ftungssystem Kleinstleck" UWORD B_TRUE 1 100 0 1 BIT_MASK 0x2 FORMAT "%13.11" ECU_ADDRESS 0x3FE402 /end MEASUREMENT
/begin MEASUREMENT Z_dmtl "Zyklusflag: DMTL-Modul" UWORD B_TRUE 1 100 0 1 BIT_MASK 0x2 FORMAT "%13.11" ECU_ADDRESS 0x3FE406 /end MEASUREMENT
/begin MEASUREMENT Z_dpmee "Zyklusflag: DM-TL Pumpenmotor aus DECJ (Endstufe)" UWORD B_TRUE 1 100 0 1 BIT_MASK 0x2 FORMAT "%13.11" ECU_ADDRESS 0x3FE408 /end MEASUREMENT
/begin MEASUREMENT Z_dvee "Zyklusflag: DV-E Endstufe" UWORD B_TRUE 1 100 0 1 BIT_MASK 0x2 FORMAT "%13.11" ECU_ADDRESS 0x3FE412 /end MEASUREMENT
/begin MEASUREMENT Z_dvef "Zyklusflag: DV-E Fehler bei Federpr¸fung" UWORD B_TRUE 1 100 0 1 BIT_MASK 0x2 FORMAT "%13.11" ECU_ADDRESS 0x3FE414 /end MEASUREMENT
/begin MEASUREMENT Z_dvefo "Zyklusflag: DV-E-Fehler bei Federpr¸fung ""÷ffnen""" UWORD B_TRUE 1 100 0 1 BIT_MASK 0x2 FORMAT "%13.11" ECU_ADDRESS 0x3FE416 /end MEASUREMENT
/begin MEASUREMENT Z_dvel "Zyklusflag: DV-E Lageabweichung" UWORD B_TRUE 1 100 0 1 BIT_MASK 0x2 FORMAT "%13.11" ECU_ADDRESS 0x3FE418 /end MEASUREMENT
/begin MEASUREMENT Z_dven "Zyklusflag: DV-E Fehler bei Pr¸fung Notluftposition" UWORD B_TRUE 1 100 0 1 BIT_MASK 0x2 FORMAT "%13.11" ECU_ADDRESS 0x3FE41A /end MEASUREMENT
/begin MEASUREMENT Z_dver "Zyklusflag: DV-E Regelbereich" UWORD B_TRUE 1 100 0 1 BIT_MASK 0x2 FORMAT "%13.11" ECU_ADDRESS 0x3FE41C /end MEASUREMENT
/begin MEASUREMENT Z_dvet "Zyklusflag: DV-E-Tauscherkennung ohne Adaption" UWORD B_TRUE 1 100 0 1 BIT_MASK 0x2 FORMAT "%13.11" ECU_ADDRESS 0x3FE422 /end MEASUREMENT
/begin MEASUREMENT Z_dveu "Zyklusflag: DV-E Fehler beim UMA-Lernen" UWORD B_TRUE 1 100 0 1 BIT_MASK 0x2 FORMAT "%13.11" ECU_ADDRESS 0x3FE424 /end MEASUREMENT
/begin MEASUREMENT Z_dveub "Zyklusflag: DV-E-Adaption Abbruch wg. Umweltbedingung" UWORD B_TRUE 1 100 0 1 BIT_MASK 0x2 FORMAT "%13.11" ECU_ADDRESS 0x3FE426 /end MEASUREMENT
/begin MEASUREMENT Z_dveuw "Zyklusflag: Fehler bei UMA-Wiederlernen" UWORD B_TRUE 1 100 0 1 BIT_MASK 0x2 FORMAT "%13.11" ECU_ADDRESS 0x3FE428 /end MEASUREMENT
/begin MEASUREMENT Z_dvev "Zyklusflag: DV-E Fehler bei Verst‰rkerabgleich" UWORD B_TRUE 1 100 0 1 BIT_MASK 0x2 FORMAT "%13.11" ECU_ADDRESS 0x3FE42A /end MEASUREMENT
/begin MEASUREMENT Z_dylsu "Zyklusflag: Dynamikdiagnose der LSU" UWORD B_TRUE 1 100 0 1 BIT_MASK 0x2 FORMAT "%13.11" ECU_ADDRESS 0x3FE454 /end MEASUREMENT
/begin MEASUREMENT Z_dylsu2 "Zyklusflag: Dynamikdiagnose der LSU, Bank 2" UWORD B_TRUE 1 100 0 1 BIT_MASK 0x2 FORMAT "%13.11" ECU_ADDRESS 0x3FE456 /end MEASUREMENT
/begin MEASUREMENT Z_els "Zyklusflag: Endstufe E-Box L¸fter" UWORD B_TRUE 1 100 0 1 BIT_MASK 0x2 FORMAT "%13.11" ECU_ADDRESS 0x3FE46A /end MEASUREMENT
/begin MEASUREMENT Z_ev1 "Zyklusflag: EV von Zyl. 1" UWORD B_TRUE 1 100 0 1 BIT_MASK 0x2 FORMAT "%13.11" ECU_ADDRESS 0x3FE476 /end MEASUREMENT
/begin MEASUREMENT Z_ev2 "Zyklusflag:	EV von Zyl. 2" UWORD B_TRUE 1 100 0 1 BIT_MASK 0x2 FORMAT "%13.11" ECU_ADDRESS 0x3FE478 /end MEASUREMENT
/begin MEASUREMENT Z_ev3 "Zyklusflag:	EV von Zyl. 3" UWORD B_TRUE 1 100 0 1 BIT_MASK 0x2 FORMAT "%13.11" ECU_ADDRESS 0x3FE47A /end MEASUREMENT
/begin MEASUREMENT Z_ev4 "Zyklusflag:	EV von Zyl. 4" UWORD B_TRUE 1 100 0 1 BIT_MASK 0x2 FORMAT "%13.11" ECU_ADDRESS 0x3FE47C /end MEASUREMENT
/begin MEASUREMENT Z_ev5 "Zyklusflag:	EV von Zyl. 5" UWORD B_TRUE 1 100 0 1 BIT_MASK 0x2 FORMAT "%13.11" ECU_ADDRESS 0x3FE47E /end MEASUREMENT
/begin MEASUREMENT Z_ev6 "Zyklusflag:	EV von Zyl. 6" UWORD B_TRUE 1 100 0 1 BIT_MASK 0x2 FORMAT "%13.11" ECU_ADDRESS 0x3FE480 /end MEASUREMENT
/begin MEASUREMENT Z_ev7 "Zyklusflag:	EV von Zyl. 7" UWORD B_TRUE 1 100 0 1 BIT_MASK 0x2 FORMAT "%13.11" ECU_ADDRESS 0x3FE482 /end MEASUREMENT
/begin MEASUREMENT Z_ev8 "Zyklusflag:	EV von Zyl. 8" UWORD B_TRUE 1 100 0 1 BIT_MASK 0x2 FORMAT "%13.11" ECU_ADDRESS 0x3FE484 /end MEASUREMENT
/begin MEASUREMENT Z_fst "Zyklusflag: Tankf¸llstand" UWORD B_TRUE 1 100 0 1 BIT_MASK 0x2 FORMAT "%13.11" ECU_ADDRESS 0x3FE498 /end MEASUREMENT
/begin MEASUREMENT Z_glfe "Zyklus Flag: Endstufe gesteuerte Luftf¸hrung" UWORD B_TRUE 1 100 0 1 BIT_MASK 0x2 FORMAT "%13.11" ECU_ADDRESS 0x3FE49A /end MEASUREMENT
/begin MEASUREMENT Z_helsu "Zyklusflag Fehlerpfad HELSU" UWORD B_TRUE 1 100 0 1 BIT_MASK 0x2 FORMAT "%13.11" ECU_ADDRESS 0x3FE49C /end MEASUREMENT
/begin MEASUREMENT Z_helsu2 "Zyklusflag Fehlerpfad HELSU, Bank 2" UWORD B_TRUE 1 100 0 1 BIT_MASK 0x2 FORMAT "%13.11" ECU_ADDRESS 0x3FE49E /end MEASUREMENT
/begin MEASUREMENT Z_hsh "Zyklusflag:Lambdasonden-Heizung hinter Katalysator" UWORD B_TRUE 1 100 0 1 BIT_MASK 0x2 FORMAT "%13.11" ECU_ADDRESS 0x3FE4A0 /end MEASUREMENT
/begin MEASUREMENT Z_hsh2 "Zyklusflag:Lambdasonden-Heizung hinter Katalysator, Bank2" UWORD B_TRUE 1 100 0 1 BIT_MASK 0x2 FORMAT "%13.11" ECU_ADDRESS 0x3FE4A2 /end MEASUREMENT
/begin MEASUREMENT Z_hshe "Zyklusflag: Lambdasonden-Heizung hinter Katalysator (Endstufe)" UWORD B_TRUE 1 100 0 1 BIT_MASK 0x2 FORMAT "%13.11" ECU_ADDRESS 0x3FE4A4 /end MEASUREMENT
/begin MEASUREMENT Z_hshe2 "Zyklusflag: Lambdasonden-Heizung hinter Katalysator, Bank2 (Endstufe)" UWORD B_TRUE 1 100 0 1 BIT_MASK 0x2 FORMAT "%13.11" ECU_ADDRESS 0x3FE4A6 /end MEASUREMENT
/begin MEASUREMENT Z_hsv "Zyklusflag:Lambdasonden-Heizung vor Katalysator" UWORD B_TRUE 1 100 0 1 BIT_MASK 0x2 FORMAT "%13.11" ECU_ADDRESS 0x3FE4A8 /end MEASUREMENT
/begin MEASUREMENT Z_hsv2 "Zyklusflag:Lambdasonden-Heizung vor Katalysator, Bank2" UWORD B_TRUE 1 100 0 1 BIT_MASK 0x2 FORMAT "%13.11" ECU_ADDRESS 0x3FE4AA /end MEASUREMENT
/begin MEASUREMENT Z_hsve "Zyklusflag:Lambdasonden-Heizung vor Katalysator (Endstufe)" UWORD B_TRUE 1 100 0 1 BIT_MASK 0x2 FORMAT "%13.11" ECU_ADDRESS 0x3FE4AC /end MEASUREMENT
/begin MEASUREMENT Z_hsve2 "Zyklusflag:Lambdasonden-Heizung vor Katalysator, Bank2 (Endstufe)" UWORD B_TRUE 1 100 0 1 BIT_MASK 0x2 FORMAT "%13.11" ECU_ADDRESS 0x3FE4AE /end MEASUREMENT
/begin MEASUREMENT Z_kpe "Zyklusflag: EKP-Relais Endstufe" UWORD B_TRUE 1 100 0 1 BIT_MASK 0x2 FORMAT "%13.11" ECU_ADDRESS 0x3FE4BE /end MEASUREMENT
/begin MEASUREMENT Z_lm "Zyklusflag:	LMM/HLM/HFM" UWORD B_TRUE 1 100 0 1 BIT_MASK 0x2 FORMAT "%13.11" ECU_ADDRESS 0x3FE4E0 /end MEASUREMENT
/begin MEASUREMENT Z_n "Zyklusflag: Drehzahlsignalgeber" UWORD B_TRUE 1 100 0 1 BIT_MASK 0x2 FORMAT "%13.11" ECU_ADDRESS 0x3FE524 /end MEASUREMENT
/begin MEASUREMENT Z_pmbatt "" UWORD B_TRUE 1 100 0 1 BIT_MASK 0x2 FORMAT "%13.11" ECU_ADDRESS 0x3FE53E /end MEASUREMENT
/begin MEASUREMENT Z_pmbn "Zyklusflag, PM Bordnetz" UWORD B_TRUE 1 100 0 1 BIT_MASK 0x2 FORMAT "%13.11" ECU_ADDRESS 0x3FE540 /end MEASUREMENT
/begin MEASUREMENT Z_tesg "Zyklusflag: Tankentl¸ftungssystem Grobleck" UWORD B_TRUE 1 100 0 1 BIT_MASK 0x2 FORMAT "%13.11" ECU_ADDRESS 0x3FE564 /end MEASUREMENT
/begin FUNCTION DFPM_DCARS "" /begin DEF_CHARACTERISTIC CDCCARS CDKCARS CDTCARS CLACARS FFTCARS TSFCARS /end DEF_CHARACTERISTIC
 /begin OUT_MEASUREMENT B_becars B_bkcars B_clcars B_ftcars B_mncars B_mxcars B_npcars B_sicars E_cars sfpcars TYP_cars Z_cars /end OUT_MEASUREMENT
/end FUNCTION
/begin FUNCTION DFPM_DCCAS "" /begin DEF_CHARACTERISTIC CDCCCAS CDKCCAS CDTCCAS CLACCAS FFTCCAS TSFCCAS /end DEF_CHARACTERISTIC
 /begin OUT_MEASUREMENT B_beccas B_bkccas B_clccas B_ftccas B_mnccas B_mxccas B_npccas B_siccas E_ccas sfpccas TYP_ccas Z_ccas /end OUT_MEASUREMENT
/end FUNCTION
/begin FUNCTION DFPM_DCDSC "" /begin DEF_CHARACTERISTIC CDCCDSC CDKCDSC CDTCDSC CLACDSC FFTCDSC TSFCDSC /end DEF_CHARACTERISTIC
 /begin OUT_MEASUREMENT B_becdsc B_bkcdsc B_clcdsc B_ftcdsc B_mncdsc B_mxcdsc B_npcdsc B_sicdsc E_cdsc sfpcdsc TYP_cdsc Z_cdsc /end OUT_MEASUREMENT
/end FUNCTION
/begin FUNCTION DFPM_DCEGS "" /begin DEF_CHARACTERISTIC CDCCEGS CDKCEGS CDTCEGS CLACEGS FFTCEGS TSFCEGS /end DEF_CHARACTERISTIC
 /begin OUT_MEASUREMENT B_becegs B_bkcegs B_clcegs B_ftcegs B_mncegs B_mxcegs B_npcegs B_sicegs E_cegs sfpcegs TYP_cegs Z_cegs /end OUT_MEASUREMENT
/end FUNCTION
/begin FUNCTION DFPM_DCFCEO "" /begin DEF_CHARACTERISTIC CDCCFC CDKCFC CDTCFC CLACFC FFTCFC TSFCFC /end DEF_CHARACTERISTIC
 /begin OUT_MEASUREMENT B_becfc B_bkcfc B_clcfc B_ftcfc B_mncfc B_mxcfc B_npcfc B_sicfc E_cfc sfpcfc TYP_cfc Z_cfc /end OUT_MEASUREMENT
/end FUNCTION
/begin FUNCTION DFPM_DCINS ""
 /begin DEF_CHARACTERISTIC CDCCIHKA CDCCINS CDKCIHKA CDKCINS CDTCIHKA CDTCINS CLACIHKA CLACINS FFTCIHKA FFTCINS TSFCIHKA TSFCINS /end DEF_CHARACTERISTIC
 /begin OUT_MEASUREMENT B_becihka B_becins B_bkcihka B_bkcins B_clcihka B_clcins B_ftcihka B_ftcins B_mncihka B_mncins B_mxcihka B_mxcins B_npcihka B_npcins B_sicihka B_sicins E_cihka E_cins sfpcihka sfpcins TYP_cihka TYP_cins Z_cihka Z_cins /end OUT_MEASUREMENT
/end FUNCTION
/begin FUNCTION DFPM_DCOD "" /begin DEF_CHARACTERISTIC CDCCOD CDKCOD CDTCOD CLACOD FFTCOD TSFCOD /end DEF_CHARACTERISTIC
 /begin OUT_MEASUREMENT B_becod B_bkcod B_clcod B_ftcod B_mncod B_mxcod B_npcod B_sicod E_cod sfpcod TYP_cod Z_cod /end OUT_MEASUREMENT
/end FUNCTION
/begin FUNCTION DFPM_DCSSG "" /begin DEF_CHARACTERISTIC CDCCSSG CDKCSSG CDTCSSG CLACSSG FFTCSSG TSFCSSG /end DEF_CHARACTERISTIC
 /begin OUT_MEASUREMENT B_becssg B_bkcssg B_clcssg B_ftcssg B_mncssg B_mxcssg B_npcssg B_sicssg E_cssg sfpcssg TYP_cssg Z_cssg /end OUT_MEASUREMENT
/end FUNCTION
/begin FUNCTION DFPM_DCSZL "" /begin DEF_CHARACTERISTIC CDCCSZL CDKCSZL CDTCSZL CLACSZL FFTCSZL TSFCSZL /end DEF_CHARACTERISTIC
 /begin OUT_MEASUREMENT B_becszl B_bkcszl B_clcszl B_ftcszl B_mncszl B_mxcszl B_npcszl B_sicszl E_cszl sfpcszl TYP_cszl Z_cszl /end OUT_MEASUREMENT
/end FUNCTION
/begin FUNCTION DFPM_DDG ""
 /begin DEF_CHARACTERISTIC CDCBM CDCN CDKBM CDKN CDTBM CDTN CLABM CLAN FFTBM FFTN TSFBM TSFN /end DEF_CHARACTERISTIC
 /begin OUT_MEASUREMENT B_bebm B_ben B_bkbm B_bkn B_clbm B_cln B_ftbm B_ftn B_mnbm B_mnn B_mxbm B_mxn B_npbm B_npn B_sibm B_sin E_bm E_n sfpbm sfpn TYP_bm TYP_n Z_bm Z_n /end OUT_MEASUREMENT
/end FUNCTION
/begin FUNCTION DFPM_DDISA ""
 /begin DEF_CHARACTERISTIC CDCDISA CDCDISAT CDKDISA CDKDISAT CDTDISA CDTDISAT CLADISA CLADISAT FFTDISA FFTDISAT TSFDISA TSFDISAT /end DEF_CHARACTERISTIC
 /begin OUT_MEASUREMENT B_bedisa B_bedisat B_bkdisa B_bkdisat B_cldisa B_cldisat B_ftdisa B_ftdisat B_mndisa B_mndisat B_mxdisa B_mxdisat B_npdisa B_npdisat B_sidisa B_sidisat E_disa E_disat sfpdisa sfpdisat TYP_disa TYP_disat Z_disa Z_disat /end OUT_MEASUREMENT
/end FUNCTION
/begin FUNCTION DFPM_DDMMVE "" /begin DEF_CHARACTERISTIC CDCDMMVE CDKDMMVE CDTDMMVE CLADMMVE FFTDMMVE TSFDMMVE /end DEF_CHARACTERISTIC
 /begin OUT_MEASUREMENT B_bedmmve B_bkdmmve B_cldmmve B_ftdmmve B_mndmmve B_mxdmmve B_npdmmve B_sidmmve E_dmmve sfpdmmve TYP_dmmve Z_dmmve /end OUT_MEASUREMENT
/end FUNCTION
/begin FUNCTION DFPM_DDMPME "" /begin DEF_CHARACTERISTIC CDCDMPME CDKDMPME CDTDMPME CLADMPME FFTDMPME TSFDMPME /end DEF_CHARACTERISTIC
 /begin OUT_MEASUREMENT B_bedmpme B_bkdmpme B_cldmpme B_ftdmpme B_mndmpme B_mxdmpme B_npdmpme B_sidmpme E_dmpme sfpdmpme TYP_dmpme Z_dmpme /end OUT_MEASUREMENT
/end FUNCTION
/begin FUNCTION DFPM_DDPMEE "" /begin DEF_CHARACTERISTIC CDCDPMEE CDKDPMEE CDTDPMEE CLADPMEE FFTDPMEE TSFDPMEE /end DEF_CHARACTERISTIC
 /begin OUT_MEASUREMENT B_bedpmee B_bkdpmee B_cldpmee B_ftdpmee B_mndpmee B_mxdpmee B_npdpmee B_sidpmee E_dpmee sfpdpmee TYP_dpmee Z_dpmee /end OUT_MEASUREMENT
/end FUNCTION
/begin FUNCTION DFPM_DDVE ""
 /begin DEF_CHARACTERISTIC CDCDK CDCDK1P CDCDK2P CDCDVEE CDCDVEF CDCDVEFO CDCDVEL CDCDVEN CDCDVER CDCDVET CDCDVEU CDCDVEUB CDCDVEUW CDCDVEV CDKDK CDKDK1P CDKDK2P CDKDVEE CDKDVEF CDKDVEFO CDKDVEL CDKDVEN CDKDVER CDKDVET CDKDVEU CDKDVEUB CDKDVEUW CDKDVEV CDTDK CDTDK1P CDTDK2P CDTDVEE CDTDVEF CDTDVEFO CDTDVEL CDTDVEN CDTDVER CDTDVET CDTDVEU CDTDVEUB CDTDVEUW CDTDVEV CLADK CLADK1P CLADK2P CLADVEE CLADVEF CLADVEFO CLADVEL CLADVEN CLADVER CLADVET CLADVEU CLADVEUB CLADVEUW CLADVEV FFTDK FFTDK1P FFTDK2P FFTDVEE FFTDVEF FFTDVEFO FFTDVEL FFTDVEN FFTDVER FFTDVET FFTDVEU FFTDVEUB FFTDVEUW FFTDVEV TSFDK TSFDK1P TSFDK2P TSFDVEE TSFDVEF TSFDVEFO TSFDVEL TSFDVEN TSFDVER TSFDVET TSFDVEU TSFDVEUB TSFDVEUW TSFDVEV /end DEF_CHARACTERISTIC
 /begin OUT_MEASUREMENT B_bedk B_bedk1p B_bedk2p B_bedvee B_bedvef B_bedvefo B_bedvel B_bedven B_bedver B_bedvet B_bedveu B_bedveub B_bedveuw B_bedvev B_bkdk B_bkdk1p B_bkdk2p B_bkdvee B_bkdvef B_bkdvefo B_bkdvel B_bkdven B_bkdver B_bkdvet B_bkdveu B_bkdveub B_bkdveuw B_bkdvev B_cldk B_cldk1p B_cldk2p B_cldvee B_cldvef B_cldvefo B_cldvel B_cldven B_cldver B_cldvet B_cldveu B_cldveub B_cldveuw B_cldvev B_ftdk B_ftdk1p B_ftdk2p B_ftdvee B_ftdvef B_ftdvefo B_ftdvel B_ftdven B_ftdver B_ftdvet B_ftdveu B_ftdveub B_ftdveuw B_ftdvev B_mndk B_mndk1p B_mndk2p B_mndvee B_mndvef B_mndvefo B_mndvel B_mndven B_mndver B_mndvet B_mndveu B_mndveub B_mndveuw B_mndvev B_mxdk B_mxdk1p B_mxdk2p B_mxdvee B_mxdvef B_mxdvefo B_mxdvel B_mxdven B_mxdver B_mxdvet B_mxdveu B_mxdveub B_mxdveuw B_mxdvev B_npdk B_npdk1p B_npdk2p B_npdvee B_npdvef B_npdvefo B_npdvel B_npdven B_npdver B_npdvet B_npdveu B_npdveub B_npdveuw B_npdvev B_sidk B_sidk1p B_sidk2p B_sidvee B_sidvef B_sidvefo B_sidvel B_sidven B_sidver B_sidvet B_sidveu B_sidveub B_sidveuw B_sidvev E_dk E_dk1p E_dk2p E_dvee E_dvef E_dvefo E_dvel E_dven E_dver E_dvet E_dveu E_dveub E_dveuw E_dvev sfpdk sfpdk1p sfpdk2p sfpdvee sfpdvef sfpdvefo sfpdvel sfpdven sfpdver sfpdvet sfpdveu sfpdveub sfpdveuw sfpdvev TYP_dk TYP_dk1p TYP_dk2p TYP_dvee TYP_dvef TYP_dvefo TYP_dvel TYP_dven TYP_dver TYP_dvet TYP_dveu TYP_dveub TYP_dveuw TYP_dvev Z_dk Z_dk1p Z_dk2p Z_dvee Z_dvef Z_dvefo Z_dvel Z_dven Z_dver Z_dvet Z_dveu Z_dveub Z_dveuw Z_dvev /end OUT_MEASUREMENT
/end FUNCTION
/begin FUNCTION DFPM_DDYLSU ""
 /begin DEF_CHARACTERISTIC CDCDYLSU CDCDYLSU2 CDKDYLSU CDKDYLSU2 CDTDYLSU CDTDYLSU2 CLADYLSU CLADYLSU2 FFTDYLSU FFTDYLSU2 TSFDYLSU TSFDYLSU2 /end DEF_CHARACTERISTIC
 /begin OUT_MEASUREMENT B_bedylsu B_bedylsu2 B_bkdylsu B_bkdylsu2 B_cldylsu B_cldylsu2 B_ftdylsu B_ftdylsu2 B_mndylsu B_mndylsu2 B_mxdylsu B_mxdylsu2 B_npdylsu B_npdylsu2 B_sidylsu B_sidylsu2 E_dylsu E_dylsu2 sfpdylsu sfpdylsu2 TYP_dylsu TYP_dylsu2 Z_dylsu Z_dylsu2 /end OUT_MEASUREMENT
/end FUNCTION
/begin FUNCTION DFPM_DEKPE "" /begin DEF_CHARACTERISTIC CDCKPE CDKKPE CDTKPE CLAKPE FFTKPE TSFKPE /end DEF_CHARACTERISTIC
 /begin OUT_MEASUREMENT B_bekpe B_bkkpe B_clkpe B_ftkpe B_mnkpe B_mxkpe B_npkpe B_sikpe E_kpe sfpkpe TYP_kpe Z_kpe /end OUT_MEASUREMENT
/end FUNCTION
/begin FUNCTION DFPM_DELSE "" /begin DEF_CHARACTERISTIC CDCELS CDKELS CDTELS CLAELS FFTELS TSFELS /end DEF_CHARACTERISTIC
 /begin OUT_MEASUREMENT B_beels B_bkels B_clels B_ftels B_mnels B_mxels B_npels B_siels E_els sfpels TYP_els Z_els /end OUT_MEASUREMENT
/end FUNCTION
/begin FUNCTION DFPM_DEVE ""
 /begin DEF_CHARACTERISTIC CDCEV1 CDCEV2 CDCEV3 CDCEV4 CDCEV5 CDCEV6 CDCEV7 CDCEV8 CDKEV1 CDKEV2 CDKEV3 CDKEV4 CDKEV5 CDKEV6 CDKEV7 CDKEV8 CDTEV1 CDTEV2 CDTEV3 CDTEV4 CDTEV5 CDTEV6 CDTEV7 CDTEV8 CLAEV1 CLAEV2 CLAEV3 CLAEV4 CLAEV5 CLAEV6 CLAEV7 CLAEV8 FFTEV1 FFTEV2 FFTEV3 FFTEV4 FFTEV5 FFTEV6 FFTEV7 FFTEV8 TSFEV1 TSFEV2 TSFEV3 TSFEV4 TSFEV5 TSFEV6 TSFEV7 TSFEV8 /end DEF_CHARACTERISTIC
 /begin OUT_MEASUREMENT B_beev1 B_beev2 B_beev3 B_beev4 B_beev5 B_beev6 B_beev7 B_beev8 B_bkev1 B_bkev2 B_bkev3 B_bkev4 B_bkev5 B_bkev6 B_bkev7 B_bkev8 B_clev1 B_clev2 B_clev3 B_clev4 B_clev5 B_clev6 B_clev7 B_clev8 B_ftev1 B_ftev2 B_ftev3 B_ftev4 B_ftev5 B_ftev6 B_ftev7 B_ftev8 B_mnev1 B_mnev2 B_mnev3 B_mnev4 B_mnev5 B_mnev6 B_mnev7 B_mnev8 B_mxev1 B_mxev2 B_mxev3 B_mxev4 B_mxev5 B_mxev6 B_mxev7 B_mxev8 B_npev1 B_npev2 B_npev3 B_npev4 B_npev5 B_npev6 B_npev7 B_npev8 B_siev1 B_siev2 B_siev3 B_siev4 B_siev5 B_siev6 B_siev7 B_siev8 E_ev1 E_ev2 E_ev3 E_ev4 E_ev5 E_ev6 E_ev7 E_ev8 sfpev1 sfpev2 sfpev3 sfpev4 sfpev5 sfpev6 sfpev7 sfpev8 TYP_ev1 TYP_ev2 TYP_ev3 TYP_ev4 TYP_ev5 TYP_ev6 TYP_ev7 TYP_ev8 Z_ev1 Z_ev2 Z_ev3 Z_ev4 Z_ev5 Z_ev6 Z_ev7 Z_ev8 /end OUT_MEASUREMENT
/end FUNCTION
/begin FUNCTION DFPM_DFPDMTL ""
 /begin DEF_CHARACTERISTIC CDCDMTK CDCDMTL CDCTESG CDKDMTK CDKDMTL CDKTESG CDTDMTK CDTDMTL CDTTESG CLADMTK CLADMTL CLATESG FFTDMTK FFTDMTL FFTTESG TSFDMTK TSFDMTL TSFTESG /end DEF_CHARACTERISTIC
 /begin OUT_MEASUREMENT B_bedmtk B_bedmtl B_betesg B_bkdmtk B_bkdmtl B_bktesg B_cldmtk B_cldmtl B_cltesg B_ftdmtk B_ftdmtl B_fttesg B_mndmtk B_mndmtl B_mntesg B_mxdmtk B_mxdmtl B_mxtesg B_npdmtk B_npdmtl B_nptesg B_sidmtk B_sidmtl B_sitesg E_dmtk E_dmtl E_tesg sfpdmtk sfpdmtl sfptesg TYP_dmtk TYP_dmtl TYP_tesg Z_dmtk Z_dmtl Z_tesg /end OUT_MEASUREMENT
/end FUNCTION
/begin FUNCTION DFPM_DFPM ""
 /begin DEF_CHARACTERISTIC CDCAAA CDCZZZ CDKAAA CDKZZZ CDTAAA CDTZZZ CLAAAA CLAZZZ FFTAAA FFTZZZ TSFAAA TSFZZZ /end DEF_CHARACTERISTIC
 /begin OUT_MEASUREMENT sfpaaa sfpzzz /end OUT_MEASUREMENT
/end FUNCTION
/begin FUNCTION DFPM_DFPMPMDIAG "DFPMPMDIAG."
 /begin DEF_CHARACTERISTIC CDCPMBATT CDCPMBN CDKPMBATT CDKPMBN CDTPMBATT CDTPMBN CLAPMBATT CLAPMBN FFTPMBATT FFTPMBN TSFPMBATT TSFPMBN /end DEF_CHARACTERISTIC
 /begin OUT_MEASUREMENT B_bepmbatt B_bepmbn B_bkpmbatt B_bkpmbn B_clpmbatt B_clpmbn B_ftpmbatt B_ftpmbn B_mnpmbatt B_mnpmbn B_mxpmbatt B_mxpmbn B_nppmbatt B_nppmbn B_sipmbatt B_sipmbn E_pmbatt E_pmbn sfppmbatt sfppmbn TYP_pmbatt TYP_pmbn Z_pmbatt Z_pmbn /end OUT_MEASUREMENT
/end FUNCTION
/begin FUNCTION DFPM_DFSTT "" /begin DEF_CHARACTERISTIC CDCFST CDKFST CDTFST CLAFST FFTFST TSFFST /end DEF_CHARACTERISTIC
 /begin OUT_MEASUREMENT B_befst B_bkfst B_clfst B_ftfst B_mnfst B_mxfst B_npfst B_sifst E_fst sfpfst TYP_fst Z_fst /end OUT_MEASUREMENT
/end FUNCTION
/begin FUNCTION DFPM_DGLFE "" /begin DEF_CHARACTERISTIC CDCGLFE CDKGLFE CDTGLFE CLAGLFE FFTGLFE TSFGLFE /end DEF_CHARACTERISTIC
 /begin OUT_MEASUREMENT B_beglfe B_bkglfe B_clglfe B_ftglfe B_mnglfe B_mxglfe B_npglfe B_siglfe E_glfe sfpglfe TYP_glfe Z_glfe /end OUT_MEASUREMENT
/end FUNCTION
/begin FUNCTION DFPM_DHDMTE ""
 /begin DEF_CHARACTERISTIC CDCDHDMTE CDKDHDMTE CDTDHDMTE CLADHDMTE FFTDHDMTE TSFDHDMTE /end DEF_CHARACTERISTIC
 /begin OUT_MEASUREMENT B_bedhdmte B_bkdhdmte B_cldhdmte B_ftdhdmte B_mndhdmte B_mxdhdmte B_npdhdmte B_sidhdmte E_dhdmte sfpdhdmte TYP_dhdmte Z_dhdmte /end OUT_MEASUREMENT
/end FUNCTION
/begin FUNCTION DFPM_DHELSU ""
 /begin DEF_CHARACTERISTIC CDCHELSU CDCHELSU2 CDKHELSU CDKHELSU2 CDTHELSU CDTHELSU2 CLAHELSU CLAHELSU2 FFTHELSU FFTHELSU2 TSFHELSU TSFHELSU2 /end DEF_CHARACTERISTIC
 /begin OUT_MEASUREMENT B_behelsu B_behelsu2 B_bkhelsu B_bkhelsu2 B_clhelsu B_clhelsu2 B_fthelsu B_fthelsu2 B_mnhelsu B_mnhelsu2 B_mxhelsu B_mxhelsu2 B_nphelsu B_nphelsu2 B_sihelsu B_sihelsu2 E_helsu E_helsu2 sfphelsu sfphelsu2 TYP_helsu TYP_helsu2 Z_helsu Z_helsu2 /end OUT_MEASUREMENT
/end FUNCTION
/begin FUNCTION DFPM_DHFM "" /begin DEF_CHARACTERISTIC CDCLM CDKLM CDTLM CLALM FFTLM TSFLM /end DEF_CHARACTERISTIC
 /begin OUT_MEASUREMENT B_belm B_bklm B_cllm B_ftlm B_mnlm B_mxlm B_nplm B_silm E_lm sfplm TYP_lm Z_lm /end OUT_MEASUREMENT
/end FUNCTION
/begin FUNCTION DFPM_DHLSHK ""
 /begin DEF_CHARACTERISTIC CDCHSH CDCHSH2 CDCHSHE CDCHSHE2 CDKHSH CDKHSH2 CDKHSHE CDKHSHE2 CDTHSH CDTHSH2 CDTHSHE CDTHSHE2 CLAHSH CLAHSH2 CLAHSHE CLAHSHE2 FFTHSH FFTHSH2 FFTHSHE FFTHSHE2 TSFHSH TSFHSH2 TSFHSHE TSFHSHE2 /end DEF_CHARACTERISTIC
 /begin OUT_MEASUREMENT B_behsh B_behsh2 B_behshe B_behshe2 B_bkhsh B_bkhsh2 B_bkhshe B_bkhshe2 B_clhsh B_clhsh2 B_clhshe B_clhshe2 B_fthsh B_fthsh2 B_fthshe B_fthshe2 B_mnhsh B_mnhsh2 B_mnhshe B_mnhshe2 B_mxhsh B_mxhsh2 B_mxhshe B_mxhshe2 B_nphsh B_nphsh2 B_nphshe B_nphshe2 B_sihsh B_sihsh2 B_sihshe B_sihshe2 E_hsh E_hsh2 E_hshe E_hshe2 sfphsh sfphsh2 sfphshe sfphshe2 TYP_hsh TYP_hsh2 TYP_hshe TYP_hshe2 Z_hsh Z_hsh2 Z_hshe Z_hshe2 /end OUT_MEASUREMENT
/end FUNCTION
/begin FUNCTION DFPM_DHRLSU ""
 /begin DEF_CHARACTERISTIC CDCHSV CDCHSV2 CDKHSV CDKHSV2 CDTHSV CDTHSV2 CLAHSV CLAHSV2 FFTHSV FFTHSV2 TSFHSV TSFHSV2 /end DEF_CHARACTERISTIC
 /begin OUT_MEASUREMENT B_behsv B_behsv2 B_bkhsv B_bkhsv2 B_clhsv B_clhsv2 B_fthsv B_fthsv2 B_mnhsv B_mnhsv2 B_mxhsv B_mxhsv2 B_nphsv B_nphsv2 B_sihsv B_sihsv2 E_hsv E_hsv2 sfphsv sfphsv2 TYP_hsv TYP_hsv2 Z_hsv Z_hsv2 /end OUT_MEASUREMENT
/end FUNCTION
/begin FUNCTION DFPM_DHRLSUE ""
 /begin DEF_CHARACTERISTIC CDCHSVE CDCHSVE2 CDKHSVE CDKHSVE2 CDTHSVE CDTHSVE2 CLAHSVE CLAHSVE2 FFTHSVE FFTHSVE2 TSFHSVE TSFHSVE2 /end DEF_CHARACTERISTIC
 /begin OUT_MEASUREMENT B_behsve B_behsve2 B_bkhsve B_bkhsve2 B_clhsve B_clhsve2 B_fthsve B_fthsve2 B_mnhsve B_mnhsve2 B_mxhsve B_mxhsve2 B_nphsve B_nphsve2 B_sihsve B_sihsve2 E_hsve E_hsve2 sfphsve sfphsve2 TYP_hsve TYP_hsve2 Z_hsve Z_hsve2 /end OUT_MEASUREMENT
/end FUNCTION
/begin COMPU_METHOD B_TRUE "boolsche Zust‰nde, positive Logik" TAB_VERB "%6.3" "" COMPU_TAB_REF B_TRUE /end COMPU_METHOD
/begin COMPU_VTAB B_TRUE "boolsche Zust‰nde, positive Logik" TAB_VERB 2 0 "----" 1 "TRUE" /end COMPU_VTAB
/begin COMPU_METHOD dez "1 : 1 Umrechnug (dez/hex)" RAT_FUNC "%6.2" "" COEFFS 0 1 0 0 0 1 /end COMPU_METHOD
/begin COMPU_METHOD default "" RAT_FUNC "%6.2" "" COEFFS 0 1 0 0 0 1 /end COMPU_METHOD
/begin RECORD_LAYOUT KwbUb FNC_VALUES 1 UBYTE COLUMN_DIR DIRECT /end RECORD_LAYOUT
/begin RECORD_LAYOUT KwbUw FNC_VALUES 1 UWORD COLUMN_DIR DIRECT /end RECORD_LAYOUT
/begin RECORD_LAYOUT KwbWU16 FNC_VALUES 1 UWORD COLUMN_DIR DIRECT /end RECORD_LAYOUT
/begin RECORD_LAYOUT KwbWU8 FNC_VALUES 1 UBYTE COLUMN_DIR DIRECT /end RECORD_LAYOUT
/begin RECORD_LAYOUT KwUb FNC_VALUES 1 UBYTE COLUMN_DIR DIRECT /end RECORD_LAYOUT
/begin RECORD_LAYOUT KwUw FNC_VALUES 1 UWORD COLUMN_DIR DIRECT /end RECORD_LAYOUT
/begin RECORD_LAYOUT KwWU16 FNC_VALUES 1 UWORD COLUMN_DIR DIRECT /end RECORD_LAYOUT
/begin RECORD_LAYOUT KwWU8 FNC_VALUES 1 UBYTE COLUMN_DIR DIRECT /end RECORD_LAYOUT
/end MODULE
/end PROJECT
