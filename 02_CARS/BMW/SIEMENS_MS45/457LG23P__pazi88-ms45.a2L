ASAP2_VERSION 1 31
/begin PROJECT MS45 "BMW Motorsteuerung R6"
/begin HEADER "_default_HeaderComment" PROJECT_NO _57 /end HEADER
/begin MODULE _default_ModuleName "_default_ModuleLongIdentifier"
/begin MOD_COMMON "_default_ModCommonComment" DEPOSIT ABSOLUTE BYTE_ORDER MSB_FIRST ALIGNMENT_BYTE 1 ALIGNMENT_WORD 2 ALIGNMENT_LONG 4 ALIGNMENT_FLOAT32_IEEE 4 ALIGNMENT_FLOAT64_IEEE 8 /end MOD_COMMON
/begin MEASUREMENT lv_inh_diag_ebox_cfa "E-Box cooling fan diagnosis: application incidence to inhibit the diagnosis" UBYTE _CNV_S_2_RANGE______2_CM 1 100. 0. 1. DISPLAY_IDENTIFIER LV_INH_DIAG_EBOX_CFA ECU_ADDRESS 0x3fe946 /end MEASUREMENT
/begin MEASUREMENT lv_inh_diag_ls_up_down_1 "Inhibit snesor activity detection" UBYTE _CNV_S_2_RANGE______2_CM 1 100. 0. 1. DISPLAY_IDENTIFIER LV_INH_DIAG_LS_UP_DOWN_1 ECU_ADDRESS 0x3fea7d /end MEASUREMENT
/begin MEASUREMENT lv_inh_diag_ls_up_down_2 "Inhibit snesor activity detection" UBYTE _CNV_S_2_RANGE______2_CM 1 100. 0. 1. DISPLAY_IDENTIFIER LV_INH_DIAG_LS_UP_DOWN_2 ECU_ADDRESS 0x3fea7e /end MEASUREMENT
/begin MEASUREMENT lv_inh_diagcps "activation condition for Functional check CPS, irreversible" UBYTE _CNV_S_2_RANGE______2_CM 1 100. 0. 1. DISPLAY_IDENTIFIER LV_INH_DIAGCPS ECU_ADDRESS 0x3fe3af BIT_MASK 0x1 /end MEASUREMENT
/begin MEASUREMENT lv_di_diagcps "activation condition for Functional check CPS, reversible" UBYTE _CNV_S_2_RANGE______2_CM 1 100. 0. 1. DISPLAY_IDENTIFIER LV_DI_DIAGCPS ECU_ADDRESS 0x3fe3b0 BIT_MASK 0x1 /end MEASUREMENT
/begin CHARACTERISTIC c_tco_min_diagcps_1 "min. temperature for FC CPS/ Step1 (CL diagnosis)" VALUE 0xffe40912 _REC_VAL_20_u1 190.5 _CNV_A_R_LINEAR_____11_CM -48. 142.5 DISPLAY_IDENTIFIER C_TCO_MIN_DIAGCPS_1 FORMAT "%5.1" /end CHARACTERISTIC
/begin MEASUREMENT flow_sp_cp_diagcps "Flow setpoint through the CPS during Functional check CPS" UWORD _CNV_A_R_LINEAR_____113_CM 1 100. 0. 7.99987793 DISPLAY_IDENTIFIER FLOW_SP_CP_DIAGCPS ECU_ADDRESS 0x3fd1ec BYTE_ORDER MSB_LAST FORMAT "%7.4" /end MEASUREMENT
/begin MEASUREMENT state_diagcps "State - Functional check CPS" UBYTE _CNV_S_6_STATE_DIAG_188_CM 1 100. 0. 5. DISPLAY_IDENTIFIER STATE_DIAGCPS ECU_ADDRESS 0x3fe3b1 /end MEASUREMENT
/begin MEASUREMENT lv_act_diagcps "Indication for Functional check cps (step 2 or 3) being activated" UBYTE _CNV_S_2_RANGE______2_CM 1 100. 0. 1. DISPLAY_IDENTIFIER LV_ACT_DIAGCPS ECU_ADDRESS 0x3fe3bd BIT_MASK 0x1 /end MEASUREMENT
/begin MEASUREMENT lv_maf_diagcps_0 "Auxiliary bit for step 3 - Functional check CPS" UBYTE _CNV_S_2_RANGE______2_CM 1 100. 0. 1. DISPLAY_IDENTIFIER LV_MAF_DIAGCPS_0 ECU_ADDRESS 0x3fe3bb BIT_MASK 0x1 /end MEASUREMENT
/begin MEASUREMENT lv_maf_diagcps_1 "Auxiliary bit for step 3 - Functional check CPS" UBYTE _CNV_S_2_RANGE______2_CM 1 100. 0. 1. DISPLAY_IDENTIFIER LV_MAF_DIAGCPS_1 ECU_ADDRESS 0x3fe3bc BIT_MASK 0x1 /end MEASUREMENT
/begin MEASUREMENT lv_n_dif_diagcps "Auxiliary bit for step 2 - Functional check CPS" UBYTE _CNV_S_2_RANGE______2_CM 1 100. 0. 1. DISPLAY_IDENTIFIER LV_N_DIF_DIAGCPS ECU_ADDRESS 0x3fe3be BIT_MASK 0x1 /end MEASUREMENT
/begin MEASUREMENT lv_supp_accin_diagcps "Bit to suppress the air conditioning compressor request signal - Functional check CPS" UBYTE _CNV_S_2_RANGE______2_CM 1 100. 0. 1. DISPLAY_IDENTIFIER LV_SUPP_ACCIN_DIAGCPS ECU_ADDRESS 0x3fe3bf BIT_MASK 0x1 /end MEASUREMENT
/begin MEASUREMENT maf_diagcps "MAF value on start of step 3 - Functional check CPS" UWORD _CNV_A_R_LINEAR_____108_CM 1 100. 0. 1389. DISPLAY_IDENTIFIER MAF_DIAGCPS ECU_ADDRESS 0x3fd1f8 BYTE_ORDER MSB_LAST FORMAT "%7.2" /end MEASUREMENT
/begin MEASUREMENT n_diagcps "N value on starting the time C_T_DIAGCPS_N_2" UWORD _CNV_A_R_LINEAR_____10_CM 1 100. 0. 8160. DISPLAY_IDENTIFIER N_DIAGCPS ECU_ADDRESS 0x3fd1fa BYTE_ORDER MSB_LAST FORMAT "%4.0" /end MEASUREMENT
/begin MEASUREMENT sum_flow_sp_diagcps_eol "Number of step 2 loops which have been passed if EOL-Test is active - fuctional check CPS" UBYTE _CNV_A_R_LINEAR_____189_CM 1 100. 0. 255. DISPLAY_IDENTIFIER SUM_FLOW_SP_DIAGCPS_EOL ECU_ADDRESS 0x3fe3b2 FORMAT "%3.0" /end MEASUREMENT
/begin MEASUREMENT sum_flow_sp_diagcps "Number of step 2 loops which have been passed - Functional check CPS" UBYTE _CNV_A_R_LINEAR_____189_CM 1 100. 0. 255. DISPLAY_IDENTIFIER SUM_FLOW_SP_DIAGCPS ECU_ADDRESS 0x3fe3b3 FORMAT "%3.0" /end MEASUREMENT
/begin MEASUREMENT sum_diag_diagcps_eol "Number of diagnoses if EOL-Test is active - Functional check CPS" UBYTE _CNV_A_R_LINEAR_____189_CM 1 100. 0. 255. DISPLAY_IDENTIFIER SUM_DIAG_DIAGCPS_EOL ECU_ADDRESS 0x3fe3b4 FORMAT "%3.0" /end MEASUREMENT
/begin MEASUREMENT sum_diag_diagcps "Number of diagnoses - Functional check CPS" UBYTE _CNV_A_R_LINEAR_____189_CM 1 100. 0. 255. DISPLAY_IDENTIFIER SUM_DIAG_DIAGCPS ECU_ADDRESS 0x3fe3b5 FORMAT "%3.0" /end MEASUREMENT
/begin MEASUREMENT t_diagcps_dly "Delay time - Functional check CPS" UBYTE _CNV_A_R_LINEAR_____24_CM 1 100. 0.1 25.5 DISPLAY_IDENTIFIER T_DIAGCPS_DLY ECU_ADDRESS 0x3fe3b6 FORMAT "%4.1" /end MEASUREMENT
/begin MEASUREMENT t_diagcps_maf "Time for active FLOW_SP offset - Functional check CPS" UBYTE _CNV_A_R_LINEAR_____24_CM 1 100. 0.1 25.5 DISPLAY_IDENTIFIER T_DIAGCPS_MAF ECU_ADDRESS 0x3fe3c2 FORMAT "%4.1" /end MEASUREMENT
/begin MEASUREMENT t_diagcps_n_1 "1st time interval for N-DIF-Diagnosis - Functional check CPS" UBYTE _CNV_A_R_LINEAR_____24_CM 1 100. 0.1 25.5 DISPLAY_IDENTIFIER T_DIAGCPS_N_1 ECU_ADDRESS 0x3fe3b7 FORMAT "%4.1" /end MEASUREMENT
/begin MEASUREMENT t_diagcps_n_2 "2nd time interval for N-DIF-Diagnosis - Functional check CPS" UBYTE _CNV_A_R_LINEAR_____24_CM 1 100. 0.1 25.5 DISPLAY_IDENTIFIER T_DIAGCPS_N_2 ECU_ADDRESS 0x3fe3b8 FORMAT "%4.1" /end MEASUREMENT
/begin MEASUREMENT t_diagcps_n_3 "3rd time interval for N-DIF-Diagnosis - Functional check CPS" UBYTE _CNV_A_R_LINEAR_____24_CM 1 100. 0.1 25.5 DISPLAY_IDENTIFIER T_DIAGCPS_N_3 ECU_ADDRESS 0x3fe3b9 FORMAT "%4.1" /end MEASUREMENT
/begin MEASUREMENT isapwm_mmv_diagcps "Moving mean value of ISAPWM (RAM cell) - Functional check CPS" UWORD _CNV_A_R_LINEAR_____8_CM 1 100. 0. 99.99847412 DISPLAY_IDENTIFIER ISAPWM_MMV_DIAGCPS ECU_ADDRESS 0x3fd1f0 BYTE_ORDER MSB_LAST /end MEASUREMENT
/begin MEASUREMENT lv_isapwm_dyw_diagcps "Indication for limited dynamic condition - Functional check CPS" UBYTE _CNV_S_2_RANGE______2_CM 1 100. 0. 1. DISPLAY_IDENTIFIER LV_ISAPWM_DYW_DIAGCPS ECU_ADDRESS 0x3fe3c0 BIT_MASK 0x1 /end MEASUREMENT
/begin CHARACTERISTIC c_cl_mmv_diagcps "Moving mean value of canister load for Functional check CPS" VALUE 0xffe41524 _REC_VAL_20_u2 1.99996948 _CNV_A_R_LINEAR_____20_CM 0. 1.99996948 DISPLAY_IDENTIFIER C_CL_MMV_DIAGCPS FORMAT "%7.5" /end CHARACTERISTIC
/begin CHARACTERISTIC c_flow_sp_diagcps_maf "Flow setpoint offset in step 3 - Functional check CPS " VALUE 0xffe4165c _REC_VAL_20_u2 7.99987793 _CNV_A_R_LINEAR_____113_CM 0. 7.99987793 DISPLAY_IDENTIFIER C_FLOW_SP_DIAGCPS_MAF FORMAT "%7.4" /end CHARACTERISTIC
/begin CHARACTERISTIC c_flow_sp_diagcps_n "Flow setpoint offset in step 2 - Functional check CPS " VALUE 0xffe4165e _REC_VAL_20_u2 7.99987793 _CNV_A_R_LINEAR_____113_CM 0. 7.99987793 DISPLAY_IDENTIFIER C_FLOW_SP_DIAGCPS_N FORMAT "%7.4" /end CHARACTERISTIC
/begin CHARACTERISTIC c_lgrd_flow_sp_neg_diagcps "Limitation gradient for closing the CPS- funtional check CPS" VALUE 0xffe41704 _REC_VAL_20_u2 7.99987793 _CNV_A_R_LINEAR_____190_CM 0. 7.99987793 DISPLAY_IDENTIFIER C_LGRD_FLOW_SP_NEG_DIAGCPS FORMAT "%7.4" /end CHARACTERISTIC
/begin CHARACTERISTIC c_lgrd_flow_sp_pos_diagcps "Limitation gradient for opening the CPS- funtional check CPS" VALUE 0xffe41706 _REC_VAL_20_u2 7.99987793 _CNV_A_R_LINEAR_____190_CM 0. 7.99987793 DISPLAY_IDENTIFIER C_LGRD_FLOW_SP_POS_DIAGCPS FORMAT "%7.4" /end CHARACTERISTIC
/begin CHARACTERISTIC c_maf_diagcps "Delta MAF for MAF decrease - Functional check CPS" VALUE 0xffe41736 _REC_VAL_20_u2 1389. _CNV_A_R_LINEAR_____108_CM 0. 1389. DISPLAY_IDENTIFIER C_MAF_DIAGCPS FORMAT "%7.2" /end CHARACTERISTIC
/begin CHARACTERISTIC c_n_diagcps "Threshold for engine speed increase in step 2 - Functional check CPS" VALUE 0xffe417f0 _REC_VAL_20_u2 8159. _CNV_A_R_LINEAR_____10_CM 1. 8160. DISPLAY_IDENTIFIER C_N_DIAGCPS FORMAT "%4.0" /end CHARACTERISTIC
/begin CHARACTERISTIC c_n_dif_diagcps "Condition for IS engine speed difference - Functional check CPS" VALUE 0xffe417f4 _REC_VAL_20_u2 8159. _CNV_A_R_LINEAR_____10_CM 1. 8160. DISPLAY_IDENTIFIER C_N_DIF_DIAGCPS FORMAT "%4.0" /end CHARACTERISTIC
/begin CHARACTERISTIC c_sum_flow_sp_diagcps_max "Max. number of step 2 loops which have been passed - Functional check CPS" VALUE 0xffe40851 _REC_VAL_20_u1 255. _CNV_A_R_LINEAR_____189_CM 0. 255. DISPLAY_IDENTIFIER C_SUM_FLOW_SP_DIAGCPS_MAX FORMAT "%3.0" /end CHARACTERISTIC
/begin CHARACTERISTIC c_sum_diagcps_max "Counter limit of C_SUM_DIAGCPS - funtional check CPS" VALUE 0xffe4084c _REC_VAL_20_u1 255. _CNV_A_R_LINEAR_____189_CM 0. 255. DISPLAY_IDENTIFIER C_SUM_DIAGCPS_MAX FORMAT "%3.0" /end CHARACTERISTIC
/begin CHARACTERISTIC c_t_diagcps_maf "Time for active FLOW_SP offset C_FLOW_SP_DIAGCPS_MAF - Functional check CPS" VALUE 0xffe4086e _REC_VAL_20_u1 25.4 _CNV_A_R_LINEAR_____24_CM 0.1 25.5 DISPLAY_IDENTIFIER C_T_DIAGCPS_MAF FORMAT "%4.1" /end CHARACTERISTIC
/begin CHARACTERISTIC c_t_diagcps_n_1 "Time interval after expiry of which the cycle of step 2 is repeated - Functional check CPS" VALUE 0xffe4086f _REC_VAL_20_u1 25.4 _CNV_A_R_LINEAR_____24_CM 0.1 25.5 DISPLAY_IDENTIFIER C_T_DIAGCPS_N_1 FORMAT "%4.1" /end CHARACTERISTIC
/begin CHARACTERISTIC c_t_diagcps_n_2 "Time as from setting C_FLOW_SP_DIAGCPS_N - Functional check CPS" VALUE 0xffe40870 _REC_VAL_20_u1 25.4 _CNV_A_R_LINEAR_____24_CM 0.1 25.5 DISPLAY_IDENTIFIER C_T_DIAGCPS_N_2 FORMAT "%4.1" /end CHARACTERISTIC
/begin CHARACTERISTIC c_t_diagcps_n_3 "Time for increasing FLOW_SP - Functional check CPS" VALUE 0xffe40871 _REC_VAL_20_u1 25.4 _CNV_A_R_LINEAR_____24_CM 0.1 25.5 DISPLAY_IDENTIFIER C_T_DIAGCPS_N_3 FORMAT "%4.1" /end CHARACTERISTIC
/begin CHARACTERISTIC c_t_diagcps_dly "Delay time - Functional check CPS" VALUE 0xffe4086d _REC_VAL_20_u1 25.4 _CNV_A_R_LINEAR_____24_CM 0.1 25.5 DISPLAY_IDENTIFIER C_T_DIAGCPS_DLY FORMAT "%3.1" /end CHARACTERISTIC
/begin CHARACTERISTIC c_crlc_isapwm_diagcps "Correlation constant for calculation of ISAPWM_MMV_DIAGCPS" VALUE 0xffe41558 _REC_VAL_20_u2 1. _CNV_A_R_LINEAR_____191_CM 0. 1. DISPLAY_IDENTIFIER C_CRLC_ISAPWM_DIAGCPS FORMAT "%7.5" /end CHARACTERISTIC
/begin CHARACTERISTIC c_isapwm_dyw_diagcps "Dynamic window around ISAPWM_MMV_DIAGCPS" VALUE 0xffe41686 _REC_VAL_20_u2 99.99847412 _CNV_A_R_LINEAR_____8_CM 0. 99.99847412 DISPLAY_IDENTIFIER C_ISAPWM_DYW_DIAGCPS FORMAT "%5.2" /end CHARACTERISTIC
/begin CHARACTERISTIC c_maf_max_diagcps "MAF condition functional check CPS" VALUE 0xffe417b8 _REC_VAL_20_u2 1389. _CNV_A_R_LINEAR_____108_CM 0. 1389. DISPLAY_IDENTIFIER C_MAF_MAX_DIAGCPS FORMAT "%7.2" /end CHARACTERISTIC
/begin MEASUREMENT flow_sp_cps_old "Last EVAP calculated flow set point through the CPS before start of FC CPS" UWORD _CNV_A_R_LINEAR_____113_CM 1 100. 0. 7.99987793 DISPLAY_IDENTIFIER FLOW_SP_CPS_OLD ECU_ADDRESS 0x3fd1ee BYTE_ORDER MSB_LAST FORMAT "%7.4" /end MEASUREMENT
/begin MEASUREMENT sum_diag_diagcps_sae "Output mode06h -  Step 2" UBYTE _CNV_A_R_LINEAR_____189_CM 1 100. 0. 255. DISPLAY_IDENTIFIER SUM_DIAG_DIAGCPS_SAE ECU_ADDRESS 0x3fe3ba FORMAT "%3.0" /end MEASUREMENT
/begin MEASUREMENT maf_diagcps_sae "Output mode06h - Step 3" UWORD _CNV_A_R_LINEAR_____108_CM 1 100. 0. 1389. DISPLAY_IDENTIFIER MAF_DIAGCPS_SAE ECU_ADDRESS 0x3fd1f4 BYTE_ORDER MSB_LAST FORMAT "%4.0" /end MEASUREMENT
/begin MEASUREMENT maf_diagcps_thd_sae "Output mode06h - Step 3" UWORD _CNV_A_R_LINEAR_____108_CM 1 100. 0. 1389. DISPLAY_IDENTIFIER MAF_DIAGCPS_THD_SAE ECU_ADDRESS 0x3fd1f6 BYTE_ORDER MSB_LAST FORMAT "%4.0" /end MEASUREMENT
/begin MEASUREMENT cl_mmv_sae "Output mode06h -  Step 1" UWORD _CNV_A_R_LINEAR_____20_CM 1 100. 0. 1.99996948 DISPLAY_IDENTIFIER CL_MMV_SAE ECU_ADDRESS 0x3fd1f2 BYTE_ORDER MSB_LAST FORMAT "%7.5" /end MEASUREMENT
/begin CHARACTERISTIC c_tco_min_diagcps "min. temperature for Functional check CPS" VALUE 0xffe40911 _REC_VAL_20_u1 190.5 _CNV_A_R_LINEAR_____11_CM -48. 142.5 DISPLAY_IDENTIFIER C_TCO_MIN_DIAGCPS FORMAT "%5.1" /end CHARACTERISTIC
/begin CHARACTERISTIC c_sum_flow_sp_diagcps_eol "EOL-test: max. number of step 2 loops which have been passed - functional check CPS" VALUE 0xffe40850 _REC_VAL_20_u1 255. _CNV_A_R_LINEAR_____189_CM 0. 255. DISPLAY_IDENTIFIER C_SUM_FLOW_SP_DIAGCPS_EOL FORMAT "%3.0" /end CHARACTERISTIC
/begin CHARACTERISTIC c_sum_diagcps_eol "EOL-test: Counter limit of SUM_DIAGCPS_EOL - functional check CPS" VALUE 0xffe4084b _REC_VAL_20_u1 255. _CNV_A_R_LINEAR_____189_CM 0. 255. DISPLAY_IDENTIFIER C_SUM_DIAGCPS_EOL FORMAT "%3.0" /end CHARACTERISTIC
/begin MEASUREMENT lv_eol_cps_err "LV indicating error of functional check CPS (step 2) after EOL - test" UBYTE _CNV_S_2_RANGE______2_CM 1 100. 0. 1. DISPLAY_IDENTIFIER LV_EOL_CPS_ERR ECU_ADDRESS 0x3fe3c1 /end MEASUREMENT
/begin MEASUREMENT lv_err_diagcps "Indication for faulty functions - functioanl check CPS" UBYTE _CNV_S_2_RANGE______1_R_CM 1 100. 0. 255. DISPLAY_IDENTIFIER LV_ERR_DIAGCPS ECU_ADDRESS 0x3fba8c /end MEASUREMENT
/begin MEASUREMENT load_clc "Calculated load" UBYTE _CNV_A_R_LINEAR_____9_CM 1 100. 0. 99.609375 DISPLAY_IDENTIFIER LOAD_CLC ECU_ADDRESS 0x3fe05e FORMAT "%4.1" /end MEASUREMENT
/begin MEASUREMENT state_ls_1 "Fuel system status bank i" UBYTE _CNV_S_4_STATE_LS_197_CM 1 100. 1. 8. DISPLAY_IDENTIFIER STATE_LS_1 ECU_ADDRESS 0x3fe05f /end MEASUREMENT
/begin MEASUREMENT state_ls_2 "Fuel system status bank i" UBYTE _CNV_S_4_STATE_LS_197_CM 1 100. 1. 8. DISPLAY_IDENTIFIER STATE_LS_2 ECU_ADDRESS 0x3fe060 /end MEASUREMENT
/begin AXIS_PTS ldp_amp_ip_load_clc_amp "" 0xffe509d0 amp _REC_AXS_20_u2 5434. _CNV_A_R_LINEAR_____49_CM 6 0. 5434. DISPLAY_IDENTIFIER LDP_AMP_IP_LOAD_CLC_AMP FORMAT "%7.2" /end AXIS_PTS
/begin AXIS_PTS ldp_n_32_ip_load_clc "" 0xffe480e2 n_32 _REC_AXS_20_u1 8160. _CNV_A_R_LINEAR_____15_CM 8 0. 8160. DISPLAY_IDENTIFIER LDP_N_32_IP_LOAD_CLC FORMAT "%4.0" /end AXIS_PTS
/begin AXIS_PTS ldp_maf_ip_load_clc "" 0xffe50dee maf _REC_AXS_20_u2 1389. _CNV_A_R_LINEAR_____108_CM 8 0. 1389. DISPLAY_IDENTIFIER LDP_MAF_IP_LOAD_CLC FORMAT "%7.2" /end AXIS_PTS
/begin CHARACTERISTIC ip_load_clc_amp__amp "Atmospheric pressure ratio" CURVE 0xffe40ce8 _REC_CUR_20_u1_u2 1.99220002 _CNV_A_R_LINEAR_____39_CM 0. 1.99220002 DISPLAY_IDENTIFIER IP_LOAD_CLC_AMP__AMP FORMAT "%5.3"
 /begin AXIS_DESCR COM_AXIS amp _CNV_A_R_LINEAR_____49_CM 6 0. 5434. FORMAT "%7.2" AXIS_PTS_REF ldp_amp_ip_load_clc_amp /end AXIS_DESCR
/end CHARACTERISTIC
/begin CHARACTERISTIC ip_load_clc__n_32__maf "Airflow ratio" MAP 0xffe46c38 _REC_MAP_20_u1_u1_u2 0.9960940000000002 _CNV_A_R_LINEAR_____50_CM 0. 0.996094 DISPLAY_IDENTIFIER IP_LOAD_CLC__N_32__MAF FORMAT "%5.3"
 /begin AXIS_DESCR COM_AXIS n_32 _CNV_A_R_LINEAR_____15_CM 8 0. 8160. FORMAT "%4.0" AXIS_PTS_REF ldp_n_32_ip_load_clc /end AXIS_DESCR
 /begin AXIS_DESCR COM_AXIS maf _CNV_A_R_LINEAR_____108_CM 8 0. 1389. FORMAT "%7.2" AXIS_PTS_REF ldp_maf_ip_load_clc /end AXIS_DESCR
/end CHARACTERISTIC
/begin MEASUREMENT lam_bank_1.ls_up_down_diag.bf.lv_req_di_lscl "Request disable lambda controller" ULONG _CNV_S_2_RANGE______2_CM 1 100. 0. 1. DISPLAY_IDENTIFIER LV_REQ_DI_LSCL_1 ECU_ADDRESS 0x3fc59c BYTE_ORDER MSB_LAST BIT_MASK 0x80000000 /end MEASUREMENT
/begin MEASUREMENT lam_bank_1.ls_up_down_diag.bf.lv_req_chk_ls_up_down "Request active test of sensors" ULONG _CNV_S_2_RANGE______2_CM 1 100. 0. 1. DISPLAY_IDENTIFIER LV_REQ_CHK_LS_UP_DOWN_1 ECU_ADDRESS 0x3fc59c BYTE_ORDER MSB_LAST BIT_MASK 0x40000000 /end MEASUREMENT
/begin MEASUREMENT lam_bank_1.ls_up_down_diag.bf.lv_req_plaus_vls_down_puc "Request activation of plausibility check of downstream sensor during PUC phase" ULONG _CNV_S_2_RANGE______2_CM 1 100. 0. 1. DISPLAY_IDENTIFIER LV_REQ_PLAUS_VLS_DOWN_PUC_1 ECU_ADDRESS 0x3fc59c BYTE_ORDER MSB_LAST BIT_MASK 0x20000000 /end MEASUREMENT
/begin MEASUREMENT lam_bank_1.ls_up_down_diag.bf.lv_req_plaus_vls_down_fl "Request activation of plausibility check of downstream sensor duringFL phase" ULONG _CNV_S_2_RANGE______2_CM 1 100. 0. 1. DISPLAY_IDENTIFIER LV_REQ_PLAUS_VLS_DOWN_FL_1 ECU_ADDRESS 0x3fc59c BYTE_ORDER MSB_LAST BIT_MASK 0x10000000 /end MEASUREMENT
/begin MEASUREMENT lam_bank_1.ls_up_down_diag.state_diag_ls_up_down "State of check downstream sensor activity" UBYTE _CNV_S_7_STATE_DIAG_338_CM 1 100. 0. 6. DISPLAY_IDENTIFIER STATE_DIAG_LS_UP_DOWN_1 ECU_ADDRESS 0x3fc5a2 /end MEASUREMENT
/begin MEASUREMENT lam_bank_1.ls_up_down_diag.t_diag_ls_up_down "Passive test diagnostic waiting timer" UWORD _CNV_A_R_LINEAR_____24_CM 1 100. 0. 6553.5 DISPLAY_IDENTIFIER T_DIAG_LS_UP_DOWN_1 ECU_ADDRESS 0x3fc5a0 BYTE_ORDER MSB_LAST FORMAT "%6.1" /end MEASUREMENT
/begin MEASUREMENT lam_bank_1.lsl_up_obd2.bf.lv_sym_lsl_plaus "Diagnose condition" ULONG _CNV_S_2_RANGE______2_CM 1 100. 0. 1. DISPLAY_IDENTIFIER LV_SYM_LSL_PLAUS_1 ECU_ADDRESS 0x3fc630 BYTE_ORDER MSB_LAST BIT_MASK 0x8000000 /end MEASUREMENT
/begin MEASUREMENT lam_bank_1.lsl_up_obd2.bf.lv_end_lsl_plaus "Diagnose condition" ULONG _CNV_S_2_RANGE______2_CM 1 100. 0. 1. DISPLAY_IDENTIFIER LV_END_LSL_PLAUS_1 ECU_ADDRESS 0x3fc630 BYTE_ORDER MSB_LAST BIT_MASK 0x2000000 /end MEASUREMENT
/begin MEASUREMENT lam_bank_1.lsl_up_obd2.bf.lv_cdn_lsl_plaus "Diagnose condition" ULONG _CNV_S_2_RANGE______2_CM 1 100. 0. 1. DISPLAY_IDENTIFIER LV_CDN_LSL_PLAUS_1 ECU_ADDRESS 0x3fc630 BYTE_ORDER MSB_LAST BIT_MASK 0x4000000 /end MEASUREMENT
/begin MEASUREMENT lam_bank_1.lsl_up_obd2.bf.lv_sym_ls_up_dyn "Debounce diagnosis value of the sensor dynamics" ULONG _CNV_S_2_RANGE______2_CM 1 100. 0. 1. DISPLAY_IDENTIFIER LV_SYM_LS_UP_DYN_1 ECU_ADDRESS 0x3fc630 BYTE_ORDER MSB_LAST BIT_MASK 0x800000 /end MEASUREMENT
/begin MEASUREMENT lam_bank_1.lsl_up_obd2.bf.lv_cdn_ls_up_dyn "Diagnosis condition" ULONG _CNV_S_2_RANGE______2_CM 1 100. 0. 1. DISPLAY_IDENTIFIER LV_CDN_LS_UP_DYN_1 ECU_ADDRESS 0x3fc630 BYTE_ORDER MSB_LAST BIT_MASK 0x400000 /end MEASUREMENT
/begin MEASUREMENT lam_bank_1.lsl_up_obd2.bf.lv_end_ls_up_dyn "Result of diagnosis exit" ULONG _CNV_S_2_RANGE______2_CM 1 100. 0. 1. DISPLAY_IDENTIFIER LV_END_LS_UP_DYN_1 ECU_ADDRESS 0x3fc630 BYTE_ORDER MSB_LAST BIT_MASK 0x200000 /end MEASUREMENT
/begin MEASUREMENT lam_bank_1.lsl_up_obd2.bf.lv_sym_plaus_ls_up_puc "Debounce diagnosis result of the signal plausibility from the upstrem sensor during PUC" ULONG _CNV_S_2_RANGE______2_CM 1 100. 0. 1. DISPLAY_IDENTIFIER LV_SYM_PLAUS_LS_UP_PUC_1 ECU_ADDRESS 0x3fc630 BYTE_ORDER MSB_LAST BIT_MASK 0x20000 /end MEASUREMENT
/begin MEASUREMENT lam_bank_1.lsl_up_obd2.bf.lv_cdn_plaus_ls_up_puc "Diagnosis condition" ULONG _CNV_S_2_RANGE______2_CM 1 100. 0. 1. DISPLAY_IDENTIFIER LV_CDN_PLAUS_LS_UP_PUC_1 ECU_ADDRESS 0x3fc630 BYTE_ORDER MSB_LAST BIT_MASK 0x10000 /end MEASUREMENT
/begin MEASUREMENT lam_bank_1.lsl_up_obd2.bf.lv_end_plaus_ls_up_puc "Timer to have a diagnosis available" ULONG _CNV_S_2_RANGE______2_CM 1 100. 0. 1. DISPLAY_IDENTIFIER LV_END_PLAUS_LS_UP_PUC_1 ECU_ADDRESS 0x3fc630 BYTE_ORDER MSB_LAST BIT_MASK 0x8000 /end MEASUREMENT
/begin MEASUREMENT lam_bank_1.lsl_up_obd2.bf.lv_delta_lamb_dyn_diag "" ULONG _CNV_S_2_RANGE______2_CM 1 100. 0. 1. DISPLAY_IDENTIFIER LV_DELTA_LAMB_DYN_DIAG_1 ECU_ADDRESS 0x3fc630 BYTE_ORDER MSB_LAST BIT_MASK 0x100000 /end MEASUREMENT
/begin MEASUREMENT lam_bank_1.lsl_up_obd2.bf.lv_ls_up_dyn_vld "" ULONG _CNV_S_2_RANGE______2_CM 1 100. 0. 1. DISPLAY_IDENTIFIER LV_LS_UP_DYN_VLD_1 ECU_ADDRESS 0x3fc630 BYTE_ORDER MSB_LAST BIT_MASK 0x80000 /end MEASUREMENT
/begin MEASUREMENT lam_bank_1.lsl_up_obd2.bf.lv_sym_st_ls "False start affecting to the sensor bhaviour recognised" ULONG _CNV_S_2_RANGE______2_CM 1 100. 0. 1. DISPLAY_IDENTIFIER LV_SYM_ST_LS_1 ECU_ADDRESS 0x3fc630 BYTE_ORDER MSB_LAST BIT_MASK 0x40000000 /end MEASUREMENT
/begin MEASUREMENT lam_bank_1.lsl_up_obd2.bf.lv_cdn_st_ls "Diagnosis condition" ULONG _CNV_S_2_RANGE______2_CM 1 100. 0. 1. DISPLAY_IDENTIFIER LV_CDN_ST_LS_1 ECU_ADDRESS 0x3fc630 BYTE_ORDER MSB_LAST BIT_MASK 0x20000000 /end MEASUREMENT
/begin MEASUREMENT lam_bank_1.lsl_up_obd2.bf.lv_end_st_ls "Result of diagnosis exit" ULONG _CNV_S_2_RANGE______2_CM 1 100. 0. 1. DISPLAY_IDENTIFIER LV_END_ST_LS_1 ECU_ADDRESS 0x3fc630 BYTE_ORDER MSB_LAST BIT_MASK 0x10000000 /end MEASUREMENT
/begin MEASUREMENT lam_bank_1.lsl_up_obd2.bf.lv_diag_sym_lam_out "Diagnosis of lambda controller output fluctuation - symptom detected " ULONG _CNV_S_2_RANGE______2_CM 1 100. 0. 1. DISPLAY_IDENTIFIER LV_DIAG_SYM_LAM_OUT_1 ECU_ADDRESS 0x3fc630 BYTE_ORDER MSB_LAST BIT_MASK 0x4000 /end MEASUREMENT
/begin MEASUREMENT lam_bank_1.lsl_up_obd2.bf.lv_diag_max_thd_vld_lam_out "Boolean flag indicating TI_LAM_COR went beyond the max threshold of this diagnosis " ULONG _CNV_S_2_RANGE______2_CM 1 100. 0. 1. DISPLAY_IDENTIFIER LV_DIAG_MAX_THD_VLD_LAM_OUT_1 ECU_ADDRESS 0x3fc630 BYTE_ORDER MSB_LAST BIT_MASK 0x2000 /end MEASUREMENT
/begin MEASUREMENT lam_bank_1.lsl_up_obd2.bf.lv_diag_min_thd_vld_lam_out "Boolean flag indicating TI_LAM_COR went below the min threshold of this diagnosis " ULONG _CNV_S_2_RANGE______2_CM 1 100. 0. 1. DISPLAY_IDENTIFIER LV_DIAG_MIN_THD_VLD_LAM_OUT_1 ECU_ADDRESS 0x3fc630 BYTE_ORDER MSB_LAST BIT_MASK 0x1000 /end MEASUREMENT
/begin MEASUREMENT lam_bank_1.lsl_up_obd2.ctr_err_st "Remaining heating cycle counter to purify the reference air as a result of the engines false start" UBYTE _CNV_A_R_LINEAR_____0_CM 1 100. 0. 255. DISPLAY_IDENTIFIER CTR_ERR_ST_1 ECU_ADDRESS 0x3fc635 FORMAT "%3.0" /end MEASUREMENT
/begin MEASUREMENT lam_bank_1.lsl_up_obd2.t_st_eng "Starting time of the engine" UBYTE _CNV_A_R_LINEAR_____24_CM 1 100. 0. 25.5 DISPLAY_IDENTIFIER T_ST_ENG_1 ECU_ADDRESS 0x3fc634 FORMAT "%4.1" /end MEASUREMENT
/begin MEASUREMENT lam_bank_1.lsl_up_obd2.t_lsh_up_on "Timer how long the recovery process is active" UWORD _CNV_A_R_LINEAR_____24_CM 1 100. 0. 6553.5 DISPLAY_IDENTIFIER T_LSH_UP_ON_1 ECU_ADDRESS 0x3fc636 BYTE_ORDER MSB_LAST FORMAT "%6.1" /end MEASUREMENT
/begin MEASUREMENT lam_bank_1.lsl_up_obd2.t_lam_lim_st_err "Time, how long the lambda controller must be in limitation" UBYTE _CNV_A_R_LINEAR_____24_CM 1 100. 0. 25.5 DISPLAY_IDENTIFIER T_LAM_LIM_ST_ERR_1 ECU_ADDRESS 0x3fc638 FORMAT "%4.1" /end MEASUREMENT
/begin MEASUREMENT lam_bank_1.lsl_up_obd2.t_plaus_ls_up "Time for the plausibility symptom (compensation of the catalyst delay)" UWORD _CNV_A_R_LINEAR_____24_CM 1 100. 0. 6553.5 DISPLAY_IDENTIFIER T_PLAUS_LS_UP_1 ECU_ADDRESS 0x3fc63c BYTE_ORDER MSB_LAST FORMAT "%6.1" /end MEASUREMENT
/begin MEASUREMENT lam_bank_1.lsl_up_obd2.t_end_diag_lsl_plaus "Timer to have a diagnostic available" UWORD _CNV_A_R_LINEAR_____24_CM 1 100. 0. 6553.5 DISPLAY_IDENTIFIER T_END_DIAG_LSL_PLAUS_1 ECU_ADDRESS 0x3fc63e BYTE_ORDER MSB_LAST FORMAT "%6.1" /end MEASUREMENT
/begin MEASUREMENT lam_bank_1.lsl_up_obd2.t_end_diag_lsh_ls_up "Timer to have a diagnostic available" UWORD _CNV_A_R_LINEAR_____24_CM 1 100. 0. 6553.5 DISPLAY_IDENTIFIER T_END_DIAG_LSH_LS_UP_1 ECU_ADDRESS 0x3fc67c BYTE_ORDER MSB_LAST FORMAT "%6.1" /end MEASUREMENT
/begin MEASUREMENT lam_bank_1.lsl_up_obd2.cycnr_delta_lamb_lsh_diag "Cycle counter of successfully carried out functions" UBYTE _CNV_A_R_LINEAR_____0_CM 1 100. 0. 255. DISPLAY_IDENTIFIER CYCNR_DELTA_LAMB_LSH_DIAG_1 ECU_ADDRESS 0x3fc640 FORMAT "%3.0" /end MEASUREMENT
/begin MEASUREMENT lam_bank_1.lsl_up_obd2.ctr_delta_lamb_lsh_diag "Number of met diagnosis conditions" UBYTE _CNV_A_R_LINEAR_____0_CM 1 100. 0. 255. DISPLAY_IDENTIFIER CTR_DELTA_LAMB_LSH_DIAG_1 ECU_ADDRESS 0x3fc641 FORMAT "%3.0" /end MEASUREMENT
/begin MEASUREMENT lam_bank_1.lsl_up_obd2.maf_int_lsh_diag "Integral of the air flow, for the activation of the heater coupling diagnosis" UWORD _CNV_A_R_LINEAR_____287_CM 1 100. 0. 1820.398 DISPLAY_IDENTIFIER MAF_INT_LSH_DIAG_1 ECU_ADDRESS 0x3fc646 BYTE_ORDER MSB_LAST FORMAT "%7.2" /end MEASUREMENT
/begin MEASUREMENT lam_bank_1.lsl_up_obd2.delta_lamb_rise_lpf "calculated value for heater coupling (rising value)" UWORD _CNV_A_R_LINEAR_____206_CM 1 100. 0. 31.99902344 DISPLAY_IDENTIFIER DELTA_LAMB_RISE_LPF_1 ECU_ADDRESS 0x3fc642 BYTE_ORDER MSB_LAST /end MEASUREMENT
/begin MEASUREMENT lam_bank_1.lsl_up_obd2.delta_lamb_fall_lpf "calculated value for heater coupling (falling value)" UWORD _CNV_A_R_LINEAR_____206_CM 1 100. 0. 31.99902344 DISPLAY_IDENTIFIER DELTA_LAMB_FALL_LPF_1 ECU_ADDRESS 0x3fc644 BYTE_ORDER MSB_LAST /end MEASUREMENT
/begin MEASUREMENT lam_bank_1.lsl_up_obd2.lamb_lsl_rise_lsh_up "Lambda value just after lshpwm signal rises" UWORD _CNV_A_R_LINEAR_____206_CM 1 100. 0. 31.99902344 DISPLAY_IDENTIFIER LAMB_LSL_RISE_LSH_UP_1 ECU_ADDRESS 0x3fc648 BYTE_ORDER MSB_LAST /end MEASUREMENT
/begin MEASUREMENT lam_bank_1.lsl_up_obd2.lamb_lsl_fall_lsh_up "Lambda value just after lshpwm signal falls" UWORD _CNV_A_R_LINEAR_____206_CM 1 100. 0. 31.99902344 DISPLAY_IDENTIFIER LAMB_LSL_FALL_LSH_UP_1 ECU_ADDRESS 0x3fc64a BYTE_ORDER MSB_LAST /end MEASUREMENT
/begin MEASUREMENT lam_bank_1.lsl_up_obd2.lamb_lsh_fall "Variation of lambda value before and after lshpwm signal falls" UWORD _CNV_A_R_LINEAR_____206_CM 1 100. 0. 31.99902344 DISPLAY_IDENTIFIER LAMB_LSH_FALL_1 ECU_ADDRESS 0x3fc64e BYTE_ORDER MSB_LAST /end MEASUREMENT
/begin MEASUREMENT lam_bank_1.lsl_up_obd2.lamb_lsh_rise "Variation of lambda value before and after lshpwm signal rises" UWORD _CNV_A_R_LINEAR_____206_CM 1 100. 0. 31.99902344 DISPLAY_IDENTIFIER LAMB_LSH_RISE_1 ECU_ADDRESS 0x3fc64c BYTE_ORDER MSB_LAST /end MEASUREMENT
/begin MEASUREMENT lam_bank_1.lsl_up_obd2.ctr_ls_up_dyn "Number of  carried out single functions" UBYTE _CNV_A_R_LINEAR_____0_CM 1 100. 0. 255. DISPLAY_IDENTIFIER CTR_LS_UP_DYN_1 ECU_ADDRESS 0x3fc666 FORMAT "%3.0" /end MEASUREMENT
/begin MEASUREMENT lam_bank_1.lsl_up_obd2.lamb_diag_dyn_min "Minimum value of the lambda sensor signal (per sample period)" UWORD _CNV_A_R_LINEAR_____206_CM 1 100. 0. 31.99902344 DISPLAY_IDENTIFIER LAMB_DIAG_DYN_MIN_1 ECU_ADDRESS 0x3fc650 BYTE_ORDER MSB_LAST /end MEASUREMENT
/begin MEASUREMENT lam_bank_1.lsl_up_obd2.lamb_diag_dyn_max "Maximum value of the lambda sensor signal (per sample period)" UWORD _CNV_A_R_LINEAR_____206_CM 1 100. 0. 31.99902344 DISPLAY_IDENTIFIER LAMB_DIAG_DYN_MAX_1 ECU_ADDRESS 0x3fc652 BYTE_ORDER MSB_LAST /end MEASUREMENT
/begin MEASUREMENT lam_bank_1.lsl_up_obd2.t_end_diag_vls_up_thd_over "Timer to have a diagnostic available" UWORD _CNV_A_R_LINEAR_____24_CM 1 100. 0. 6553.5 DISPLAY_IDENTIFIER T_END_DIAG_VLS_UP_THD_OVER_1 ECU_ADDRESS 0x3fc67e BYTE_ORDER MSB_LAST FORMAT "%6.1" /end MEASUREMENT
/begin MEASUREMENT lam_bank_1.lsl_up_obd2.t_end_diag_plaus_ls_up_puc "Timer to have a diagnostic available" UWORD _CNV_A_R_LINEAR_____24_CM 1 100. 0. 6553.5 DISPLAY_IDENTIFIER T_END_DIAG_PLAUS_LS_UP_PUC_1 ECU_ADDRESS 0x3fc66e BYTE_ORDER MSB_LAST FORMAT "%6.1" /end MEASUREMENT
/begin MEASUREMENT lam_bank_1.lsl_up_obd2.sym_st_ls "Symptom of the false start identification without consideration abnormal lambda reculation behaviour" UBYTE _CNV_S_4_RANGE_SYM__339_CM 1 100. 0. 4. DISPLAY_IDENTIFIER SYM_ST_LS_1 ECU_ADDRESS 0x3fc639 /end MEASUREMENT
/begin MEASUREMENT lam_bank_1.lsl_up_obd2.sym_plaus_ls_up_puc "Symptom of the signal plausibility from the signal from the upstream sensor during PUC" UBYTE _CNV_S_3_RANGE_SYM__340_CM 1 100. 0. 2. DISPLAY_IDENTIFIER SYM_PLAUS_LS_UP_PUC_1 ECU_ADDRESS 0x3fc66c /end MEASUREMENT
/begin MEASUREMENT lam_bank_1.lsl_up_obd2.vls_up_plaus_puc_save "Upstream sensor voltage" UWORD _CNV_A_R_LINEAR_____341_CM 1 100. 0. 4.995 DISPLAY_IDENTIFIER VLS_UP_PLAUS_PUC_SAVE_1 ECU_ADDRESS 0x3fc670 BYTE_ORDER MSB_LAST FORMAT "%5.3" /end MEASUREMENT
/begin MEASUREMENT lam_bank_1.lsl_up_obd2.lamb_ampl_ls_up_dyn "" UBYTE _CNV_A_R_LINEAR_____342_CM 1 100. 0. 0.124023 DISPLAY_IDENTIFIER LAMB_AMPL_LS_UP_DYN_1 ECU_ADDRESS 0x3fc662 FORMAT "%5.3" /end MEASUREMENT
/begin MEASUREMENT lam_bank_1.lsl_up_obd2.lamb_ampl_min_ls_up_dyn "" UBYTE _CNV_A_R_LINEAR_____342_CM 1 100. 0. 0.124023 DISPLAY_IDENTIFIER LAMB_AMPL_MIN_LS_UP_DYN_1 ECU_ADDRESS 0x3fc663 FORMAT "%5.3" /end MEASUREMENT
/begin MEASUREMENT lam_bank_1.lsl_up_obd2.lamb_ampl_max_ls_up_dyn "" UBYTE _CNV_A_R_LINEAR_____342_CM 1 100. 0. 0.124023 DISPLAY_IDENTIFIER LAMB_AMPL_MAX_LS_UP_DYN_1 ECU_ADDRESS 0x3fc664 FORMAT "%5.3" /end MEASUREMENT
/begin MEASUREMENT lam_bank_1.lsl_up_obd2.lamb_ampl_mv_ls_up_dyn "" UBYTE _CNV_A_R_LINEAR_____342_CM 1 100. 0. 0.124023 DISPLAY_IDENTIFIER LAMB_AMPL_MV_LS_UP_DYN_1 ECU_ADDRESS 0x3fc665 FORMAT "%5.3" /end MEASUREMENT
/begin MEASUREMENT lam_bank_1.lsl_up_obd2.lamb_ampl_int_ls_up_dyn "" UWORD _CNV_A_R_LINEAR_____206_CM 1 100. 0. 31.99902344 DISPLAY_IDENTIFIER LAMB_AMPL_INT_LS_UP_DYN_1 ECU_ADDRESS 0x3fc654 BYTE_ORDER MSB_LAST /end MEASUREMENT
/begin MEASUREMENT lam_bank_1.lsl_up_obd2.ctr_ls_up_dyn_min "" UBYTE _CNV_A_R_LINEAR_____0_CM 1 100. 0. 255. DISPLAY_IDENTIFIER CTR_LS_UP_DYN_MIN_1 ECU_ADDRESS 0x3fc667 FORMAT "%3.0" /end MEASUREMENT
/begin MEASUREMENT lam_bank_1.lsl_up_obd2.ctr_ls_up_dyn_wait "" UBYTE _CNV_A_R_LINEAR_____0_CM 1 100. 0. 255. DISPLAY_IDENTIFIER CTR_LS_UP_DYN_WAIT_1 ECU_ADDRESS 0x3fc668 FORMAT "%3.0" /end MEASUREMENT
/begin MEASUREMENT lam_bank_1.lsl_up_obd2.cycnr_ls_up_dyn "" UBYTE _CNV_A_R_LINEAR_____0_CM 1 100. 0. 255. DISPLAY_IDENTIFIER CYCNR_LS_UP_DYN_1 ECU_ADDRESS 0x3fc669 FORMAT "%3.0" /end MEASUREMENT
/begin MEASUREMENT lam_bank_1.lsl_up_obd2.state_dyn_diag "" UBYTE _CNV_A_R_LINEAR_____0_CM 1 100. 0. 3. DISPLAY_IDENTIFIER STATE_DYN_DIAG_1 ECU_ADDRESS 0x3fc66a FORMAT "%1.0" /end MEASUREMENT
/begin MEASUREMENT lam_bank_1.lsl_up_obd2.fac_value_ls_up_dyn "" UWORD _CNV_A_R_LINEAR_____206_CM 1 100. 0. 31.99902344 DISPLAY_IDENTIFIER FAC_VALUE_LS_UP_DYN_1 ECU_ADDRESS 0x3fc656 BYTE_ORDER MSB_LAST /end MEASUREMENT
/begin MEASUREMENT lam_bank_1.lsl_up_obd2.fac_mv_ls_up_dyn "" UWORD _CNV_A_R_LINEAR_____206_CM 1 100. 0. 31.99902344 DISPLAY_IDENTIFIER FAC_MV_LS_UP_DYN_1 ECU_ADDRESS 0x3fc65a BYTE_ORDER MSB_LAST FORMAT "%7.4" /end MEASUREMENT
/begin MEASUREMENT lam_bank_1.lsl_up_obd2.fac_ad_min_ls_up_dyn "" UWORD _CNV_A_R_LINEAR_____206_CM 1 100. 0. 31.99902344 DISPLAY_IDENTIFIER FAC_AD_MIN_LS_UP_DYN_1 ECU_ADDRESS 0x3fc65c BYTE_ORDER MSB_LAST /end MEASUREMENT
/begin MEASUREMENT lam_bank_1.lsl_up_obd2.fac_ad_max_ls_up_dyn "" UWORD _CNV_A_R_LINEAR_____206_CM 1 100. 0. 31.99902344 DISPLAY_IDENTIFIER FAC_AD_MAX_LS_UP_DYN_1 ECU_ADDRESS 0x3fc65e BYTE_ORDER MSB_LAST /end MEASUREMENT
/begin MEASUREMENT lam_bank_1.lsl_up_obd2.fac_ls_up_dyn "" UWORD _CNV_A_R_LINEAR_____206_CM 1 100. 0. 31.99902344 DISPLAY_IDENTIFIER FAC_LS_UP_DYN_1 ECU_ADDRESS 0x3fc660 BYTE_ORDER MSB_LAST /end MEASUREMENT
/begin MEASUREMENT lam_bank_1.lsl_up_obd2.fac_sum_ls_up_dyn "" UWORD _CNV_A_R_LINEAR_____118_CM 1 100. 0. 63.99902344 DISPLAY_IDENTIFIER FAC_SUM_LS_UP_DYN_1 ECU_ADDRESS 0x3fc658 BYTE_ORDER MSB_LAST FORMAT "%7.4" /end MEASUREMENT
/begin MEASUREMENT lam_bank_1.lsl_up_obd2.sym_lsl_plaus "Symptom of of the heater coupling diagnosis" UBYTE _CNV_S_4_RANGE_SYM__339_CM 1 100. 0. 4. DISPLAY_IDENTIFIER SYM_LSL_PLAUS_1 ECU_ADDRESS 0x3fc63a /end MEASUREMENT
/begin MEASUREMENT lam_bank_1.lsl_up_obd2.ctr_diag_sym_lam_out "Counter for the fluctuation of TI_LAM_COR exceeding the min/max thresholds" UBYTE _CNV_A_R_LINEAR_____0_CM 1 100. 0. 255. DISPLAY_IDENTIFIER CTR_DIAG_SYM_LAM_OUT_1 ECU_ADDRESS 0x3fc674 FORMAT "%3.0" /end MEASUREMENT
/begin MEASUREMENT lam_bank_1.lsl_up_obd2.t_sum_rst_diag_lam_out "Reset Timer  " UWORD _CNV_A_R_LINEAR_____198_CM 1 100. 0. 1310.7 DISPLAY_IDENTIFIER T_SUM_RST_DIAG_LAM_OUT_1 ECU_ADDRESS 0x3fc672 BYTE_ORDER MSB_LAST FORMAT "%7.2" /end MEASUREMENT
/begin MEASUREMENT lam_bank_1.lam_dly_obd2.t_sum_max_delta_lamb_i "Total duration over C_DELTA_LAMB_I_MAX_DIAG" UWORD _CNV_A_R_LINEAR_____30_CM 1 100. 0. 65535. DISPLAY_IDENTIFIER T_SUM_MAX_DELTA_LAMB_I_1 ECU_ADDRESS 0x3fc6a0 BYTE_ORDER MSB_LAST FORMAT "%5.0" /end MEASUREMENT
/begin MEASUREMENT lam_bank_1.lam_dly_obd2.t_sum_min_delta_lamb_i "Total duration over C_DELTA_LAMB_I_MIN_DIAG" UWORD _CNV_A_R_LINEAR_____30_CM 1 100. 0. 65535. DISPLAY_IDENTIFIER T_SUM_MIN_DELTA_LAMB_I_1 ECU_ADDRESS 0x3fc6a2 BYTE_ORDER MSB_LAST FORMAT "%5.0" /end MEASUREMENT
/begin MEASUREMENT lam_bank_1.lam_dly_obd2.t_sum_rst_delta_lamb_i "Time counter to reset T_SUM_MIN_LAM_DLY_i and T_SUM_MAX_LAM_DLY_i" UWORD _CNV_A_R_LINEAR_____30_CM 1 100. 0. 65535. DISPLAY_IDENTIFIER T_SUM_RST_DELTA_LAMB_I_1 ECU_ADDRESS 0x3fc6a4 BYTE_ORDER MSB_LAST FORMAT "%5.0" /end MEASUREMENT
/begin MEASUREMENT lam_bank_1.lam_dly_obd2.t_end_diag_delta_lamb_i "Time counter to set LV_END_DIAG_DELTA_LAMB_I_i" UWORD _CNV_A_R_LINEAR_____30_CM 1 100. 0. 65535. DISPLAY_IDENTIFIER T_END_DIAG_DELTA_LAMB_I_1 ECU_ADDRESS 0x3fc69e BYTE_ORDER MSB_LAST FORMAT "%5.0" /end MEASUREMENT
/begin MEASUREMENT lam_bank_1.lam_dly_obd2.delta_lamb_i_save "I-share from trim controller - to be transmitted to the San-Tool mode06" SWORD _CNV_A_R_LINEAR_____285_CM 1 100. -0.125 0.125 DISPLAY_IDENTIFIER DELTA_LAMB_I_SAVE_1 ECU_ADDRESS 0x3fc6b0 BYTE_ORDER MSB_LAST FORMAT "%7.4" /end MEASUREMENT
/begin MEASUREMENT lam_bank_1.lam_dly_obd2.sym_vls_dif_dly "Symptoms of the trim control errors" UWORD _CNV_S_6_RANGE_ERR__337_CM 1 100. 0. 15. DISPLAY_IDENTIFIER SYM_VLS_DIF_DLY_1 ECU_ADDRESS 0x3fc69c BYTE_ORDER MSB_LAST /end MEASUREMENT
/begin MEASUREMENT lam_bank_1.lam_dly_obd2.t_sum_max_vls_dif_dly "Total duration of maximum VLS_DIF_DLY deviation" UWORD _CNV_A_R_LINEAR_____24_CM 1 100. 0. 6553.5 DISPLAY_IDENTIFIER T_SUM_MAX_VLS_DIF_DLY_1 ECU_ADDRESS 0x3fc6a6 BYTE_ORDER MSB_LAST FORMAT "%5.1" /end MEASUREMENT
/begin MEASUREMENT lam_bank_1.lam_dly_obd2.t_sum_min_vls_dif_dly "Total duration of minimum VLS_DIF_DLY deviation" UWORD _CNV_A_R_LINEAR_____24_CM 1 100. 0. 6553.5 DISPLAY_IDENTIFIER T_SUM_MIN_VLS_DIF_DLY_1 ECU_ADDRESS 0x3fc6a8 BYTE_ORDER MSB_LAST FORMAT "%5.1" /end MEASUREMENT
/begin MEASUREMENT lam_bank_1.lam_dly_obd2.t_end_diag_vls_dif_dly "Time counter to set T_END_DIAG_VLS_DIF_DLY_i" UWORD _CNV_A_R_LINEAR_____24_CM 1 100. 0. 6553.5 DISPLAY_IDENTIFIER T_END_DIAG_VLS_DIF_DLY_1 ECU_ADDRESS 0x3fc6ac BYTE_ORDER MSB_LAST FORMAT "%5.1" /end MEASUREMENT
/begin MEASUREMENT lam_bank_1.lam_dly_obd2.t_sum_rst_vls_dif_dly "Time counter to reset T_SUM_MIN_VLS_DIF_DLY_i and T_SUM_MAX_VLS_DIF_DLY_i" UWORD _CNV_A_R_LINEAR_____24_CM 1 100. 0. 6553.5 DISPLAY_IDENTIFIER T_SUM_RST_VLS_DIF_DLY_1 ECU_ADDRESS 0x3fc6aa BYTE_ORDER MSB_LAST FORMAT "%5.1" /end MEASUREMENT
/begin MEASUREMENT lam_bank_1.lam_dly_obd2.bf.lv_sym_vls_dif_dly "Status diagnostic result of trim monitoring" ULONG _CNV_S_2_RANGE______2_CM 1 100. 0. 1. DISPLAY_IDENTIFIER LV_SYM_VLS_DIF_DLY_1 ECU_ADDRESS 0x3fc698 BYTE_ORDER MSB_LAST BIT_MASK 0x80000000 /end MEASUREMENT
/begin MEASUREMENT lam_bank_1.lam_dly_obd2.bf.lv_cdn_vls_dif_dly "Condition to activate trim controller deviation diagnosis" ULONG _CNV_S_2_RANGE______2_CM 1 100. 0. 1. DISPLAY_IDENTIFIER LV_CDN_VLS_DIF_DLY_1 ECU_ADDRESS 0x3fc698 BYTE_ORDER MSB_LAST BIT_MASK 0x40000000 /end MEASUREMENT
/begin MEASUREMENT lam_bank_1.lam_dly_obd2.bf.lv_end_vls_dif_dly "Trim controller deviation diagnostic available" ULONG _CNV_S_2_RANGE______2_CM 1 100. 0. 1. DISPLAY_IDENTIFIER LV_END_VLS_DIF_DLY_1 ECU_ADDRESS 0x3fc698 BYTE_ORDER MSB_LAST BIT_MASK 0x20000000 /end MEASUREMENT
/begin MEASUREMENT lam_bank_1.lam_dly_obd2.bf.lv_ldc_vls_dif_dly "Status limited dynamic for the function \"Monitoring Trim Controller Deviation\"" ULONG _CNV_S_2_RANGE______2_CM 1 100. 0. 1. DISPLAY_IDENTIFIER LV_LDC_VLS_DIF_DLY_1 ECU_ADDRESS 0x3fc698 BYTE_ORDER MSB_LAST BIT_MASK 0x10000000 /end MEASUREMENT
/begin MEASUREMENT lam_bank_1.lam_dly_obd2.bf.lv_lam_mv_ldc_vls_dif_dly "Status limited dynamic LAM_MV_i" ULONG _CNV_S_2_RANGE______2_CM 1 100. 0. 1. DISPLAY_IDENTIFIER LV_LAM_MV_LDC_VLS_DIF_DLY_1 ECU_ADDRESS 0x3fc698 BYTE_ORDER MSB_LAST BIT_MASK 0x8000000 /end MEASUREMENT
/begin MEASUREMENT lam_bank_1.lam_dly_obd2.maf_int_ldc_vls_dif_dly "integral of mass air flow since limited dynamic conditions fulfilled" UWORD _CNV_A_R_LINEAR_____273_CM 1 100. 0. 1820.4167 DISPLAY_IDENTIFIER MAF_INT_LDC_VLS_DIF_DLY_1 ECU_ADDRESS 0x3fc6ae BYTE_ORDER MSB_LAST FORMAT "%9.4" /end MEASUREMENT
/begin MEASUREMENT lam_bank_1.lam_dly_obd2.lam_mmv_ldc_vls_dif_dly "floating mean value for limited lambda deviation" SWORD _CNV_A_R_LINEAR_____111_CM 1 100. -50. 49.99847412 DISPLAY_IDENTIFIER LAM_MMV_LDC_VLS_DIF_DLY_1 ECU_ADDRESS 0x3fc6b2 BYTE_ORDER MSB_LAST FORMAT "%7.3" /end MEASUREMENT
/begin MEASUREMENT lam_bank_2.ls_up_down_diag.bf.lv_req_di_lscl "Request disable lambda controller" ULONG _CNV_S_2_RANGE______2_CM 1 100. 0. 1. DISPLAY_IDENTIFIER LV_REQ_DI_LSCL_2 ECU_ADDRESS 0x3fca54 BYTE_ORDER MSB_LAST BIT_MASK 0x80000000 /end MEASUREMENT
/begin MEASUREMENT lam_bank_2.ls_up_down_diag.bf.lv_req_chk_ls_up_down "Request active test of sensors" ULONG _CNV_S_2_RANGE______2_CM 1 100. 0. 1. DISPLAY_IDENTIFIER LV_REQ_CHK_LS_UP_DOWN_2 ECU_ADDRESS 0x3fca54 BYTE_ORDER MSB_LAST BIT_MASK 0x40000000 /end MEASUREMENT
/begin MEASUREMENT lam_bank_2.ls_up_down_diag.bf.lv_req_plaus_vls_down_puc "Request activation of plausibility check of downstream sensor during PUC phase" ULONG _CNV_S_2_RANGE______2_CM 1 100. 0. 1. DISPLAY_IDENTIFIER LV_REQ_PLAUS_VLS_DOWN_PUC_2 ECU_ADDRESS 0x3fca54 BYTE_ORDER MSB_LAST BIT_MASK 0x20000000 /end MEASUREMENT
/begin MEASUREMENT lam_bank_2.ls_up_down_diag.bf.lv_req_plaus_vls_down_fl "Request activation of plausibility check of downstream sensor duringFL phase" ULONG _CNV_S_2_RANGE______2_CM 1 100. 0. 1. DISPLAY_IDENTIFIER LV_REQ_PLAUS_VLS_DOWN_FL_2 ECU_ADDRESS 0x3fca54 BYTE_ORDER MSB_LAST BIT_MASK 0x10000000 /end MEASUREMENT
/begin MEASUREMENT lam_bank_2.ls_up_down_diag.state_diag_ls_up_down "State of check downstream sensor activity" UBYTE _CNV_S_7_STATE_DIAG_338_CM 1 100. 0. 6. DISPLAY_IDENTIFIER STATE_DIAG_LS_UP_DOWN_2 ECU_ADDRESS 0x3fca5a /end MEASUREMENT
/begin MEASUREMENT lam_bank_2.ls_up_down_diag.t_diag_ls_up_down "Passive test diagnostic waiting timer" UWORD _CNV_A_R_LINEAR_____24_CM 1 100. 0. 6553.5 DISPLAY_IDENTIFIER T_DIAG_LS_UP_DOWN_2 ECU_ADDRESS 0x3fca58 BYTE_ORDER MSB_LAST FORMAT "%6.1" /end MEASUREMENT
/begin MEASUREMENT lam_bank_2.lsl_up_obd2.bf.lv_sym_lsl_plaus "Diagnose condition" ULONG _CNV_S_2_RANGE______2_CM 1 100. 0. 1. DISPLAY_IDENTIFIER LV_SYM_LSL_PLAUS_2 ECU_ADDRESS 0x3fcae8 BYTE_ORDER MSB_LAST BIT_MASK 0x8000000 /end MEASUREMENT
/begin MEASUREMENT lam_bank_2.lsl_up_obd2.bf.lv_end_lsl_plaus "Diagnose condition" ULONG _CNV_S_2_RANGE______2_CM 1 100. 0. 1. DISPLAY_IDENTIFIER LV_END_LSL_PLAUS_2 ECU_ADDRESS 0x3fcae8 BYTE_ORDER MSB_LAST BIT_MASK 0x2000000 /end MEASUREMENT
/begin MEASUREMENT lam_bank_2.lsl_up_obd2.bf.lv_cdn_lsl_plaus "Diagnose condition" ULONG _CNV_S_2_RANGE______2_CM 1 100. 0. 1. DISPLAY_IDENTIFIER LV_CDN_LSL_PLAUS_2 ECU_ADDRESS 0x3fcae8 BYTE_ORDER MSB_LAST BIT_MASK 0x4000000 /end MEASUREMENT
/begin MEASUREMENT lam_bank_2.lsl_up_obd2.bf.lv_sym_ls_up_dyn "Debounce diagnosis value of the sensor dynamics" ULONG _CNV_S_2_RANGE______2_CM 1 100. 0. 1. DISPLAY_IDENTIFIER LV_SYM_LS_UP_DYN_2 ECU_ADDRESS 0x3fcae8 BYTE_ORDER MSB_LAST BIT_MASK 0x800000 /end MEASUREMENT
/begin MEASUREMENT lam_bank_2.lsl_up_obd2.bf.lv_cdn_ls_up_dyn "Diagnosis condition" ULONG _CNV_S_2_RANGE______2_CM 1 100. 0. 1. DISPLAY_IDENTIFIER LV_CDN_LS_UP_DYN_2 ECU_ADDRESS 0x3fcae8 BYTE_ORDER MSB_LAST BIT_MASK 0x400000 /end MEASUREMENT
/begin MEASUREMENT lam_bank_2.lsl_up_obd2.bf.lv_end_ls_up_dyn "Result of diagnosis exit" ULONG _CNV_S_2_RANGE______2_CM 1 100. 0. 1. DISPLAY_IDENTIFIER LV_END_LS_UP_DYN_2 ECU_ADDRESS 0x3fcae8 BYTE_ORDER MSB_LAST BIT_MASK 0x200000 /end MEASUREMENT
/begin MEASUREMENT lam_bank_2.lsl_up_obd2.bf.lv_sym_plaus_ls_up_puc "Debounce diagnosis result of the signal plausibility from the upstrem sensor during PUC" ULONG _CNV_S_2_RANGE______2_CM 1 100. 0. 1. DISPLAY_IDENTIFIER LV_SYM_PLAUS_LS_UP_PUC_2 ECU_ADDRESS 0x3fcae8 BYTE_ORDER MSB_LAST BIT_MASK 0x20000 /end MEASUREMENT
/begin MEASUREMENT lam_bank_2.lsl_up_obd2.bf.lv_cdn_plaus_ls_up_puc "Diagnosis condition" ULONG _CNV_S_2_RANGE______2_CM 1 100. 0. 1. DISPLAY_IDENTIFIER LV_CDN_PLAUS_LS_UP_PUC_2 ECU_ADDRESS 0x3fcae8 BYTE_ORDER MSB_LAST BIT_MASK 0x10000 /end MEASUREMENT
/begin MEASUREMENT lam_bank_2.lsl_up_obd2.bf.lv_end_plaus_ls_up_puc "Timer to have a diagnosis available" ULONG _CNV_S_2_RANGE______2_CM 1 100. 0. 1. DISPLAY_IDENTIFIER LV_END_PLAUS_LS_UP_PUC_2 ECU_ADDRESS 0x3fcae8 BYTE_ORDER MSB_LAST BIT_MASK 0x8000 /end MEASUREMENT
/begin MEASUREMENT lam_bank_2.lsl_up_obd2.bf.lv_delta_lamb_dyn_diag "" ULONG _CNV_S_2_RANGE______2_CM 1 100. 0. 1. DISPLAY_IDENTIFIER LV_DELTA_LAMB_DYN_DIAG_2 ECU_ADDRESS 0x3fcae8 BYTE_ORDER MSB_LAST BIT_MASK 0x100000 /end MEASUREMENT
/begin MEASUREMENT lam_bank_2.lsl_up_obd2.bf.lv_ls_up_dyn_vld "" ULONG _CNV_S_2_RANGE______2_CM 1 100. 0. 1. DISPLAY_IDENTIFIER LV_LS_UP_DYN_VLD_2 ECU_ADDRESS 0x3fcae8 BYTE_ORDER MSB_LAST BIT_MASK 0x80000 /end MEASUREMENT
/begin MEASUREMENT lam_bank_2.lsl_up_obd2.bf.lv_sym_st_ls "False start affecting to the sensor bhaviour recognised" ULONG _CNV_S_2_RANGE______2_CM 1 100. 0. 1. DISPLAY_IDENTIFIER LV_SYM_ST_LS_2 ECU_ADDRESS 0x3fcae8 BYTE_ORDER MSB_LAST BIT_MASK 0x40000000 /end MEASUREMENT
/begin MEASUREMENT lam_bank_2.lsl_up_obd2.bf.lv_cdn_st_ls "Diagnosis condition" ULONG _CNV_S_2_RANGE______2_CM 1 100. 0. 1. DISPLAY_IDENTIFIER LV_CDN_ST_LS_2 ECU_ADDRESS 0x3fcae8 BYTE_ORDER MSB_LAST BIT_MASK 0x20000000 /end MEASUREMENT
/begin MEASUREMENT lam_bank_2.lsl_up_obd2.bf.lv_end_st_ls "Result of diagnosis exit" ULONG _CNV_S_2_RANGE______2_CM 1 100. 0. 1. DISPLAY_IDENTIFIER LV_END_ST_LS_2 ECU_ADDRESS 0x3fcae8 BYTE_ORDER MSB_LAST BIT_MASK 0x10000000 /end MEASUREMENT
/begin MEASUREMENT lam_bank_2.lsl_up_obd2.bf.lv_diag_sym_lam_out "Diagnosis of lambda controller output fluctuation - symptom detected " ULONG _CNV_S_2_RANGE______2_CM 1 100. 0. 1. DISPLAY_IDENTIFIER LV_DIAG_SYM_LAM_OUT_2 ECU_ADDRESS 0x3fcae8 BYTE_ORDER MSB_LAST BIT_MASK 0x4000 /end MEASUREMENT
/begin MEASUREMENT lam_bank_2.lsl_up_obd2.bf.lv_diag_max_thd_vld_lam_out "Boolean flag indicating TI_LAM_COR went beyond the max threshold of this diagnosis " ULONG _CNV_S_2_RANGE______2_CM 1 100. 0. 1. DISPLAY_IDENTIFIER LV_DIAG_MAX_THD_VLD_LAM_OUT_2 ECU_ADDRESS 0x3fcae8 BYTE_ORDER MSB_LAST BIT_MASK 0x2000 /end MEASUREMENT
/begin MEASUREMENT lam_bank_2.lsl_up_obd2.bf.lv_diag_min_thd_vld_lam_out "Boolean flag indicating TI_LAM_COR went below the min threshold of this diagnosis " ULONG _CNV_S_2_RANGE______2_CM 1 100. 0. 1. DISPLAY_IDENTIFIER LV_DIAG_MIN_THD_VLD_LAM_OUT_2 ECU_ADDRESS 0x3fcae8 BYTE_ORDER MSB_LAST BIT_MASK 0x1000 /end MEASUREMENT
/begin MEASUREMENT lam_bank_2.lsl_up_obd2.ctr_err_st "Remaining heating cycle counter to purify the reference air as a result of the engines false start" UBYTE _CNV_A_R_LINEAR_____0_CM 1 100. 0. 255. DISPLAY_IDENTIFIER CTR_ERR_ST_2 ECU_ADDRESS 0x3fcaed FORMAT "%3.0" /end MEASUREMENT
/begin MEASUREMENT lam_bank_2.lsl_up_obd2.t_st_eng "Starting time of the engine" UBYTE _CNV_A_R_LINEAR_____24_CM 1 100. 0. 25.5 DISPLAY_IDENTIFIER T_ST_ENG_2 ECU_ADDRESS 0x3fcaec FORMAT "%4.1" /end MEASUREMENT
/begin MEASUREMENT lam_bank_2.lsl_up_obd2.t_lsh_up_on "Timer how long the recovery process is active" UWORD _CNV_A_R_LINEAR_____24_CM 1 100. 0. 6553.5 DISPLAY_IDENTIFIER T_LSH_UP_ON_2 ECU_ADDRESS 0x3fcaee BYTE_ORDER MSB_LAST FORMAT "%6.1" /end MEASUREMENT
/begin MEASUREMENT lam_bank_2.lsl_up_obd2.t_lam_lim_st_err "Time, how long the lambda controller must be in limitation" UBYTE _CNV_A_R_LINEAR_____24_CM 1 100. 0. 25.5 DISPLAY_IDENTIFIER T_LAM_LIM_ST_ERR_2 ECU_ADDRESS 0x3fcaf0 FORMAT "%4.1" /end MEASUREMENT
/begin MEASUREMENT lam_bank_2.lsl_up_obd2.t_plaus_ls_up "Time for the plausibility symptom (compensation of the catalyst delay)" UWORD _CNV_A_R_LINEAR_____24_CM 1 100. 0. 6553.5 DISPLAY_IDENTIFIER T_PLAUS_LS_UP_2 ECU_ADDRESS 0x3fcaf4 BYTE_ORDER MSB_LAST FORMAT "%6.1" /end MEASUREMENT
/begin MEASUREMENT lam_bank_2.lsl_up_obd2.t_end_diag_lsl_plaus "Timer to have a diagnostic available" UWORD _CNV_A_R_LINEAR_____24_CM 1 100. 0. 6553.5 DISPLAY_IDENTIFIER T_END_DIAG_LSL_PLAUS_2 ECU_ADDRESS 0x3fcaf6 BYTE_ORDER MSB_LAST FORMAT "%6.1" /end MEASUREMENT
/begin MEASUREMENT lam_bank_2.lsl_up_obd2.t_end_diag_lsh_ls_up "Timer to have a diagnostic available" UWORD _CNV_A_R_LINEAR_____24_CM 1 100. 0. 6553.5 DISPLAY_IDENTIFIER T_END_DIAG_LSH_LS_UP_2 ECU_ADDRESS 0x3fcb34 BYTE_ORDER MSB_LAST FORMAT "%6.1" /end MEASUREMENT
/begin MEASUREMENT lam_bank_2.lsl_up_obd2.cycnr_delta_lamb_lsh_diag "Cycle counter of successfully carried out functions" UBYTE _CNV_A_R_LINEAR_____0_CM 1 100. 0. 255. DISPLAY_IDENTIFIER CYCNR_DELTA_LAMB_LSH_DIAG_2 ECU_ADDRESS 0x3fcaf8 FORMAT "%3.0" /end MEASUREMENT
/begin MEASUREMENT lam_bank_2.lsl_up_obd2.ctr_delta_lamb_lsh_diag "Number of met diagnosis conditions" UBYTE _CNV_A_R_LINEAR_____0_CM 1 100. 0. 255. DISPLAY_IDENTIFIER CTR_DELTA_LAMB_LSH_DIAG_2 ECU_ADDRESS 0x3fcaf9 FORMAT "%3.0" /end MEASUREMENT
/begin MEASUREMENT lam_bank_2.lsl_up_obd2.maf_int_lsh_diag "Integral of the air flow, for the activation of the heater coupling diagnosis" UWORD _CNV_A_R_LINEAR_____287_CM 1 100. 0. 1820.398 DISPLAY_IDENTIFIER MAF_INT_LSH_DIAG_2 ECU_ADDRESS 0x3fcafe BYTE_ORDER MSB_LAST FORMAT "%7.2" /end MEASUREMENT
/begin MEASUREMENT lam_bank_2.lsl_up_obd2.delta_lamb_rise_lpf "calculated value for heater coupling (rising value)" UWORD _CNV_A_R_LINEAR_____206_CM 1 100. 0. 31.99902344 DISPLAY_IDENTIFIER DELTA_LAMB_RISE_LPF_2 ECU_ADDRESS 0x3fcafa BYTE_ORDER MSB_LAST /end MEASUREMENT
/begin MEASUREMENT lam_bank_2.lsl_up_obd2.delta_lamb_fall_lpf "calculated value for heater coupling (falling value)" UWORD _CNV_A_R_LINEAR_____206_CM 1 100. 0. 31.99902344 DISPLAY_IDENTIFIER DELTA_LAMB_FALL_LPF_2 ECU_ADDRESS 0x3fcafc BYTE_ORDER MSB_LAST /end MEASUREMENT
/begin MEASUREMENT lam_bank_2.lsl_up_obd2.lamb_lsl_rise_lsh_up "Lambda value just after lshpwm signal rises" UWORD _CNV_A_R_LINEAR_____206_CM 1 100. 0. 31.99902344 DISPLAY_IDENTIFIER LAMB_LSL_RISE_LSH_UP_2 ECU_ADDRESS 0x3fcb00 BYTE_ORDER MSB_LAST /end MEASUREMENT
/begin MEASUREMENT lam_bank_2.lsl_up_obd2.lamb_lsl_fall_lsh_up "Lambda value just after lshpwm signal falls" UWORD _CNV_A_R_LINEAR_____206_CM 1 100. 0. 31.99902344 DISPLAY_IDENTIFIER LAMB_LSL_FALL_LSH_UP_2 ECU_ADDRESS 0x3fcb02 BYTE_ORDER MSB_LAST /end MEASUREMENT
/begin MEASUREMENT lam_bank_2.lsl_up_obd2.lamb_lsh_fall "Variation of lambda value before and after lshpwm signal falls" UWORD _CNV_A_R_LINEAR_____206_CM 1 100. 0. 31.99902344 DISPLAY_IDENTIFIER LAMB_LSH_FALL_2 ECU_ADDRESS 0x3fcb06 BYTE_ORDER MSB_LAST /end MEASUREMENT
/begin MEASUREMENT lam_bank_2.lsl_up_obd2.lamb_lsh_rise "Variation of lambda value before and after lshpwm signal rises" UWORD _CNV_A_R_LINEAR_____206_CM 1 100. 0. 31.99902344 DISPLAY_IDENTIFIER LAMB_LSH_RISE_2 ECU_ADDRESS 0x3fcb04 BYTE_ORDER MSB_LAST /end MEASUREMENT
/begin MEASUREMENT lam_bank_2.lsl_up_obd2.ctr_ls_up_dyn "Number of  carried out single functions" UBYTE _CNV_A_R_LINEAR_____0_CM 1 100. 0. 255. DISPLAY_IDENTIFIER CTR_LS_UP_DYN_2 ECU_ADDRESS 0x3fcb1e FORMAT "%3.0" /end MEASUREMENT
/begin MEASUREMENT lam_bank_2.lsl_up_obd2.lamb_diag_dyn_min "Minimum value of the lambda sensor signal (per sample period)" UWORD _CNV_A_R_LINEAR_____206_CM 1 100. 0. 31.99902344 DISPLAY_IDENTIFIER LAMB_DIAG_DYN_MIN_2 ECU_ADDRESS 0x3fcb08 BYTE_ORDER MSB_LAST /end MEASUREMENT
/begin MEASUREMENT lam_bank_2.lsl_up_obd2.lamb_diag_dyn_max "Maximum value of the lambda sensor signal (per sample period)" UWORD _CNV_A_R_LINEAR_____206_CM 1 100. 0. 31.99902344 DISPLAY_IDENTIFIER LAMB_DIAG_DYN_MAX_2 ECU_ADDRESS 0x3fcb0a BYTE_ORDER MSB_LAST /end MEASUREMENT
/begin MEASUREMENT lam_bank_2.lsl_up_obd2.t_end_diag_vls_up_thd_over "Timer to have a diagnostic available" UWORD _CNV_A_R_LINEAR_____24_CM 1 100. 0. 6553.5 DISPLAY_IDENTIFIER T_END_DIAG_VLS_UP_THD_OVER_2 ECU_ADDRESS 0x3fcb36 BYTE_ORDER MSB_LAST FORMAT "%6.1" /end MEASUREMENT
/begin MEASUREMENT lam_bank_2.lsl_up_obd2.t_end_diag_plaus_ls_up_puc "Timer to have a diagnostic available" UWORD _CNV_A_R_LINEAR_____24_CM 1 100. 0. 6553.5 DISPLAY_IDENTIFIER T_END_DIAG_PLAUS_LS_UP_PUC_2 ECU_ADDRESS 0x3fcb26 BYTE_ORDER MSB_LAST FORMAT "%6.1" /end MEASUREMENT
/begin MEASUREMENT lam_bank_2.lsl_up_obd2.sym_st_ls "Symptom of the false start identification without consideration abnormal lambda reculation behaviour" UBYTE _CNV_S_4_RANGE_SYM__339_CM 1 100. 0. 4. DISPLAY_IDENTIFIER SYM_ST_LS_2 ECU_ADDRESS 0x3fcaf1 /end MEASUREMENT
/begin MEASUREMENT lam_bank_2.lsl_up_obd2.sym_plaus_ls_up_puc "Symptom of the signal plausibility from the signal from the upstream sensor during PUC" UBYTE _CNV_S_3_RANGE_SYM__340_CM 1 100. 0. 2. DISPLAY_IDENTIFIER SYM_PLAUS_LS_UP_PUC_2 ECU_ADDRESS 0x3fcb24 /end MEASUREMENT
/begin MEASUREMENT lam_bank_2.lsl_up_obd2.vls_up_plaus_puc_save "Upstream sensor voltage" UWORD _CNV_A_R_LINEAR_____341_CM 1 100. 0. 4.995 DISPLAY_IDENTIFIER VLS_UP_PLAUS_PUC_SAVE_2 ECU_ADDRESS 0x3fcb28 BYTE_ORDER MSB_LAST FORMAT "%5.3" /end MEASUREMENT
/begin MEASUREMENT lam_bank_2.lsl_up_obd2.lamb_ampl_ls_up_dyn "" UBYTE _CNV_A_R_LINEAR_____342_CM 1 100. 0. 0.124023 DISPLAY_IDENTIFIER LAMB_AMPL_LS_UP_DYN_2 ECU_ADDRESS 0x3fcb1a FORMAT "%5.3" /end MEASUREMENT
/begin MEASUREMENT lam_bank_2.lsl_up_obd2.lamb_ampl_min_ls_up_dyn "" UBYTE _CNV_A_R_LINEAR_____342_CM 1 100. 0. 0.124023 DISPLAY_IDENTIFIER LAMB_AMPL_MIN_LS_UP_DYN_2 ECU_ADDRESS 0x3fcb1b FORMAT "%5.3" /end MEASUREMENT
/begin MEASUREMENT lam_bank_2.lsl_up_obd2.lamb_ampl_max_ls_up_dyn "" UBYTE _CNV_A_R_LINEAR_____342_CM 1 100. 0. 0.124023 DISPLAY_IDENTIFIER LAMB_AMPL_MAX_LS_UP_DYN_2 ECU_ADDRESS 0x3fcb1c FORMAT "%5.3" /end MEASUREMENT
/begin MEASUREMENT lam_bank_2.lsl_up_obd2.lamb_ampl_mv_ls_up_dyn "" UBYTE _CNV_A_R_LINEAR_____342_CM 1 100. 0. 0.124023 DISPLAY_IDENTIFIER LAMB_AMPL_MV_LS_UP_DYN_2 ECU_ADDRESS 0x3fcb1d FORMAT "%5.3" /end MEASUREMENT
/begin MEASUREMENT lam_bank_2.lsl_up_obd2.lamb_ampl_int_ls_up_dyn "" UWORD _CNV_A_R_LINEAR_____206_CM 1 100. 0. 31.99902344 DISPLAY_IDENTIFIER LAMB_AMPL_INT_LS_UP_DYN_2 ECU_ADDRESS 0x3fcb0c BYTE_ORDER MSB_LAST /end MEASUREMENT
/begin MEASUREMENT lam_bank_2.lsl_up_obd2.ctr_ls_up_dyn_min "" UBYTE _CNV_A_R_LINEAR_____0_CM 1 100. 0. 255. DISPLAY_IDENTIFIER CTR_LS_UP_DYN_MIN_2 ECU_ADDRESS 0x3fcb1f FORMAT "%3.0" /end MEASUREMENT
/begin MEASUREMENT lam_bank_2.lsl_up_obd2.ctr_ls_up_dyn_wait "" UBYTE _CNV_A_R_LINEAR_____0_CM 1 100. 0. 255. DISPLAY_IDENTIFIER CTR_LS_UP_DYN_WAIT_2 ECU_ADDRESS 0x3fcb20 FORMAT "%3.0" /end MEASUREMENT
/begin MEASUREMENT lam_bank_2.lsl_up_obd2.cycnr_ls_up_dyn "" UBYTE _CNV_A_R_LINEAR_____0_CM 1 100. 0. 255. DISPLAY_IDENTIFIER CYCNR_LS_UP_DYN_2 ECU_ADDRESS 0x3fcb21 FORMAT "%3.0" /end MEASUREMENT
/begin MEASUREMENT lam_bank_2.lsl_up_obd2.state_dyn_diag "" UBYTE _CNV_A_R_LINEAR_____0_CM 1 100. 0. 3. DISPLAY_IDENTIFIER STATE_DYN_DIAG_2 ECU_ADDRESS 0x3fcb22 FORMAT "%1.0" /end MEASUREMENT
/begin MEASUREMENT lam_bank_2.lsl_up_obd2.fac_value_ls_up_dyn "" UWORD _CNV_A_R_LINEAR_____206_CM 1 100. 0. 31.99902344 DISPLAY_IDENTIFIER FAC_VALUE_LS_UP_DYN_2 ECU_ADDRESS 0x3fcb0e BYTE_ORDER MSB_LAST /end MEASUREMENT
/begin MEASUREMENT lam_bank_2.lsl_up_obd2.fac_mv_ls_up_dyn "" UWORD _CNV_A_R_LINEAR_____206_CM 1 100. 0. 31.99902344 DISPLAY_IDENTIFIER FAC_MV_LS_UP_DYN_2 ECU_ADDRESS 0x3fcb12 BYTE_ORDER MSB_LAST FORMAT "%7.4" /end MEASUREMENT
/begin MEASUREMENT lam_bank_2.lsl_up_obd2.fac_ad_min_ls_up_dyn "" UWORD _CNV_A_R_LINEAR_____206_CM 1 100. 0. 31.99902344 DISPLAY_IDENTIFIER FAC_AD_MIN_LS_UP_DYN_2 ECU_ADDRESS 0x3fcb14 BYTE_ORDER MSB_LAST /end MEASUREMENT
/begin MEASUREMENT lam_bank_2.lsl_up_obd2.fac_ad_max_ls_up_dyn "" UWORD _CNV_A_R_LINEAR_____206_CM 1 100. 0. 31.99902344 DISPLAY_IDENTIFIER FAC_AD_MAX_LS_UP_DYN_2 ECU_ADDRESS 0x3fcb16 BYTE_ORDER MSB_LAST /end MEASUREMENT
/begin MEASUREMENT lam_bank_2.lsl_up_obd2.fac_ls_up_dyn "" UWORD _CNV_A_R_LINEAR_____206_CM 1 100. 0. 31.99902344 DISPLAY_IDENTIFIER FAC_LS_UP_DYN_2 ECU_ADDRESS 0x3fcb18 BYTE_ORDER MSB_LAST /end MEASUREMENT
/begin MEASUREMENT lam_bank_2.lsl_up_obd2.fac_sum_ls_up_dyn "" UWORD _CNV_A_R_LINEAR_____118_CM 1 100. 0. 63.99902344 DISPLAY_IDENTIFIER FAC_SUM_LS_UP_DYN_2 ECU_ADDRESS 0x3fcb10 BYTE_ORDER MSB_LAST FORMAT "%7.4" /end MEASUREMENT
/begin MEASUREMENT lam_bank_2.lsl_up_obd2.sym_lsl_plaus "Symptom of of the heater coupling diagnosis" UBYTE _CNV_S_4_RANGE_SYM__339_CM 1 100. 0. 4. DISPLAY_IDENTIFIER SYM_LSL_PLAUS_2 ECU_ADDRESS 0x3fcaf2 /end MEASUREMENT
/begin MEASUREMENT lam_bank_2.lsl_up_obd2.ctr_diag_sym_lam_out "Counter for the fluctuation of TI_LAM_COR exceeding the min/max thresholds" UBYTE _CNV_A_R_LINEAR_____0_CM 1 100. 0. 255. DISPLAY_IDENTIFIER CTR_DIAG_SYM_LAM_OUT_2 ECU_ADDRESS 0x3fcb2c FORMAT "%3.0" /end MEASUREMENT
/begin MEASUREMENT lam_bank_2.lsl_up_obd2.t_sum_rst_diag_lam_out "Reset Timer  " UWORD _CNV_A_R_LINEAR_____198_CM 1 100. 0. 1310.7 DISPLAY_IDENTIFIER T_SUM_RST_DIAG_LAM_OUT_2 ECU_ADDRESS 0x3fcb2a BYTE_ORDER MSB_LAST FORMAT "%7.2" /end MEASUREMENT
/begin MEASUREMENT lam_bank_2.lam_dly_obd2.t_sum_max_delta_lamb_i "Total duration over C_DELTA_LAMB_I_MAX_DIAG" UWORD _CNV_A_R_LINEAR_____30_CM 1 100. 0. 65535. DISPLAY_IDENTIFIER T_SUM_MAX_DELTA_LAMB_I_2 ECU_ADDRESS 0x3fcb58 BYTE_ORDER MSB_LAST FORMAT "%5.0" /end MEASUREMENT
/begin MEASUREMENT lam_bank_2.lam_dly_obd2.t_sum_min_delta_lamb_i "Total duration over C_DELTA_LAMB_I_MIN_DIAG" UWORD _CNV_A_R_LINEAR_____30_CM 1 100. 0. 65535. DISPLAY_IDENTIFIER T_SUM_MIN_DELTA_LAMB_I_2 ECU_ADDRESS 0x3fcb5a BYTE_ORDER MSB_LAST FORMAT "%5.0" /end MEASUREMENT
/begin MEASUREMENT lam_bank_2.lam_dly_obd2.t_sum_rst_delta_lamb_i "Time counter to reset T_SUM_MIN_LAM_DLY_i and T_SUM_MAX_LAM_DLY_i" UWORD _CNV_A_R_LINEAR_____30_CM 1 100. 0. 65535. DISPLAY_IDENTIFIER T_SUM_RST_DELTA_LAMB_I_2 ECU_ADDRESS 0x3fcb5c BYTE_ORDER MSB_LAST FORMAT "%5.0" /end MEASUREMENT
/begin MEASUREMENT lam_bank_2.lam_dly_obd2.t_end_diag_delta_lamb_i "Time counter to set LV_END_DIAG_DELTA_LAMB_I_i" UWORD _CNV_A_R_LINEAR_____30_CM 1 100. 0. 65535. DISPLAY_IDENTIFIER T_END_DIAG_DELTA_LAMB_I_2 ECU_ADDRESS 0x3fcb56 BYTE_ORDER MSB_LAST FORMAT "%5.0" /end MEASUREMENT
/begin MEASUREMENT lam_bank_2.lam_dly_obd2.delta_lamb_i_save "I-share from trim controller - to be transmitted to the San-Tool mode06" SWORD _CNV_A_R_LINEAR_____285_CM 1 100. -0.125 0.125 DISPLAY_IDENTIFIER DELTA_LAMB_I_SAVE_2 ECU_ADDRESS 0x3fcb68 BYTE_ORDER MSB_LAST FORMAT "%7.4" /end MEASUREMENT
/begin MEASUREMENT lam_bank_2.lam_dly_obd2.sym_vls_dif_dly "Symptoms of the trim control errors" UWORD _CNV_S_6_RANGE_ERR__337_CM 1 100. 0. 15. DISPLAY_IDENTIFIER SYM_VLS_DIF_DLY_2 ECU_ADDRESS 0x3fcb54 BYTE_ORDER MSB_LAST /end MEASUREMENT
/begin MEASUREMENT lam_bank_2.lam_dly_obd2.t_sum_max_vls_dif_dly "Total duration of maximum VLS_DIF_DLY deviation" UWORD _CNV_A_R_LINEAR_____24_CM 1 100. 0. 6553.5 DISPLAY_IDENTIFIER T_SUM_MAX_VLS_DIF_DLY_2 ECU_ADDRESS 0x3fcb5e BYTE_ORDER MSB_LAST FORMAT "%5.1" /end MEASUREMENT
/begin MEASUREMENT lam_bank_2.lam_dly_obd2.t_sum_min_vls_dif_dly "Total duration of minimum VLS_DIF_DLY deviation" UWORD _CNV_A_R_LINEAR_____24_CM 1 100. 0. 6553.5 DISPLAY_IDENTIFIER T_SUM_MIN_VLS_DIF_DLY_2 ECU_ADDRESS 0x3fcb60 BYTE_ORDER MSB_LAST FORMAT "%5.1" /end MEASUREMENT
/begin MEASUREMENT lam_bank_2.lam_dly_obd2.t_end_diag_vls_dif_dly "Time counter to set T_END_DIAG_VLS_DIF_DLY_i" UWORD _CNV_A_R_LINEAR_____24_CM 1 100. 0. 6553.5 DISPLAY_IDENTIFIER T_END_DIAG_VLS_DIF_DLY_2 ECU_ADDRESS 0x3fcb64 BYTE_ORDER MSB_LAST FORMAT "%5.1" /end MEASUREMENT
/begin MEASUREMENT lam_bank_2.lam_dly_obd2.t_sum_rst_vls_dif_dly "Time counter to reset T_SUM_MIN_VLS_DIF_DLY_i and T_SUM_MAX_VLS_DIF_DLY_i" UWORD _CNV_A_R_LINEAR_____24_CM 1 100. 0. 6553.5 DISPLAY_IDENTIFIER T_SUM_RST_VLS_DIF_DLY_2 ECU_ADDRESS 0x3fcb62 BYTE_ORDER MSB_LAST FORMAT "%5.1" /end MEASUREMENT
/begin MEASUREMENT lam_bank_2.lam_dly_obd2.bf.lv_sym_vls_dif_dly "Status diagnostic result of trim monitoring" ULONG _CNV_S_2_RANGE______2_CM 1 100. 0. 1. DISPLAY_IDENTIFIER LV_SYM_VLS_DIF_DLY_2 ECU_ADDRESS 0x3fcb50 BYTE_ORDER MSB_LAST BIT_MASK 0x80000000 /end MEASUREMENT
/begin MEASUREMENT lam_bank_2.lam_dly_obd2.bf.lv_cdn_vls_dif_dly "Condition to activate trim controller deviation diagnosis" ULONG _CNV_S_2_RANGE______2_CM 1 100. 0. 1. DISPLAY_IDENTIFIER LV_CDN_VLS_DIF_DLY_2 ECU_ADDRESS 0x3fcb50 BYTE_ORDER MSB_LAST BIT_MASK 0x40000000 /end MEASUREMENT
/begin MEASUREMENT lam_bank_2.lam_dly_obd2.bf.lv_end_vls_dif_dly "Trim controller deviation diagnostic available" ULONG _CNV_S_2_RANGE______2_CM 1 100. 0. 1. DISPLAY_IDENTIFIER LV_END_VLS_DIF_DLY_2 ECU_ADDRESS 0x3fcb50 BYTE_ORDER MSB_LAST BIT_MASK 0x20000000 /end MEASUREMENT
/begin MEASUREMENT lam_bank_2.lam_dly_obd2.bf.lv_ldc_vls_dif_dly "Status limited dynamic for the function \"Monitoring Trim Controller Deviation\"" ULONG _CNV_S_2_RANGE______2_CM 1 100. 0. 1. DISPLAY_IDENTIFIER LV_LDC_VLS_DIF_DLY_2 ECU_ADDRESS 0x3fcb50 BYTE_ORDER MSB_LAST BIT_MASK 0x10000000 /end MEASUREMENT
/begin MEASUREMENT lam_bank_2.lam_dly_obd2.bf.lv_lam_mv_ldc_vls_dif_dly "Status limited dynamic LAM_MV_i" ULONG _CNV_S_2_RANGE______2_CM 1 100. 0. 1. DISPLAY_IDENTIFIER LV_LAM_MV_LDC_VLS_DIF_DLY_2 ECU_ADDRESS 0x3fcb50 BYTE_ORDER MSB_LAST BIT_MASK 0x8000000 /end MEASUREMENT
/begin MEASUREMENT lam_bank_2.lam_dly_obd2.maf_int_ldc_vls_dif_dly "integral of mass air flow since limited dynamic conditions fulfilled" UWORD _CNV_A_R_LINEAR_____273_CM 1 100. 0. 1820.4167 DISPLAY_IDENTIFIER MAF_INT_LDC_VLS_DIF_DLY_2 ECU_ADDRESS 0x3fcb66 BYTE_ORDER MSB_LAST FORMAT "%9.4" /end MEASUREMENT
/begin MEASUREMENT lam_bank_2.lam_dly_obd2.lam_mmv_ldc_vls_dif_dly "floating mean value for limited lambda deviation" SWORD _CNV_A_R_LINEAR_____111_CM 1 100. -50. 49.99847412 DISPLAY_IDENTIFIER LAM_MMV_LDC_VLS_DIF_DLY_2 ECU_ADDRESS 0x3fcb6a BYTE_ORDER MSB_LAST FORMAT "%7.3" /end MEASUREMENT
/begin MEASUREMENT lv_err_chg_ls_down "Debounced error: downstream sensor of bank 1 and 2 interchanged" UBYTE _CNV_S_2_RANGE______1_R_CM 1 100. 0. 255. DISPLAY_IDENTIFIER LV_ERR_CHG_LS_DOWN ECU_ADDRESS 0x3fbb10 /end MEASUREMENT
/begin CHARACTERISTIC c_t_end_diag_chg_ls_up "Max. time to set LV_END_... = 1" VALUE 0xffe4194e _REC_VAL_20_u2 6553.5 _CNV_A_R_LINEAR_____24_CM 0. 6553.5 DISPLAY_IDENTIFIER C_T_END_DIAG_CHG_LS_UP FORMAT "%6.1" /end CHARACTERISTIC
/begin CHARACTERISTIC c_t_end_diag_chg_ls_down "Max. time to set LV_END_... = 1" VALUE 0xffe4194c _REC_VAL_20_u2 65535. _CNV_A_R_LINEAR_____30_CM 0. 65535. DISPLAY_IDENTIFIER C_T_END_DIAG_CHG_LS_DOWN FORMAT "%5.0" /end CHARACTERISTIC
/begin CHARACTERISTIC c_maf_int_diag_chg_ls_up "Max. MAF integral value when ERR_SYM_... ne \"NO_SYM\"" VALUE 0xffe41750 _REC_VAL_20_u2 1820.398 _CNV_A_R_LINEAR_____287_CM 0. 1820.398 DISPLAY_IDENTIFIER C_MAF_INT_DIAG_CHG_LS_UP FORMAT "%7.2" /end CHARACTERISTIC
/begin MEASUREMENT lv_err_chg_ls_up "Debounced error: upstream sensor of bank 1 and 2 interchanged" UBYTE _CNV_S_2_RANGE______1_R_CM 1 100. 0. 255. DISPLAY_IDENTIFIER LV_ERR_CHG_LS_UP ECU_ADDRESS 0x3fbb0c /end MEASUREMENT
/begin MEASUREMENT t_end_diag_chg_ls_up "Timer to set LV_END_...= 1" UWORD _CNV_A_R_LINEAR_____24_CM 1 100. 0. 6553.5 DISPLAY_IDENTIFIER T_END_DIAG_CHG_LS_UP ECU_ADDRESS 0x3fdc2e BYTE_ORDER MSB_LAST FORMAT "%6.1" /end MEASUREMENT
/begin MEASUREMENT t_end_diag_chg_ls_down "Timer to set LV_END_...= 1" UWORD _CNV_A_R_LINEAR_____30_CM 1 100. 0. 65535. DISPLAY_IDENTIFIER T_END_DIAG_CHG_LS_DOWN ECU_ADDRESS 0x3fdc30 BYTE_ORDER MSB_LAST FORMAT "%5.0" /end MEASUREMENT
/begin MEASUREMENT maf_int_diag_chg_ls_up "MAF integral value when ERR_SYM_...ne \"NO_SYM\"" UWORD _CNV_A_R_LINEAR_____287_CM 1 100. 0. 1820.398 DISPLAY_IDENTIFIER MAF_INT_DIAG_CHG_LS_UP ECU_ADDRESS 0x3fdc2c BYTE_ORDER MSB_LAST FORMAT "%7.2" /end MEASUREMENT
/begin CHARACTERISTIC c_max_ti_lam_cor_chg_ls_up "Max. Threshold to detect a interchanged sensor" VALUE 0xffe40454 _REC_VAL_20_s2 99.99847412 _CNV_A_R_LINEAR_____111_CM -50. 49.99847412 DISPLAY_IDENTIFIER C_MAX_TI_LAM_COR_CHG_LS_UP FORMAT "%7.3" /end CHARACTERISTIC
/begin CHARACTERISTIC c_min_ti_lam_cor_chg_ls_up "Min. Threshold to detect a interchanged sensor" VALUE 0xffe40464 _REC_VAL_20_s2 99.99847412 _CNV_A_R_LINEAR_____111_CM -50. 49.99847412 DISPLAY_IDENTIFIER C_MIN_TI_LAM_COR_CHG_LS_UP FORMAT "%7.3" /end CHARACTERISTIC
/begin MEASUREMENT lv_inh_diag_chg_ls_up "Inhibit diagnosis interchaged upstream sensors" UBYTE _CNV_S_2_RANGE______2_CM 1 100. 0. 1. DISPLAY_IDENTIFIER LV_INH_DIAG_CHG_LS_UP ECU_ADDRESS 0x3fea7b /end MEASUREMENT
/begin MEASUREMENT lv_inh_diag_chg_ls_down "Inhibit diagnosis interchaged downstream sensors" UBYTE _CNV_S_2_RANGE______2_CM 1 100. 0. 1. DISPLAY_IDENTIFIER LV_INH_DIAG_CHG_LS_DOWN ECU_ADDRESS 0x3fea7c /end MEASUREMENT
/begin MEASUREMENT lv_err_ls_up_2 "final diagnostic of the upstream oxygen sensor" UBYTE _CNV_S_2_RANGE______1_R_CM 1 100. 0. 255. DISPLAY_IDENTIFIER LV_ERR_LS_UP_2 ECU_ADDRESS 0x3fe4d6 /end MEASUREMENT
/begin MEASUREMENT lv_err_ls_down_1 "final diagnostic of the downstream oxygen sensor" UBYTE _CNV_S_2_RANGE______1_R_CM 1 100. 0. 255. DISPLAY_IDENTIFIER LV_ERR_LS_DOWN_1 ECU_ADDRESS 0x3fe4d4 /end MEASUREMENT
/begin MEASUREMENT lv_err_ls_up_1 "final diagnostic of the upstream oxygen sensor" UBYTE _CNV_S_2_RANGE______1_R_CM 1 100. 0. 255. DISPLAY_IDENTIFIER LV_ERR_LS_UP_1 ECU_ADDRESS 0x3fe4d3 /end MEASUREMENT
/begin MEASUREMENT lv_err_ls_down_2 "final diagnostic of the downstream oxygen sensor" UBYTE _CNV_S_2_RANGE______1_R_CM 1 100. 0. 255. DISPLAY_IDENTIFIER LV_ERR_LS_DOWN_2 ECU_ADDRESS 0x3fe4d7 /end MEASUREMENT
/begin MEASUREMENT lv_beg_act_test_1 "boolean flag to indication the Diag.Manager must go directly to the Active Test status" UBYTE _CNV_S_2_RANGE______1_R_CM 1 100. 0. 255. DISPLAY_IDENTIFIER LV_BEG_ACT_TEST_1 ECU_ADDRESS 0x3fe4d5 /end MEASUREMENT
/begin MEASUREMENT lv_beg_act_test_2 "boolean flag to indication the Diag.Manager must go directly to the Active Test status" UBYTE _CNV_S_2_RANGE______1_R_CM 1 100. 0. 255. DISPLAY_IDENTIFIER LV_BEG_ACT_TEST_2 ECU_ADDRESS 0x3fe4d8 /end MEASUREMENT
/begin CHARACTERISTIC c_max_t_diag_ls_up_down "passive test diagnostic waiting time - maximum value" VALUE 0xffe417d4 _REC_VAL_20_u2 6553.5 _CNV_A_R_LINEAR_____24_CM 0. 6553.5 DISPLAY_IDENTIFIER C_MAX_T_DIAG_LS_UP_DOWN FORMAT "%6.1" /end CHARACTERISTIC
/begin CHARACTERISTIC lc_prj_auth_act_test "authorization begin active plausibility test" VALUE 0xffe40fc9 _REC_VAL_20_u1 1. _CNV_A_R_LINEAR_____0_CM 0. 1. DISPLAY_IDENTIFIER LC_PRJ_AUTH_ACT_TEST FORMAT "%2.0" /end CHARACTERISTIC
/begin CHARACTERISTIC lc_prj_resu_act_test "authorization continue active plausibility test" VALUE 0xffe40fca _REC_VAL_20_u1 1. _CNV_A_R_LINEAR_____0_CM 0. 1. DISPLAY_IDENTIFIER LC_PRJ_RESU_ACT_TEST FORMAT "%2.0" /end CHARACTERISTIC
/begin MEASUREMENT lv_err_ls_up_puc_vld_1 "Boolean flag indicating the validation of correspondent symptom" UBYTE _CNV_S_2_RANGE______1_R_CM 1 100. 0. 255. DISPLAY_IDENTIFIER LV_ERR_LS_UP_PUC_VLD_1 ECU_ADDRESS 0x3fbbc0 /end MEASUREMENT
/begin MEASUREMENT lv_err_ls_up_puc_vld_2 "Boolean flag indicating the validation of correspondent symptom" UBYTE _CNV_S_2_RANGE______1_R_CM 1 100. 0. 255. DISPLAY_IDENTIFIER LV_ERR_LS_UP_PUC_VLD_2 ECU_ADDRESS 0x3fbbc4 /end MEASUREMENT
/begin MEASUREMENT lv_err_ls_up_dyn_vld_1 "Boolean flag indicating the validation of correspondent symptom" UBYTE _CNV_S_2_RANGE______1_R_CM 1 100. 0. 255. DISPLAY_IDENTIFIER LV_ERR_LS_UP_DYN_VLD_1 ECU_ADDRESS 0x3fbbb8 /end MEASUREMENT
/begin MEASUREMENT lv_err_ls_up_dyn_vld_2 "Boolean flag indicating the validation of correspondent symptom" UBYTE _CNV_S_2_RANGE______1_R_CM 1 100. 0. 255. DISPLAY_IDENTIFIER LV_ERR_LS_UP_DYN_VLD_2 ECU_ADDRESS 0x3fbbbc /end MEASUREMENT
/begin MEASUREMENT lv_err_lsh_up_obd2_vld_1 "Boolean flag indicating the validation of correspondent symptom" UBYTE _CNV_S_2_RANGE______1_R_CM 1 100. 0. 255. DISPLAY_IDENTIFIER LV_ERR_LSH_UP_OBD2_VLD_1 ECU_ADDRESS 0x3fbbc8 /end MEASUREMENT
/begin MEASUREMENT lv_err_lsh_up_obd2_vld_2 "Boolean flag indicating the validation of correspondent symptom" UBYTE _CNV_S_2_RANGE______1_R_CM 1 100. 0. 255. DISPLAY_IDENTIFIER LV_ERR_LSH_UP_OBD2_VLD_2 ECU_ADDRESS 0x3fbbcc /end MEASUREMENT
/begin MEASUREMENT lv_err_ls_up_shift_afl_2 "WRAF Sensor characteristic line shift to lean ERROR detected" UBYTE _CNV_S_2_RANGE______21_CM 1 100. 0. 1. DISPLAY_IDENTIFIER LV_ERR_LS_UP_SHIFT_AFL_2 ECU_ADDRESS 0x3fbb34 BIT_MASK 0x1 /end MEASUREMENT
/begin MEASUREMENT lv_err_ls_up_shift_afl_1 "WRAF Sensor characteristic line shift to lean ERROR detected" UBYTE _CNV_S_2_RANGE______21_CM 1 100. 0. 1. DISPLAY_IDENTIFIER LV_ERR_LS_UP_SHIFT_AFL_1 ECU_ADDRESS 0x3fbb30 BIT_MASK 0x1 /end MEASUREMENT
/begin MEASUREMENT lv_err_ls_up_shift_afr_2 "WRAF Sensor characteristic line shift to rich ERROR detected" UBYTE _CNV_S_2_RANGE______21_CM 1 100. 0. 1. DISPLAY_IDENTIFIER LV_ERR_LS_UP_SHIFT_AFR_2 ECU_ADDRESS 0x3fbb3c BIT_MASK 0x1 /end MEASUREMENT
/begin MEASUREMENT lv_err_ls_up_shift_afr_1 "WRAF Sensor characteristic line shift to rich ERROR detected" UBYTE _CNV_S_2_RANGE______21_CM 1 100. 0. 1. DISPLAY_IDENTIFIER LV_ERR_LS_UP_SHIFT_AFR_1 ECU_ADDRESS 0x3fbb38 BIT_MASK 0x1 /end MEASUREMENT
/begin CHARACTERISTIC lc_err_ls_up_dyn_1 "Authorization to consider a dynamicaly slow sensor as an Sensor Error" VALUE 0xffe40f63 _REC_VAL_20_u1 1. _CNV_A_R_LINEAR_____22_CM 0. 1. DISPLAY_IDENTIFIER LC_ERR_LS_UP_DYN_1 FORMAT "%1.0" /end CHARACTERISTIC
/begin CHARACTERISTIC lc_err_ls_up_dyn_2 "Authorization to consider a dynamicaly slow sensor as an Sensor Error" VALUE 0xffe40f64 _REC_VAL_20_u1 1. _CNV_A_R_LINEAR_____22_CM 0. 1. DISPLAY_IDENTIFIER LC_ERR_LS_UP_DYN_2 FORMAT "%1.0" /end CHARACTERISTIC
/begin MEASUREMENT lv_inh_load_tps_plaus "boolean flag to stop the load/TPS rationality check" UBYTE _CNV_S_2_RANGE______2_CM 1 100. 0. 1. DISPLAY_IDENTIFIER LV_INH_LOAD_TPS_PLAUS ECU_ADDRESS 0x3fe499 BIT_MASK 0x1 /end MEASUREMENT
/begin MEASUREMENT lv_err_mec_isa "Error present idle speed actuator is jammed mechanical" UBYTE _CNV_S_2_RANGE______2_CM 1 100. 0. 1. DISPLAY_IDENTIFIER LV_ERR_MEC_ISA ECU_ADDRESS 0x3fe49a BIT_MASK 0x1 /end MEASUREMENT
/begin MEASUREMENT int_nox_nox_sens_2 "total integral of downstream sensor signal for computation of mean value" UWORD _CNV_A_R_LINEAR_____104_CM 1 100. 0. 65535. DISPLAY_IDENTIFIER INT_NOX_NOX_SENS_2 ECU_ADDRESS 0x3fdb96 BYTE_ORDER MSB_LAST FORMAT "%5.0" /end MEASUREMENT
/begin MEASUREMENT sum_cat_diag_nox_1 "Diagnosis monitoring cycle counter" UWORD _CNV_A_R_LINEAR_____22_CM 1 100. 0. 511. DISPLAY_IDENTIFIER SUM_CAT_DIAG_NOX_1 ECU_ADDRESS 0x3fdb86 BYTE_ORDER MSB_LAST FORMAT "%4.0" /end MEASUREMENT
/begin MEASUREMENT sum_cat_diag_nox_2 "Diagnosis monitoring cycle counter" UWORD _CNV_A_R_LINEAR_____22_CM 1 100. 0. 511. DISPLAY_IDENTIFIER SUM_CAT_DIAG_NOX_2 ECU_ADDRESS 0x3fdb98 BYTE_ORDER MSB_LAST FORMAT "%4.0" /end MEASUREMENT
/begin MEASUREMENT cat_diag_clc_nox_1 "value for catalyst conversion capability" UWORD _CNV_A_R_LINEAR_____434_CM 1 100. 0. 1310.7 DISPLAY_IDENTIFIER CAT_DIAG_CLC_NOX_1 ECU_ADDRESS 0x3fdb88 BYTE_ORDER MSB_LAST FORMAT "%7.2" /end MEASUREMENT
/begin MEASUREMENT cat_diag_clc_nox_2 "value for catalyst conversion capability" UWORD _CNV_A_R_LINEAR_____434_CM 1 100. 0. 1310.7 DISPLAY_IDENTIFIER CAT_DIAG_CLC_NOX_2 ECU_ADDRESS 0x3fdb9a BYTE_ORDER MSB_LAST FORMAT "%7.2" /end MEASUREMENT
/begin MEASUREMENT cat_diag_nox_1 "value for catalyst conversion capability" UWORD _CNV_A_R_LINEAR_____434_CM 1 100. 0. 1310.7 DISPLAY_IDENTIFIER CAT_DIAG_NOX_1 ECU_ADDRESS 0x3fdb80 BYTE_ORDER MSB_LAST FORMAT "%7.2" /end MEASUREMENT
/begin MEASUREMENT cat_diag_nox_2 "value for catalyst conversion capability" UWORD _CNV_A_R_LINEAR_____434_CM 1 100. 0. 1310.7 DISPLAY_IDENTIFIER CAT_DIAG_NOX_2 ECU_ADDRESS 0x3fdb82 BYTE_ORDER MSB_LAST FORMAT "%7.2" /end MEASUREMENT
/begin MEASUREMENT int_nox_nox_sens_sum_1 "Summed up INT_NOX_NOX_SENS_i for all monitoring cycles" UWORD _CNV_A_R_LINEAR_____435_CM 1 100. 0. 83884.8 DISPLAY_IDENTIFIER INT_NOX_NOX_SENS_SUM_1 ECU_ADDRESS 0x3fdb8a BYTE_ORDER MSB_LAST FORMAT "%5.0" /end MEASUREMENT
/begin MEASUREMENT int_nox_nox_sens_sum_2 "Summed up INT_NOX_NOX_SENS_i for all monitoring cycles" UWORD _CNV_A_R_LINEAR_____435_CM 1 100. 0. 83884.8 DISPLAY_IDENTIFIER INT_NOX_NOX_SENS_SUM_2 ECU_ADDRESS 0x3fdb9c BYTE_ORDER MSB_LAST FORMAT "%5.0" /end MEASUREMENT
/begin MEASUREMENT int_o2_ld_cat_1 "O2 surplus during lean part of lambda oscillation" UWORD _CNV_A_R_LINEAR_____436_CM 1 100. 0. 1194.375 DISPLAY_IDENTIFIER INT_O2_LD_CAT_1 ECU_ADDRESS 0x3fdb90 BYTE_ORDER MSB_LAST FORMAT "%7.2" /end MEASUREMENT
/begin MEASUREMENT int_o2_ld_cat_2 "O2 surplus during lean part of lambda oscillation" UWORD _CNV_A_R_LINEAR_____436_CM 1 100. 0. 1194.375 DISPLAY_IDENTIFIER INT_O2_LD_CAT_2 ECU_ADDRESS 0x3fdba2 BYTE_ORDER MSB_LAST FORMAT "%7.2" /end MEASUREMENT
/begin MEASUREMENT state_cat_diag_nox_1 "States of diagnosis" ULONG _CNV_S_5_RANGE_STAT_437_CM 1 100. 0. 4. DISPLAY_IDENTIFIER STATE_CAT_DIAG_NOX_1 ECU_ADDRESS 0x3fea0c BYTE_ORDER MSB_LAST /end MEASUREMENT
/begin MEASUREMENT state_cat_diag_nox_2 "States of diagnosis" ULONG _CNV_S_5_RANGE_STAT_437_CM 1 100. 0. 4. DISPLAY_IDENTIFIER STATE_CAT_DIAG_NOX_2 ECU_ADDRESS 0x3fea10 BYTE_ORDER MSB_LAST /end MEASUREMENT
/begin MEASUREMENT lv_req_cat_diag_nox_1 "Flag passed to the OBD sequencer indicating a request to do catalyst diagnosis" UBYTE _CNV_S_2_RANGE______2_CM 1 100. 0. 1. DISPLAY_IDENTIFIER LV_REQ_CAT_DIAG_NOX_1 ECU_ADDRESS 0x3fea08 BIT_MASK 0x1 /end MEASUREMENT
/begin MEASUREMENT lv_req_cat_diag_nox_2 "Flag passed to the OBD sequencer indicating a request to do catalyst diagnosis" UBYTE _CNV_S_2_RANGE______2_CM 1 100. 0. 1. DISPLAY_IDENTIFIER LV_REQ_CAT_DIAG_NOX_2 ECU_ADDRESS 0x3fea09 BIT_MASK 0x1 /end MEASUREMENT
/begin MEASUREMENT int_nox_nox_sens_mv_1 "Nox sensor signal mean value for complete lambda perion" UWORD _CNV_A_R_LINEAR_____434_CM 1 100. 0. 1310.7 DISPLAY_IDENTIFIER INT_NOX_NOX_SENS_MV_1 ECU_ADDRESS 0x3fdb8c BYTE_ORDER MSB_LAST FORMAT "%7.2" /end MEASUREMENT
/begin MEASUREMENT int_nox_nox_sens_mv_2 "Nox sensor signal mean value for complete lambda perion" UWORD _CNV_A_R_LINEAR_____434_CM 1 100. 0. 1310.7 DISPLAY_IDENTIFIER INT_NOX_NOX_SENS_MV_2 ECU_ADDRESS 0x3fdb9e BYTE_ORDER MSB_LAST FORMAT "%7.2" /end MEASUREMENT
/begin MEASUREMENT int_nox_nox_sens_cor_1 "Corrected Nox sensor signal mean value for complete lambda perion" UWORD _CNV_A_R_LINEAR_____434_CM 1 100. 0. 1310.7 DISPLAY_IDENTIFIER INT_NOX_NOX_SENS_COR_1 ECU_ADDRESS 0x3fdb8e BYTE_ORDER MSB_LAST FORMAT "%7.2" /end MEASUREMENT
/begin MEASUREMENT int_nox_nox_sens_cor_2 "Corrected Nox sensor signal mean value for complete lambda perion" UWORD _CNV_A_R_LINEAR_____434_CM 1 100. 0. 1310.7 DISPLAY_IDENTIFIER INT_NOX_NOX_SENS_COR_2 ECU_ADDRESS 0x3fdba0 BYTE_ORDER MSB_LAST FORMAT "%7.2" /end MEASUREMENT
/begin CHARACTERISTIC c_sum_min_cat_diag_nox "min. threshold of required monitoring cycles for catalyst diagnosis " VALUE 0xffe418b8 _REC_VAL_20_u2 511. _CNV_A_R_LINEAR_____22_CM 0. 511. DISPLAY_IDENTIFIER C_SUM_MIN_CAT_DIAG_NOX FORMAT "%4.0" /end CHARACTERISTIC
/begin CHARACTERISTIC c_cat_diag_nox_max_thd "max. threshold of CAT_DIAG_NOX_i to detect a catalyst with malfunction" VALUE 0xffe41510 _REC_VAL_20_u2 1310.7 _CNV_A_R_LINEAR_____434_CM 0. 1310.7 DISPLAY_IDENTIFIER C_CAT_DIAG_NOX_MAX_THD FORMAT "%7.2" /end CHARACTERISTIC
/begin CHARACTERISTIC c_n_32_cat_diag_nox_deac_thd "Engine speed threshold to deactivate catalyst diagnosis to save ECU performance" VALUE 0xffe407c0 _REC_VAL_20_u1 8160. _CNV_A_R_LINEAR_____15_CM 0. 8160. DISPLAY_IDENTIFIER C_N_32_CAT_DIAG_NOX_DEAC_THD FORMAT "%4.0" /end CHARACTERISTIC
/begin CHARACTERISTIC c_vls_nox_sens_max_thd "Maximum threshold for binary O2 sensor signal of NOx-sensor to terminate monitoring cycle" VALUE 0xffe41b90 _REC_VAL_20_u2 1400. _CNV_A_R_LINEAR_____105_CM -200. 1200. DISPLAY_IDENTIFIER C_VLS_NOX_SENS_MAX_THD FORMAT "%4.0" /end CHARACTERISTIC
/begin CHARACTERISTIC c_vls_nox_sens_min_thd "Minimum threshold for binary O2 sensor signal of NOx-sensor to terminate monitoring cycle" VALUE 0xffe41b92 _REC_VAL_20_u2 1400. _CNV_A_R_LINEAR_____105_CM -200. 1200. DISPLAY_IDENTIFIER C_VLS_NOX_SENS_MIN_THD FORMAT "%4.0" /end CHARACTERISTIC
/begin CHARACTERISTIC lc_nox_sens_vld_off "Flag to switch off NOx-sensor validity check" VALUE 0xffe40fbd _REC_VAL_20_u1 1. _CNV_A_R_LINEAR_____22_CM 0. 1. DISPLAY_IDENTIFIER LC_NOX_SENS_VLD_OFF FORMAT "%1.0" /end CHARACTERISTIC
/begin CHARACTERISTIC ip_int_nox_nox_sens_cor_mt "Weighting factor for Nox concentration integral value (manual transmission)" MAP 0xffe4bc2a _REC_MAP_20_u2_u1_u1 16.38375 _CNV_A_R_LINEAR_____438_CM 0. 327.675 DISPLAY_IDENTIFIER IP_INT_NOX_NOX_SENS_COR_MT FORMAT "%7.3"
 /begin AXIS_DESCR COM_AXIS n_32 _CNV_A_R_LINEAR_____15_CM 6 0. 8160. FORMAT "%4.0" AXIS_PTS_REF ldpm_n_32_1_egtr /end AXIS_DESCR
 /begin AXIS_DESCR COM_AXIS maf _CNV_A_R_LINEAR_____27_CM 6 0. 1389. FORMAT "%4.0" AXIS_PTS_REF ldpm_maf_1_egtr /end AXIS_DESCR
/end CHARACTERISTIC
/begin CHARACTERISTIC ip_int_nox_nox_sens_cor_at "Weighting factor for Nox concentration integral value (automatic transmission)" MAP 0xffe4bbe2 _REC_MAP_20_u2_u1_u1 16.38375 _CNV_A_R_LINEAR_____438_CM 0. 327.675 DISPLAY_IDENTIFIER IP_INT_NOX_NOX_SENS_COR_AT FORMAT "%7.3"
 /begin AXIS_DESCR COM_AXIS n_32 _CNV_A_R_LINEAR_____15_CM 6 0. 8160. FORMAT "%4.0" AXIS_PTS_REF ldpm_n_32_1_egtr /end AXIS_DESCR
 /begin AXIS_DESCR COM_AXIS maf _CNV_A_R_LINEAR_____27_CM 6 0. 1389. FORMAT "%4.0" AXIS_PTS_REF ldpm_maf_1_egtr /end AXIS_DESCR
/end CHARACTERISTIC
/begin MEASUREMENT int_nox_nox_sens_1 "total integral of downstream sensor signal for computation of mean value" UWORD _CNV_A_R_LINEAR_____104_CM 1 100. 0. 65535. DISPLAY_IDENTIFIER INT_NOX_NOX_SENS_1 ECU_ADDRESS 0x3fdb84 BYTE_ORDER MSB_LAST FORMAT "%5.0" /end MEASUREMENT
/begin MEASUREMENT ctr_vls_nox_sens_afl_1 "Counter for binary signal of NOx-Sensor in lean range" UWORD _CNV_A_R_LINEAR_____0_CM 1 100. 0. 65535. DISPLAY_IDENTIFIER CTR_VLS_NOX_SENS_AFL_1 ECU_ADDRESS 0x3fdb92 BYTE_ORDER MSB_LAST FORMAT "%5.0" /end MEASUREMENT
/begin MEASUREMENT ctr_vls_nox_sens_afl_2 "Counter for binary signal of NOx-Sensor in lean range" UWORD _CNV_A_R_LINEAR_____0_CM 1 100. 0. 65535. DISPLAY_IDENTIFIER CTR_VLS_NOX_SENS_AFL_2 ECU_ADDRESS 0x3fdba4 BYTE_ORDER MSB_LAST FORMAT "%5.0" /end MEASUREMENT
/begin CHARACTERISTIC c_vls_nox_sens_afl_thd "threshold for binary O2 sensor signal of NOx-sensor to detect lean exhaust gas" VALUE 0xffe41b8c _REC_VAL_20_u2 1400. _CNV_A_R_LINEAR_____105_CM -200. 1200. DISPLAY_IDENTIFIER C_VLS_NOX_SENS_AFL_THD FORMAT "%4.0" /end CHARACTERISTIC
/begin CHARACTERISTIC c_ctr_vls_nox_sens_afl_thd "Threshold for minimum duration of NOX_NOX_SENS_i integration to obtain valid monitoring cycle" VALUE 0xffe41590 _REC_VAL_20_u2 65535. _CNV_A_R_LINEAR_____0_CM 0. 65535. DISPLAY_IDENTIFIER C_CTR_VLS_NOX_SENS_AFL_THD FORMAT "%5.0" /end CHARACTERISTIC
/begin MEASUREMENT ctr_cat_diag_nox_afr_afl_1 "counter of rich->lean changes after trim control and forcaed stimulation param changed" UBYTE _CNV_A_R_LINEAR_____0_CM 1 100. 0. 255. DISPLAY_IDENTIFIER CTR_CAT_DIAG_NOX_AFR_AFL_1 ECU_ADDRESS 0x3fea14 FORMAT "%3.0" /end MEASUREMENT
/begin MEASUREMENT ctr_cat_diag_nox_afr_afl_2 "counter of rich->lean changes after trim control and forcaed stimulation param changed" UBYTE _CNV_A_R_LINEAR_____0_CM 1 100. 0. 255. DISPLAY_IDENTIFIER CTR_CAT_DIAG_NOX_AFR_AFL_2 ECU_ADDRESS 0x3fea15 FORMAT "%3.0" /end MEASUREMENT
/begin MEASUREMENT vls_nox_sens_mmv_1 "low pass filter of binary O2 signal measured by NOX sensor" UWORD _CNV_A_R_LINEAR_____105_CM 1 100. -200. 1200. DISPLAY_IDENTIFIER VLS_NOX_SENS_MMV_1 ECU_ADDRESS 0x3fdb94 BYTE_ORDER MSB_LAST FORMAT "%4.0" /end MEASUREMENT
/begin MEASUREMENT vls_nox_sens_mmv_2 "low pass filter of binary O2 signal measured by NOX sensor" UWORD _CNV_A_R_LINEAR_____105_CM 1 100. -200. 1200. DISPLAY_IDENTIFIER VLS_NOX_SENS_MMV_2 ECU_ADDRESS 0x3fdba6 BYTE_ORDER MSB_LAST FORMAT "%4.0" /end MEASUREMENT
/begin CHARACTERISTIC c_crlc_vls_nox_sens "low pass filter parameter" VALUE 0xffe4069f _REC_VAL_20_u1 255. _CNV_A_R_LINEAR_____0_CM 0. 255. DISPLAY_IDENTIFIER C_CRLC_VLS_NOX_SENS FORMAT "%3.0" /end CHARACTERISTIC
/begin MEASUREMENT lv_inh_diag_cat_diag_nox_1 "Flag to inhibit NOx-sensor based catalyst diagnosis function if there is a component failure" UBYTE _CNV_S_2_RANGE______2_CM 1 100. 0. 1. DISPLAY_IDENTIFIER LV_INH_DIAG_CAT_DIAG_NOX_1 ECU_ADDRESS 0x3fea18 BIT_MASK 0x1 /end MEASUREMENT
/begin MEASUREMENT lv_inh_diag_cat_diag_nox_2 "Flag to inhibit NOx-sensor based catalyst diagnosis function if there is a component failure" UBYTE _CNV_S_2_RANGE______2_CM 1 100. 0. 1. DISPLAY_IDENTIFIER LV_INH_DIAG_CAT_DIAG_NOX_2 ECU_ADDRESS 0x3fea1a BIT_MASK 0x1 /end MEASUREMENT
/begin MEASUREMENT lv_auth_cat_diag_nox_1 "Nox-sensor based cat, diag. is authorized" UBYTE _CNV_S_2_RANGE______2_CM 1 100. 0. 1. DISPLAY_IDENTIFIER LV_AUTH_CAT_DIAG_NOX_1 ECU_ADDRESS 0x3fea19 BIT_MASK 0x1 /end MEASUREMENT
/begin MEASUREMENT lv_auth_cat_diag_nox_2 "Nox-sensor based cat, diag. is authorized" UBYTE _CNV_S_2_RANGE______2_CM 1 100. 0. 1. DISPLAY_IDENTIFIER LV_AUTH_CAT_DIAG_NOX_2 ECU_ADDRESS 0x3fea1b BIT_MASK 0x1 /end MEASUREMENT
/begin AXIS_PTS ldpm_n_32_1_egtr "" 0xffe41389 n_32 _REC_AXS_20_u1 8160. _CNV_A_R_LINEAR_____15_CM 6 0. 8160. DISPLAY_IDENTIFIER LDPM_N_32_1_EGTR FORMAT "%4.0" /end AXIS_PTS
/begin AXIS_PTS ldpm_maf_1_egtr "" 0xffe41364 maf _REC_AXS_20_u1 1389. _CNV_A_R_LINEAR_____27_CM 6 0. 1389. DISPLAY_IDENTIFIER LDPM_MAF_1_EGTR FORMAT "%4.0" /end AXIS_PTS
/begin CHARACTERISTIC c_delta_lamb_i_max_diag "Maximum limit of DELTA_LAMB_i" VALUE 0xffe403f2 _REC_VAL_20_s2 0.25 _CNV_A_R_LINEAR_____285_CM -0.125 0.125 DISPLAY_IDENTIFIER C_DELTA_LAMB_I_MAX_DIAG FORMAT "%7.4" /end CHARACTERISTIC
/begin CHARACTERISTIC c_delta_lamb_i_min_diag "Minimum limit of DELTA_LAMB_i" VALUE 0xffe403f6 _REC_VAL_20_s2 0.25 _CNV_A_R_LINEAR_____285_CM -0.125 0.125 DISPLAY_IDENTIFIER C_DELTA_LAMB_I_MIN_DIAG FORMAT "%7.4" /end CHARACTERISTIC
/begin CHARACTERISTIC c_t_sum_vls_dif_dly "Maximum time of VLS_DIF_DLY deviation" VALUE 0xffe41a04 _REC_VAL_20_u2 6553.5 _CNV_A_R_LINEAR_____24_CM 0. 6553.5 DISPLAY_IDENTIFIER C_T_SUM_VLS_DIF_DLY FORMAT "%5.1" /end CHARACTERISTIC
/begin CHARACTERISTIC c_max_vls_dif_dly "Maximum threshold for VLS_DIF_DLY deviation" VALUE 0xffe40456 _REC_VAL_20_s2 9.99023438 _CNV_A_R_LINEAR_____3_CM -4.99511719 4.99511719 DISPLAY_IDENTIFIER C_MAX_VLS_DIF_DLY FORMAT "%5.2" /end CHARACTERISTIC
/begin CHARACTERISTIC c_min_vls_dif_dly "Minimum threshold for VLS_DIF_DLY deviation" VALUE 0xffe40466 _REC_VAL_20_s2 9.99023438 _CNV_A_R_LINEAR_____3_CM -4.99511719 4.99511719 DISPLAY_IDENTIFIER C_MIN_VLS_DIF_DLY FORMAT "%5.2" /end CHARACTERISTIC
/begin CHARACTERISTIC c_t_end_diag_vls_dif_dly "Time counter to set T_END_DIAG_VLS_DIF_DLY_i" VALUE 0xffe4195c _REC_VAL_20_u2 6553.5 _CNV_A_R_LINEAR_____24_CM 0. 6553.5 DISPLAY_IDENTIFIER C_T_END_DIAG_VLS_DIF_DLY FORMAT "%5.1" /end CHARACTERISTIC
/begin CHARACTERISTIC c_t_sum_rst_vls_dif_dly "Time counter to reset T_SUM_MIN_VLS_DIF_DLY_i and T_SUM_MAX_VLS_DIF_DLY_i" VALUE 0xffe41a02 _REC_VAL_20_u2 6553.5 _CNV_A_R_LINEAR_____24_CM 0. 6553.5 DISPLAY_IDENTIFIER C_T_SUM_RST_VLS_DIF_DLY FORMAT "%5.1" /end CHARACTERISTIC
/begin CHARACTERISTIC c_t_end_diag_delta_lamb_i "Time limit to set LV_END_DIAG_DELTA_LAMB_I_i" VALUE 0xffe41950 _REC_VAL_20_u2 65535. _CNV_A_R_LINEAR_____30_CM 0. 65535. DISPLAY_IDENTIFIER C_T_END_DIAG_DELTA_LAMB_I FORMAT "%5.0" /end CHARACTERISTIC
/begin CHARACTERISTIC c_t_sum_max_delta_lamb_i "Total duration over T_SUM_MAX_DELTA_LAMB_i" VALUE 0xffe419f4 _REC_VAL_20_u2 65535. _CNV_A_R_LINEAR_____30_CM 0. 65535. DISPLAY_IDENTIFIER C_T_SUM_MAX_DELTA_LAMB_I FORMAT "%5.0" /end CHARACTERISTIC
/begin CHARACTERISTIC c_t_sum_min_delta_lamb_i "Total duration over T_SUM_MIN_DELTA_LAMB_i" VALUE 0xffe419f8 _REC_VAL_20_u2 65535. _CNV_A_R_LINEAR_____30_CM 0. 65535. DISPLAY_IDENTIFIER C_T_SUM_MIN_DELTA_LAMB_I FORMAT "%5.0" /end CHARACTERISTIC
/begin CHARACTERISTIC c_t_sum_rst_delta_lamb_i "Time counter to reset T_SUM_MIN_DELTA_LAMB_I_i and T_SUM_MAX_DELTA_LAMB_I_i" VALUE 0xffe419fc _REC_VAL_20_u2 65535. _CNV_A_R_LINEAR_____30_CM 0. 65535. DISPLAY_IDENTIFIER C_T_SUM_RST_DELTA_LAMB_I FORMAT "%5.0" /end CHARACTERISTIC
/begin CHARACTERISTIC c_maf_int_min_vls_dif_dly "threshold limited dynamic engine maf " VALUE 0xffe41772 _REC_VAL_20_u2 1820.4167 _CNV_A_R_LINEAR_____273_CM 0. 1820.4167 DISPLAY_IDENTIFIER C_MAF_INT_MIN_VLS_DIF_DLY FORMAT "%9.4" /end CHARACTERISTIC
/begin CHARACTERISTIC c_lam_mv_ldc_vls_dif_dly "threshold limited dynamic lambda " VALUE 0xffe416a2 _REC_VAL_20_u2 99.99847412 _CNV_A_R_LINEAR_____8_CM 0. 99.99847412 DISPLAY_IDENTIFIER C_LAM_MV_LDC_VLS_DIF_DLY /end CHARACTERISTIC
/begin CHARACTERISTIC c_n_ldc_vls_dif_dly "threshold limited dynamic engine speed" VALUE 0xffe4180a _REC_VAL_20_u2 8160. _CNV_A_R_LINEAR_____10_CM 0. 8160. DISPLAY_IDENTIFIER C_N_LDC_VLS_DIF_DLY FORMAT "%4.0" /end CHARACTERISTIC
/begin CHARACTERISTIC c_maf_crlc_ldc_vls_dif_dly "correlation constant floating mean value calculation maf" VALUE 0xffe4172a _REC_VAL_20_u2 0.99998474 _CNV_A_R_LINEAR_____37_CM 0. 0.99998474 DISPLAY_IDENTIFIER C_MAF_CRLC_LDC_VLS_DIF_DLY FORMAT "%7.5" /end CHARACTERISTIC
/begin CHARACTERISTIC c_n_crlc_ldc_vls_dif_dly " correlation constant floating mean value calculation engine speed" VALUE 0xffe417ec _REC_VAL_20_u2 0.99998474 _CNV_A_R_LINEAR_____37_CM 0. 0.99998474 DISPLAY_IDENTIFIER C_N_CRLC_LDC_VLS_DIF_DLY FORMAT "%7.5" /end CHARACTERISTIC
/begin CHARACTERISTIC c_lam_mv_crlc_ldc_vls_dif_dly "correlation constant floating mean value calculation lambda" VALUE 0xffe41698 _REC_VAL_20_u2 0.99998474 _CNV_A_R_LINEAR_____37_CM 0. 0.99998474 DISPLAY_IDENTIFIER C_LAM_MV_CRLC_LDC_VLS_DIF_DLY FORMAT "%7.5" /end CHARACTERISTIC
/begin MEASUREMENT n_mmv_ldc_vls_dif_dly "floating mean value for limited engine speed" UWORD _CNV_A_R_LINEAR_____10_CM 1 100. 0. 8160. DISPLAY_IDENTIFIER N_MMV_LDC_VLS_DIF_DLY ECU_ADDRESS 0x3fdbfa BYTE_ORDER MSB_LAST FORMAT "%4.0" /end MEASUREMENT
/begin MEASUREMENT maf_mmv_ldc_vls_dif_dly "floating mean value for limited MAF" UWORD _CNV_A_R_LINEAR_____108_CM 1 100. 0. 1389. DISPLAY_IDENTIFIER MAF_MMV_LDC_VLS_DIF_DLY ECU_ADDRESS 0x3fdbfc BYTE_ORDER MSB_LAST FORMAT "%4.0" /end MEASUREMENT
/begin MEASUREMENT lv_n_ldc_vls_dif_dly "Status limited dynamic N" UBYTE _CNV_S_2_RANGE______2_CM 1 100. 0. 1. DISPLAY_IDENTIFIER LV_N_LDC_VLS_DIF_DLY ECU_ADDRESS 0x3fea56 /end MEASUREMENT
/begin MEASUREMENT lv_maf_ldc_vls_dif_dly "Status limited dynamic MAF" UBYTE _CNV_S_2_RANGE______2_CM 1 100. 0. 1. DISPLAY_IDENTIFIER LV_MAF_LDC_VLS_DIF_DLY ECU_ADDRESS 0x3fea57 /end MEASUREMENT
/begin CHARACTERISTIC c_maf_ldc_vls_dif_dly "threshold limited dynamic engine maf " VALUE 0xffe417b2 _REC_VAL_20_u2 1389. _CNV_A_R_LINEAR_____108_CM 0. 1389. DISPLAY_IDENTIFIER C_MAF_LDC_VLS_DIF_DLY FORMAT "%4.0" /end CHARACTERISTIC
/begin CHARACTERISTIC c_t_lsh_on_thd "Minimum duration of heater activation after starting time exceeded" VALUE 0xffe4198a _REC_VAL_20_u2 6553.5 _CNV_A_R_LINEAR_____24_CM 0. 6553.5 DISPLAY_IDENTIFIER C_T_LSH_ON_THD FORMAT "%5.1" /end CHARACTERISTIC
/begin CHARACTERISTIC c_t_lam_lim_st_err "Minimum duration of the lambda controller manipulated value limitation to assure fasle start recognition" VALUE 0xffe4089c _REC_VAL_20_u1 25.5 _CNV_A_R_LINEAR_____24_CM 0. 25.5 DISPLAY_IDENTIFIER C_T_LAM_LIM_ST_ERR FORMAT "%4.1" /end CHARACTERISTIC
/begin CHARACTERISTIC c_ctr_err_st_ini "Initial value of CTR_ERR_ST in case of a false start" VALUE 0xffe406cd _REC_VAL_20_u1 255. _CNV_A_R_LINEAR_____0_CM 0. 255. DISPLAY_IDENTIFIER C_CTR_ERR_ST_INI FORMAT "%3.0" /end CHARACTERISTIC
/begin CHARACTERISTIC ip_t_st_eng_max "Maximum value of the starting time for a normal start" CURVE 0xffe40e68 _REC_CUR_20_u1_u1 25.5 _CNV_A_R_LINEAR_____24_CM 0. 25.5 DISPLAY_IDENTIFIER IP_T_ST_ENG_MAX FORMAT "%4.1"
 /begin AXIS_DESCR COM_AXIS tco_st _CNV_A_R_LINEAR_____11_CM 4 -48. 142.5 FORMAT "%5.1" AXIS_PTS_REF ldp_tco_st__t_st_eng_max /end AXIS_DESCR
/end CHARACTERISTIC
/begin CHARACTERISTIC c_vls_down_plaus_min "Minimum voltage of the oxygen sensor to carry out the plausibility" VALUE 0xffe41b6e _REC_VAL_20_u2 4.99511719 _CNV_A_R_LINEAR_____3_CM 0. 4.99511719 DISPLAY_IDENTIFIER C_VLS_DOWN_PLAUS_MIN FORMAT "%5.3" /end CHARACTERISTIC
/begin CHARACTERISTIC c_vls_down_plaus_max "Maximum voltage of the oxygen sensor to carry out the plausibility" VALUE 0xffe41b6c _REC_VAL_20_u2 4.99511719 _CNV_A_R_LINEAR_____3_CM 0. 4.99511719 DISPLAY_IDENTIFIER C_VLS_DOWN_PLAUS_MAX FORMAT "%5.3" /end CHARACTERISTIC
/begin CHARACTERISTIC c_temp_cat_plaus_min "Minimum temperature of the catalyst to carry out the plausibility" VALUE 0xffe40944 _REC_VAL_20_u1 1023. _CNV_A_R_LINEAR_____352_CM -33. 990. DISPLAY_IDENTIFIER C_TEMP_CAT_PLAUS_MIN FORMAT "%4.0" /end CHARACTERISTIC
/begin CHARACTERISTIC c_temp_cat_plaus_max "Maximum temperature of the catalyst to carry out the plausibility" VALUE 0xffe40943 _REC_VAL_20_u1 1023. _CNV_A_R_LINEAR_____352_CM -33. 990. DISPLAY_IDENTIFIER C_TEMP_CAT_PLAUS_MAX FORMAT "%4.0" /end CHARACTERISTIC
/begin CHARACTERISTIC c_maf_kgh_ls_plaus_min "Minimum mass air flow to carry out the plausibility" VALUE 0xffe417a0 _REC_VAL_20_u2 2047.96875 _CNV_A_R_LINEAR_____115_CM 0. 2047.96875 DISPLAY_IDENTIFIER C_MAF_KGH_LS_PLAUS_MIN FORMAT "%7.2" /end CHARACTERISTIC
/begin CHARACTERISTIC c_maf_kgh_ls_plaus_max "Maximum mass air flow to carry out the plausibility" VALUE 0xffe4179e _REC_VAL_20_u2 2047.96875 _CNV_A_R_LINEAR_____115_CM 0. 2047.96875 DISPLAY_IDENTIFIER C_MAF_KGH_LS_PLAUS_MAX FORMAT "%7.2" /end CHARACTERISTIC
/begin CHARACTERISTIC c_cat_diag_plaus_max "Maximum value of the catalyst efficiency diagnosis to carry out the plausibility" VALUE 0xffe40650 _REC_VAL_20_u1 1.9968 _CNV_A_R_LINEAR_____335_CM 0. 1.9968 DISPLAY_IDENTIFIER C_CAT_DIAG_PLAUS_MAX FORMAT "%4.2" /end CHARACTERISTIC
/begin CHARACTERISTIC c_vls_down_plaus_afl "Lean-mixture threshold of the downstream sensor voltage" VALUE 0xffe41b68 _REC_VAL_20_u2 4.99511719 _CNV_A_R_LINEAR_____3_CM 0. 4.99511719 DISPLAY_IDENTIFIER C_VLS_DOWN_PLAUS_AFL FORMAT "%5.3" /end CHARACTERISTIC
/begin CHARACTERISTIC c_vls_down_plaus_afr "Rich-mixture threshold of the downstream sensor voltage" VALUE 0xffe41b6a _REC_VAL_20_u2 4.99511719 _CNV_A_R_LINEAR_____3_CM 0. 4.99511719 DISPLAY_IDENTIFIER C_VLS_DOWN_PLAUS_AFR FORMAT "%5.3" /end CHARACTERISTIC
/begin CHARACTERISTIC c_lamb_plaus_afl "Lean-mixture threshold of the upstream sensor voltage" VALUE 0xffe416ce _REC_VAL_20_u2 31.99902344 _CNV_A_R_LINEAR_____206_CM 0. 31.99902344 DISPLAY_IDENTIFIER C_LAMB_PLAUS_AFL FORMAT "%7.4" /end CHARACTERISTIC
/begin CHARACTERISTIC c_lamb_plaus_afr "Rich-mixture threshold of the upstream sensor voltage" VALUE 0xffe416d0 _REC_VAL_20_u2 31.99902344 _CNV_A_R_LINEAR_____206_CM 0. 31.99902344 DISPLAY_IDENTIFIER C_LAMB_PLAUS_AFR FORMAT "%7.4" /end CHARACTERISTIC
/begin CHARACTERISTIC c_lamb_plaus_min "Minimum threshold of the upstream sensor to carry out a signal plausibility" VALUE 0xffe416d4 _REC_VAL_20_u2 31.99902344 _CNV_A_R_LINEAR_____206_CM 0. 31.99902344 DISPLAY_IDENTIFIER C_LAMB_PLAUS_MIN FORMAT "%7.4" /end CHARACTERISTIC
/begin CHARACTERISTIC c_lamb_plaus_max "Maximum threshold of the upstream sensor to carry out a signal plausibility" VALUE 0xffe416d2 _REC_VAL_20_u2 31.99902344 _CNV_A_R_LINEAR_____206_CM 0. 31.99902344 DISPLAY_IDENTIFIER C_LAMB_PLAUS_MAX FORMAT "%7.4" /end CHARACTERISTIC
/begin CHARACTERISTIC c_tco_min_plaus_lsl "Minimum threshold of the cooling-water temperature to activate the function" VALUE 0xffe4091d _REC_VAL_20_u1 190.5 _CNV_A_R_LINEAR_____11_CM -48. 142.5 DISPLAY_IDENTIFIER C_TCO_MIN_PLAUS_LSL FORMAT "%5.1" /end CHARACTERISTIC
/begin CHARACTERISTIC c_delta_lamb_thd_lsh_diag "Threshold for the maximum transition of the sensor signal" VALUE 0xffe415b6 _REC_VAL_20_u2 31.99902344 _CNV_A_R_LINEAR_____206_CM 0. 31.99902344 DISPLAY_IDENTIFIER C_DELTA_LAMB_THD_LSH_DIAG /end CHARACTERISTIC
/begin CHARACTERISTIC c_cycnr_delta_lamb_lsh_diag_max "Quantity of valid diagnosis values in one function cycle" VALUE 0xffe406da _REC_VAL_20_u1 255. _CNV_A_R_LINEAR_____0_CM 0. 255. DISPLAY_IDENTIFIER C_CYCNR_DELTA_LAMB_LSH_DIAG_MAX FORMAT "%3.0" /end CHARACTERISTIC
/begin CHARACTERISTIC c_ctr_delta_lamb_lsh_diag_max "Limit value of the diagnosis results to diagnose the heater coupling" VALUE 0xffe406a3 _REC_VAL_20_u1 255. _CNV_A_R_LINEAR_____0_CM 0. 255. DISPLAY_IDENTIFIER C_CTR_DELTA_LAMB_LSH_DIAG_MAX FORMAT "%3.0" /end CHARACTERISTIC
/begin CHARACTERISTIC c_sp_lamb_de_max "Maximum value of the forced excitation amplitude to activate the diagnosis" VALUE 0xffe40840 _REC_VAL_20_u1 0.124023 _CNV_A_R_LINEAR_____342_CM 0. 0.124023 DISPLAY_IDENTIFIER C_SP_LAMB_DE_MAX FORMAT "%5.3" /end CHARACTERISTIC
/begin CHARACTERISTIC c_teg_dyn_lsh_diag_min "Minimum value of the exhaust temperature to activate  the function" VALUE 0xffe41a4a _REC_VAL_20_u2 2047. _CNV_A_R_LINEAR_____6_CM 0. 2047. DISPLAY_IDENTIFIER C_TEG_DYN_LSH_DIAG_MIN FORMAT "%7.2" /end CHARACTERISTIC
/begin CHARACTERISTIC c_maf_int_lsh_diag "Threshold for the activation of the MAF-Integral" VALUE 0xffe4175a _REC_VAL_20_u2 1820.398 _CNV_A_R_LINEAR_____287_CM 0. 1820.398 DISPLAY_IDENTIFIER C_MAF_INT_LSH_DIAG FORMAT "%7.2" /end CHARACTERISTIC
/begin CHARACTERISTIC c_t_per_lamb_de_lsh_diag_max "Threshold of the MAF-Integral to activate the heater-coupling diagnosis" VALUE 0xffe419d6 _REC_VAL_20_u2 655.35 _CNV_A_R_LINEAR_____4_CM 0. 655.35 DISPLAY_IDENTIFIER C_T_PER_LAMB_DE_LSH_DIAG_MAX FORMAT "%6.2" /end CHARACTERISTIC
/begin CHARACTERISTIC c_delta_lamb_fall_lpf_crlc "Filter constant for Fall" VALUE 0xffe406e3 _REC_VAL_20_u1 0.99610001 _CNV_A_R_LINEAR_____29_CM 0. 0.99610001 DISPLAY_IDENTIFIER C_DELTA_LAMB_FALL_LPF_CRLC FORMAT "%5.3" /end CHARACTERISTIC
/begin CHARACTERISTIC c_delta_lamb_rise_lpf_crlc "Filter constant for Rise" VALUE 0xffe406e4 _REC_VAL_20_u1 0.99610001 _CNV_A_R_LINEAR_____29_CM 0. 0.99610001 DISPLAY_IDENTIFIER C_DELTA_LAMB_RISE_LPF_CRLC_ FORMAT "%5.3" /end CHARACTERISTIC
/begin CHARACTERISTIC c_ctr_ls_up_dyn_min "Number of  single functions until to the calculation of the mean diagnosis value" VALUE 0xffe406cf _REC_VAL_20_u1 255. _CNV_A_R_LINEAR_____0_CM 0. 255. DISPLAY_IDENTIFIER C_CTR_LS_UP_DYN_MIN FORMAT "%3.0" /end CHARACTERISTIC
/begin CHARACTERISTIC c_ctr_ls_up_dyn_min_ext_req "Maximum number of revolutions to activate the diagnosis" VALUE 0xffe406d0 _REC_VAL_20_u1 0.9375 _CNV_A_R_LINEAR_____46_CM 0. 0.9375 DISPLAY_IDENTIFIER C_CTR_LS_UP_DYN_MIN_EXT_REQ FORMAT "%6.4" /end CHARACTERISTIC
/begin CHARACTERISTIC c_n_max_ls_dyn "Maximum number of revolutions to activate the diagnosis" VALUE 0xffe407e8 _REC_VAL_20_u1 8160. _CNV_A_R_LINEAR_____15_CM 0. 8160. DISPLAY_IDENTIFIER C_N_MAX_LS_DYN FORMAT "%4.0" /end CHARACTERISTIC
/begin CHARACTERISTIC c_n_min_ls_dyn "Minimum number of revolutions to activate the diagnosis" VALUE 0xffe407f8 _REC_VAL_20_u1 8160. _CNV_A_R_LINEAR_____15_CM 0. 8160. DISPLAY_IDENTIFIER C_N_MIN_LS_DYN FORMAT "%4.0" /end CHARACTERISTIC
/begin CHARACTERISTIC c_ls_dyn_diag_maf_max "Maximum mass flow to activate the diagnosis function" VALUE 0xffe41722 _REC_VAL_20_u2 1389. _CNV_A_R_LINEAR_____108_CM 0. 1389. DISPLAY_IDENTIFIER C_LS_DYN_DIAG_MAF_MAX FORMAT "%7.2" /end CHARACTERISTIC
/begin CHARACTERISTIC c_ls_dyn_diag_maf_min "Minimum mass flow to activate the diagnosis function" VALUE 0xffe41724 _REC_VAL_20_u2 1389. _CNV_A_R_LINEAR_____108_CM 0. 1389. DISPLAY_IDENTIFIER C_LS_DYN_DIAG_MAF_MIN FORMAT "%7.2" /end CHARACTERISTIC
/begin CHARACTERISTIC c_vls_up_thd_min "Upstream sensor signal min. threshold during engine operation (PUC excepted)" VALUE 0xffe41b9e _REC_VAL_20_u2 4.99511719 _CNV_A_R_LINEAR_____3_CM 0. 4.99511719 DISPLAY_IDENTIFIER C_VLS_UP_THD_MIN FORMAT "%5.3" /end CHARACTERISTIC
/begin CHARACTERISTIC c_vls_up_thd_max "Upstream sensor signal max. threshold during engine operation (PUC excepted)" VALUE 0xffe41b9c _REC_VAL_20_u2 4.99511719 _CNV_A_R_LINEAR_____3_CM 0. 4.99511719 DISPLAY_IDENTIFIER C_VLS_UP_THD_MAX FORMAT "%5.3" /end CHARACTERISTIC
/begin CHARACTERISTIC c_t_vls_up_thd_over "Time filter to detect a symptom" VALUE 0xffe41a22 _REC_VAL_20_u2 409.5 _CNV_A_R_LINEAR_____24_CM 0. 409.5 DISPLAY_IDENTIFIER C_T_VLS_UP_THD_OVER FORMAT "%5.1" /end CHARACTERISTIC
/begin CHARACTERISTIC c_t_plaus_ls_up_puc "Time filter to detect a symptom" VALUE 0xffe419d8 _REC_VAL_20_u2 409.5 _CNV_A_R_LINEAR_____24_CM 0. 409.5 DISPLAY_IDENTIFIER C_T_PLAUS_LS_UP_PUC FORMAT "%5.1" /end CHARACTERISTIC
/begin CHARACTERISTIC c_t_wait_plaus_ls_up_puc "Waiting time after beginning of PUC to test sensor signal" VALUE 0xffe41a26 _REC_VAL_20_u2 409.5 _CNV_A_R_LINEAR_____24_CM 0. 409.5 DISPLAY_IDENTIFIER C_T_WAIT_PLAUS_LS_UP_PUC FORMAT "%5.1" /end CHARACTERISTIC
/begin CHARACTERISTIC c_vls_up_plaus_puc_min "Minimum admissible upstream sensor output voltage in PUC" VALUE 0xffe41b9a _REC_VAL_20_u2 4.99511719 _CNV_A_R_LINEAR_____3_CM 0. 4.99511719 DISPLAY_IDENTIFIER C_VLS_UP_PLAUS_PUC_MIN FORMAT "%5.3" /end CHARACTERISTIC
/begin CHARACTERISTIC c_vls_up_plaus_puc_max "Maximum admissible upstream sensor output voltage in PUC" VALUE 0xffe41b98 _REC_VAL_20_u2 4.99511719 _CNV_A_R_LINEAR_____3_CM 0. 4.99511719 DISPLAY_IDENTIFIER C_VLS_UP_PLAUS_PUC_MAX FORMAT "%5.3" /end CHARACTERISTIC
/begin CHARACTERISTIC c_teg_dyn_min_plaus_puc "Minimum admissible exhaust gas temperature in PUC" VALUE 0xffe41a4c _REC_VAL_20_u2 2047. _CNV_A_R_LINEAR_____6_CM 0. 2047. DISPLAY_IDENTIFIER C_TEG_DYN_MIN_PLAUS_PUC FORMAT "%7.2" /end CHARACTERISTIC
/begin CHARACTERISTIC c_cl_mmv_ls_up_diag_max "Maximum degree of saturation of the evaporative canister to activate the function" VALUE 0xffe41528 _REC_VAL_20_u2 1.99996948 _CNV_A_R_LINEAR_____20_CM 0. 1.99996948 DISPLAY_IDENTIFIER C_CL_MMV_LS_UP_DIAG_MAX FORMAT "%7.5" /end CHARACTERISTIC
/begin AXIS_PTS ldp_tco_st__t_st_eng_max "" 0xffe4121e tco_st _REC_AXS_20_u1 190.5 _CNV_A_R_LINEAR_____11_CM 4 -48. 142.5 DISPLAY_IDENTIFIER LDP_TCO_ST__T_ST_ENG_MAX FORMAT "%5.1" /end AXIS_PTS
/begin AXIS_PTS ldp_maf_kgh__t_plaus_ls_up "" 0xffe50e3a maf_kgh _REC_AXS_20_u2 2047.96875 _CNV_A_R_LINEAR_____115_CM 4 0. 2047.96875 DISPLAY_IDENTIFIER LDP_MAF_KGH__T_PLAUS_LS_UP FORMAT "%7.2" /end AXIS_PTS
/begin MEASUREMENT lv_err_vls_up_thd_over_1 "Debounced diagnosis result of upstream sensor signal monitoring" UBYTE _CNV_S_2_RANGE______1_R_CM 1 100. 0. 255. DISPLAY_IDENTIFIER LV_ERR_VLS_UP_THD_OVER_1 ECU_ADDRESS 0x3fbb98 /end MEASUREMENT
/begin MEASUREMENT lv_err_vls_up_thd_over_2 "Debounced diagnosis result of upstream sensor signal monitoring" UBYTE _CNV_S_2_RANGE______1_R_CM 1 100. 0. 255. DISPLAY_IDENTIFIER LV_ERR_VLS_UP_THD_OVER_2 ECU_ADDRESS 0x3fbb9c /end MEASUREMENT
/begin MEASUREMENT lv_err_lsh_ls_up_1 "Debounced heater coupling diagnosis value" UBYTE _CNV_S_2_RANGE______1_R_CM 1 100. 0. 255. DISPLAY_IDENTIFIER LV_ERR_LSH_LS_UP_1 ECU_ADDRESS 0x3fbb90 /end MEASUREMENT
/begin MEASUREMENT lv_err_lsh_ls_up_2 "Debounced heater coupling diagnosis value" UBYTE _CNV_S_2_RANGE______1_R_CM 1 100. 0. 255. DISPLAY_IDENTIFIER LV_ERR_LSH_LS_UP_2 ECU_ADDRESS 0x3fbb94 /end MEASUREMENT
/begin CHARACTERISTIC ip_t_plaus_ls_up "Time debounced of the plausibility error" CURVE 0xffe41cb8 _REC_CUR_20_u2_u2 6553.5 _CNV_A_R_LINEAR_____24_CM 0. 6553.5 DISPLAY_IDENTIFIER IP_T_PLAUS_LS_UP__MAF_KGH FORMAT "%5.1"
 /begin AXIS_DESCR COM_AXIS maf_kgh _CNV_A_R_LINEAR_____115_CM 4 0. 2047.96875 FORMAT "%7.2" AXIS_PTS_REF ldp_maf_kgh__t_plaus_ls_up /end AXIS_DESCR
/end CHARACTERISTIC
/begin CHARACTERISTIC c_t_end_diag_lsl_plaus "Time to have a diagnostic available" VALUE 0xffe41956 _REC_VAL_20_u2 6553.5 _CNV_A_R_LINEAR_____24_CM 0. 6553.5 DISPLAY_IDENTIFIER C_T_END_DIAG_LSL_PLAUS FORMAT "%5.1" /end CHARACTERISTIC
/begin CHARACTERISTIC c_t_end_diag_lsh_ls_up "Time to have a diagnostic available" VALUE 0xffe41954 _REC_VAL_20_u2 6553.5 _CNV_A_R_LINEAR_____24_CM 0. 6553.5 DISPLAY_IDENTIFIER C_T_END_DIAG_LSH_LS_UP FORMAT "%5.1" /end CHARACTERISTIC
/begin CHARACTERISTIC c_t_end_diag_vls_up_thd_over "Time to have a diagnostic available" VALUE 0xffe4195e _REC_VAL_20_u2 6553.5 _CNV_A_R_LINEAR_____24_CM 0. 6553.5 DISPLAY_IDENTIFIER C_T_END_DIAG_VLS_UP_THD_OVER FORMAT "%5.1" /end CHARACTERISTIC
/begin CHARACTERISTIC c_t_end_diag_plaus_ls_up_puc "Time to have a diagnostic available" VALUE 0xffe4195a _REC_VAL_20_u2 6553.5 _CNV_A_R_LINEAR_____24_CM 0. 6553.5 DISPLAY_IDENTIFIER C_T_END_DIAG_PLAUS_LS_UP_PUC FORMAT "%5.1" /end CHARACTERISTIC
/begin CHARACTERISTIC c_inc_ctr_diag_lsl_plaus "Second anti-bounce filter: counter incement" VALUE 0xffe40777 _REC_VAL_20_u1 255. _CNV_A_R_LINEAR_____0_CM 0. 255. DISPLAY_IDENTIFIER C_INC_CTR_DIAG_LSL_PLAUS FORMAT "%3.0" /end CHARACTERISTIC
/begin CHARACTERISTIC c_dec_ctr_diag_lsl_plaus "Second anti-bounce filter: counter decrement" VALUE 0xffe406e0 _REC_VAL_20_u1 255. _CNV_A_R_LINEAR_____0_CM 0. 255. DISPLAY_IDENTIFIER C_DEC_CTR_DIAG_LSL_PLAUS FORMAT "%3.0" /end CHARACTERISTIC
/begin CHARACTERISTIC c_max_ctr_diag_lsl_plaus "Second anti-bounce filter: max. counter threshold" VALUE 0xffe40799 _REC_VAL_20_u1 255. _CNV_A_R_LINEAR_____0_CM 0. 255. DISPLAY_IDENTIFIER C_MAX_CTR_DIAG_LSL_PLAUS FORMAT "%3.0" /end CHARACTERISTIC
/begin CHARACTERISTIC c_ctr_ls_up_dyn_wait_max "Number of  forced stimulation cycles to wait until begin calculation of sensor signal amplitude" VALUE 0xffe406d1 _REC_VAL_20_u1 255. _CNV_A_R_LINEAR_____0_CM 0. 255. DISPLAY_IDENTIFIER C_CTR_LS_UP_DYN_WAIT_MAX FORMAT "%3.0" /end CHARACTERISTIC
/begin CHARACTERISTIC c_cycnr_ls_up_dyn_min "Minimun number of cycles necessary to finish the diagnosis" VALUE 0xffe406de _REC_VAL_20_u1 255. _CNV_A_R_LINEAR_____0_CM 0. 255. DISPLAY_IDENTIFIER C_CYCNR_LS_UP_DYN_MIN FORMAT "%3.0" /end CHARACTERISTIC
/begin CHARACTERISTIC c_lamb_ls_up_dyn_min "Lowest allowed sensor signal min value" VALUE 0xffe416bc _REC_VAL_20_u2 31.99902344 _CNV_A_R_LINEAR_____206_CM 0. 31.99902344 DISPLAY_IDENTIFIER C_LAMB_LS_UP_DYN_MIN /end CHARACTERISTIC
/begin CHARACTERISTIC c_lamb_ls_up_dyn_max "Highest allowed sensor signal max value" VALUE 0xffe416ba _REC_VAL_20_u2 31.99902344 _CNV_A_R_LINEAR_____206_CM 0. 31.99902344 DISPLAY_IDENTIFIER C_LAMB_LS_UP_DYN_MAX /end CHARACTERISTIC
/begin CHARACTERISTIC c_lamb_ampl_min_ls_up_dyn "Calibration data for adjust the expected amplitude:  low range" VALUE 0xffe4078a _REC_VAL_20_u1 0.124023 _CNV_A_R_LINEAR_____342_CM 0. 0.124023 DISPLAY_IDENTIFIER C_LAMB_AMPL_MIN_LS_UP_DYN FORMAT "%5.3" /end CHARACTERISTIC
/begin CHARACTERISTIC c_lamb_ampl_max_ls_up_dyn "Calibration data for adjust the expected amplitude:  low range" VALUE 0xffe40789 _REC_VAL_20_u1 0.124023 _CNV_A_R_LINEAR_____342_CM 0. 0.124023 DISPLAY_IDENTIFIER C_LAMB_AMPL_MAX_LS_UP_DYN FORMAT "%5.3" /end CHARACTERISTIC
/begin CHARACTERISTIC c_fac_mv_thd_ls_up_dyn "Limited diagnosis value for the error diagnosis" VALUE 0xffe4161c _REC_VAL_20_u2 31.99902344 _CNV_A_R_LINEAR_____206_CM 0. 31.99902344 DISPLAY_IDENTIFIER C_FAC_MV_THD_LS_UP_DYN FORMAT "%7.4" /end CHARACTERISTIC
/begin CHARACTERISTIC c_fac_ad_thd_ls_up_dyn "Diagnosis value threshold for begin adaption of sensor time constant model" VALUE 0xffe415ec _REC_VAL_20_u2 31.99902344 _CNV_A_R_LINEAR_____206_CM 0. 31.99902344 DISPLAY_IDENTIFIER C_FAC_AD_THD_LS_UP_DYN FORMAT "%7.4" /end CHARACTERISTIC
/begin CHARACTERISTIC c_fac_ad_delta_ls_up_dyn "Diagnosis value window allowed" VALUE 0xffe415ea _REC_VAL_20_u2 31.99902344 _CNV_A_R_LINEAR_____206_CM 0. 31.99902344 DISPLAY_IDENTIFIER C_FAC_AD_DELTA__LS_UP_DYN FORMAT "%7.4" /end CHARACTERISTIC
/begin CHARACTERISTIC c_fac_ad_lpf_ls_up_dyn "Low pass filter coeficient to calculate diagnosis mean value" VALUE 0xffe4072a _REC_VAL_20_u1 0.99610001 _CNV_A_R_LINEAR_____29_CM 0. 0.99610001 DISPLAY_IDENTIFIER C_FAC_AD_LPF_LS_UP_DYN FORMAT "%5.3" /end CHARACTERISTIC
/begin CHARACTERISTIC lc_syn_ls_up_dyn_cat_diag "Synchronize sensor dynamic diagnosis with the catalyst efficiency diagnosis" VALUE 0xffe40fdf _REC_VAL_20_u1 1. _CNV_S_2_RANGE______21_CM 0. 1. DISPLAY_IDENTIFIER LC_SYN_LS_UP_DYN_CAT_DIAG /end CHARACTERISTIC
/begin CHARACTERISTIC lc_t1_lamb_ad_ls_up_dyn_1 "Allow adaption of modeled sensor time constant T1_LAMB" VALUE 0xffe40fe0 _REC_VAL_20_u1 1. _CNV_S_2_RANGE______21_CM 0. 1. DISPLAY_IDENTIFIER LC_T1_LAMB_AD_LS_UP_DYN_1 /end CHARACTERISTIC
/begin CHARACTERISTIC lc_t1_lamb_ad_ls_up_dyn_2 "Allow adaption of modeled sensor time constant T1_LAMB" VALUE 0xffe40fe1 _REC_VAL_20_u1 1. _CNV_S_2_RANGE______21_CM 0. 1. DISPLAY_IDENTIFIER LC_T1_LAMB_AD_LS_UP_DYN_2 /end CHARACTERISTIC
/begin CHARACTERISTIC ip_lamb_ampl_max_ls_up_dyn_1 "Ampitude of nominal sensor by forced stimulation" MAP 0xffe46b14 _REC_MAP_20_u1_u1_u1 0.124023 _CNV_A_R_LINEAR_____342_CM 0. 0.124023 DISPLAY_IDENTIFIER IP_LAMB_AMPL_MAX_LS_UP_DYN_1 FORMAT "%5.3"
 /begin AXIS_DESCR COM_AXIS n_32 _CNV_A_R_LINEAR_____15_CM 8 0. 8160. FORMAT "%4.0" AXIS_PTS_REF ldpm_n_32_ls_up_dyn /end AXIS_DESCR
 /begin AXIS_DESCR COM_AXIS maf _CNV_A_R_LINEAR_____27_CM 8 0. 1389. FORMAT "%4.0" AXIS_PTS_REF ldpm_maf_hb_ls_up_dyn /end AXIS_DESCR
/end CHARACTERISTIC
/begin CHARACTERISTIC ip_lamb_ampl_max_ls_up_dyn_2 "Ampitude of nominal sensor by forced stimulation" MAP 0xffe46b54 _REC_MAP_20_u1_u1_u1 0.124023 _CNV_A_R_LINEAR_____342_CM 0. 0.124023 DISPLAY_IDENTIFIER IP_LAMB_AMPL_MAX_LS_UP_DYN_2 FORMAT "%5.3"
 /begin AXIS_DESCR COM_AXIS n_32 _CNV_A_R_LINEAR_____15_CM 8 0. 8160. FORMAT "%4.0" AXIS_PTS_REF ldpm_n_32_ls_up_dyn /end AXIS_DESCR
 /begin AXIS_DESCR COM_AXIS maf _CNV_A_R_LINEAR_____27_CM 8 0. 1389. FORMAT "%4.0" AXIS_PTS_REF ldpm_maf_hb_ls_up_dyn /end AXIS_DESCR
/end CHARACTERISTIC
/begin CHARACTERISTIC ip_lamb_ampl_min_ls_up_dyn_1 "Value to standardize the amplitude proportion" MAP 0xffe46b94 _REC_MAP_20_u1_u1_u1 0.124023 _CNV_A_R_LINEAR_____342_CM 0. 0.124023 DISPLAY_IDENTIFIER IP_LAMB_AMPL_MIN_LS_UP_DYN_1 FORMAT "%5.3"
 /begin AXIS_DESCR COM_AXIS n_32 _CNV_A_R_LINEAR_____15_CM 8 0. 8160. FORMAT "%4.0" AXIS_PTS_REF ldpm_n_32_ls_up_dyn /end AXIS_DESCR
 /begin AXIS_DESCR COM_AXIS maf _CNV_A_R_LINEAR_____27_CM 8 0. 1389. FORMAT "%4.0" AXIS_PTS_REF ldpm_maf_hb_ls_up_dyn /end AXIS_DESCR
/end CHARACTERISTIC
/begin CHARACTERISTIC ip_lamb_ampl_min_ls_up_dyn_2 "Value to standardize the amplitude proportion" MAP 0xffe46bd4 _REC_MAP_20_u1_u1_u1 0.124023 _CNV_A_R_LINEAR_____342_CM 0. 0.124023 DISPLAY_IDENTIFIER IP_LAMB_AMPL_MIN_LS_UP_DYN_2 FORMAT "%5.3"
 /begin AXIS_DESCR COM_AXIS n_32 _CNV_A_R_LINEAR_____15_CM 8 0. 8160. FORMAT "%4.0" AXIS_PTS_REF ldpm_n_32_ls_up_dyn /end AXIS_DESCR
 /begin AXIS_DESCR COM_AXIS maf _CNV_A_R_LINEAR_____27_CM 8 0. 1389. FORMAT "%4.0" AXIS_PTS_REF ldpm_maf_hb_ls_up_dyn /end AXIS_DESCR
/end CHARACTERISTIC
/begin AXIS_PTS ldpm_n_32_ls_up_dyn "" 0xffe48552 n_32 _REC_AXS_20_u1 8160. _CNV_A_R_LINEAR_____15_CM 8 0. 8160. DISPLAY_IDENTIFIER LDPM_N_32_LS_UP_DYN FORMAT "%4.0" /end AXIS_PTS
/begin AXIS_PTS ldpm_maf_hb_ls_up_dyn "" 0xffe4840b maf _REC_AXS_20_u1 1389. _CNV_A_R_LINEAR_____27_CM 8 0. 1389. DISPLAY_IDENTIFIER LDPM_MAF_HB_LS_UP_DYN FORMAT "%4.0" /end AXIS_PTS
/begin MEASUREMENT lv_lamb_puls_dyn_diag "Request forced stimulation parameters specific for the WRAF sensor dynamic" UBYTE _CNV_S_2_RANGE______1_R_CM 1 100. 0. 255. DISPLAY_IDENTIFIER LV_LAMB_PULS_DYN_DIAG ECU_ADDRESS 0x3fea74 /end MEASUREMENT
/begin MEASUREMENT lv_pv_diag_cdn_lam_out "boolean flag indicating the pedal value dynamic is not too high " UBYTE _CNV_S_2_RANGE______2_CM 1 100. 0. 1. DISPLAY_IDENTIFIER LV_PV_DIAG_CDN_LAM_OUT ECU_ADDRESS 0x3fea76 /end MEASUREMENT
/begin MEASUREMENT pv_av_grd_sum_diag_lam_out "summe of pedal value gradient" UWORD _CNV_A_R_LINEAR_____318_CM 1 100. 0. 639990.2340000001 DISPLAY_IDENTIFIER PV_AV_GRD_SUM_DIAG_LAM_OUT ECU_ADDRESS 0x3fdc0e BYTE_ORDER MSB_LAST FORMAT "%8.1" /end MEASUREMENT
/begin MEASUREMENT t_pv_av_grd_dec_diag_lam_out "timer to decrement pedal value gradient summe" UBYTE _CNV_A_R_LINEAR_____198_CM 1 100. 0. 5.1 DISPLAY_IDENTIFIER T_PV_AV_GRD_DEC_DIAG_LAM_OUT ECU_ADDRESS 0x3fea75 FORMAT "%4.2" /end MEASUREMENT
/begin CHARACTERISTIC c_ti_lam_max_thd_diag_lam_out "maximum threshold to detect the upper part of a ti_lam_cor_i fluctuation." VALUE 0xffe4049e _REC_VAL_20_s2 99.99847412 _CNV_A_R_LINEAR_____111_CM -50. 49.99847412 DISPLAY_IDENTIFIER C_TI_LAM_MAX_THD_DIAG_LAM_OUT FORMAT "%5.4" /end CHARACTERISTIC
/begin CHARACTERISTIC c_t_sum_rst_diag_lam_out "time window to carry out a diagnostic" VALUE 0xffe419fe _REC_VAL_20_u2 1310.7 _CNV_A_R_LINEAR_____198_CM 0. 1310.7 DISPLAY_IDENTIFIER C_T_SUM_RST_DIAG_LAM_OUT FORMAT "%7.2" /end CHARACTERISTIC
/begin CHARACTERISTIC c_ctr_diag_sym_lam_out "counter for the fluctuation of ti_lam_cor exceeding the min/max thresholds" VALUE 0xffe406ad _REC_VAL_20_u1 255. _CNV_A_R_LINEAR_____0_CM 0. 255. DISPLAY_IDENTIFIER C_CTR_DIAG_SYM_LAM_OUT FORMAT "%3.0" /end CHARACTERISTIC
/begin CHARACTERISTIC c_pv_av_grd_min_diag_lam_out "minimum value of pv_av gradient to increment pv_av_grd_diag_lam_out" VALUE 0xffe40823 _REC_VAL_20_u1 2490.234 _CNV_A_R_LINEAR_____358_CM 0. 2490.234 DISPLAY_IDENTIFIER C_PV_AV_GRD_MIN_DIAG_LAM_OUT FORMAT "%6.1" /end CHARACTERISTIC
/begin CHARACTERISTIC c_t_pv_av_grd_dec_diag_lam_out "time periods for calculation limited dynamic pv_av gradient" VALUE 0xffe408c6 _REC_VAL_20_u1 5.1 _CNV_A_R_LINEAR_____198_CM 0. 5.1 DISPLAY_IDENTIFIER C_T_PV_AV_GRD_DEC_DIAG_LAM_OUT FORMAT "%4.2" /end CHARACTERISTIC
/begin CHARACTERISTIC c_pv_av_grd_dec_diag_lam_out "decrement for calculation pv_av gradient" VALUE 0xffe40821 _REC_VAL_20_u1 2490.234 _CNV_A_R_LINEAR_____358_CM 0. 2490.234 DISPLAY_IDENTIFIER C_PV_AV_GRD_DEC_DIAG_LAM_OUT FORMAT "%6.1" /end CHARACTERISTIC
/begin CHARACTERISTIC c_pv_av_grd_sum_diag_lam_out "max threshold limited dynamic  pv_av gradient" VALUE 0xffe41884 _REC_VAL_20_u2 639990.2340000001 _CNV_A_R_LINEAR_____318_CM 0. 639990.2340000001 DISPLAY_IDENTIFIER C_PV_AV_GRD_SUM_DIAG_LAM_OUT FORMAT "%8.1" /end CHARACTERISTIC
/begin CHARACTERISTIC c_ti_lam_min_thd_diag_lam_out "minimum threshold to detect the lower part of a ti_lam_cor_i fluctuation." VALUE 0xffe404a0 _REC_VAL_20_s2 99.99847412 _CNV_A_R_LINEAR_____111_CM -50. 49.99847412 DISPLAY_IDENTIFIER C_TI_LAM_MIN_THD_DIAG_LAM_OUT FORMAT "%5.4" /end CHARACTERISTIC
/begin CHARACTERISTIC lc_inh_man_diag_lam_out "manual inhibition of this diagnostic " VALUE 0xffe40f81 _REC_VAL_20_u1 1. _CNV_S_2_RANGE______2_CM 0. 1. DISPLAY_IDENTIFIER LC_INH_MAN_DIAG_LAM_OUT /end CHARACTERISTIC
/begin MEASUREMENT lv_err_sa_sap "Present failure: Minimum secondary air flow rate failure after filtering" UBYTE _CNV_S_2_RANGE______1_R_CM 1 100. 0. 255. DISPLAY_IDENTIFIER LV_ERR_SA_SAP ECU_ADDRESS 0x3fba18 /end MEASUREMENT
/begin MEASUREMENT lv_err_sa_sav "Present failure: Mechanical jammed SAV after filtering" UBYTE _CNV_S_2_RANGE______1_R_CM 1 100. 0. 255. DISPLAY_IDENTIFIER LV_ERR_SA_SAV ECU_ADDRESS 0x3fba20 /end MEASUREMENT
/begin CHARACTERISTIC c_frc_obd2_lsh_up "Fault detection threshold, when exceeded, heater is determined to be defective during driving cycle" VALUE 0xffe41664 _REC_VAL_20_u2 1023. _CNV_A_R_LINEAR_____22_CM 0. 1023. DISPLAY_IDENTIFIER C_FRC_OBD2_LSH_UP FORMAT "%4.0" /end CHARACTERISTIC
/begin MEASUREMENT lv_inh_diag_lsl_plaus_1 "Deactivation of \"Plausibility check of the sensor signal\"" UBYTE _CNV_S_2_RANGE______2_CM 1 100. 0. 1. DISPLAY_IDENTIFIER LV_INH_DIAG_LSL_PLAUS_1 ECU_ADDRESS 0x3fea60 /end MEASUREMENT
/begin MEASUREMENT lv_inh_diag_lsl_plaus_2 "Deactivation of \"Plausibility check of the sensor signal\"" UBYTE _CNV_S_2_RANGE______2_CM 1 100. 0. 1. DISPLAY_IDENTIFIER LV_INH_DIAG_LSL_PLAUS_2 ECU_ADDRESS 0x3fea67 BIT_MASK 0x1 /end MEASUREMENT
/begin MEASUREMENT lv_inh_diag_st_ls_2 "Inhibition of false start recognition  diagnosis" UBYTE _CNV_S_2_RANGE______21_CM 1 100. 0. 1. DISPLAY_IDENTIFIER LV_INH_DIAG_ST_LS_2 ECU_ADDRESS 0x3fea66 /end MEASUREMENT
/begin MEASUREMENT lv_inh_diag_st_ls_1 "Inhibition of false start recognition  diagnosis" UBYTE _CNV_S_2_RANGE______21_CM 1 100. 0. 1. DISPLAY_IDENTIFIER LV_INH_DIAG_ST_LS_1 ECU_ADDRESS 0x3fea5f /end MEASUREMENT
/begin MEASUREMENT lv_inh_diag_lsh_ls_up_2 "Deactivation of \"Diagnosis of the Heater Coupling in the Sensor Signal\"" UBYTE _CNV_S_2_RANGE______21_CM 1 100. 0. 1. DISPLAY_IDENTIFIER LV_INH_DIAG_LSH_LS_UP_2 ECU_ADDRESS 0x3fea68 /end MEASUREMENT
/begin MEASUREMENT lv_inh_diag_lsh_ls_up_1 "Deactivation of \"Diagnosis of the Heater Coupling in the Sensor Signal\"" UBYTE _CNV_S_2_RANGE______21_CM 1 100. 0. 1. DISPLAY_IDENTIFIER LV_INH_DIAG_LSH_LS_UP_1 ECU_ADDRESS 0x3fea61 /end MEASUREMENT
/begin MEASUREMENT lv_inh_diag_ls_up_dyn_2 "Deactivation of \"Diagnosis of the WRAF Sensor Dynamic\"" UBYTE _CNV_S_2_RANGE______21_CM 1 100. 0. 1. DISPLAY_IDENTIFIER LV_INH_DIAG_LS_UP_DYN_2 ECU_ADDRESS 0x3fea69 /end MEASUREMENT
/begin MEASUREMENT lv_ls_diag_ext_req_1 "Activation by short test" UBYTE _CNV_S_2_RANGE______21_CM 1 100. 0. 1. DISPLAY_IDENTIFIER LV_LS_DIAG_EXT_REQ_1 ECU_ADDRESS 0x3fea65 /end MEASUREMENT
/begin MEASUREMENT lv_ls_diag_ext_req_2 "Activation by short test" UBYTE _CNV_S_2_RANGE______21_CM 1 100. 0. 1. DISPLAY_IDENTIFIER LV_LS_DIAG_EXT_REQ_2 ECU_ADDRESS 0x3fea6c /end MEASUREMENT
/begin MEASUREMENT lv_inh_diag_ls_up_dyn_1 "Deactivation of \"Diagnosis of the WRAF Sensor Dynamic\"" UBYTE _CNV_S_2_RANGE______21_CM 1 100. 0. 1. DISPLAY_IDENTIFIER LV_INH_DIAG_LS_UP_DYN_1 ECU_ADDRESS 0x3fea62 /end MEASUREMENT
/begin MEASUREMENT lv_inh_diag_vls_up_thd_over_2 "Deactivation of \"Monitoring Upstream Sensor Signal \"" UBYTE _CNV_S_2_RANGE______21_CM 1 100. 0. 1. DISPLAY_IDENTIFIER LV_INH_DIAG_VLS_UP_THD_OVER_2 ECU_ADDRESS 0x3fea6b /end MEASUREMENT
/begin MEASUREMENT lv_inh_diag_vls_up_thd_over_1 "Deactivation of \"Monitoring Upstream Sensor Signal \"" UBYTE _CNV_S_2_RANGE______21_CM 1 100. 0. 1. DISPLAY_IDENTIFIER LV_INH_DIAG_VLS_UP_THD_OVER_1 ECU_ADDRESS 0x3fea64 /end MEASUREMENT
/begin MEASUREMENT lv_inh_diag_plaus_ls_up_puc_1 "Deactivation of \"Monitoring Upstream Sensor Signal during PUC\"" UBYTE _CNV_S_2_RANGE______21_CM 1 100. 0. 1. DISPLAY_IDENTIFIER LV_INH_DIAG_PLAUS_LS_UP_PUC_1 ECU_ADDRESS 0x3fea63 /end MEASUREMENT
/begin MEASUREMENT lv_inh_diag_plaus_ls_up_puc_2 "Deactivation of \"Monitoring Upstream Sensor Signal during PUC\"" UBYTE _CNV_S_2_RANGE______21_CM 1 100. 0. 1. DISPLAY_IDENTIFIER LV_INH_DIAG_PLAUS_LS_UP_PUC_2 ECU_ADDRESS 0x3fea6a /end MEASUREMENT
/begin CHARACTERISTIC c_map_drv1_max_load_tps_plaus "" VALUE 0xffe40450 _REC_VAL_20_s2 165.8 _CNV_A_R_LINEAR_____260_CM -82.90000000000001 82.90000000000001 DISPLAY_IDENTIFIER C_MAP_DRV1_MAX_LOAD_TPS_PLAUS FORMAT "%7.3" /end CHARACTERISTIC
/begin CHARACTERISTIC c_map_drv1_min_load_tps_plaus "" VALUE 0xffe40452 _REC_VAL_20_s2 165.8 _CNV_A_R_LINEAR_____260_CM -82.90000000000001 82.90000000000001 DISPLAY_IDENTIFIER C_MAP_DRV1_MIN_LOAD_TPS_PLAUS FORMAT "%7.3" /end CHARACTERISTIC
/begin CHARACTERISTIC c_n_max_load_tps_plaus "" VALUE 0xffe41822 _REC_VAL_20_u2 8160. _CNV_A_R_LINEAR_____10_CM 0. 8160. DISPLAY_IDENTIFIER C_N_MAX_LOAD_TPS_PLAUS FORMAT "%4.0" /end CHARACTERISTIC
/begin CHARACTERISTIC c_n_min_load_tps_plaus "" VALUE 0xffe4182c _REC_VAL_20_u2 8160. _CNV_A_R_LINEAR_____10_CM 0. 8160. DISPLAY_IDENTIFIER C_N_MIN_LOAD_TPS_PLAUS FORMAT "%4.0" /end CHARACTERISTIC
/begin MEASUREMENT lv_amp_ctl_rst "Control bit for resetting of pressure controller" UBYTE _CNV_S_2_RANGE______2_CM 1 100. 0. 1. DISPLAY_IDENTIFIER LV_AMP_CTL_RST ECU_ADDRESS 0x3fea6d BIT_MASK 0x1 /end MEASUREMENT
/begin MEASUREMENT lv_ar_red_ctl_rst "Control bit for resetting of reduced area controller" UBYTE _CNV_S_2_RANGE______2_CM 1 100. 0. 1. DISPLAY_IDENTIFIER LV_AR_RED_CTL_RST ECU_ADDRESS 0x3fea6e BIT_MASK 0x1 /end MEASUREMENT
/begin MEASUREMENT lv_ratio_chk_err "Boolean for actual value MAF or TPS ratio check is present" UBYTE _CNV_S_2_RANGE______2_CM 1 100. 0. 1. DISPLAY_IDENTIFIER LV_RATIO_CHK_ERR ECU_ADDRESS 0x3fea6f BIT_MASK 0x1 /end MEASUREMENT
/begin CHARACTERISTIC c_amp_mdl_dif_max "Upper threshold for pressure controller plausibility check" VALUE 0xffe403ae _REC_VAL_20_s2 5434. _CNV_A_R_LINEAR_____110_CM -2717.04 2716.96 DISPLAY_IDENTIFIER C_AMP_MDL_DIF_MAX FORMAT "%8.2" /end CHARACTERISTIC
/begin CHARACTERISTIC c_amp_mdl_dif_min "Lower threshold for pressure controller plausibility check" VALUE 0xffe403b0 _REC_VAL_20_s2 5434. _CNV_A_R_LINEAR_____110_CM -2717.04 2716.96 DISPLAY_IDENTIFIER C_AMP_MDL_DIF_MIN FORMAT "%8.2" /end CHARACTERISTIC
/begin CHARACTERISTIC c_crlc_maf_dif_hfm_mmv "Constant for MAF_DIF_MFM filtering" VALUE 0xffe40686 _REC_VAL_20_u1 0.9960940000000002 _CNV_A_R_LINEAR_____50_CM 0. 0.996094 DISPLAY_IDENTIFIER C_CRLC_MAF_DIF_HFM_MMV FORMAT "%5.3" /end CHARACTERISTIC
/begin CHARACTERISTIC c_pq_maf_plaus "Treshold for switching off the diagnosis" VALUE 0xffe41874 _REC_VAL_20_u2 0.9999847 _CNV_A_R_LINEAR_____357_CM 0. 0.9999847 DISPLAY_IDENTIFIER C_PQ_MAF_PLAUS FORMAT "%7.5" /end CHARACTERISTIC
/begin CHARACTERISTIC c_maf_dif_hfm_mdl_mmv "Threshold  for detecting to high difference between air mass differences" VALUE 0xffe41738 _REC_VAL_20_u2 2047.96875 _CNV_A_R_LINEAR_____115_CM 0. 2047.96875 DISPLAY_IDENTIFIER C_MAF_DIF_HFM_MDL_MMV FORMAT "%7.2" /end CHARACTERISTIC
/begin CHARACTERISTIC c_maf_turb_ratio_min_isa_check "Threshold for detecting ISA error" VALUE 0xffe40797 _REC_VAL_20_u1 0.9960940000000002 _CNV_A_R_LINEAR_____50_CM 0. 0.996094 DISPLAY_IDENTIFIER C_MAF_TURB_RATIO_MIN_ISA_CHECK FORMAT "%5.3" /end CHARACTERISTIC
/begin CHARACTERISTIC c_t_err_isa_amp_plaus "Threshold to distinguish between ISA and AMP error" VALUE 0xffe40898 _REC_VAL_20_u1 25.5 _CNV_A_R_LINEAR_____24_CM 0. 25.5 DISPLAY_IDENTIFIER C_T_ERR_ISA_AMP_PLAUS FORMAT "%4.1" /end CHARACTERISTIC
/begin MEASUREMENT ar_red_tot_bas "Sum of AR_RED_BAS and AR_RED_ISA_BAS" UWORD _CNV_A_R_LINEAR_____382_CM 1 100. 0. 58.592855 DISPLAY_IDENTIFIER AR_RED_TOT_BAS ECU_ADDRESS 0x3fdc00 BYTE_ORDER MSB_LAST FORMAT "%7.4" /end MEASUREMENT
/begin CHARACTERISTIC ip_ar_red_dif_max "Maximum basic reduced opening area at the throttle and at ISA for detecting error" CURVE 0xffe48f18 _REC_CUR_20_u2_u2 99.99847412 _CNV_A_R_LINEAR_____262_CM -50. 49.99847412 DISPLAY_IDENTIFIER IP_AR_RED_DIF_MAX FORMAT "%7.3"
 /begin AXIS_DESCR COM_AXIS ar_red_tot_bas _CNV_A_R_LINEAR_____382_CM 6 0. 58.592855 FORMAT "%7.4" AXIS_PTS_REF ldpm_ar_red_tot_bas /end AXIS_DESCR
/end CHARACTERISTIC
/begin CHARACTERISTIC ip_ar_red_dif_min "Minimum basic reduced opening area at the throttle and ISA for detecting error" CURVE 0xffe48f24 _REC_CUR_20_u2_u2 99.99847412 _CNV_A_R_LINEAR_____262_CM -50. 49.99847412 DISPLAY_IDENTIFIER IP_AR_RED_DIF_MIN FORMAT "%7.3"
 /begin AXIS_DESCR COM_AXIS ar_red_tot_bas _CNV_A_R_LINEAR_____382_CM 6 0. 58.592855 FORMAT "%7.4" AXIS_PTS_REF ldpm_ar_red_tot_bas /end AXIS_DESCR
/end CHARACTERISTIC
/begin MEASUREMENT lv_sym_load "Load difference exists" UBYTE _CNV_A_R_LINEAR_____22_CM 1 100. 0. 1. DISPLAY_IDENTIFIER LV_SYM_LOAD ECU_ADDRESS 0x3fea73 FORMAT "%1.0" /end MEASUREMENT
/begin MEASUREMENT maf_kgh_mff "Mass air flow calculated out of mass fuel flow" UWORD _CNV_A_R_LINEAR_____115_CM 1 100. 0. 2047.96875 DISPLAY_IDENTIFIER MAF_KGH_MFF ECU_ADDRESS 0x3fdc02 BYTE_ORDER MSB_LAST FORMAT "%7.2" /end MEASUREMENT
/begin MEASUREMENT maf_thr_opl "Mass air flow at Throttle without adjusting on HFM" UWORD _CNV_A_R_LINEAR_____115_CM 1 100. 0. 2047.96875 DISPLAY_IDENTIFIER MAF_THR_OPL ECU_ADDRESS 0x3fdc04 BYTE_ORDER MSB_LAST FORMAT "%7.2" /end MEASUREMENT
/begin MEASUREMENT maf_isa_opl "Mass air flow at ISA without adjusting on HFM" UWORD _CNV_A_R_LINEAR_____115_CM 1 100. 0. 2047.96875 DISPLAY_IDENTIFIER MAF_ISA_OPL ECU_ADDRESS 0x3fdc06 BYTE_ORDER MSB_LAST FORMAT "%7.2" /end MEASUREMENT
/begin MEASUREMENT maf_thr_isa_tot_opl "Mass air flow without adjusting on HFM" UWORD _CNV_A_R_LINEAR_____115_CM 1 100. 0. 2047.96875 DISPLAY_IDENTIFIER MAF_THR_ISA_TOT_OPL ECU_ADDRESS 0x3fdc08 BYTE_ORDER MSB_LAST FORMAT "%7.2" /end MEASUREMENT
/begin MEASUREMENT maf_dif_hfm_mmv "Filtered difference between MAF_KGH_MFF and MAF_KGH_MES" SWORD _CNV_A_R_LINEAR_____115_CM 1 100. -1024. 1023.96875 DISPLAY_IDENTIFIER MAF_DIF_HFM_MMV ECU_ADDRESS 0x3fdc0a BYTE_ORDER MSB_LAST FORMAT "%8.2" /end MEASUREMENT
/begin MEASUREMENT maf_dif_mdl_mmv "Filtered difference between MAF_KGH_MFF and MAF_THR_ISA_TOT_OPL" SWORD _CNV_A_R_LINEAR_____115_CM 1 100. -1024. 1023.96875 DISPLAY_IDENTIFIER MAF_DIF_MDL_MMV ECU_ADDRESS 0x3fdc0c BYTE_ORDER MSB_LAST FORMAT "%8.2" /end MEASUREMENT
/begin MEASUREMENT t_err_isa_plaus "Timer for detecting ISA error" UBYTE _CNV_A_R_LINEAR_____24_CM 1 100. 0. 25.5 DISPLAY_IDENTIFIER T_ERR_ISA_PLAUS ECU_ADDRESS 0x3fea70 FORMAT "%4.1" /end MEASUREMENT
/begin MEASUREMENT t_err_amp_plaus "Timer for detecting AMP error" UBYTE _CNV_A_R_LINEAR_____24_CM 1 100. 0. 25.5 DISPLAY_IDENTIFIER T_ERR_AMP_PLAUS ECU_ADDRESS 0x3fea71 FORMAT "%4.1" /end MEASUREMENT
/begin AXIS_PTS ldpm_ar_red_tot_bas "" 0xffe51744 ar_red_tot_bas _REC_AXS_20_u2 58.592855 _CNV_A_R_LINEAR_____382_CM 6 0. 58.592855 DISPLAY_IDENTIFIER LDPM_AR_RED_TOT_BAS FORMAT "%7.4" /end AXIS_PTS
/begin CHARACTERISTIC c_crlc_maf_dif_mdl_mmv "Constant for MAF_DIF_MDL filtering" VALUE 0xffe40687 _REC_VAL_20_u1 0.9960940000000002 _CNV_A_R_LINEAR_____50_CM 0. 0.996094 DISPLAY_IDENTIFIER C_CRLC_MAF_DIF_MDL_MMV FORMAT "%5.3" /end CHARACTERISTIC
/begin CHARACTERISTIC c_tcc_obd2_ttip_ls_up " Number of valid diagnosis cycles over which statistical eveluation is to be carried out " VALUE 0xffe41a30 _REC_VAL_20_u2 65535. _CNV_A_R_LINEAR_____0_CM 0. 65535. DISPLAY_IDENTIFIER C_TCC_OBD2_TTIP_LS_UP FORMAT "%5.0" /end CHARACTERISTIC
/begin CHARACTERISTIC c_frc_obd2_ttip_ls_up " Fault detection threshold,when exceeded,ceramic temperature determined to be defective " VALUE 0xffe41666 _REC_VAL_20_u2 65535. _CNV_A_R_LINEAR_____0_CM 0. 65535. DISPLAY_IDENTIFIER C_FRC_OBD2_TTIP_LS_UP FORMAT "%5.0" /end CHARACTERISTIC
/begin CHARACTERISTIC lc_rep_obd2_ttip_ls_up " Logical constant permitting diagnosis to be repeated within one driving cycle " VALUE 0xffe40fcf _REC_VAL_20_u1 1. _CNV_A_R_LINEAR_____22_CM 0. 1. DISPLAY_IDENTIFIER LC_REP_OBD2_TTIP_LS_UP FORMAT "%1.0" /end CHARACTERISTIC
/begin CHARACTERISTIC lc_obd2_ttip_ls_up " Logical constant permitting diagnosis to be carried out " VALUE 0xffe40fc4 _REC_VAL_20_u1 1. _CNV_A_R_LINEAR_____22_CM 0. 1. DISPLAY_IDENTIFIER LC_OBD2_TTIP_LS_UP FORMAT "%1.0" /end CHARACTERISTIC
/begin MEASUREMENT v_temp_ls_up_mes_ofs_obd2_1 " offset voltage of internal resistance determination circuit in mes mode " UWORD _CNV_A_R_LINEAR_____306_CM 1 100. 0. 4.995 DISPLAY_IDENTIFIER V_TEMP_LS_UP_MES_OFS_OBD2_1 ECU_ADDRESS 0x3fdc10 BYTE_ORDER MSB_LAST FORMAT "%5.3" /end MEASUREMENT
/begin MEASUREMENT v_temp_ls_up_adj_ofs_obd2_1 " offset voltage of internal resistance determination circuit in adj mode " UWORD _CNV_A_R_LINEAR_____306_CM 1 100. 0. 4.995 DISPLAY_IDENTIFIER V_TEMP_LS_UP_ADJ_OFS_OBD2_1 ECU_ADDRESS 0x3fdc12 BYTE_ORDER MSB_LAST FORMAT "%5.3" /end MEASUREMENT
/begin MEASUREMENT gain_temp_ls_up_obd2_1 " gain of O2 sensor internal resistance determination circuit " UWORD _CNV_A_R_LINEAR_____307_CM 1 100. 0. 19.99969 DISPLAY_IDENTIFIER GAIN_TEMP_LS_UP_OBD2_1 ECU_ADDRESS 0x3fdc14 BYTE_ORDER MSB_LAST FORMAT "%7.4" /end MEASUREMENT
/begin MEASUREMENT v_temp_ls_up_adj_ofs_obd2_2 " offset voltage of internal resistance determination circuit in adj mode " UWORD _CNV_A_R_LINEAR_____306_CM 1 100. 0. 4.995 DISPLAY_IDENTIFIER V_TEMP_LS_UP_ADJ_OFS_OBD2_2 ECU_ADDRESS 0x3fdc18 BYTE_ORDER MSB_LAST FORMAT "%5.3" /end MEASUREMENT
/begin MEASUREMENT gain_temp_ls_up_obd2_2 " gain of O2 sensor internal resistance determination circuit " UWORD _CNV_A_R_LINEAR_____307_CM 1 100. 0. 19.99969 DISPLAY_IDENTIFIER GAIN_TEMP_LS_UP_OBD2_2 ECU_ADDRESS 0x3fdc1a BYTE_ORDER MSB_LAST FORMAT "%7.4" /end MEASUREMENT
/begin MEASUREMENT v_temp_ls_up_mes_ofs_obd2_2 " offset voltage of internal resistance determination circuit in mes mode " UWORD _CNV_A_R_LINEAR_____306_CM 1 100. 0. 4.995 DISPLAY_IDENTIFIER V_TEMP_LS_UP_MES_OFS_OBD2_2 ECU_ADDRESS 0x3fdc16 BYTE_ORDER MSB_LAST FORMAT "%5.3" /end MEASUREMENT
/begin MEASUREMENT lv_rep_obd2_ttip_ls_up_1 "flag interface to ceramic temperature function to reset counters, indicates diagnosis complete" UBYTE _CNV_A_R_LINEAR_____22_CM 1 100. 0. 1. DISPLAY_IDENTIFIER LV_REP_OBD2_TTIP_LS_UP_1 ECU_ADDRESS 0x3fea79 FORMAT "%1.0" /end MEASUREMENT
/begin MEASUREMENT lv_rep_obd2_ttip_ls_up_2 "flag interface to ceramic temperature function to reset counters, indicates diagnosis complete      " UBYTE _CNV_A_R_LINEAR_____22_CM 1 100. 0. 1. DISPLAY_IDENTIFIER LV_REP_OBD2_TTIP_LS_UP_2 ECU_ADDRESS 0x3fea7a FORMAT "%1.0" /end MEASUREMENT
/begin MEASUREMENT sum_afl_vls_diag_sa_2 "Lean indication counter cylinder group 2" UWORD _CNV_A_R_LINEAR_____0_CM 1 100. 0. 65535. DISPLAY_IDENTIFIER SUM_AFL_VLS_DIAG_SA_2 ECU_ADDRESS 0x3fd67c BYTE_ORDER MSB_LAST FORMAT "%5.0" /end MEASUREMENT
/begin MEASUREMENT t_dly_diag_sa "Time delay after secondary air activation to start the SA monitoring" UWORD _CNV_A_R_LINEAR_____364_CM 1 100. 0. 655.3200000000001 DISPLAY_IDENTIFIER T_DLY_DIAG_SA ECU_ADDRESS 0x3fd67e BYTE_ORDER MSB_LAST FORMAT "%6.2" /end MEASUREMENT
/begin MEASUREMENT t_diag_sa "Timer for duration of Minimum air flow monitoring" UWORD _CNV_A_R_LINEAR_____364_CM 1 100. 0. 655.3200000000001 DISPLAY_IDENTIFIER T_DIAG_SA ECU_ADDRESS 0x3fd674 BYTE_ORDER MSB_LAST FORMAT "%6.2" /end MEASUREMENT
/begin MEASUREMENT lam_diag_sav_max "Maximum LAM-value during SAV check with LAM threshold exceed" SWORD _CNV_A_R_LINEAR_____111_CM 1 100. -50. 49.99847412 DISPLAY_IDENTIFIER LAM_DIAG_SAV_MAX ECU_ADDRESS 0x3fd68c BYTE_ORDER MSB_LAST FORMAT "%7.3" /end MEASUREMENT
/begin CHARACTERISTIC id_t_dly_diag_sa "Time after START  to start the SA diagnosis" CURVE 0xffe48da0 _REC_CUR_20_u2_u1 654.99 _CNV_A_R_LINEAR_____457_CM 1.e-002 655. DISPLAY_IDENTIFIER ID_T_DLY_DIAG_SA FORMAT "%7.3"
 /begin AXIS_DESCR COM_AXIS tco_st _CNV_A_R_LINEAR_____11_CM 8 -48. 142.5 FORMAT "%5.1" AXIS_PTS_REF ldp_tco_st_id_t_dly_diag_sa /end AXIS_DESCR
/end CHARACTERISTIC
/begin CHARACTERISTIC c_sum_afl_vls_min_diag_sa "Lean indication threshold for Monitoring of minimum flow rate" VALUE 0xffe418b4 _REC_VAL_20_u2 65535. _CNV_A_R_LINEAR_____0_CM 0. 65535. DISPLAY_IDENTIFIER C_SUM_AFL_VLS_MIN_DIAG_SA FORMAT "%5.0" /end CHARACTERISTIC
/begin CHARACTERISTIC c_t_diag_sa "Maximum duration for Monitoring of minimum flow rate" VALUE 0xffe418fc _REC_VAL_20_u2 655.3200000000001 _CNV_A_R_LINEAR_____364_CM 0. 655.3200000000001 DISPLAY_IDENTIFIER C_T_DIAG_SA FORMAT "%6.2" /end CHARACTERISTIC
/begin CHARACTERISTIC c_conf_diag_sav "Configuration byte for activation of the SAV diagnosis" VALUE 0xffe40657 _REC_VAL_20_u1 10. _CNV_S_7_RANGE_C_CO_458_CM 0. 10. DISPLAY_IDENTIFIER C_CONF_DIAG_SAV /end CHARACTERISTIC
/begin MEASUREMENT lv_sap_cnl "SAP break-off in case of  mechanically jammed SAV before plausibility check" UBYTE _CNV_S_2_RANGE______2_CM 1 100. 0. 1. DISPLAY_IDENTIFIER LV_SAP_CNL ECU_ADDRESS 0x3fe631 /end MEASUREMENT
/begin MEASUREMENT state_diag_sa_ls "State_SA diagnosis" UBYTE _CNV_S_9_STATE_DIAG_459_CM 1 100. 0. 8. DISPLAY_IDENTIFIER STATE_DIAG_SA_LS ECU_ADDRESS 0x3fe62f /end MEASUREMENT
/begin AXIS_PTS ldp_tco_st_id_t_dly_diag_sa "" 0xffe48278 tco_st _REC_AXS_20_u1 190.5 _CNV_A_R_LINEAR_____11_CM 8 -48. 142.5 DISPLAY_IDENTIFIER LDP_TCO_ST_ID_T_DLY_DIAG_SA FORMAT "%5.1" /end AXIS_PTS
/begin MEASUREMENT t_dly_intr_diag_sa "Time delay after secair interrupt to continue the SA monitoring" UBYTE _CNV_A_R_LINEAR_____24_CM 1 100. 0. 25.5 DISPLAY_IDENTIFIER T_DLY_INTR_DIAG_SA ECU_ADDRESS 0x3fe630 FORMAT "%4.1" /end MEASUREMENT
/begin CHARACTERISTIC c_t_dly_intr_diag_sa "Time delay after leaving the STATE_SA = INTERRUPT to continue the SA monitoring" VALUE 0xffe4087c _REC_VAL_20_u1 25.5 _CNV_A_R_LINEAR_____24_CM 0. 25.5 DISPLAY_IDENTIFIER C_T_DLY_INTR_DIAG_SA FORMAT "%4.1" /end CHARACTERISTIC
/begin MEASUREMENT sum_afl_vls_diag_sa_1 "Lean indication counter cylinder group 1" UWORD _CNV_A_R_LINEAR_____0_CM 1 100. 0. 65535. DISPLAY_IDENTIFIER SUM_AFL_VLS_DIAG_SA_1 ECU_ADDRESS 0x3fd67a BYTE_ORDER MSB_LAST FORMAT "%5.0" /end MEASUREMENT
/begin MEASUREMENT sum_afl_vls_diag_sa_1_sae "Lean indication counter cylinder group 1 for the mode 6" UWORD _CNV_A_R_LINEAR_____0_CM 1 100. 0. 65535. DISPLAY_IDENTIFIER SUM_AFL_VLS_DIAG_SA_1_SAE ECU_ADDRESS 0x3fd676 BYTE_ORDER MSB_LAST FORMAT "%5.0" /end MEASUREMENT
/begin MEASUREMENT sum_afl_vls_diag_sa_2_sae "Lean indication counter cylinder group 2 for the mode 6" UWORD _CNV_A_R_LINEAR_____0_CM 1 100. 0. 65535. DISPLAY_IDENTIFIER SUM_AFL_VLS_DIAG_SA_2_SAE ECU_ADDRESS 0x3fd678 BYTE_ORDER MSB_LAST FORMAT "%5.0" /end MEASUREMENT
/begin CHARACTERISTIC c_ctr_p_diag_sa_sav "Nr. of P-jumps (lambda period = 2 \"P\" -jumps) for the SAV-diagnosis" VALUE 0xffe41588 _REC_VAL_20_u2 65535. _CNV_A_R_LINEAR_____0_CM 0. 65535. DISPLAY_IDENTIFIER C_CTR_P_DIAG_SA_SAV FORMAT "%5.0" /end CHARACTERISTIC
/begin CHARACTERISTIC c_lam_thd_diag_sav "LAM-threshold for SAV diagnosis" VALUE 0xffe416a4 _REC_VAL_20_u2 49.99850082 _CNV_A_R_LINEAR_____270_CM 0. 49.99850082 DISPLAY_IDENTIFIER C_LAM_THD_DIAG_SAV FORMAT "%7.3" /end CHARACTERISTIC
/begin CHARACTERISTIC c_ctr_p_diag_sa_sap "Nr. of P-jumps (lambda period = 2 \"P\" -jumps) to  weighten diagnosis results with exceed of the LAM-threshold  " VALUE 0xffe41586 _REC_VAL_20_u2 65535. _CNV_A_R_LINEAR_____0_CM 0. 65535. DISPLAY_IDENTIFIER C_CTR_P_DIAG_SA_SAP FORMAT "%5.0" /end CHARACTERISTIC
/begin MEASUREMENT lam_mv_diag_sav "Mean LAM-value during SAV check with active lambda control" SWORD _CNV_A_R_LINEAR_____111_CM 1 100. -50. 49.99847412 DISPLAY_IDENTIFIER LAM_MV_DIAG_SAV ECU_ADDRESS 0x3fd68e BYTE_ORDER MSB_LAST FORMAT "%7.3" /end MEASUREMENT
/begin MEASUREMENT ctr_p_diag_sa_sap_2 "actual P-jumps Bank2 (lambda period = 2 \"P\"-jumps) for the SAP diagnosis" UWORD _CNV_A_R_LINEAR_____0_CM 1 100. 0. 65535. DISPLAY_IDENTIFIER CTR_P_DIAG_SA_SAP_2 ECU_ADDRESS 0x3fd696 BYTE_ORDER MSB_LAST FORMAT "%5.0" /end MEASUREMENT
/begin MEASUREMENT ctr_p_diag_sa_sap_1 "actual P-jumps Bank1 (lambda period = 2 \"P\"-jumps) for the SAP diagnosis" UWORD _CNV_A_R_LINEAR_____0_CM 1 100. 0. 65535. DISPLAY_IDENTIFIER CTR_P_DIAG_SA_SAP_1 ECU_ADDRESS 0x3fd686 BYTE_ORDER MSB_LAST FORMAT "%5.0" /end MEASUREMENT
/begin MEASUREMENT ctr_p_diag_sa_sav "actual P-jumps Bank1 (lambda period = 2 \"P\"-jumps) for the SAV diagnosis" UWORD _CNV_A_R_LINEAR_____0_CM 1 100. 0. 65535. DISPLAY_IDENTIFIER CTR_P_DIAG_SA_SAV ECU_ADDRESS 0x3fd684 BYTE_ORDER MSB_LAST FORMAT "%5.0" /end MEASUREMENT
/begin MEASUREMENT lv_sa_min_flow_diag "State Minimum secondary air flow rate diagnosis condition" UBYTE _CNV_S_2_RANGE______192_CM 1 100. 0. 1. DISPLAY_IDENTIFIER LV_SA_MIN_FLOW_DIAG ECU_ADDRESS 0x3fe632 BIT_MASK 0x1 /end MEASUREMENT
/begin MEASUREMENT lv_sa_min_flow_diag_eol "Minimum secondary air flow rate diagnosis is finished" UBYTE _CNV_S_2_RANGE______192_CM 1 100. 0. 1. DISPLAY_IDENTIFIER LV_SA_MIN_FLOW_DIAG_EOL ECU_ADDRESS 0x3fe633 BIT_MASK 0x1 /end MEASUREMENT
/begin MEASUREMENT lv_inh_diag_sa "Secondary air system diagnosis: application incidence to inhibit the diagnosis" UBYTE _CNV_S_2_RANGE______2_CM 1 100. 0. 1. DISPLAY_IDENTIFIER LV_INH_DIAG_SA ECU_ADDRESS 0x3fe63f /end MEASUREMENT
/begin MEASUREMENT state_diag_sa_safm "States of secondary air system diagnosis" UBYTE _CNV_S_7_STATE_DIAG_460_CM 1 100. 0. 6. DISPLAY_IDENTIFIER STATE_DIAG_SA_SAFM ECU_ADDRESS 0x3fe643 /end MEASUREMENT
/begin MEASUREMENT state_diag_sa_err "Error states of secondary air system diagnosis" UBYTE _CNV_S_7_STATE_DIAG_461_CM 1 100. 0. 6. DISPLAY_IDENTIFIER STATE_DIAG_SA_ERR ECU_ADDRESS 0x3fe648 /end MEASUREMENT
/begin MEASUREMENT lv_safm_monit_diag_end "Control flag signals the end of SAFM diagnosis(1.1)" UBYTE _CNV_S_2_RANGE______2_CM 1 100. 0. 1. DISPLAY_IDENTIFIER LV_SAFM_MONIT_DIAG_END ECU_ADDRESS 0x3fe64a /end MEASUREMENT
/begin MEASUREMENT lv_sa_min_diag_end "Control flag signals the end of minimum or maximum deviation diagnosis(1.2)" UBYTE _CNV_S_2_RANGE______2_CM 1 100. 0. 1. DISPLAY_IDENTIFIER LV_SA_MIN_DIAG_END ECU_ADDRESS 0x3fe64b /end MEASUREMENT
/begin MEASUREMENT lv_sav_diag_end "Control flag signals the end of SAV diagnosis(1.3)" UBYTE _CNV_S_2_RANGE______2_CM 1 100. 0. 1. DISPLAY_IDENTIFIER LV_SAV_DIAG_END ECU_ADDRESS 0x3fe64c /end MEASUREMENT
/begin MEASUREMENT lv_sa_t_diag_start "Control flag signals the start of the diagnose timer" UBYTE _CNV_S_2_RANGE______2_CM 1 100. 0. 1. DISPLAY_IDENTIFIER LV_SA_T_DIAG_START ECU_ADDRESS 0x3fe64d /end MEASUREMENT
/begin MEASUREMENT ctr_safm_diag "Counter for Min/Max of SAF_KGH during SAFM diagnosis active" UWORD _CNV_A_R_LINEAR_____0_CM 1 100. 0. 65534. DISPLAY_IDENTIFIER CTR_SAFM_DIAG ECU_ADDRESS 0x3fd6a2 BYTE_ORDER MSB_LAST FORMAT "%5.0" /end MEASUREMENT
/begin MEASUREMENT saf_kgh_max_diag "Maximum value of SAF_KGH during the time ctr_safm_diag or ctr_sav_thd" UWORD _CNV_A_R_LINEAR_____47_CM 1 100. 0. 1023.984375 DISPLAY_IDENTIFIER SAF_KGH_MAX_DIAG ECU_ADDRESS 0x3fd6a4 BYTE_ORDER MSB_LAST FORMAT "%7.2" /end MEASUREMENT
/begin MEASUREMENT saf_kgh_min_diag "Minimum value of SAF_KGH during the time ctr_safm_diag or ctr_sav_thd" UWORD _CNV_A_R_LINEAR_____47_CM 1 100. 0. 1023.984375 DISPLAY_IDENTIFIER SAF_KGH_MIN_DIAG ECU_ADDRESS 0x3fd6a6 BYTE_ORDER MSB_LAST FORMAT "%7.2" /end MEASUREMENT
/begin MEASUREMENT sum_saf_diag_max "Number of  maximum air flow diagnosis steps" UWORD _CNV_A_R_LINEAR_____0_CM 1 100. 0. 65534. DISPLAY_IDENTIFIER SUM_SAF_DIAG_MAX ECU_ADDRESS 0x3fd6aa BYTE_ORDER MSB_LAST FORMAT "%5.0" /end MEASUREMENT
/begin MEASUREMENT sum_saf_diag_quo_max "Sum of diagnosis value maximum air flow" ULONG _CNV_A_R_LINEAR_____462_CM 1 100. 0. 16711170. DISPLAY_IDENTIFIER SUM_SAF_DIAG_QUO_MAX ECU_ADDRESS 0x3fcbdc BYTE_ORDER MSB_LAST FORMAT "%12.3" /end MEASUREMENT
/begin MEASUREMENT saf_diag_quo_max "Diagnosis value of maximum air flow (weighted)" UWORD _CNV_A_R_LINEAR_____462_CM 1 100. 0. 255. DISPLAY_IDENTIFIER SAF_DIAG_QUO_MAX ECU_ADDRESS 0x3fd6ac BYTE_ORDER MSB_LAST FORMAT "%7.3" /end MEASUREMENT
/begin MEASUREMENT sum_saf_diag_min "Number of  minimum air flow diagnosis steps" UWORD _CNV_A_R_LINEAR_____0_CM 1 100. 0. 65534. DISPLAY_IDENTIFIER SUM_SAF_DIAG_MIN ECU_ADDRESS 0x3fd6ae BYTE_ORDER MSB_LAST FORMAT "%5.0" /end MEASUREMENT
/begin MEASUREMENT sum_saf_diag_quo_min "Sum of diagnosis value minimum air flow" ULONG _CNV_A_R_LINEAR_____462_CM 1 100. 0. 16711170. DISPLAY_IDENTIFIER SUM_SAF_DIAG_QUO_MIN ECU_ADDRESS 0x3fcbe0 BYTE_ORDER MSB_LAST FORMAT "%12.3" /end MEASUREMENT
/begin MEASUREMENT saf_diag_quo_min "Diagnosis value of minimum air flow (weighted)" UWORD _CNV_A_R_LINEAR_____462_CM 1 100. 0. 255. DISPLAY_IDENTIFIER SAF_DIAG_QUO_MIN ECU_ADDRESS 0x3fd6b0 BYTE_ORDER MSB_LAST FORMAT "%7.3" /end MEASUREMENT
/begin MEASUREMENT saf_kgh_diag "Difference of model and actual value of SAF" SWORD _CNV_A_R_LINEAR_____463_CM 1 100. -512. 511.98 DISPLAY_IDENTIFIER SAF_KGH_DIAG ECU_ADDRESS 0x3fd6ba BYTE_ORDER MSB_LAST FORMAT "%7.3" /end MEASUREMENT
/begin MEASUREMENT saf_kgh_dif_sav_diag "Difference of minimum and maximum value of SAF_KGH_xxx_DIAG during the SAV-diagnosis" UWORD _CNV_A_R_LINEAR_____47_CM 1 100. 0. 1023.984375 DISPLAY_IDENTIFIER SAF_KGH_DIF_SAV_DIAG ECU_ADDRESS 0x3fd6b2 BYTE_ORDER MSB_LAST FORMAT "%7.2" /end MEASUREMENT
/begin MEASUREMENT lv_sap_sav_cnl "End of Secondary air injection in reason of SA error" UBYTE _CNV_S_2_RANGE______2_CM 1 100. 0. 1. DISPLAY_IDENTIFIER LV_SAP_SAV_CNL ECU_ADDRESS 0x3fe646 /end MEASUREMENT
/begin CHARACTERISTIC id_saf_kgh_diag_min "minimum deviation of air mass flow without emissions-deterioration" MAP 0xffe44245 _REC_MAP_20_u1_u1_u1 63.75 _CNV_A_R_LINEAR_____464_CM 0. 63.75 DISPLAY_IDENTIFIER ID_SAF_KGH_DIAG_MIN
 /begin AXIS_DESCR COM_AXIS n_32 _CNV_A_R_LINEAR_____15_CM 8 0. 8160. FORMAT "%4.0" AXIS_PTS_REF ldpm_n_32_id_saf_kgh_diag_min /end AXIS_DESCR
 /begin AXIS_DESCR COM_AXIS maf _CNV_A_R_LINEAR_____27_CM 8 0. 1389. FORMAT "%4.0" AXIS_PTS_REF ldpm_maf_id_saf_kgh_diag_min /end AXIS_DESCR
/end CHARACTERISTIC
/begin CHARACTERISTIC id_saf_kgh_diag_max "Detection of leaky in the secondary air system" MAP 0xffe44205 _REC_MAP_20_u1_u1_u1 63.75 _CNV_A_R_LINEAR_____464_CM 0. 63.75 DISPLAY_IDENTIFIER ID_SAF_KGH_DIAG_MAX
 /begin AXIS_DESCR COM_AXIS n_32 _CNV_A_R_LINEAR_____15_CM 8 0. 8160. FORMAT "%4.0" AXIS_PTS_REF ldpm_n_32_id_saf_kgh_diag_max /end AXIS_DESCR
 /begin AXIS_DESCR COM_AXIS maf _CNV_A_R_LINEAR_____27_CM 8 0. 1389. FORMAT "%4.0" AXIS_PTS_REF ldpm_maf_id_saf_kgh_diag_max /end AXIS_DESCR
/end CHARACTERISTIC
/begin CHARACTERISTIC c_sum_saf_diag_min "Counter for minimum air flow deviation" VALUE 0xffe418be _REC_VAL_20_u2 65534. _CNV_A_R_LINEAR_____0_CM 0. 65534. DISPLAY_IDENTIFIER C_SUM_SAF_DIAG_MIN FORMAT "%5.0" /end CHARACTERISTIC
/begin CHARACTERISTIC c_saf_diag_min "Error detection threshold for minimum deviation" VALUE 0xffe4189a _REC_VAL_20_u2 255. _CNV_A_R_LINEAR_____462_CM 0. 255. DISPLAY_IDENTIFIER C_SAF_DIAG_MIN FORMAT "%7.3" /end CHARACTERISTIC
/begin CHARACTERISTIC c_saf_diag_max "Error detection threshold for maximum deviation" VALUE 0xffe41898 _REC_VAL_20_u2 255. _CNV_A_R_LINEAR_____462_CM 0. 255. DISPLAY_IDENTIFIER C_SAF_DIAG_MAX FORMAT "%7.3" /end CHARACTERISTIC
/begin CHARACTERISTIC c_t_dly_diag_safm "Time delay of SAFM-diagnosis" VALUE 0xffe4190a _REC_VAL_20_u2 6553.5 _CNV_A_R_LINEAR_____24_CM 0. 6553.5 DISPLAY_IDENTIFIER C_T_DLY_DIAG_SAFM FORMAT "%6.1" /end CHARACTERISTIC
/begin CHARACTERISTIC c_saf_kgh_dif "Difference threshold for error detection \"SA-tube blocked\"" VALUE 0xffe4189c _REC_VAL_20_u2 1023.984375 _CNV_A_R_LINEAR_____47_CM 0. 1023.984375 DISPLAY_IDENTIFIER C_SAF_KGH_DIF FORMAT "%7.2" /end CHARACTERISTIC
/begin CHARACTERISTIC c_saf_mes_thd "Absolute threshold for detection SAP is started" VALUE 0xffe418a2 _REC_VAL_20_u2 1023.984375 _CNV_A_R_LINEAR_____47_CM 0. 1023.984375 DISPLAY_IDENTIFIER C_SAF_MES_THD FORMAT "%7.2" /end CHARACTERISTIC
/begin CHARACTERISTIC c_t_max_diag_sav "Maximum operating life of SAV-diagnosis" VALUE 0xffe41992 _REC_VAL_20_u2 6553.5 _CNV_A_R_LINEAR_____24_CM 0. 6553.5 DISPLAY_IDENTIFIER C_T_MAX_DIAG_SAV FORMAT "%6.1" /end CHARACTERISTIC
/begin CHARACTERISTIC c_sum_sav_thd "Number of check-up" VALUE 0xffe40854 _REC_VAL_20_u1 255. _CNV_A_R_LINEAR_____0_CM 0. 255. DISPLAY_IDENTIFIER C_SUM_SAV_THD FORMAT "%3.0" /end CHARACTERISTIC
/begin CHARACTERISTIC c_saf_kgh_dif_sav_diag "Difference threshold for error detection \"SAV_ERR\"" VALUE 0xffe4189e _REC_VAL_20_u2 1023.984375 _CNV_A_R_LINEAR_____47_CM 0. 1023.984375 DISPLAY_IDENTIFIER C_SAF_KGH_DIF_SAV_DIAG FORMAT "%7.2" /end CHARACTERISTIC
/begin CHARACTERISTIC c_maf_kgh_min_saf "MAF-threshold for start of SAV-diagnosis" VALUE 0xffe417a6 _REC_VAL_20_u2 16383.75 _CNV_A_R_LINEAR_____464_CM 0. 16383.75 DISPLAY_IDENTIFIER C_MAF_KGH_MIN_SAF FORMAT "%7.1" /end CHARACTERISTIC
/begin CHARACTERISTIC c_t_dly_diag_sav "Delelaytime after end of secondary air function for start of SAV-diagnosis" VALUE 0xffe4190e _REC_VAL_20_u2 6553.5 _CNV_A_R_LINEAR_____24_CM 0. 6553.5 DISPLAY_IDENTIFIER C_T_DLY_DIAG_SAV FORMAT "%6.1" /end CHARACTERISTIC
/begin AXIS_PTS ldpm_n_32_id_saf_kgh_diag_min "" 0xffe4852f n_32 _REC_AXS_20_u1 8160. _CNV_A_R_LINEAR_____15_CM 8 0. 8160. DISPLAY_IDENTIFIER LDPM_N_32_ID_SAF_KGH_DIAG_MIN FORMAT "%4.0" /end AXIS_PTS
/begin AXIS_PTS ldpm_n_32_id_saf_kgh_diag_max "" 0xffe48526 n_32 _REC_AXS_20_u1 8160. _CNV_A_R_LINEAR_____15_CM 8 0. 8160. DISPLAY_IDENTIFIER LDPM_N_32_ID_SAF_KGH_DIAG_MAX FORMAT "%4.0" /end AXIS_PTS
/begin AXIS_PTS ldpm_maf_id_saf_kgh_diag_min "" 0xffe4841d maf _REC_AXS_20_u1 1389. _CNV_A_R_LINEAR_____27_CM 8 0. 1389. DISPLAY_IDENTIFIER LDPM_MAF_ID_SAF_KGH_DIAG_MIN FORMAT "%4.0" /end AXIS_PTS
/begin AXIS_PTS ldpm_maf_id_saf_kgh_diag_max "" 0xffe48414 maf _REC_AXS_20_u1 1389. _CNV_A_R_LINEAR_____27_CM 8 0. 1389. DISPLAY_IDENTIFIER LDPM_MAF_ID_SAF_KGH_DIAG_MAX FORMAT "%4.0" /end AXIS_PTS
/begin MEASUREMENT sum_sav_thd "Counter for Min/Max of SAF_KGH during SAV diagnosis active" UBYTE _CNV_A_R_LINEAR_____0_CM 1 100. 0. 255. DISPLAY_IDENTIFIER SUM_SAV_THD ECU_ADDRESS 0x3fe649 FORMAT "%3.0" /end MEASUREMENT
/begin MEASUREMENT t_dly_intr_diag_safm "Time delay after secair interrupt to continue the SA monitoring" UBYTE _CNV_A_R_LINEAR_____24_CM 1 100. 0. 25.5 DISPLAY_IDENTIFIER T_DLY_INTR_DIAG_SAFM ECU_ADDRESS 0x3fe644 FORMAT "%4.1" /end MEASUREMENT
/begin CHARACTERISTIC c_t_dly_intr_diag_safm "Time delay after leaving the STATE_SA = INTERRUPT to continue the SA monitoring" VALUE 0xffe4087d _REC_VAL_20_u1 25.5 _CNV_A_R_LINEAR_____24_CM 0. 25.5 DISPLAY_IDENTIFIER C_T_DLY_INTR_DIAG_SAFM FORMAT "%4.1" /end CHARACTERISTIC
/begin MEASUREMENT saf_diag_max "Mean diagnosis value of maximum air flow " UWORD _CNV_A_R_LINEAR_____462_CM 1 100. 0. 255. DISPLAY_IDENTIFIER SAF_DIAG_MAX ECU_ADDRESS 0x3fd6a0 BYTE_ORDER MSB_LAST FORMAT "%7.3" /end MEASUREMENT
/begin MEASUREMENT saf_diag_max_sae "Mean diagnosis value of maximum air flow for SAE" UWORD _CNV_A_R_LINEAR_____462_CM 1 100. 0. 255. DISPLAY_IDENTIFIER SAF_DIAG_MAX_SAE ECU_ADDRESS 0x3fd69a BYTE_ORDER MSB_LAST FORMAT "%7.3" /end MEASUREMENT
/begin MEASUREMENT saf_diag_min_sae "Mean diagnosis value of minimum air flow for SAE" UWORD _CNV_A_R_LINEAR_____462_CM 1 100. 0. 255. DISPLAY_IDENTIFIER SAF_DIAG_MIN_SAE ECU_ADDRESS 0x3fd698 BYTE_ORDER MSB_LAST FORMAT "%7.3" /end MEASUREMENT
/begin MEASUREMENT saf_kgh_dif "Difference of minimum and maximum value of SAF_KGH_xxx_DIAG " UWORD _CNV_A_R_LINEAR_____47_CM 1 100. 0. 1023.984375 DISPLAY_IDENTIFIER SAF_KGH_DIF ECU_ADDRESS 0x3fd6a8 BYTE_ORDER MSB_LAST FORMAT "%7.2" /end MEASUREMENT
/begin MEASUREMENT saf_kgh_dif_sae "Difference of minimum and maximum value for SAE" UWORD _CNV_A_R_LINEAR_____47_CM 1 100. 0. 1023.984375 DISPLAY_IDENTIFIER SAF_KGH_DIF_SAE ECU_ADDRESS 0x3fd69c BYTE_ORDER MSB_LAST FORMAT "%7.2" /end MEASUREMENT
/begin MEASUREMENT lv_err_sa_sys "Present failure: Minimum secair flow rate failure after filtering" UBYTE _CNV_S_2_RANGE______1_R_CM 1 100. 0. 255. DISPLAY_IDENTIFIER LV_ERR_SA_SYS ECU_ADDRESS 0x3fba1c /end MEASUREMENT
/begin MEASUREMENT lv_err_sa_safm "Present failure: Component Secondary air flow meter failure" UBYTE _CNV_S_2_RANGE______1_R_CM 1 100. 0. 255. DISPLAY_IDENTIFIER LV_ERR_SA_SAFM ECU_ADDRESS 0x3fba14 /end MEASUREMENT
/begin CHARACTERISTIC c_saf_mdl_cor_eol "Secondary air model value correction in reason of EOL-test" VALUE 0xffe40494 _REC_VAL_20_s2 1023.98 _CNV_A_R_LINEAR_____463_CM -512. 511.98 DISPLAY_IDENTIFIER C_SAF_MDL_COR_EOL FORMAT "%7.3" /end CHARACTERISTIC
/begin CHARACTERISTIC c_t_dly_diag_safm_eol "Time delay of SAFM-diagnosis for EOL-Test" VALUE 0xffe4190c _REC_VAL_20_u2 6553.5 _CNV_A_R_LINEAR_____24_CM 0. 6553.5 DISPLAY_IDENTIFIER C_T_DLY_DIAG_SAFM_EOL FORMAT "%6.1" /end CHARACTERISTIC
/begin CHARACTERISTIC c_maf_kgh_min_saf_eol "MAF-threshold for start of SAV-diagnosis for EOL-Test" VALUE 0xffe417a8 _REC_VAL_20_u2 16383.75 _CNV_A_R_LINEAR_____464_CM 0. 16383.75 DISPLAY_IDENTIFIER C_MAF_KGH_MIN_SAF_EOL FORMAT "%7.1" /end CHARACTERISTIC
/begin MEASUREMENT saf_diag_min "Mean diagnosis value of minimum air flow" UWORD _CNV_A_R_LINEAR_____462_CM 1 100. 0. 255. DISPLAY_IDENTIFIER SAF_DIAG_MIN ECU_ADDRESS 0x3fd69e BYTE_ORDER MSB_LAST FORMAT "%7.3" /end MEASUREMENT
/begin MEASUREMENT sum_saf_kgh "Sum of SAF value during SAFM_SAFM_MONIT" ULONG _CNV_A_R_LINEAR_____45_CM 1 100. 0. 67108863.98 DISPLAY_IDENTIFIER SUM_SAF_KGH ECU_ADDRESS 0x3fcbe4 BYTE_ORDER MSB_LAST FORMAT "%11.2" /end MEASUREMENT
/begin CHARACTERISTIC c_sum_saf_diag_max "Counter for maximum air flow deviation" VALUE 0xffe418bc _REC_VAL_20_u2 65534. _CNV_A_R_LINEAR_____0_CM 0. 65534. DISPLAY_IDENTIFIER C_SUM_SAF_DIAG_MAX FORMAT "%5.0" /end CHARACTERISTIC
/begin CHARACTERISTIC c_sum_saf_kgh "Cumulated SAF_KGH threshold to detect SAFM-error" VALUE 0xffe418c0 _REC_VAL_20_u2 16383.75 _CNV_A_R_LINEAR_____464_CM 0. 16383.75 DISPLAY_IDENTIFIER C_SUM_SAF_KGH FORMAT "%7.1" /end CHARACTERISTIC
/begin CHARACTERISTIC c_saf_kgh_safm "Cumulated SAF_KGH threshold to detect SAFM stucked" VALUE 0xffe418a0 _REC_VAL_20_u2 16383.75 _CNV_A_R_LINEAR_____464_CM 0. 16383.75 DISPLAY_IDENTIFIER C_SAF_KGH_SAFM FORMAT "%7.1" /end CHARACTERISTIC
/begin AXIS_PTS ldp_tco_st_id_sum_safm_diag "" 0xffe4826f tco_st _REC_AXS_20_u1 190.5 _CNV_A_R_LINEAR_____11_CM 8 -48. 142.5 DISPLAY_IDENTIFIER LDP_TCO_ST_ID_SUM_SAFM_DIAG FORMAT "%5.1" /end AXIS_PTS
/begin CHARACTERISTIC id_sum_safm_diag "Number of measurements for diagnosis" CURVE 0xffe48d70 _REC_CUR_20_u2_u1 65534. _CNV_A_R_LINEAR_____0_CM 0. 65534. DISPLAY_IDENTIFIER ID_SUM_SAFM_DIAG FORMAT "%5.0"
 /begin AXIS_DESCR COM_AXIS tco_st _CNV_A_R_LINEAR_____11_CM 8 -48. 142.5 FORMAT "%5.1" AXIS_PTS_REF ldp_tco_st_id_sum_safm_diag /end AXIS_DESCR
/end CHARACTERISTIC
/begin CHARACTERISTIC lc_inh_safm_man_deac "Constant to switch of the inhibition (=1)" VALUE 0xffe40f86 _REC_VAL_20_u1 1. _CNV_A_R_LINEAR_____22_CM 0. 1. DISPLAY_IDENTIFIER LC_INH_SAFM_MAN_DEAC FORMAT "%1.0" /end CHARACTERISTIC
/begin MEASUREMENT lv_err_load_tps_plaus "Boolean that indicates inconsistencies between actual load and throttle position (if set)" UBYTE _CNV_S_2_RANGE______1_R_CM 1 100. 0. 255. DISPLAY_IDENTIFIER LV_ERR_LOAD_TPS_PLAUS ECU_ADDRESS 0x3fbafc /end MEASUREMENT
/begin CHARACTERISTIC c_maf_max_diag_sa "Maximum load for interrupt the SA diagnosis" VALUE 0xffe417b6 _REC_VAL_20_u2 1389. _CNV_A_R_LINEAR_____108_CM 0. 1389. DISPLAY_IDENTIFIER C_MAF_MAX_DIAG_SA FORMAT "%7.2" /end CHARACTERISTIC
/begin MEASUREMENT lv_inh_diag_obd2_ttip_ls_up_1 " Boolean inhibit flag for O2 sensor temperature OBDII monitoring " UBYTE _CNV_S_2_RANGE______1_R_CM 1 100. 0. 255. DISPLAY_IDENTIFIER LV_INH_DIAG_OBD2_TTIP_LS_UP_1 ECU_ADDRESS 0x3fea77 /end MEASUREMENT
/begin MEASUREMENT lv_inh_diag_obd2_ttip_ls_up_2 " Boolean inhibit flag for O2 sensor temperature OBDII monitoring " UBYTE _CNV_S_2_RANGE______1_R_CM 1 100. 0. 255. DISPLAY_IDENTIFIER LV_INH_DIAG_OBD2_TTIP_LS_UP_2 ECU_ADDRESS 0x3fea78 /end MEASUREMENT
/begin COMPU_METHOD _CNV_A_R_LINEAR_____0_CM "" RAT_FUNC "%6.3" "-" COEFFS 0 1. 0. 0 0 1 /end COMPU_METHOD
/begin COMPU_METHOD _CNV_S_2_RANGE______1_R_CM "" TAB_VERB "%6.3" "[-]" COMPU_TAB_REF _CNV_S_2_RANGE______1_R /end COMPU_METHOD
/begin COMPU_VTAB_RANGE _CNV_S_2_RANGE______1_R "" 2 0 0 "0" 1 255 "1" /end COMPU_VTAB_RANGE
/begin COMPU_METHOD _CNV_S_2_RANGE______2_CM "" TAB_VERB "%6.3" "[-]" COMPU_TAB_REF _CNV_S_2_RANGE______2 /end COMPU_METHOD
/begin COMPU_VTAB _CNV_S_2_RANGE______2 "" TAB_VERB 2 0 "0" 1 "1" /end COMPU_VTAB
/begin COMPU_METHOD _CNV_A_R_LINEAR_____3_CM "" RAT_FUNC "%6.3" "V" COEFFS 0 204.7999998974999 0. 0 0 1 /end COMPU_METHOD
/begin COMPU_METHOD _CNV_A_R_LINEAR_____4_CM "" RAT_FUNC "%6.3" "s" COEFFS 0 100. 0. 0 0 1 /end COMPU_METHOD
/begin COMPU_METHOD _CNV_A_R_LINEAR_____6_CM "" RAT_FUNC "%6.3" "°C" COEFFS 0 16. 0. 0 0 1 /end COMPU_METHOD
/begin COMPU_METHOD _CNV_A_R_LINEAR_____8_CM "" RAT_FUNC "%6.3" "%" COEFFS 0 655.3600000071681 0. 0 0 1 /end COMPU_METHOD
/begin COMPU_METHOD _CNV_A_R_LINEAR_____9_CM "" RAT_FUNC "%6.3" "%" COEFFS 0 2.56 0. 0 0 1 /end COMPU_METHOD
/begin COMPU_METHOD _CNV_A_R_LINEAR_____10_CM "" RAT_FUNC "%6.3" "rpm" COEFFS 0 1. 0. 0 0 1 /end COMPU_METHOD
/begin COMPU_METHOD _CNV_A_R_LINEAR_____11_CM "" RAT_FUNC "%6.3" "°C" COEFFS 0 1.333333333333333 64. 0 0 1 /end COMPU_METHOD
/begin COMPU_METHOD _CNV_A_R_LINEAR_____15_CM "" RAT_FUNC "%6.3" "rpm" COEFFS 0 3.125e-002 0. 0 0 1 /end COMPU_METHOD
/begin COMPU_METHOD _CNV_A_R_LINEAR_____20_CM "" RAT_FUNC "%6.3" "-" COEFFS 0 32768.00003968061 0. 0 0 1 /end COMPU_METHOD
/begin COMPU_METHOD _CNV_S_2_RANGE______21_CM "" TAB_VERB "%6.3" "-" COMPU_TAB_REF _CNV_S_2_RANGE______21 /end COMPU_METHOD
/begin COMPU_VTAB _CNV_S_2_RANGE______21 "" TAB_VERB 2 0 "0" 1 "1" /end COMPU_VTAB
/begin COMPU_METHOD _CNV_A_R_LINEAR_____22_CM "" RAT_FUNC "%6.3" "[-]" COEFFS 0 1. 0. 0 0 1 /end COMPU_METHOD
/begin COMPU_METHOD _CNV_A_R_LINEAR_____24_CM "" RAT_FUNC "%6.3" "s" COEFFS 0 10. 0. 0 0 1 /end COMPU_METHOD
/begin COMPU_METHOD _CNV_A_R_LINEAR_____27_CM "" RAT_FUNC "%6.3" "mg/stk" COEFFS 0 0.183585313174946 0. 0 0 1 /end COMPU_METHOD
/begin COMPU_METHOD _CNV_A_R_LINEAR_____29_CM "" RAT_FUNC "%6.3" "-" COEFFS 0 255.9983911655618 0. 0 0 1 /end COMPU_METHOD
/begin COMPU_METHOD _CNV_A_R_LINEAR_____30_CM "" RAT_FUNC "%6.3" "s" COEFFS 0 1. 0. 0 0 1 /end COMPU_METHOD
/begin COMPU_METHOD _CNV_A_R_LINEAR_____37_CM "" RAT_FUNC "%6.3" "-" COEFFS 0 65536.00007936121 0. 0 0 1 /end COMPU_METHOD
/begin COMPU_METHOD _CNV_A_R_LINEAR_____39_CM "" RAT_FUNC "%6.3" "-" COEFFS 0 127.9991955827809 0. 0 0 1 /end COMPU_METHOD
/begin COMPU_METHOD _CNV_A_R_LINEAR_____45_CM "" RAT_FUNC "%6.3" "kg/h" COEFFS 0 64.00000000417234 0. 0 0 1 /end COMPU_METHOD
/begin COMPU_METHOD _CNV_A_R_LINEAR_____46_CM "" RAT_FUNC "%6.3" "-" COEFFS 0 16. 0. 0 0 1 /end COMPU_METHOD
/begin COMPU_METHOD _CNV_A_R_LINEAR_____47_CM "" RAT_FUNC "%6.3" "kg/h" COEFFS 0 64. 0. 0 0 1 /end COMPU_METHOD
/begin COMPU_METHOD _CNV_A_R_LINEAR_____49_CM "" RAT_FUNC "%6.3" "hPa" COEFFS 0 12.06017666543982 0. 0 0 1 /end COMPU_METHOD
/begin COMPU_METHOD _CNV_A_R_LINEAR_____50_CM "" RAT_FUNC "%6.3" "[-]" COEFFS 0 255.9999357490357 0. 0 0 1 /end COMPU_METHOD
/begin COMPU_METHOD _CNV_A_R_LINEAR_____104_CM "" RAT_FUNC "%6.3" "ppm" COEFFS 0 1. 0. 0 0 1 /end COMPU_METHOD
/begin COMPU_METHOD _CNV_A_R_LINEAR_____105_CM "" RAT_FUNC "%6.3" "mV" COEFFS 0 1. 200. 0 0 1 /end COMPU_METHOD
/begin COMPU_METHOD _CNV_A_R_LINEAR_____108_CM "" RAT_FUNC "%6.3" "mg/stk" COEFFS 0 47.18142548596112 0. 0 0 1 /end COMPU_METHOD
/begin COMPU_METHOD _CNV_A_R_LINEAR_____110_CM "" RAT_FUNC "%6.3" "hPa" COEFFS 0 12.06017666543982 -1.759293338545831e-002 0 0 1 /end COMPU_METHOD
/begin COMPU_METHOD _CNV_A_R_LINEAR_____111_CM "" RAT_FUNC "%6.3" "%" COEFFS 0 655.3600000071681 3.584063961170614e-007 0 0 1 /end COMPU_METHOD
/begin COMPU_METHOD _CNV_A_R_LINEAR_____113_CM "" RAT_FUNC "%6.3" "kg/h" COEFFS 0 8191.999999679995 0. 0 0 1 /end COMPU_METHOD
/begin COMPU_METHOD _CNV_A_R_LINEAR_____115_CM "" RAT_FUNC "%6.3" "kg/h" COEFFS 0 32. 0. 0 0 1 /end COMPU_METHOD
/begin COMPU_METHOD _CNV_A_R_LINEAR_____118_CM "" RAT_FUNC "%6.3" "-" COEFFS 0 1023.999999959999 0. 0 0 1 /end COMPU_METHOD
/begin COMPU_METHOD _CNV_S_6_STATE_DIAG_188_CM "" TAB_VERB "%6.3" "-" COMPU_TAB_REF _CNV_S_6_STATE_DIAG_188 /end COMPU_METHOD
/begin COMPU_VTAB _CNV_S_6_STATE_DIAG_188 "" TAB_VERB 6 0 "STEP_INIT" 1 "STEP_1" 2 "STEP_2" 3 "STEP_3" 4 "CPS_RAMP" 5 "LOCK_STEP" /end COMPU_VTAB
/begin COMPU_METHOD _CNV_A_R_LINEAR_____189_CM "" RAT_FUNC "%6.3" "cyc" COEFFS 0 1. 0. 0 0 1 /end COMPU_METHOD
/begin COMPU_METHOD _CNV_A_R_LINEAR_____190_CM "" RAT_FUNC "%6.3" "kg/h" COEFFS 0 8191.874997772622 1. 0 0 1 /end COMPU_METHOD
/begin COMPU_METHOD _CNV_A_R_LINEAR_____191_CM "" RAT_FUNC "%6.3" "-" COEFFS 0 65535. 0. 0 0 1 /end COMPU_METHOD
/begin COMPU_METHOD _CNV_S_2_RANGE______192_CM "" TAB_VERB "%6.3" "[-]" COMPU_TAB_REF _CNV_S_2_RANGE______192 /end COMPU_METHOD
/begin COMPU_VTAB _CNV_S_2_RANGE______192 "" TAB_VERB 2 0 "PASSIVE" 1 "ACTIVE" /end COMPU_VTAB
/begin COMPU_METHOD _CNV_S_4_STATE_LS_197_CM "" TAB_VERB "%6.3" "[-]" COMPU_TAB_REF _CNV_S_4_STATE_LS_197 /end COMPU_METHOD
/begin COMPU_VTAB _CNV_S_4_STATE_LS_197 "" TAB_VERB 4 1 "OL_CDN" 2 "CL" 4 "OL_INTR" 8 "OL_ERR" /end COMPU_VTAB
/begin COMPU_METHOD _CNV_A_R_LINEAR_____198_CM "" RAT_FUNC "%6.3" "s" COEFFS 0 50. 0. 0 0 1 /end COMPU_METHOD
/begin COMPU_METHOD _CNV_A_R_LINEAR_____206_CM "" RAT_FUNC "%6.3" "-" COEFFS 0 1023.999999919998 0. 0 0 1 /end COMPU_METHOD
/begin COMPU_METHOD _CNV_A_R_LINEAR_____260_CM "" RAT_FUNC "%6.3" "hPa/ms" COEFFS 0 395.2653799758745 -0.5 0 0 1 /end COMPU_METHOD
/begin COMPU_METHOD _CNV_A_R_LINEAR_____262_CM "" RAT_FUNC "%6.3" "%" COEFFS 0 655.3600000071681 32768.00000035841 0 0 1 /end COMPU_METHOD
/begin COMPU_METHOD _CNV_A_R_LINEAR_____270_CM "" RAT_FUNC "%6.3" "%" COEFFS 0 655.359650041603 0. 0 0 1 /end COMPU_METHOD
/begin COMPU_METHOD _CNV_A_R_LINEAR_____273_CM "" RAT_FUNC "%6.3" "g" COEFFS 0 35.99999934081027 0. 0 0 1 /end COMPU_METHOD
/begin COMPU_METHOD _CNV_A_R_LINEAR_____285_CM "" RAT_FUNC "%6.3" "-" COEFFS 0 1024. 0. 0 0 1 /end COMPU_METHOD
/begin COMPU_METHOD _CNV_A_R_LINEAR_____287_CM "" RAT_FUNC "%6.3" "g" COEFFS 0 36.00036915004301 0. 0 0 1 /end COMPU_METHOD
/begin COMPU_METHOD _CNV_A_R_LINEAR_____306_CM "" RAT_FUNC "%6.3" "V" COEFFS 0 819.2192192192192 0. 0 0 1 /end COMPU_METHOD
/begin COMPU_METHOD _CNV_A_R_LINEAR_____307_CM "" RAT_FUNC "%6.3" "-" COEFFS 0 3276.800790412251 0. 0 0 1 /end COMPU_METHOD
/begin COMPU_METHOD _CNV_A_R_LINEAR_____318_CM "" RAT_FUNC "%6.3" "%/s" COEFFS 0 0.1024000000600009 0. 0 0 1 /end COMPU_METHOD
/begin COMPU_METHOD _CNV_A_R_LINEAR_____335_CM "" RAT_FUNC "%6.3" "-" COEFFS 0 63.60176282051283 0. 0 0 1 /end COMPU_METHOD
/begin COMPU_METHOD _CNV_S_6_RANGE_ERR__337_CM "" TAB_VERB "%6.3" "[-]" COMPU_TAB_REF _CNV_S_6_RANGE_ERR__337 /end COMPU_METHOD
/begin COMPU_VTAB _CNV_S_6_RANGE_ERR__337 "" TAB_VERB 6 0 "NO_SYM" 1 "SYM_0" 2 "SYM_1" 4 "SYM_2" 8 "SYM_3" 15 "BENCH_MODE" /end COMPU_VTAB
/begin COMPU_METHOD _CNV_S_7_STATE_DIAG_338_CM "" TAB_VERB "%6.3" "[-]" COMPU_TAB_REF _CNV_S_7_STATE_DIAG_338 /end COMPU_METHOD
/begin COMPU_VTAB _CNV_S_7_STATE_DIAG_338 "" TAB_VERB 7 0 "passive" 1 "Active" 2 "Passive test" 3 "active test" 4 "down error" 5 "up error" 6 "no error" /end COMPU_VTAB
/begin COMPU_METHOD _CNV_S_4_RANGE_SYM__339_CM "" TAB_VERB "%6.3" "[-]" COMPU_TAB_REF _CNV_S_4_RANGE_SYM__339 /end COMPU_METHOD
/begin COMPU_VTAB _CNV_S_4_RANGE_SYM__339 "" TAB_VERB 4 0 "No symptom" 1 "Sensor too lean" 2 "Sensor too rich" 4 "Sensor not active" /end COMPU_VTAB
/begin COMPU_METHOD _CNV_S_3_RANGE_SYM__340_CM "" TAB_VERB "%6.3" "[-]" COMPU_TAB_REF _CNV_S_3_RANGE_SYM__340 /end COMPU_METHOD
/begin COMPU_VTAB _CNV_S_3_RANGE_SYM__340 "" TAB_VERB 3 0 "No symptom" 1 "Sensor too low" 2 "Sensor too high" /end COMPU_VTAB
/begin COMPU_METHOD _CNV_A_R_LINEAR_____341_CM "" RAT_FUNC "%6.3" "V" COEFFS 0 204.8048048048048 0. 0 0 1 /end COMPU_METHOD
/begin COMPU_METHOD _CNV_A_R_LINEAR_____342_CM "" RAT_FUNC "%6.3" "-" COEFFS 0 1024.003612233215 0. 0 0 1 /end COMPU_METHOD
/begin COMPU_METHOD _CNV_A_R_LINEAR_____352_CM "" RAT_FUNC "%6.3" "°C" COEFFS 0 0.249266862170088 8.225806451612904 0 0 1 /end COMPU_METHOD
/begin COMPU_METHOD _CNV_A_R_LINEAR_____357_CM "" RAT_FUNC "%6.3" "-" COEFFS 0 65536.00270084133 0. 0 0 1 /end COMPU_METHOD
/begin COMPU_METHOD _CNV_A_R_LINEAR_____358_CM "" RAT_FUNC "%6.3" "%/s" COEFFS 0 0.1024000154202376 0. 0 0 1 /end COMPU_METHOD
/begin COMPU_METHOD _CNV_A_R_LINEAR_____364_CM "" RAT_FUNC "%6.3" "s" COEFFS 0 100.0015259720442 0. 0 0 1 /end COMPU_METHOD
/begin COMPU_METHOD _CNV_A_R_LINEAR_____382_CM "" RAT_FUNC "%6.3" "cm²" COEFFS 0 1118.481084425738 0. 0 0 1 /end COMPU_METHOD
/begin COMPU_METHOD _CNV_A_R_LINEAR_____434_CM "" RAT_FUNC "%6.3" "ppm" COEFFS 0 50. 0. 0 0 1 /end COMPU_METHOD
/begin COMPU_METHOD _CNV_A_R_LINEAR_____435_CM "" RAT_FUNC "%6.3" "ppm" COEFFS 0 0.78125 0. 0 0 1 /end COMPU_METHOD
/begin COMPU_METHOD _CNV_A_R_LINEAR_____436_CM "" RAT_FUNC "%6.3" "mg" COEFFS 0 54.86970172684458 0. 0 0 1 /end COMPU_METHOD
/begin COMPU_METHOD _CNV_S_5_RANGE_STAT_437_CM "" TAB_VERB "%6.3" "[-]" COMPU_TAB_REF _CNV_S_5_RANGE_STAT_437 /end COMPU_METHOD
/begin COMPU_VTAB _CNV_S_5_RANGE_STAT_437 "" TAB_VERB 5 0 "PASSIVE" 1 "WAIT" 2 "CYC_LEAN" 3 "CYC_RICH" 4 "END" /end COMPU_VTAB
/begin COMPU_METHOD _CNV_A_R_LINEAR_____438_CM "" RAT_FUNC "%6.3" "-" COEFFS 0 200. 0. 0 0 1 /end COMPU_METHOD
/begin COMPU_METHOD _CNV_A_R_LINEAR_____457_CM "" RAT_FUNC "%6.3" "s" COEFFS 0 100.0015267408663 -1.000015267408663 0 0 1 /end COMPU_METHOD
/begin COMPU_METHOD _CNV_S_7_RANGE_C_CO_458_CM "" TAB_VERB "%6.3" "[-]" COMPU_TAB_REF _CNV_S_7_RANGE_C_CO_458 /end COMPU_METHOD
/begin COMPU_VTAB _CNV_S_7_RANGE_C_CO_458 "" TAB_VERB 7 0 "NO_SAV_DIAG_EOL" 1 "DIAG_Bank_1" 2 "DIAG_Bank_2" 4 "EOL_Bank_1" 5 "DIAG_EOL_BANK_1" 8 "EOL_BANK_2" 10 "DIAG_EOL_BANK_2" /end COMPU_VTAB
/begin COMPU_METHOD _CNV_S_9_STATE_DIAG_459_CM "" TAB_VERB "%6.3" "[-]" COMPU_TAB_REF _CNV_S_9_STATE_DIAG_459 /end COMPU_METHOD
/begin COMPU_VTAB _CNV_S_9_STATE_DIAG_459 "" TAB_VERB 9 0 "SA_DIAG_INACT" 1 "SA_DIAG_DLY" 2 "SA_MIN_DIAG" 3 "SA_DIAG_INTR" 4 "SAV_DIAG_DLY" 5 "SA_DIAG_SAV" 6 "SA_DIAG_CHK" 7 "SA_DIAG_END" 8 "SA_DIAG_CNL" /end COMPU_VTAB
/begin COMPU_METHOD _CNV_S_7_STATE_DIAG_460_CM "" TAB_VERB "%6.3" "[-]" COMPU_TAB_REF _CNV_S_7_STATE_DIAG_460 /end COMPU_METHOD
/begin COMPU_VTAB _CNV_S_7_STATE_DIAG_460 "" TAB_VERB 7 0 "SAFM_DIAG_OFF" 1 "SAFM_SAFM_MONIT" 2 "SAFM_MIN_DIAG" 3 "SAFM_WAIT_SAV_DIAG" 4 "SAFM_SAV_DIAG" 5 "SAFM_DIAG_END" 6 "SAFM_DIAG_CNL" /end COMPU_VTAB
/begin COMPU_METHOD _CNV_S_7_STATE_DIAG_461_CM "" TAB_VERB "%6.3" "[-]" COMPU_TAB_REF _CNV_S_7_STATE_DIAG_461 /end COMPU_METHOD
/begin COMPU_VTAB _CNV_S_7_STATE_DIAG_461 "" TAB_VERB 7 0 "NO_ERR" 1 "SAFM_ERR" 2 "SAP_ERR" 3 "SAV_ERR" 4 "MIN_SAF_ERR" 5 "SA_CONF_ERR" 6 "SAV_1_ERR" /end COMPU_VTAB
/begin COMPU_METHOD _CNV_A_R_LINEAR_____462_CM "" RAT_FUNC "%6.3" "kg/h" COEFFS 0 256. 0. 0 0 1 /end COMPU_METHOD
/begin COMPU_METHOD _CNV_A_R_LINEAR_____463_CM "" RAT_FUNC "%6.3" "kg/h" COEFFS 0 64.00027344284068 0.1400027344279806 0 0 1 /end COMPU_METHOD
/begin COMPU_METHOD _CNV_A_R_LINEAR_____464_CM "" RAT_FUNC "%6.3" "kg/h" COEFFS 0 4. 0. 0 0 1 /end COMPU_METHOD
/begin RECORD_LAYOUT _REC_VAL_20_u1 FNC_VALUES 1 UBYTE COLUMN_DIR DIRECT /end RECORD_LAYOUT
/begin RECORD_LAYOUT _REC_VAL_20_u2 FNC_VALUES 1 UWORD COLUMN_DIR DIRECT /end RECORD_LAYOUT
/begin RECORD_LAYOUT _REC_CUR_20_u2_u1 FNC_VALUES 1 UWORD COLUMN_DIR DIRECT /end RECORD_LAYOUT
/begin RECORD_LAYOUT _REC_AXS_20_u1 NO_AXIS_PTS_X 1 UBYTE AXIS_PTS_X 2 UBYTE INDEX_INCR DIRECT /end RECORD_LAYOUT
/begin RECORD_LAYOUT _REC_MAP_20_u1_u1_u1 FNC_VALUES 1 UBYTE COLUMN_DIR DIRECT /end RECORD_LAYOUT
/begin RECORD_LAYOUT _REC_CUR_20_u1_u1 FNC_VALUES 1 UBYTE COLUMN_DIR DIRECT /end RECORD_LAYOUT
/begin RECORD_LAYOUT _REC_AXS_20_u2 NO_AXIS_PTS_X 1 UWORD AXIS_PTS_X 2 UWORD INDEX_INCR DIRECT /end RECORD_LAYOUT
/begin RECORD_LAYOUT _REC_MAP_20_u1_u1_u2 FNC_VALUES 1 UBYTE COLUMN_DIR DIRECT /end RECORD_LAYOUT
/begin RECORD_LAYOUT _REC_CUR_20_u1_u2 FNC_VALUES 1 UBYTE COLUMN_DIR DIRECT /end RECORD_LAYOUT
/begin RECORD_LAYOUT _REC_MAP_20_u2_u1_u1 FNC_VALUES 1 UWORD COLUMN_DIR DIRECT /end RECORD_LAYOUT
/begin RECORD_LAYOUT _REC_CUR_20_u2_u2 FNC_VALUES 1 UWORD COLUMN_DIR DIRECT /end RECORD_LAYOUT
/begin RECORD_LAYOUT _REC_VAL_20_s2 FNC_VALUES 1 SWORD COLUMN_DIR DIRECT /end RECORD_LAYOUT
/begin FUNCTION OBD_Cat_Efficiency_Diagnosis_wit "_Cat Efficiency Diagnosis with NOx-Sensor"
 /begin DEF_CHARACTERISTIC c_sum_min_cat_diag_nox c_cat_diag_nox_max_thd c_n_32_cat_diag_nox_deac_thd c_vls_nox_sens_max_thd c_vls_nox_sens_min_thd lc_nox_sens_vld_off ip_int_nox_nox_sens_cor_mt ip_int_nox_nox_sens_cor_at c_vls_nox_sens_afl_thd c_ctr_vls_nox_sens_afl_thd c_crlc_vls_nox_sens /end DEF_CHARACTERISTIC
 /begin OUT_MEASUREMENT int_nox_nox_sens_2 sum_cat_diag_nox_1 sum_cat_diag_nox_2 cat_diag_clc_nox_1 cat_diag_clc_nox_2 cat_diag_nox_1 cat_diag_nox_2 int_nox_nox_sens_sum_1 int_nox_nox_sens_sum_2 int_o2_ld_cat_1 int_o2_ld_cat_2 state_cat_diag_nox_1 state_cat_diag_nox_2 lv_req_cat_diag_nox_1 lv_req_cat_diag_nox_2 int_nox_nox_sens_mv_1 int_nox_nox_sens_mv_2 int_nox_nox_sens_cor_1 int_nox_nox_sens_cor_2 int_nox_nox_sens_1 ctr_vls_nox_sens_afl_1 ctr_vls_nox_sens_afl_2 ctr_cat_diag_nox_afr_afl_1 ctr_cat_diag_nox_afr_afl_2 vls_nox_sens_mmv_1 vls_nox_sens_mmv_2 lv_inh_diag_cat_diag_nox_1 lv_inh_diag_cat_diag_nox_2 lv_auth_cat_diag_nox_1 lv_auth_cat_diag_nox_2 /end OUT_MEASUREMENT
/end FUNCTION
/begin FUNCTION OBD_Functional_Check_CPS "_Functional Check CPS"
 /begin DEF_CHARACTERISTIC c_tco_min_diagcps_1 c_cl_mmv_diagcps c_flow_sp_diagcps_maf c_flow_sp_diagcps_n c_lgrd_flow_sp_neg_diagcps c_lgrd_flow_sp_pos_diagcps c_maf_diagcps c_n_diagcps c_n_dif_diagcps c_sum_flow_sp_diagcps_max c_sum_diagcps_max c_t_diagcps_maf c_t_diagcps_n_1 c_t_diagcps_n_2 c_t_diagcps_n_3 c_t_diagcps_dly c_crlc_isapwm_diagcps c_isapwm_dyw_diagcps c_maf_max_diagcps c_tco_min_diagcps c_sum_flow_sp_diagcps_eol c_sum_diagcps_eol /end DEF_CHARACTERISTIC
 /begin OUT_MEASUREMENT lv_inh_diagcps lv_di_diagcps flow_sp_cp_diagcps state_diagcps lv_act_diagcps lv_maf_diagcps_0 lv_maf_diagcps_1 lv_n_dif_diagcps lv_supp_accin_diagcps maf_diagcps n_diagcps sum_flow_sp_diagcps_eol sum_flow_sp_diagcps sum_diag_diagcps_eol sum_diag_diagcps t_diagcps_dly t_diagcps_maf t_diagcps_n_1 t_diagcps_n_2 t_diagcps_n_3 isapwm_mmv_diagcps lv_isapwm_dyw_diagcps flow_sp_cps_old sum_diag_diagcps_sae maf_diagcps_sae maf_diagcps_thd_sae cl_mmv_sae lv_eol_cps_err lv_err_diagcps /end OUT_MEASUREMENT
/end FUNCTION
/begin FUNCTION OBD_Application_Incidences_of_th "_Application Incidences of the Oxygen Sensor Diagnosis Management" /begin OUT_MEASUREMENT lv_inh_diag_ls_up_down_1 lv_inh_diag_ls_up_down_2 /end OUT_MEASUREMENT /end FUNCTION
/begin FUNCTION OBD_SA_system_diagnosis_through_ "_SA system diagnosis through SAF - determination"
 /begin DEF_CHARACTERISTIC id_saf_kgh_diag_min id_saf_kgh_diag_max c_sum_saf_diag_min c_saf_diag_min c_saf_diag_max c_t_dly_diag_safm c_saf_kgh_dif c_saf_mes_thd c_t_max_diag_sav c_sum_sav_thd c_saf_kgh_dif_sav_diag c_maf_kgh_min_saf c_t_dly_diag_sav c_t_dly_intr_diag_safm c_saf_mdl_cor_eol c_t_dly_diag_safm_eol c_maf_kgh_min_saf_eol c_sum_saf_diag_max c_sum_saf_kgh c_saf_kgh_safm id_sum_safm_diag /end DEF_CHARACTERISTIC
 /begin OUT_MEASUREMENT state_diag_sa_safm state_diag_sa_err lv_safm_monit_diag_end lv_sa_min_diag_end lv_sav_diag_end lv_sa_t_diag_start ctr_safm_diag saf_kgh_max_diag saf_kgh_min_diag sum_saf_diag_max sum_saf_diag_quo_max saf_diag_quo_max sum_saf_diag_min sum_saf_diag_quo_min saf_diag_quo_min saf_kgh_diag saf_kgh_dif_sav_diag lv_sap_sav_cnl sum_sav_thd t_dly_intr_diag_safm saf_diag_max saf_diag_max_sae saf_diag_min_sae saf_kgh_dif saf_kgh_dif_sae lv_err_sa_sys lv_err_sa_safm saf_diag_min sum_saf_kgh /end OUT_MEASUREMENT
/end FUNCTION
/begin FUNCTION OBD_Application_incidences_for_S "_Application incidences for SA system monitoring through SAFM" /begin DEF_CHARACTERISTIC lc_inh_safm_man_deac c_maf_max_diag_sa /end DEF_CHARACTERISTIC
 /begin OUT_MEASUREMENT lv_inh_diag_ebox_cfa lv_sap_cnl state_diag_sa_ls lv_sa_min_flow_diag lv_sa_min_flow_diag_eol lv_inh_diag_sa /end OUT_MEASUREMENT
/end FUNCTION
/begin FUNCTION OBD_SA_system_monitoring_through "_SA system monitoring through binary lambda sensor (ZrO2)"
 /begin DEF_CHARACTERISTIC id_t_dly_diag_sa c_sum_afl_vls_min_diag_sa c_t_diag_sa c_conf_diag_sav c_t_dly_intr_diag_sa c_ctr_p_diag_sa_sav c_lam_thd_diag_sav c_ctr_p_diag_sa_sap /end DEF_CHARACTERISTIC
 /begin OUT_MEASUREMENT lv_err_sa_sap lv_err_sa_sav sum_afl_vls_diag_sa_2 t_dly_diag_sa t_diag_sa lam_diag_sav_max t_dly_intr_diag_sa sum_afl_vls_diag_sa_1 sum_afl_vls_diag_sa_1_sae sum_afl_vls_diag_sa_2_sae lam_mv_diag_sav ctr_p_diag_sa_sap_2 ctr_p_diag_sa_sap_1 ctr_p_diag_sa_sav /end OUT_MEASUREMENT
/end FUNCTION
/begin FUNCTION OBD_Oxygen_sensor_diagnosis_mana "_Oxygen sensor diagnosis management"
 /begin DEF_CHARACTERISTIC c_max_t_diag_ls_up_down lc_prj_auth_act_test lc_prj_resu_act_test lc_err_ls_up_dyn_1 lc_err_ls_up_dyn_2 /end DEF_CHARACTERISTIC
 /begin OUT_MEASUREMENT lam_bank_1.ls_up_down_diag.bf.lv_req_di_lscl lam_bank_1.ls_up_down_diag.bf.lv_req_chk_ls_up_down lam_bank_1.ls_up_down_diag.bf.lv_req_plaus_vls_down_puc lam_bank_1.ls_up_down_diag.bf.lv_req_plaus_vls_down_fl lam_bank_1.ls_up_down_diag.state_diag_ls_up_down lam_bank_1.ls_up_down_diag.t_diag_ls_up_down lam_bank_2.ls_up_down_diag.bf.lv_req_di_lscl lam_bank_2.ls_up_down_diag.bf.lv_req_chk_ls_up_down lam_bank_2.ls_up_down_diag.bf.lv_req_plaus_vls_down_puc lam_bank_2.ls_up_down_diag.bf.lv_req_plaus_vls_down_fl lam_bank_2.ls_up_down_diag.state_diag_ls_up_down lam_bank_2.ls_up_down_diag.t_diag_ls_up_down lv_err_ls_up_2 lv_err_ls_down_1 lv_err_ls_up_1 lv_err_ls_down_2 lv_beg_act_test_1 lv_beg_act_test_2 lv_err_ls_up_puc_vld_1 lv_err_ls_up_puc_vld_2 lv_err_ls_up_dyn_vld_1 lv_err_ls_up_dyn_vld_2 lv_err_lsh_up_obd2_vld_1 lv_err_lsh_up_obd2_vld_2 lv_err_ls_up_shift_afl_2 lv_err_ls_up_shift_afl_1 lv_err_ls_up_shift_afr_2 lv_err_ls_up_shift_afr_1 /end OUT_MEASUREMENT
/end FUNCTION
/begin FUNCTION OBD_Dynamic_Fuel_trim_diagnosis "_Dynamic Fuel trim diagnosis"
 /begin DEF_CHARACTERISTIC c_delta_lamb_i_max_diag c_delta_lamb_i_min_diag c_t_sum_vls_dif_dly c_max_vls_dif_dly c_min_vls_dif_dly c_t_end_diag_vls_dif_dly c_t_sum_rst_vls_dif_dly c_t_end_diag_delta_lamb_i c_t_sum_max_delta_lamb_i c_t_sum_min_delta_lamb_i c_t_sum_rst_delta_lamb_i c_maf_int_min_vls_dif_dly c_lam_mv_ldc_vls_dif_dly c_n_ldc_vls_dif_dly c_maf_crlc_ldc_vls_dif_dly c_n_crlc_ldc_vls_dif_dly c_lam_mv_crlc_ldc_vls_dif_dly c_maf_ldc_vls_dif_dly /end DEF_CHARACTERISTIC
 /begin OUT_MEASUREMENT lam_bank_1.lam_dly_obd2.t_sum_max_delta_lamb_i lam_bank_1.lam_dly_obd2.t_sum_min_delta_lamb_i lam_bank_1.lam_dly_obd2.t_sum_rst_delta_lamb_i lam_bank_1.lam_dly_obd2.t_end_diag_delta_lamb_i lam_bank_1.lam_dly_obd2.delta_lamb_i_save lam_bank_1.lam_dly_obd2.sym_vls_dif_dly lam_bank_1.lam_dly_obd2.t_sum_max_vls_dif_dly lam_bank_1.lam_dly_obd2.t_sum_min_vls_dif_dly lam_bank_1.lam_dly_obd2.t_end_diag_vls_dif_dly lam_bank_1.lam_dly_obd2.t_sum_rst_vls_dif_dly lam_bank_1.lam_dly_obd2.bf.lv_sym_vls_dif_dly lam_bank_1.lam_dly_obd2.bf.lv_cdn_vls_dif_dly lam_bank_1.lam_dly_obd2.bf.lv_end_vls_dif_dly lam_bank_1.lam_dly_obd2.bf.lv_ldc_vls_dif_dly lam_bank_1.lam_dly_obd2.bf.lv_lam_mv_ldc_vls_dif_dly lam_bank_1.lam_dly_obd2.maf_int_ldc_vls_dif_dly lam_bank_1.lam_dly_obd2.lam_mmv_ldc_vls_dif_dly lam_bank_2.lam_dly_obd2.t_sum_max_delta_lamb_i lam_bank_2.lam_dly_obd2.t_sum_min_delta_lamb_i lam_bank_2.lam_dly_obd2.t_sum_rst_delta_lamb_i lam_bank_2.lam_dly_obd2.t_end_diag_delta_lamb_i lam_bank_2.lam_dly_obd2.delta_lamb_i_save lam_bank_2.lam_dly_obd2.sym_vls_dif_dly lam_bank_2.lam_dly_obd2.t_sum_max_vls_dif_dly lam_bank_2.lam_dly_obd2.t_sum_min_vls_dif_dly lam_bank_2.lam_dly_obd2.t_end_diag_vls_dif_dly lam_bank_2.lam_dly_obd2.t_sum_rst_vls_dif_dly lam_bank_2.lam_dly_obd2.bf.lv_sym_vls_dif_dly lam_bank_2.lam_dly_obd2.bf.lv_cdn_vls_dif_dly lam_bank_2.lam_dly_obd2.bf.lv_end_vls_dif_dly lam_bank_2.lam_dly_obd2.bf.lv_ldc_vls_dif_dly lam_bank_2.lam_dly_obd2.bf.lv_lam_mv_ldc_vls_dif_dly lam_bank_2.lam_dly_obd2.maf_int_ldc_vls_dif_dly lam_bank_2.lam_dly_obd2.lam_mmv_ldc_vls_dif_dly n_mmv_ldc_vls_dif_dly maf_mmv_ldc_vls_dif_dly lv_n_ldc_vls_dif_dly lv_maf_ldc_vls_dif_dly /end OUT_MEASUREMENT
/end FUNCTION
/begin FUNCTION OBD_Upstream_O2_sensor_ceramic_t "_Upstream O2 sensor ceramic temp OBDII monitoring"
 /begin DEF_CHARACTERISTIC c_frc_obd2_lsh_up c_tcc_obd2_ttip_ls_up c_frc_obd2_ttip_ls_up lc_rep_obd2_ttip_ls_up lc_obd2_ttip_ls_up /end DEF_CHARACTERISTIC
 /begin OUT_MEASUREMENT v_temp_ls_up_mes_ofs_obd2_1 v_temp_ls_up_adj_ofs_obd2_1 gain_temp_ls_up_obd2_1 v_temp_ls_up_adj_ofs_obd2_2 gain_temp_ls_up_obd2_2 v_temp_ls_up_mes_ofs_obd2_2 lv_rep_obd2_ttip_ls_up_1 lv_rep_obd2_ttip_ls_up_2 /end OUT_MEASUREMENT
/end FUNCTION
/begin FUNCTION OBD_Diagnosis_of_WRAF_Sensor "_Diagnosis of WRAF Sensor"
 /begin DEF_CHARACTERISTIC c_t_lsh_on_thd c_t_lam_lim_st_err c_ctr_err_st_ini ip_t_st_eng_max c_vls_down_plaus_min c_vls_down_plaus_max c_temp_cat_plaus_min c_temp_cat_plaus_max c_maf_kgh_ls_plaus_min c_maf_kgh_ls_plaus_max c_cat_diag_plaus_max c_vls_down_plaus_afl c_vls_down_plaus_afr c_lamb_plaus_afl c_lamb_plaus_afr c_lamb_plaus_min c_lamb_plaus_max c_tco_min_plaus_lsl c_delta_lamb_thd_lsh_diag c_cycnr_delta_lamb_lsh_diag_max c_ctr_delta_lamb_lsh_diag_max c_sp_lamb_de_max c_teg_dyn_lsh_diag_min c_maf_int_lsh_diag c_t_per_lamb_de_lsh_diag_max c_delta_lamb_fall_lpf_crlc c_delta_lamb_rise_lpf_crlc c_ctr_ls_up_dyn_min c_ctr_ls_up_dyn_min_ext_req c_n_max_ls_dyn c_n_min_ls_dyn c_ls_dyn_diag_maf_max c_ls_dyn_diag_maf_min c_vls_up_thd_min c_vls_up_thd_max c_t_vls_up_thd_over c_t_plaus_ls_up_puc c_t_wait_plaus_ls_up_puc c_vls_up_plaus_puc_min c_vls_up_plaus_puc_max c_teg_dyn_min_plaus_puc c_cl_mmv_ls_up_diag_max ip_t_plaus_ls_up c_t_end_diag_lsl_plaus c_t_end_diag_lsh_ls_up c_t_end_diag_vls_up_thd_over c_t_end_diag_plaus_ls_up_puc c_inc_ctr_diag_lsl_plaus c_dec_ctr_diag_lsl_plaus c_max_ctr_diag_lsl_plaus c_ctr_ls_up_dyn_wait_max c_cycnr_ls_up_dyn_min c_lamb_ls_up_dyn_min c_lamb_ls_up_dyn_max c_lamb_ampl_min_ls_up_dyn c_lamb_ampl_max_ls_up_dyn c_fac_mv_thd_ls_up_dyn c_fac_ad_thd_ls_up_dyn c_fac_ad_delta_ls_up_dyn c_fac_ad_lpf_ls_up_dyn lc_syn_ls_up_dyn_cat_diag lc_t1_lamb_ad_ls_up_dyn_1 lc_t1_lamb_ad_ls_up_dyn_2 ip_lamb_ampl_max_ls_up_dyn_1 ip_lamb_ampl_max_ls_up_dyn_2 ip_lamb_ampl_min_ls_up_dyn_1 ip_lamb_ampl_min_ls_up_dyn_2 c_ti_lam_max_thd_diag_lam_out c_t_sum_rst_diag_lam_out c_ctr_diag_sym_lam_out c_pv_av_grd_min_diag_lam_out c_t_pv_av_grd_dec_diag_lam_out c_pv_av_grd_dec_diag_lam_out c_pv_av_grd_sum_diag_lam_out c_ti_lam_min_thd_diag_lam_out lc_inh_man_diag_lam_out /end DEF_CHARACTERISTIC
 /begin OUT_MEASUREMENT lam_bank_1.lsl_up_obd2.bf.lv_sym_lsl_plaus lam_bank_1.lsl_up_obd2.bf.lv_end_lsl_plaus lam_bank_1.lsl_up_obd2.bf.lv_cdn_lsl_plaus lam_bank_1.lsl_up_obd2.bf.lv_sym_ls_up_dyn lam_bank_1.lsl_up_obd2.bf.lv_cdn_ls_up_dyn lam_bank_1.lsl_up_obd2.bf.lv_end_ls_up_dyn lam_bank_1.lsl_up_obd2.bf.lv_sym_plaus_ls_up_puc lam_bank_1.lsl_up_obd2.bf.lv_cdn_plaus_ls_up_puc lam_bank_1.lsl_up_obd2.bf.lv_end_plaus_ls_up_puc lam_bank_1.lsl_up_obd2.bf.lv_delta_lamb_dyn_diag lam_bank_1.lsl_up_obd2.bf.lv_ls_up_dyn_vld lam_bank_1.lsl_up_obd2.bf.lv_sym_st_ls lam_bank_1.lsl_up_obd2.bf.lv_cdn_st_ls lam_bank_1.lsl_up_obd2.bf.lv_end_st_ls lam_bank_1.lsl_up_obd2.bf.lv_diag_sym_lam_out lam_bank_1.lsl_up_obd2.bf.lv_diag_max_thd_vld_lam_out lam_bank_1.lsl_up_obd2.bf.lv_diag_min_thd_vld_lam_out lam_bank_1.lsl_up_obd2.ctr_err_st lam_bank_1.lsl_up_obd2.t_st_eng lam_bank_1.lsl_up_obd2.t_lsh_up_on lam_bank_1.lsl_up_obd2.t_lam_lim_st_err lam_bank_1.lsl_up_obd2.t_plaus_ls_up lam_bank_1.lsl_up_obd2.t_end_diag_lsl_plaus lam_bank_1.lsl_up_obd2.t_end_diag_lsh_ls_up lam_bank_1.lsl_up_obd2.cycnr_delta_lamb_lsh_diag lam_bank_1.lsl_up_obd2.ctr_delta_lamb_lsh_diag lam_bank_1.lsl_up_obd2.maf_int_lsh_diag lam_bank_1.lsl_up_obd2.delta_lamb_rise_lpf lam_bank_1.lsl_up_obd2.delta_lamb_fall_lpf lam_bank_1.lsl_up_obd2.lamb_lsl_rise_lsh_up lam_bank_1.lsl_up_obd2.lamb_lsl_fall_lsh_up lam_bank_1.lsl_up_obd2.lamb_lsh_fall lam_bank_1.lsl_up_obd2.lamb_lsh_rise lam_bank_1.lsl_up_obd2.ctr_ls_up_dyn lam_bank_1.lsl_up_obd2.lamb_diag_dyn_min lam_bank_1.lsl_up_obd2.lamb_diag_dyn_max lam_bank_1.lsl_up_obd2.t_end_diag_vls_up_thd_over lam_bank_1.lsl_up_obd2.t_end_diag_plaus_ls_up_puc lam_bank_1.lsl_up_obd2.sym_st_ls lam_bank_1.lsl_up_obd2.sym_plaus_ls_up_puc lam_bank_1.lsl_up_obd2.vls_up_plaus_puc_save lam_bank_1.lsl_up_obd2.lamb_ampl_ls_up_dyn lam_bank_1.lsl_up_obd2.lamb_ampl_min_ls_up_dyn lam_bank_1.lsl_up_obd2.lamb_ampl_max_ls_up_dyn lam_bank_1.lsl_up_obd2.lamb_ampl_mv_ls_up_dyn lam_bank_1.lsl_up_obd2.lamb_ampl_int_ls_up_dyn lam_bank_1.lsl_up_obd2.ctr_ls_up_dyn_min lam_bank_1.lsl_up_obd2.ctr_ls_up_dyn_wait lam_bank_1.lsl_up_obd2.cycnr_ls_up_dyn lam_bank_1.lsl_up_obd2.state_dyn_diag lam_bank_1.lsl_up_obd2.fac_value_ls_up_dyn lam_bank_1.lsl_up_obd2.fac_mv_ls_up_dyn lam_bank_1.lsl_up_obd2.fac_ad_min_ls_up_dyn lam_bank_1.lsl_up_obd2.fac_ad_max_ls_up_dyn lam_bank_1.lsl_up_obd2.fac_ls_up_dyn lam_bank_1.lsl_up_obd2.fac_sum_ls_up_dyn lam_bank_1.lsl_up_obd2.sym_lsl_plaus lam_bank_1.lsl_up_obd2.ctr_diag_sym_lam_out lam_bank_1.lsl_up_obd2.t_sum_rst_diag_lam_out lam_bank_2.lsl_up_obd2.bf.lv_sym_lsl_plaus lam_bank_2.lsl_up_obd2.bf.lv_end_lsl_plaus lam_bank_2.lsl_up_obd2.bf.lv_cdn_lsl_plaus lam_bank_2.lsl_up_obd2.bf.lv_sym_ls_up_dyn lam_bank_2.lsl_up_obd2.bf.lv_cdn_ls_up_dyn lam_bank_2.lsl_up_obd2.bf.lv_end_ls_up_dyn lam_bank_2.lsl_up_obd2.bf.lv_sym_plaus_ls_up_puc lam_bank_2.lsl_up_obd2.bf.lv_cdn_plaus_ls_up_puc lam_bank_2.lsl_up_obd2.bf.lv_end_plaus_ls_up_puc lam_bank_2.lsl_up_obd2.bf.lv_delta_lamb_dyn_diag lam_bank_2.lsl_up_obd2.bf.lv_ls_up_dyn_vld lam_bank_2.lsl_up_obd2.bf.lv_sym_st_ls lam_bank_2.lsl_up_obd2.bf.lv_cdn_st_ls lam_bank_2.lsl_up_obd2.bf.lv_end_st_ls lam_bank_2.lsl_up_obd2.bf.lv_diag_sym_lam_out lam_bank_2.lsl_up_obd2.bf.lv_diag_max_thd_vld_lam_out lam_bank_2.lsl_up_obd2.bf.lv_diag_min_thd_vld_lam_out lam_bank_2.lsl_up_obd2.ctr_err_st lam_bank_2.lsl_up_obd2.t_st_eng lam_bank_2.lsl_up_obd2.t_lsh_up_on lam_bank_2.lsl_up_obd2.t_lam_lim_st_err lam_bank_2.lsl_up_obd2.t_plaus_ls_up lam_bank_2.lsl_up_obd2.t_end_diag_lsl_plaus lam_bank_2.lsl_up_obd2.t_end_diag_lsh_ls_up lam_bank_2.lsl_up_obd2.cycnr_delta_lamb_lsh_diag lam_bank_2.lsl_up_obd2.ctr_delta_lamb_lsh_diag lam_bank_2.lsl_up_obd2.maf_int_lsh_diag lam_bank_2.lsl_up_obd2.delta_lamb_rise_lpf lam_bank_2.lsl_up_obd2.delta_lamb_fall_lpf lam_bank_2.lsl_up_obd2.lamb_lsl_rise_lsh_up lam_bank_2.lsl_up_obd2.lamb_lsl_fall_lsh_up lam_bank_2.lsl_up_obd2.lamb_lsh_fall lam_bank_2.lsl_up_obd2.lamb_lsh_rise lam_bank_2.lsl_up_obd2.ctr_ls_up_dyn lam_bank_2.lsl_up_obd2.lamb_diag_dyn_min lam_bank_2.lsl_up_obd2.lamb_diag_dyn_max lam_bank_2.lsl_up_obd2.t_end_diag_vls_up_thd_over lam_bank_2.lsl_up_obd2.t_end_diag_plaus_ls_up_puc lam_bank_2.lsl_up_obd2.sym_st_ls lam_bank_2.lsl_up_obd2.sym_plaus_ls_up_puc lam_bank_2.lsl_up_obd2.vls_up_plaus_puc_save lam_bank_2.lsl_up_obd2.lamb_ampl_ls_up_dyn lam_bank_2.lsl_up_obd2.lamb_ampl_min_ls_up_dyn lam_bank_2.lsl_up_obd2.lamb_ampl_max_ls_up_dyn lam_bank_2.lsl_up_obd2.lamb_ampl_mv_ls_up_dyn lam_bank_2.lsl_up_obd2.lamb_ampl_int_ls_up_dyn lam_bank_2.lsl_up_obd2.ctr_ls_up_dyn_min lam_bank_2.lsl_up_obd2.ctr_ls_up_dyn_wait lam_bank_2.lsl_up_obd2.cycnr_ls_up_dyn lam_bank_2.lsl_up_obd2.state_dyn_diag lam_bank_2.lsl_up_obd2.fac_value_ls_up_dyn lam_bank_2.lsl_up_obd2.fac_mv_ls_up_dyn lam_bank_2.lsl_up_obd2.fac_ad_min_ls_up_dyn lam_bank_2.lsl_up_obd2.fac_ad_max_ls_up_dyn lam_bank_2.lsl_up_obd2.fac_ls_up_dyn lam_bank_2.lsl_up_obd2.fac_sum_ls_up_dyn lam_bank_2.lsl_up_obd2.sym_lsl_plaus lam_bank_2.lsl_up_obd2.ctr_diag_sym_lam_out lam_bank_2.lsl_up_obd2.t_sum_rst_diag_lam_out lv_err_vls_up_thd_over_1 lv_err_vls_up_thd_over_2 lv_err_lsh_ls_up_1 lv_err_lsh_ls_up_2 lv_lamb_puls_dyn_diag lv_pv_diag_cdn_lam_out pv_av_grd_sum_diag_lam_out t_pv_av_grd_dec_diag_lam_out /end OUT_MEASUREMENT
/end FUNCTION
/begin FUNCTION OBD_Application_Incidencies_of_t "_Application Incidencies of the Plausibility check of the sensor signal" /end FUNCTION
/begin FUNCTION OBD_Application_incidences_Load_ "_Application incidences Load-Throttle position rationality check" /begin OUT_MEASUREMENT lv_inh_load_tps_plaus lv_err_mec_isa /end OUT_MEASUREMENT /end FUNCTION
/begin FUNCTION OBD_Load_Throttle_position_ratio "_Load-Throttle position rationality check"
 /begin DEF_CHARACTERISTIC c_map_drv1_max_load_tps_plaus c_map_drv1_min_load_tps_plaus c_n_max_load_tps_plaus c_n_min_load_tps_plaus c_amp_mdl_dif_max c_amp_mdl_dif_min c_crlc_maf_dif_hfm_mmv c_pq_maf_plaus c_maf_dif_hfm_mdl_mmv c_maf_turb_ratio_min_isa_check c_t_err_isa_amp_plaus ip_ar_red_dif_max ip_ar_red_dif_min c_crlc_maf_dif_mdl_mmv /end DEF_CHARACTERISTIC
 /begin OUT_MEASUREMENT lv_amp_ctl_rst lv_ar_red_ctl_rst lv_ratio_chk_err ar_red_tot_bas lv_sym_load maf_kgh_mff maf_thr_opl maf_isa_opl maf_thr_isa_tot_opl maf_dif_hfm_mmv maf_dif_mdl_mmv t_err_isa_plaus t_err_amp_plaus lv_err_load_tps_plaus /end OUT_MEASUREMENT
/end FUNCTION
/begin FUNCTION OBD_Oxygen_sensor_temperature "_Oxygen sensor temperature"
 /begin OUT_MEASUREMENT lv_inh_diag_obd2_ttip_ls_up_1 lv_inh_diag_obd2_ttip_ls_up_2 /end OUT_MEASUREMENT
/end FUNCTION
/begin FUNCTION OBD_Application_Incidences_for_D "_Application Incidences for Diagnosis of Wide Range A/F Sensors"
 /begin OUT_MEASUREMENT lv_inh_diag_lsl_plaus_1 lv_inh_diag_lsl_plaus_2 lv_inh_diag_st_ls_2 lv_inh_diag_st_ls_1 lv_inh_diag_lsh_ls_up_2 lv_inh_diag_lsh_ls_up_1 lv_inh_diag_ls_up_dyn_2 lv_ls_diag_ext_req_1 lv_ls_diag_ext_req_2 lv_inh_diag_ls_up_dyn_1 lv_inh_diag_vls_up_thd_over_2 lv_inh_diag_vls_up_thd_over_1 lv_inh_diag_plaus_ls_up_puc_1 lv_inh_diag_plaus_ls_up_puc_2 /end OUT_MEASUREMENT
/end FUNCTION
/begin FUNCTION OBD_Application_incidence_of_Oxy "_Application incidence of Oxygen Sensor Interchanged Signal Diagnosis" /begin OUT_MEASUREMENT lv_inh_diag_chg_ls_up lv_inh_diag_chg_ls_down /end OUT_MEASUREMENT /end FUNCTION
/begin FUNCTION OBD_Oxygen_Sensor_Interchanged_S "_Oxygen Sensor Interchanged Signal Diagnosis"
 /begin DEF_CHARACTERISTIC c_t_end_diag_chg_ls_up c_t_end_diag_chg_ls_down c_maf_int_diag_chg_ls_up c_max_ti_lam_cor_chg_ls_up c_min_ti_lam_cor_chg_ls_up /end DEF_CHARACTERISTIC
 /begin OUT_MEASUREMENT lv_err_chg_ls_down lv_err_chg_ls_up t_end_diag_chg_ls_up t_end_diag_chg_ls_down maf_int_diag_chg_ls_up /end OUT_MEASUREMENT
/end FUNCTION
/begin FUNCTION OBD_Application_incidence_enviro "_Application incidence environmental data" /begin DEF_CHARACTERISTIC ip_load_clc_amp__amp ip_load_clc__n_32__maf /end DEF_CHARACTERISTIC /begin OUT_MEASUREMENT load_clc state_ls_1 state_ls_2 /end OUT_MEASUREMENT /end FUNCTION
/end MODULE
/end PROJECT
