ASAP2_VERSION 1 30
/begin PROJECT MSS65-ign "Generiert am 14.10.05 um 09:57:47"
/begin HEADER "" VERSION "R341" /end HEADER
/begin MODULE _MSS65-ign "Generiert am 14.10.05 um 09:57:47"
/begin MOD_COMMON "" BYTE_ORDER MSB_FIRST ALIGNMENT_BYTE 1 ALIGNMENT_WORD 2 ALIGNMENT_LONG 4 ALIGNMENT_FLOAT32_IEEE 4 ALIGNMENT_FLOAT64_IEEE 8 /end MOD_COMMON
/begin CHARACTERISTIC K_CODIER_INDEX "Codierindex" VALUE 0x7024A TKW_VV_VV_UB 100.0 FORMULA_0003 0.0 255.0 /end CHARACTERISTIC
/begin CHARACTERISTIC K_DIAGNOSE_INDEX_HI "Diagnoseindex" VALUE 0x7024B TKW_VV_VV_UB 100.0 FORMULA_0003 0.0 255.0 /end CHARACTERISTIC
/begin CHARACTERISTIC K_DIAGNOSE_INDEX_LO "Diagnoseindex" VALUE 0x7024C TKW_VV_VV_UB 100.0 FORMULA_0003 0.0 255.0 /end CHARACTERISTIC
/begin CHARACTERISTIC K_ED_PCTRL_IGN.DEC_VOR_EINTRAG "Filterverringerung vorm Fehlerspeichereintrag" VALUE 0x70DFD TKW_VV_VV_UB 100.0 FORMULA_0003 0.0 255.0 /end CHARACTERISTIC
/begin CHARACTERISTIC K_ED_PCTRL_IGN.FEHLERSCHWELLE "Filterschwelle fuer Fehlereintrag" VALUE 0x70DFA TKW_VV_VV_UB 100.0 FORMULA_0003 0.0 255.0 /end CHARACTERISTIC
/begin CHARACTERISTIC K_ED_PCTRL_IGN.INC_NACH_EINTRAG "Filtererhoehung nach Fehlerspeichereintrag" VALUE 0x70DFE TKW_VV_VV_UB 100.0 FORMULA_0003 0.0 255.0 /end CHARACTERISTIC
/begin CHARACTERISTIC K_ED_PCTRL_IGN.INC_VOR_EINTRAG "Filtererhoehung vorm Fehlerspeichereintrag" VALUE 0x70DFC TKW_VV_VV_UB 100.0 FORMULA_0003 0.0 255.0 /end CHARACTERISTIC
/begin CHARACTERISTIC K_ED_PCTRL_IGN.KLASSENINDEX "Auswahl der Fehlerklasse" VALUE 0x70E00 TKW_VV_VV_UB 100.0 FORMULA_0003 0.0 8.0 /end CHARACTERISTIC
/begin CHARACTERISTIC K_ED_PCTRL_IGN.OK_SCHWELLE "Filterschwelle fuer Fehleraustrag" VALUE 0x70DFB TKW_VV_VV_UB 100.0 FORMULA_0003 0.0 255.0 /end CHARACTERISTIC
/begin CHARACTERISTIC K_ED_PCTRL_IGN.P_CODE_OPENLOAD "P-Code fuer die Art OPENLOAD" VALUE 0x70DF6 TKW_VV_VV_UW 100.0 FORMULA_0010 0.0 65535.0 /end CHARACTERISTIC
/begin CHARACTERISTIC K_ED_PCTRL_IGN.P_CODE_SH_TO_GND "P-Code fuer die Art SH_TO_GND" VALUE 0x70DF4 TKW_VV_VV_UW 100.0 FORMULA_0010 0.0 65535.0 /end CHARACTERISTIC
/begin CHARACTERISTIC K_ED_PCTRL_IGN.P_CODE_SH_TO_UB "P-Code fuer die Art SH_TO_UB" VALUE 0x70DF2 TKW_VV_VV_UW 100.0 FORMULA_0010 0.0 65535.0 /end CHARACTERISTIC
/begin CHARACTERISTIC K_ED_PCTRL_IGN.P_CODE_UNPLAUSIBEL "P-Code fuer die Art UNPLAUSIBEL" VALUE 0x70DF8 TKW_VV_VV_UW 100.0 FORMULA_0010 0.0 65535.0 /end CHARACTERISTIC
/begin CHARACTERISTIC K_ED_PWG_BLS.DEC_NACH_EINTRAG "Filterverringerung nach Fehlerspeichereintrag" VALUE 0x716BB TKW_VV_VV_UB 100.0 FORMULA_0003 0.0 255.0 /end CHARACTERISTIC
/begin CHARACTERISTIC K_ED_PWG_BLS.DEC_VOR_EINTRAG "Filterverringerung vorm Fehlerspeichereintrag" VALUE 0x716B9 TKW_VV_VV_UB 100.0 FORMULA_0003 0.0 255.0 /end CHARACTERISTIC
/begin CHARACTERISTIC K_ED_PWG_BLS.FEHLERSCHWELLE "Filterschwelle fuer Fehlereintrag" VALUE 0x716B6 TKW_VV_VV_UB 100.0 FORMULA_0003 0.0 255.0 /end CHARACTERISTIC
/begin CHARACTERISTIC K_ED_PWG_BLS.INC_NACH_EINTRAG "Filtererhoehung nach Fehlerspeichereintrag" VALUE 0x716BA TKW_VV_VV_UB 100.0 FORMULA_0003 0.0 255.0 /end CHARACTERISTIC
/begin CHARACTERISTIC K_ED_PWG_BLS.INC_VOR_EINTRAG "Filtererhoehung vorm Fehlerspeichereintrag" VALUE 0x716B8 TKW_VV_VV_UB 100.0 FORMULA_0003 0.0 255.0 /end CHARACTERISTIC
/begin CHARACTERISTIC K_ED_PWG_BLS.KLASSENINDEX "Auswahl der Fehlerklasse" VALUE 0x716BC TKW_VV_VV_UB 100.0 FORMULA_0003 0.0 8.0 /end CHARACTERISTIC
/begin CHARACTERISTIC K_ED_PWG_BLS.OK_SCHWELLE "Filterschwelle fuer Fehleraustrag" VALUE 0x716B7 TKW_VV_VV_UB 100.0 FORMULA_0003 0.0 255.0 /end CHARACTERISTIC
/begin CHARACTERISTIC K_ED_PWG_BLS.P_CODE_OPENLOAD "P-Code fuer die Art OPENLOAD" VALUE 0x716B2 TKW_VV_VV_UW 100.0 FORMULA_0010 0.0 65535.0 /end CHARACTERISTIC
/begin CHARACTERISTIC K_ED_PWG_BLS.P_CODE_SH_TO_GND "P-Code fuer die Art SH_TO_GND" VALUE 0x716B0 TKW_VV_VV_UW 100.0 FORMULA_0010 0.0 65535.0 /end CHARACTERISTIC
/begin CHARACTERISTIC K_ED_PWG_BLS.P_CODE_SH_TO_UB "P-Code fuer die Art SH_TO_UB" VALUE 0x716AE TKW_VV_VV_UW 100.0 FORMULA_0010 0.0 65535.0 /end CHARACTERISTIC
/begin CHARACTERISTIC K_ED_PWG_BLS.P_CODE_UNPLAUSIBEL "P-Code fuer die Art UNPLAUSIBEL" VALUE 0x716B4 TKW_VV_VV_UW 100.0 FORMULA_0010 0.0 65535.0 /end CHARACTERISTIC
/begin CHARACTERISTIC K_ED_PWG_VGL.DEC_NACH_EINTRAG "Filterverringerung nach Fehlerspeichereintrag" VALUE 0x70DE5 TKW_VV_VV_UB 100.0 FORMULA_0003 0.0 255.0 /end CHARACTERISTIC
/begin CHARACTERISTIC K_ED_PWG_VGL.DEC_VOR_EINTRAG "Filterverringerung vorm Fehlerspeichereintrag" VALUE 0x70DE3 TKW_VV_VV_UB 100.0 FORMULA_0003 0.0 255.0 /end CHARACTERISTIC
/begin CHARACTERISTIC K_ED_PWG_VGL.FEHLERSCHWELLE "Filterschwelle fuer Fehlereintrag" VALUE 0x70DE0 TKW_VV_VV_UB 100.0 FORMULA_0003 0.0 255.0 /end CHARACTERISTIC
/begin CHARACTERISTIC K_ED_PWG_VGL.INC_NACH_EINTRAG "Filtererhoehung nach Fehlerspeichereintrag" VALUE 0x70DE4 TKW_VV_VV_UB 100.0 FORMULA_0003 0.0 255.0 /end CHARACTERISTIC
/begin CHARACTERISTIC K_ED_PWG_VGL.INC_VOR_EINTRAG "Filtererhoehung vorm Fehlerspeichereintrag" VALUE 0x70DE2 TKW_VV_VV_UB 100.0 FORMULA_0003 0.0 255.0 /end CHARACTERISTIC
/begin CHARACTERISTIC K_ED_PWG_VGL.KLASSENINDEX "Auswahl der Fehlerklasse" VALUE 0x70DE6 TKW_VV_VV_UB 100.0 FORMULA_0003 0.0 8.0 /end CHARACTERISTIC
/begin CHARACTERISTIC K_ED_PWG_VGL.OK_SCHWELLE "Filterschwelle fuer Fehleraustrag" VALUE 0x70DE1 TKW_VV_VV_UB 100.0 FORMULA_0003 0.0 255.0 /end CHARACTERISTIC
/begin CHARACTERISTIC K_ED_PWG_VGL.P_CODE_OPENLOAD "P-Code fuer die Art OPENLOAD" VALUE 0x70DDC TKW_VV_VV_UW 100.0 FORMULA_0010 0.0 65535.0 /end CHARACTERISTIC
/begin CHARACTERISTIC K_ED_PWG_VGL.P_CODE_SH_TO_GND "P-Code fuer die Art SH_TO_GND" VALUE 0x70DDA TKW_VV_VV_UW 100.0 FORMULA_0010 0.0 65535.0 /end CHARACTERISTIC
/begin CHARACTERISTIC K_ED_PWG_VGL.P_CODE_SH_TO_UB "P-Code fuer die Art SH_TO_UB" VALUE 0x70DD8 TKW_VV_VV_UW 100.0 FORMULA_0010 0.0 65535.0 /end CHARACTERISTIC
/begin CHARACTERISTIC K_ED_PWG_VGL.P_CODE_UNPLAUSIBEL "P-Code fuer die Art UNPLAUSIBEL" VALUE 0x70DDE TKW_VV_VV_UW 100.0 FORMULA_0010 0.0 65535.0 /end CHARACTERISTIC
/begin CHARACTERISTIC K_ED_PWG1.DEC_NACH_EINTRAG "Filterverringerung nach Fehlerspeichereintrag" VALUE 0x70DB1 TKW_VV_VV_UB 100.0 FORMULA_0003 0.0 255.0 /end CHARACTERISTIC
/begin CHARACTERISTIC K_ED_PWG1.DEC_VOR_EINTRAG "Filterverringerung vorm Fehlerspeichereintrag" VALUE 0x70DAF TKW_VV_VV_UB 100.0 FORMULA_0003 0.0 255.0 /end CHARACTERISTIC
/begin CHARACTERISTIC K_ED_PWG1.FEHLERSCHWELLE "Filterschwelle fuer Fehlereintrag" VALUE 0x70DAC TKW_VV_VV_UB 100.0 FORMULA_0003 0.0 255.0 /end CHARACTERISTIC
/begin CHARACTERISTIC K_ED_PWG1.INC_NACH_EINTRAG "Filtererhoehung nach Fehlerspeichereintrag" VALUE 0x70DB0 TKW_VV_VV_UB 100.0 FORMULA_0003 0.0 255.0 /end CHARACTERISTIC
/begin CHARACTERISTIC K_ED_PWG1.INC_VOR_EINTRAG "Filtererhoehung vorm Fehlerspeichereintrag" VALUE 0x70DAE TKW_VV_VV_UB 100.0 FORMULA_0003 0.0 255.0 /end CHARACTERISTIC
/begin CHARACTERISTIC K_ED_PWG1.KLASSENINDEX "Auswahl der Fehlerklasse" VALUE 0x70DB2 TKW_VV_VV_UB 100.0 FORMULA_0003 0.0 8.0 /end CHARACTERISTIC
/begin CHARACTERISTIC K_ED_PWG1.OK_SCHWELLE "Filterschwelle fuer Fehleraustrag" VALUE 0x70DAD TKW_VV_VV_UB 100.0 FORMULA_0003 0.0 255.0 /end CHARACTERISTIC
/begin CHARACTERISTIC K_ED_PWG1.P_CODE_OPENLOAD "P-Code fuer die Art OPENLOAD" VALUE 0x70DA8 TKW_VV_VV_UW 100.0 FORMULA_0010 0.0 65535.0 /end CHARACTERISTIC
/begin CHARACTERISTIC K_ED_PWG1.P_CODE_SH_TO_GND "P-Code fuer die Art SH_TO_GND" VALUE 0x70DA6 TKW_VV_VV_UW 100.0 FORMULA_0010 0.0 65535.0 /end CHARACTERISTIC
/begin CHARACTERISTIC K_ED_PWG1.P_CODE_SH_TO_UB "P-Code fuer die Art SH_TO_UB" VALUE 0x70DA4 TKW_VV_VV_UW 100.0 FORMULA_0010 0.0 65535.0 /end CHARACTERISTIC
/begin CHARACTERISTIC K_ED_PWG1.P_CODE_UNPLAUSIBEL "P-Code fuer die Art UNPLAUSIBEL" VALUE 0x70DAA TKW_VV_VV_UW 100.0 FORMULA_0010 0.0 65535.0 /end CHARACTERISTIC
/begin CHARACTERISTIC K_ED_PWG2.DEC_NACH_EINTRAG "Filterverringerung nach Fehlerspeichereintrag" VALUE 0x70DCB TKW_VV_VV_UB 100.0 FORMULA_0003 0.0 255.0 /end CHARACTERISTIC
/begin CHARACTERISTIC K_ED_PWG2.DEC_VOR_EINTRAG "Filterverringerung vorm Fehlerspeichereintrag" VALUE 0x70DC9 TKW_VV_VV_UB 100.0 FORMULA_0003 0.0 255.0 /end CHARACTERISTIC
/begin CHARACTERISTIC K_ED_PWG2.FEHLERSCHWELLE "Filterschwelle fuer Fehlereintrag" VALUE 0x70DC6 TKW_VV_VV_UB 100.0 FORMULA_0003 0.0 255.0 /end CHARACTERISTIC
/begin CHARACTERISTIC K_ED_PWG2.INC_NACH_EINTRAG "Filtererhoehung nach Fehlerspeichereintrag" VALUE 0x70DCA TKW_VV_VV_UB 100.0 FORMULA_0003 0.0 255.0 /end CHARACTERISTIC
/begin CHARACTERISTIC K_ED_PWG2.INC_VOR_EINTRAG "Filtererhoehung vorm Fehlerspeichereintrag" VALUE 0x70DC8 TKW_VV_VV_UB 100.0 FORMULA_0003 0.0 255.0 /end CHARACTERISTIC
/begin CHARACTERISTIC K_ED_PWG2.KLASSENINDEX "Auswahl der Fehlerklasse" VALUE 0x70DCC TKW_VV_VV_UB 100.0 FORMULA_0003 0.0 8.0 /end CHARACTERISTIC
/begin CHARACTERISTIC K_ED_PWG2.OK_SCHWELLE "Filterschwelle fuer Fehleraustrag" VALUE 0x70DC7 TKW_VV_VV_UB 100.0 FORMULA_0003 0.0 255.0 /end CHARACTERISTIC
/begin CHARACTERISTIC K_ED_PWG2.P_CODE_OPENLOAD "P-Code fuer die Art OPENLOAD" VALUE 0x70DC2 TKW_VV_VV_UW 100.0 FORMULA_0010 0.0 65535.0 /end CHARACTERISTIC
/begin CHARACTERISTIC K_ED_PWG2.P_CODE_SH_TO_GND "P-Code fuer die Art SH_TO_GND" VALUE 0x70DC0 TKW_VV_VV_UW 100.0 FORMULA_0010 0.0 65535.0 /end CHARACTERISTIC
/begin CHARACTERISTIC K_ED_PWG2.P_CODE_SH_TO_UB "P-Code fuer die Art SH_TO_UB" VALUE 0x70DBE TKW_VV_VV_UW 100.0 FORMULA_0010 0.0 65535.0 /end CHARACTERISTIC
/begin CHARACTERISTIC K_ED_PWG2.P_CODE_UNPLAUSIBEL "P-Code fuer die Art UNPLAUSIBEL" VALUE 0x70DC4 TKW_VV_VV_UW 100.0 FORMULA_0010 0.0 65535.0 /end CHARACTERISTIC
/begin CHARACTERISTIC K_ED_RBM_EVAP_MAX "Maximaltemperatur EVAP" VALUE 0x71966 TKW_VV_VV_SW 100.0 FORMULA_0023 -50.0 170.0 FORMAT "%4.1" /end CHARACTERISTIC
/begin CHARACTERISTIC K_ED_RBM_EVAP_MIN "Mindesttemperatur EVAP" VALUE 0x71964 TKW_VV_VV_SW 100.0 FORMULA_0023 -50.0 170.0 FORMAT "%4.1" /end CHARACTERISTIC
/begin CHARACTERISTIC K_ED_RBM_EVAP_TEMP_DELTA "Max. Differenz zwischen tmot und tumg fuer EVAP" VALUE 0x71968 TKW_VV_VV_SW 100.0 FORMULA_0074 -1000.0 1000.0 FORMAT "%4.1" /end CHARACTERISTIC
/begin CHARACTERISTIC K_ED_RBM_PUMG_MIN "Mindestluftdruck fuer Rate-Based" VALUE 0x71958 TKW_VV_VV_SW 100.0 FORMULA_0075 400.0 1200.0 FORMAT "%4.1" /end CHARACTERISTIC
/begin CHARACTERISTIC K_ED_RBM_TIME "Gesamtzeit fuer Fahrzyklus" VALUE 0x7195C TKW_VV_VV_UW 100.0 FORMULA_0071 0.0 6553.5 FORMAT "%4.1" /end CHARACTERISTIC
/begin CHARACTERISTIC K_ED_RBM_TIME_LL "Mindestleerlauf Fahrzyklus" VALUE 0x71960 TKW_VV_VV_UW 100.0 FORMULA_0071 0.0 6553.5 FORMAT "%4.1" /end CHARACTERISTIC
/begin CHARACTERISTIC K_ED_RBM_TIME_V "Geschwindigkeitszeit Fahrzyklus" VALUE 0x7195E TKW_VV_VV_UW 100.0 FORMULA_0071 0.0 6553.5 FORMAT "%4.1" /end CHARACTERISTIC
/begin CHARACTERISTIC K_ED_RBM_TUMG_MIN "Mindesttemperatur" VALUE 0x7195A TKW_VV_VV_SW 100.0 FORMULA_0023 -50.0 170.0 FORMAT "%4.1" /end CHARACTERISTIC
/begin CHARACTERISTIC K_ED_RBM_V_MIN "Mindestgeschwindigkeit Fahrzyklus" VALUE 0x71962 TKW_VV_VV_SW 100.0 FORMULA_0076 -80.0 360.0 FORMAT "%4.1" /end CHARACTERISTIC
/begin CHARACTERISTIC K_ED_SC_BUSOFF.DEC_NACH_EINTRAG "Filterverringerung nach Fehlerspeichereintrag" VALUE 0x7125D TKW_VV_VV_UB 100.0 FORMULA_0003 0.0 255.0 /end CHARACTERISTIC
/begin CHARACTERISTIC K_ED_SC_BUSOFF.DEC_VOR_EINTRAG "Filterverringerung vorm Fehlerspeichereintrag" VALUE 0x7125B TKW_VV_VV_UB 100.0 FORMULA_0003 0.0 255.0 /end CHARACTERISTIC
/begin CHARACTERISTIC K_ED_SC_BUSOFF.FEHLERSCHWELLE "Filterschwelle fuer Fehlereintrag" VALUE 0x71258 TKW_VV_VV_UB 100.0 FORMULA_0003 0.0 255.0 /end CHARACTERISTIC
/begin CHARACTERISTIC K_ED_SC_BUSOFF.INC_NACH_EINTRAG "Filtererhoehung nach Fehlerspeichereintrag" VALUE 0x7125C TKW_VV_VV_UB 100.0 FORMULA_0003 0.0 255.0 /end CHARACTERISTIC
/begin CHARACTERISTIC K_ED_SC_BUSOFF.INC_VOR_EINTRAG "Filtererhoehung vorm Fehlerspeichereintrag" VALUE 0x7125A TKW_VV_VV_UB 100.0 FORMULA_0003 0.0 255.0 /end CHARACTERISTIC
/begin CHARACTERISTIC K_ED_SC_BUSOFF.KLASSENINDEX "Auswahl der Fehlerklasse" VALUE 0x7125E TKW_VV_VV_UB 100.0 FORMULA_0003 0.0 8.0 /end CHARACTERISTIC
/begin CHARACTERISTIC K_ED_SC_BUSOFF.OK_SCHWELLE "Filterschwelle fuer Fehleraustrag" VALUE 0x71259 TKW_VV_VV_UB 100.0 FORMULA_0003 0.0 255.0 /end CHARACTERISTIC
/begin CHARACTERISTIC K_ED_SC_BUSOFF.P_CODE_OPENLOAD "P-Code fuer die Art OPENLOAD" VALUE 0x71254 TKW_VV_VV_UW 100.0 FORMULA_0010 0.0 65535.0 /end CHARACTERISTIC
/begin CHARACTERISTIC K_ED_SC_BUSOFF.P_CODE_SH_TO_GND "P-Code fuer die Art SH_TO_GND" VALUE 0x71252 TKW_VV_VV_UW 100.0 FORMULA_0010 0.0 65535.0 /end CHARACTERISTIC
/begin CHARACTERISTIC K_ED_SC_BUSOFF.P_CODE_SH_TO_UB "P-Code fuer die Art SH_TO_UB" VALUE 0x71250 TKW_VV_VV_UW 100.0 FORMULA_0010 0.0 65535.0 /end CHARACTERISTIC
/begin CHARACTERISTIC K_ED_SC_BUSOFF.P_CODE_UNPLAUSIBEL "P-Code fuer die Art UNPLAUSIBEL" VALUE 0x71256 TKW_VV_VV_UW 100.0 FORMULA_0010 0.0 65535.0 /end CHARACTERISTIC
/begin CHARACTERISTIC K_ED_SC_PKS.DEC_NACH_EINTRAG "Filterverringerung nach Fehlerspeichereintrag" VALUE 0x71569 TKW_VV_VV_UB 100.0 FORMULA_0003 0.0 255.0 /end CHARACTERISTIC
/begin CHARACTERISTIC K_ED_SC_PKS.DEC_VOR_EINTRAG "Filterverringerung vorm Fehlerspeichereintrag" VALUE 0x71567 TKW_VV_VV_UB 100.0 FORMULA_0003 0.0 255.0 /end CHARACTERISTIC
/begin CHARACTERISTIC K_ED_SC_PKS.FEHLERSCHWELLE "Filterschwelle fuer Fehlereintrag" VALUE 0x71564 TKW_VV_VV_UB 100.0 FORMULA_0003 0.0 255.0 /end CHARACTERISTIC
/begin CHARACTERISTIC K_ED_SC_PKS.INC_NACH_EINTRAG "Filtererhoehung nach Fehlerspeichereintrag" VALUE 0x71568 TKW_VV_VV_UB 100.0 FORMULA_0003 0.0 255.0 /end CHARACTERISTIC
/begin CHARACTERISTIC K_ED_SC_PKS.INC_VOR_EINTRAG "Filtererhoehung vorm Fehlerspeichereintrag" VALUE 0x71566 TKW_VV_VV_UB 100.0 FORMULA_0003 0.0 255.0 /end CHARACTERISTIC
/begin CHARACTERISTIC K_ED_SC_PKS.KLASSENINDEX "Auswahl der Fehlerklasse" VALUE 0x7156A TKW_VV_VV_UB 100.0 FORMULA_0003 0.0 8.0 /end CHARACTERISTIC
/begin CHARACTERISTIC K_ED_SC_PKS.OK_SCHWELLE "Filterschwelle fuer Fehleraustrag" VALUE 0x71565 TKW_VV_VV_UB 100.0 FORMULA_0003 0.0 255.0 /end CHARACTERISTIC
/begin CHARACTERISTIC K_ED_SC_PKS.P_CODE_OPENLOAD "P-Code fuer die Art OPENLOAD" VALUE 0x71560 TKW_VV_VV_UW 100.0 FORMULA_0010 0.0 65535.0 /end CHARACTERISTIC
/begin CHARACTERISTIC K_ED_SC_PKS.P_CODE_SH_TO_GND "P-Code fuer die Art SH_TO_GND" VALUE 0x7155E TKW_VV_VV_UW 100.0 FORMULA_0010 0.0 65535.0 /end CHARACTERISTIC
/begin CHARACTERISTIC K_ED_SC_PKS.P_CODE_SH_TO_UB "P-Code fuer die Art SH_TO_UB" VALUE 0x7155C TKW_VV_VV_UW 100.0 FORMULA_0010 0.0 65535.0 /end CHARACTERISTIC
/begin CHARACTERISTIC K_ED_SC_PKS.P_CODE_UNPLAUSIBEL "P-Code fuer die Art UNPLAUSIBEL" VALUE 0x71562 TKW_VV_VV_UW 100.0 FORMULA_0010 0.0 65535.0 /end CHARACTERISTIC
/begin CHARACTERISTIC K_ED_SC_SMG1.DEC_NACH_EINTRAG "Filterverringerung nach Fehlerspeichereintrag" VALUE 0x7120F TKW_VV_VV_UB 100.0 FORMULA_0003 0.0 255.0 /end CHARACTERISTIC
/begin CHARACTERISTIC K_ED_SC_SMG1.DEC_VOR_EINTRAG "Filterverringerung vorm Fehlerspeichereintrag" VALUE 0x7120D TKW_VV_VV_UB 100.0 FORMULA_0003 0.0 255.0 /end CHARACTERISTIC
/begin CHARACTERISTIC K_ED_SC_SMG1.FEHLERSCHWELLE "Filterschwelle fuer Fehlereintrag" VALUE 0x7120A TKW_VV_VV_UB 100.0 FORMULA_0003 0.0 255.0 /end CHARACTERISTIC
/begin CHARACTERISTIC K_ED_SC_SMG1.INC_NACH_EINTRAG "Filtererhoehung nach Fehlerspeichereintrag" VALUE 0x7120E TKW_VV_VV_UB 100.0 FORMULA_0003 0.0 255.0 /end CHARACTERISTIC
/begin CHARACTERISTIC K_ED_SC_SMG1.INC_VOR_EINTRAG "Filtererhoehung vorm Fehlerspeichereintrag" VALUE 0x7120C TKW_VV_VV_UB 100.0 FORMULA_0003 0.0 255.0 /end CHARACTERISTIC
/begin CHARACTERISTIC K_ED_SC_SMG1.KLASSENINDEX "Auswahl der Fehlerklasse" VALUE 0x71210 TKW_VV_VV_UB 100.0 FORMULA_0003 0.0 8.0 /end CHARACTERISTIC
/begin CHARACTERISTIC K_ED_SC_SMG1.OK_SCHWELLE "Filterschwelle fuer Fehleraustrag" VALUE 0x7120B TKW_VV_VV_UB 100.0 FORMULA_0003 0.0 255.0 /end CHARACTERISTIC
/begin CHARACTERISTIC K_ED_SC_SMG1.P_CODE_OPENLOAD "P-Code fuer die Art OPENLOAD" VALUE 0x71206 TKW_VV_VV_UW 100.0 FORMULA_0010 0.0 65535.0 /end CHARACTERISTIC
/begin CHARACTERISTIC K_ED_SC_SMG1.P_CODE_SH_TO_GND "P-Code fuer die Art SH_TO_GND" VALUE 0x71204 TKW_VV_VV_UW 100.0 FORMULA_0010 0.0 65535.0 /end CHARACTERISTIC
/begin CHARACTERISTIC K_ED_SC_SMG1.P_CODE_SH_TO_UB "P-Code fuer die Art SH_TO_UB" VALUE 0x71202 TKW_VV_VV_UW 100.0 FORMULA_0010 0.0 65535.0 /end CHARACTERISTIC
/begin CHARACTERISTIC K_ED_SC_SMG1.P_CODE_UNPLAUSIBEL "P-Code fuer die Art UNPLAUSIBEL" VALUE 0x71208 TKW_VV_VV_UW 100.0 FORMULA_0010 0.0 65535.0 /end CHARACTERISTIC
/begin CHARACTERISTIC K_ED_SC_SMG2.DEC_NACH_EINTRAG "Filterverringerung nach Fehlerspeichereintrag" VALUE 0x71229 TKW_VV_VV_UB 100.0 FORMULA_0003 0.0 255.0 /end CHARACTERISTIC
/begin CHARACTERISTIC K_ED_SC_SMG2.DEC_VOR_EINTRAG "Filterverringerung vorm Fehlerspeichereintrag" VALUE 0x71227 TKW_VV_VV_UB 100.0 FORMULA_0003 0.0 255.0 /end CHARACTERISTIC
/begin CHARACTERISTIC K_ED_SC_SMG2.FEHLERSCHWELLE "Filterschwelle fuer Fehlereintrag" VALUE 0x71224 TKW_VV_VV_UB 100.0 FORMULA_0003 0.0 255.0 /end CHARACTERISTIC
/begin CHARACTERISTIC K_ED_SC_SMG2.INC_NACH_EINTRAG "Filtererhoehung nach Fehlerspeichereintrag" VALUE 0x71228 TKW_VV_VV_UB 100.0 FORMULA_0003 0.0 255.0 /end CHARACTERISTIC
/begin CHARACTERISTIC K_ED_SC_SMG2.INC_VOR_EINTRAG "Filtererhoehung vorm Fehlerspeichereintrag" VALUE 0x71226 TKW_VV_VV_UB 100.0 FORMULA_0003 0.0 255.0 /end CHARACTERISTIC
/begin CHARACTERISTIC K_ED_SC_SMG2.KLASSENINDEX "Auswahl der Fehlerklasse" VALUE 0x7122A TKW_VV_VV_UB 100.0 FORMULA_0003 0.0 8.0 /end CHARACTERISTIC
/begin CHARACTERISTIC K_ED_SC_SMG2.OK_SCHWELLE "Filterschwelle fuer Fehleraustrag" VALUE 0x71225 TKW_VV_VV_UB 100.0 FORMULA_0003 0.0 255.0 /end CHARACTERISTIC
/begin CHARACTERISTIC K_ED_SC_SMG2.P_CODE_OPENLOAD "P-Code fuer die Art OPENLOAD" VALUE 0x71220 TKW_VV_VV_UW 100.0 FORMULA_0010 0.0 65535.0 /end CHARACTERISTIC
/begin CHARACTERISTIC K_ED_SC_SMG2.P_CODE_SH_TO_GND "P-Code fuer die Art SH_TO_GND" VALUE 0x7121E TKW_VV_VV_UW 100.0 FORMULA_0010 0.0 65535.0 /end CHARACTERISTIC
/begin CHARACTERISTIC K_ED_SC_SMG2.P_CODE_SH_TO_UB "P-Code fuer die Art SH_TO_UB" VALUE 0x7121C TKW_VV_VV_UW 100.0 FORMULA_0010 0.0 65535.0 /end CHARACTERISTIC
/begin CHARACTERISTIC K_ED_SC_SMG2.P_CODE_UNPLAUSIBEL "P-Code fuer die Art UNPLAUSIBEL" VALUE 0x71222 TKW_VV_VV_UW 100.0 FORMULA_0010 0.0 65535.0 /end CHARACTERISTIC
/begin CHARACTERISTIC K_ED_SC_SMG3.DEC_NACH_EINTRAG "Filterverringerung nach Fehlerspeichereintrag" VALUE 0x71243 TKW_VV_VV_UB 100.0 FORMULA_0003 0.0 255.0 /end CHARACTERISTIC
/begin CHARACTERISTIC K_ED_SC_SMG3.DEC_VOR_EINTRAG "Filterverringerung vorm Fehlerspeichereintrag" VALUE 0x71241 TKW_VV_VV_UB 100.0 FORMULA_0003 0.0 255.0 /end CHARACTERISTIC
/begin CHARACTERISTIC K_ED_SC_SMG3.FEHLERSCHWELLE "Filterschwelle fuer Fehlereintrag" VALUE 0x7123E TKW_VV_VV_UB 100.0 FORMULA_0003 0.0 255.0 /end CHARACTERISTIC
/begin CHARACTERISTIC K_ED_SC_SMG3.INC_NACH_EINTRAG "Filtererhoehung nach Fehlerspeichereintrag" VALUE 0x71242 TKW_VV_VV_UB 100.0 FORMULA_0003 0.0 255.0 /end CHARACTERISTIC
/begin CHARACTERISTIC K_ED_SC_SMG3.INC_VOR_EINTRAG "Filtererhoehung vorm Fehlerspeichereintrag" VALUE 0x71240 TKW_VV_VV_UB 100.0 FORMULA_0003 0.0 255.0 /end CHARACTERISTIC
/begin CHARACTERISTIC K_ED_SC_SMG3.KLASSENINDEX "Auswahl der Fehlerklasse" VALUE 0x71244 TKW_VV_VV_UB 100.0 FORMULA_0003 0.0 8.0 /end CHARACTERISTIC
/begin CHARACTERISTIC K_ED_SC_SMG3.OK_SCHWELLE "Filterschwelle fuer Fehleraustrag" VALUE 0x7123F TKW_VV_VV_UB 100.0 FORMULA_0003 0.0 255.0 /end CHARACTERISTIC
/begin CHARACTERISTIC K_ED_SC_SMG3.P_CODE_OPENLOAD "P-Code fuer die Art OPENLOAD" VALUE 0x7123A TKW_VV_VV_UW 100.0 FORMULA_0010 0.0 65535.0 /end CHARACTERISTIC
/begin CHARACTERISTIC K_ED_SC_SMG3.P_CODE_SH_TO_GND "P-Code fuer die Art SH_TO_GND" VALUE 0x71238 TKW_VV_VV_UW 100.0 FORMULA_0010 0.0 65535.0 /end CHARACTERISTIC
/begin CHARACTERISTIC K_ED_SC_SMG3.P_CODE_SH_TO_UB "P-Code fuer die Art SH_TO_UB" VALUE 0x71236 TKW_VV_VV_UW 100.0 FORMULA_0010 0.0 65535.0 /end CHARACTERISTIC
/begin CHARACTERISTIC K_ED_SC_SMG3.P_CODE_UNPLAUSIBEL "P-Code fuer die Art UNPLAUSIBEL" VALUE 0x7123C TKW_VV_VV_UW 100.0 FORMULA_0010 0.0 65535.0 /end CHARACTERISTIC
/begin CHARACTERISTIC K_ED_SCDN_ABDECKUNG_AUSTRAG "Similar Abdeckung fuer Fehlerspeicheraustrag " VALUE 0x71952 TKW_VV_VV_UW 100.0 FORMULA_0073 0.0 4.0 FORMAT "%6.3" /end CHARACTERISTIC
/begin CHARACTERISTIC K_ED_SCDN_ABDECKUNG_EINTRAG "Similar Abdeckung fuer Fehlerspeichereintrag " VALUE 0x71950 TKW_VV_VV_UW 100.0 FORMULA_0073 0.0 4.0 FORMAT "%6.3" /end CHARACTERISTIC
/begin CHARACTERISTIC K_ED_SERVO_I.DEC_NACH_EINTRAG "Filterverringerung nach Fehlerspeichereintrag" VALUE 0x71723 TKW_VV_VV_UB 100.0 FORMULA_0003 0.0 255.0 /end CHARACTERISTIC
/begin CHARACTERISTIC K_ED_SERVO_I.DEC_VOR_EINTRAG "Filterverringerung vorm Fehlerspeichereintrag" VALUE 0x71721 TKW_VV_VV_UB 100.0 FORMULA_0003 0.0 255.0 /end CHARACTERISTIC
/begin CHARACTERISTIC K_ED_SERVO_I.FEHLERSCHWELLE "Filterschwelle fuer Fehlereintrag" VALUE 0x7171E TKW_VV_VV_UB 100.0 FORMULA_0003 0.0 255.0 /end CHARACTERISTIC
/begin CHARACTERISTIC K_ED_SERVO_I.INC_NACH_EINTRAG "Filtererhoehung nach Fehlerspeichereintrag" VALUE 0x71722 TKW_VV_VV_UB 100.0 FORMULA_0003 0.0 255.0 /end CHARACTERISTIC
/begin CHARACTERISTIC K_ED_SERVO_I.INC_VOR_EINTRAG "Filtererhoehung vorm Fehlerspeichereintrag" VALUE 0x71720 TKW_VV_VV_UB 100.0 FORMULA_0003 0.0 255.0 /end CHARACTERISTIC
/begin CHARACTERISTIC K_ED_SERVO_I.KLASSENINDEX "Auswahl der Fehlerklasse" VALUE 0x71724 TKW_VV_VV_UB 100.0 FORMULA_0003 0.0 8.0 /end CHARACTERISTIC
/begin CHARACTERISTIC K_ED_SERVO_I.OK_SCHWELLE "Filterschwelle fuer Fehleraustrag" VALUE 0x7171F TKW_VV_VV_UB 100.0 FORMULA_0003 0.0 255.0 /end CHARACTERISTIC
/begin CHARACTERISTIC K_ED_SERVO_I.P_CODE_OPENLOAD "P-Code fuer die Art OPENLOAD" VALUE 0x7171A TKW_VV_VV_UW 100.0 FORMULA_0010 0.0 65535.0 /end CHARACTERISTIC
/begin CHARACTERISTIC K_ED_SERVO_I.P_CODE_SH_TO_GND "P-Code fuer die Art SH_TO_GND" VALUE 0x71718 TKW_VV_VV_UW 100.0 FORMULA_0010 0.0 65535.0 /end CHARACTERISTIC
/begin CHARACTERISTIC K_ED_SERVO_I.P_CODE_SH_TO_UB "P-Code fuer die Art SH_TO_UB" VALUE 0x71716 TKW_VV_VV_UW 100.0 FORMULA_0010 0.0 65535.0 /end CHARACTERISTIC
/begin CHARACTERISTIC K_ED_SERVO_I.P_CODE_UNPLAUSIBEL "P-Code fuer die Art UNPLAUSIBEL" VALUE 0x7171C TKW_VV_VV_UW 100.0 FORMULA_0010 0.0 65535.0 /end CHARACTERISTIC
/begin CHARACTERISTIC K_ED_SERVO_V.DEC_NACH_EINTRAG "Filterverringerung nach Fehlerspeichereintrag" VALUE 0x7173D TKW_VV_VV_UB 100.0 FORMULA_0003 0.0 255.0 /end CHARACTERISTIC
/begin CHARACTERISTIC K_ED_SERVO_V.DEC_VOR_EINTRAG "Filterverringerung vorm Fehlerspeichereintrag" VALUE 0x7173B TKW_VV_VV_UB 100.0 FORMULA_0003 0.0 255.0 /end CHARACTERISTIC
/begin CHARACTERISTIC K_ED_SERVO_V.FEHLERSCHWELLE "Filterschwelle fuer Fehlereintrag" VALUE 0x71738 TKW_VV_VV_UB 100.0 FORMULA_0003 0.0 255.0 /end CHARACTERISTIC
/begin CHARACTERISTIC K_ED_SERVO_V.INC_NACH_EINTRAG "Filtererhoehung nach Fehlerspeichereintrag" VALUE 0x7173C TKW_VV_VV_UB 100.0 FORMULA_0003 0.0 255.0 /end CHARACTERISTIC
/begin CHARACTERISTIC K_ED_SERVO_V.INC_VOR_EINTRAG "Filtererhoehung vorm Fehlerspeichereintrag" VALUE 0x7173A TKW_VV_VV_UB 100.0 FORMULA_0003 0.0 255.0 /end CHARACTERISTIC
/begin CHARACTERISTIC K_ED_SERVO_V.KLASSENINDEX "Auswahl der Fehlerklasse" VALUE 0x7173E TKW_VV_VV_UB 100.0 FORMULA_0003 0.0 8.0 /end CHARACTERISTIC
/begin CHARACTERISTIC K_ED_SERVO_V.OK_SCHWELLE "Filterschwelle fuer Fehleraustrag" VALUE 0x71739 TKW_VV_VV_UB 100.0 FORMULA_0003 0.0 255.0 /end CHARACTERISTIC
/begin CHARACTERISTIC K_ED_SERVO_V.P_CODE_OPENLOAD "P-Code fuer die Art OPENLOAD" VALUE 0x71734 TKW_VV_VV_UW 100.0 FORMULA_0010 0.0 65535.0 /end CHARACTERISTIC
/begin CHARACTERISTIC K_ED_SERVO_V.P_CODE_SH_TO_GND "P-Code fuer die Art SH_TO_GND" VALUE 0x71732 TKW_VV_VV_UW 100.0 FORMULA_0010 0.0 65535.0 /end CHARACTERISTIC
/begin CHARACTERISTIC K_ED_SERVO_V.P_CODE_SH_TO_UB "P-Code fuer die Art SH_TO_UB" VALUE 0x71730 TKW_VV_VV_UW 100.0 FORMULA_0010 0.0 65535.0 /end CHARACTERISTIC
/begin CHARACTERISTIC K_ED_SERVO_V.P_CODE_UNPLAUSIBEL "P-Code fuer die Art UNPLAUSIBEL" VALUE 0x71736 TKW_VV_VV_UW 100.0 FORMULA_0010 0.0 65535.0 /end CHARACTERISTIC
/begin CHARACTERISTIC K_ED_SG_IGN.DEC_NACH_EINTRAG "Filterverringerung nach Fehlerspeichereintrag" VALUE 0x715B7 TKW_VV_VV_UB 100.0 FORMULA_0003 0.0 255.0 /end CHARACTERISTIC
/begin CHARACTERISTIC K_ED_SG_IGN.DEC_VOR_EINTRAG "Filterverringerung vorm Fehlerspeichereintrag" VALUE 0x715B5 TKW_VV_VV_UB 100.0 FORMULA_0003 0.0 255.0 /end CHARACTERISTIC
/begin CHARACTERISTIC K_ED_SG_IGN.FEHLERSCHWELLE "Filterschwelle fuer Fehlereintrag" VALUE 0x715B2 TKW_VV_VV_UB 100.0 FORMULA_0003 0.0 255.0 /end CHARACTERISTIC
/begin CHARACTERISTIC K_ED_SG_IGN.INC_NACH_EINTRAG "Filtererhoehung nach Fehlerspeichereintrag" VALUE 0x715B6 TKW_VV_VV_UB 100.0 FORMULA_0003 0.0 255.0 /end CHARACTERISTIC
/begin CHARACTERISTIC K_ED_SG_IGN.INC_VOR_EINTRAG "Filtererhoehung vorm Fehlerspeichereintrag" VALUE 0x715B4 TKW_VV_VV_UB 100.0 FORMULA_0003 0.0 255.0 /end CHARACTERISTIC
/begin CHARACTERISTIC K_ED_SG_IGN.KLASSENINDEX "Auswahl der Fehlerklasse" VALUE 0x715B8 TKW_VV_VV_UB 100.0 FORMULA_0003 0.0 8.0 /end CHARACTERISTIC
/begin CHARACTERISTIC K_ED_SG_IGN.OK_SCHWELLE "Filterschwelle fuer Fehleraustrag" VALUE 0x715B3 TKW_VV_VV_UB 100.0 FORMULA_0003 0.0 255.0 /end CHARACTERISTIC
/begin CHARACTERISTIC K_ED_SG_IGN.P_CODE_OPENLOAD "P-Code fuer die Art OPENLOAD" VALUE 0x715AE TKW_VV_VV_UW 100.0 FORMULA_0010 0.0 65535.0 /end CHARACTERISTIC
/begin CHARACTERISTIC K_ED_SG_IGN.P_CODE_SH_TO_GND "P-Code fuer die Art SH_TO_GND" VALUE 0x715AC TKW_VV_VV_UW 100.0 FORMULA_0010 0.0 65535.0 /end CHARACTERISTIC
/begin CHARACTERISTIC K_ED_SG_IGN.P_CODE_SH_TO_UB "P-Code fuer die Art SH_TO_UB" VALUE 0x715AA TKW_VV_VV_UW 100.0 FORMULA_0010 0.0 65535.0 /end CHARACTERISTIC
/begin CHARACTERISTIC K_ED_SG_IGN.P_CODE_UNPLAUSIBEL "P-Code fuer die Art UNPLAUSIBEL" VALUE 0x715B0 TKW_VV_VV_UW 100.0 FORMULA_0010 0.0 65535.0 /end CHARACTERISTIC
/begin CHARACTERISTIC K_ED_SK_MANAGER_IGN.DEC_NACH_EINTRAG "Filterverringerung nach Fehlerspeichereintrag" VALUE 0x71605 TKW_VV_VV_UB 100.0 FORMULA_0003 0.0 255.0 /end CHARACTERISTIC
/begin CHARACTERISTIC K_ED_SK_MANAGER_IGN.DEC_VOR_EINTRAG "Filterverringerung vorm Fehlerspeichereintrag" VALUE 0x71603 TKW_VV_VV_UB 100.0 FORMULA_0003 0.0 255.0 /end CHARACTERISTIC
/begin CHARACTERISTIC K_ED_SK_MANAGER_IGN.FEHLERSCHWELLE "Filterschwelle fuer Fehlereintrag" VALUE 0x71600 TKW_VV_VV_UB 100.0 FORMULA_0003 0.0 255.0 /end CHARACTERISTIC
/begin CHARACTERISTIC K_ED_SK_MANAGER_IGN.INC_NACH_EINTRAG "Filtererhoehung nach Fehlerspeichereintrag" VALUE 0x71604 TKW_VV_VV_UB 100.0 FORMULA_0003 0.0 255.0 /end CHARACTERISTIC
/begin CHARACTERISTIC K_ED_SK_MANAGER_IGN.INC_VOR_EINTRAG "Filtererhoehung vorm Fehlerspeichereintrag" VALUE 0x71602 TKW_VV_VV_UB 100.0 FORMULA_0003 0.0 255.0 /end CHARACTERISTIC
/begin CHARACTERISTIC K_ED_SK_MANAGER_IGN.KLASSENINDEX "Auswahl der Fehlerklasse" VALUE 0x71606 TKW_VV_VV_UB 100.0 FORMULA_0003 0.0 8.0 /end CHARACTERISTIC
/begin CHARACTERISTIC K_ED_SK_MANAGER_IGN.OK_SCHWELLE "Filterschwelle fuer Fehleraustrag" VALUE 0x71601 TKW_VV_VV_UB 100.0 FORMULA_0003 0.0 255.0 /end CHARACTERISTIC
/begin CHARACTERISTIC K_ED_SK_MANAGER_IGN.P_CODE_OPENLOAD "P-Code fuer die Art OPENLOAD" VALUE 0x715FC TKW_VV_VV_UW 100.0 FORMULA_0010 0.0 65535.0 /end CHARACTERISTIC
/begin CHARACTERISTIC K_ED_SK_MANAGER_IGN.P_CODE_SH_TO_GND "P-Code fuer die Art SH_TO_GND" VALUE 0x715FA TKW_VV_VV_UW 100.0 FORMULA_0010 0.0 65535.0 /end CHARACTERISTIC
/begin CHARACTERISTIC K_ED_SK_MANAGER_IGN.P_CODE_SH_TO_UB "P-Code fuer die Art SH_TO_UB" VALUE 0x715F8 TKW_VV_VV_UW 100.0 FORMULA_0010 0.0 65535.0 /end CHARACTERISTIC
/begin CHARACTERISTIC K_ED_SK_MANAGER_IGN.P_CODE_UNPLAUSIBEL "P-Code fuer die Art UNPLAUSIBEL" VALUE 0x715FE TKW_VV_VV_UW 100.0 FORMULA_0010 0.0 65535.0 /end CHARACTERISTIC
/begin CHARACTERISTIC K_ED_SK_TR_IGN.DEC_NACH_EINTRAG "Filterverringerung nach Fehlerspeichereintrag" VALUE 0x70C5F TKW_VV_VV_UB 100.0 FORMULA_0003 0.0 255.0 /end CHARACTERISTIC
/begin CHARACTERISTIC K_ED_SK_TR_IGN.DEC_VOR_EINTRAG "Filterverringerung vorm Fehlerspeichereintrag" VALUE 0x70C5D TKW_VV_VV_UB 100.0 FORMULA_0003 0.0 255.0 /end CHARACTERISTIC
/begin CHARACTERISTIC K_ED_SK_TR_IGN.FEHLERSCHWELLE "Filterschwelle fuer Fehlereintrag" VALUE 0x70C5A TKW_VV_VV_UB 100.0 FORMULA_0003 0.0 255.0 /end CHARACTERISTIC
/begin CHARACTERISTIC K_ED_SK_TR_IGN.INC_NACH_EINTRAG "Filtererhoehung nach Fehlerspeichereintrag" VALUE 0x70C5E TKW_VV_VV_UB 100.0 FORMULA_0003 0.0 255.0 /end CHARACTERISTIC
/begin CHARACTERISTIC K_ED_SK_TR_IGN.INC_VOR_EINTRAG "Filtererhoehung vorm Fehlerspeichereintrag" VALUE 0x70C5C TKW_VV_VV_UB 100.0 FORMULA_0003 0.0 255.0 /end CHARACTERISTIC
/begin CHARACTERISTIC K_ED_SK_TR_IGN.KLASSENINDEX "Auswahl der Fehlerklasse" VALUE 0x70C60 TKW_VV_VV_UB 100.0 FORMULA_0003 0.0 8.0 /end CHARACTERISTIC
/begin CHARACTERISTIC K_ED_SK_TR_IGN.OK_SCHWELLE "Filterschwelle fuer Fehleraustrag" VALUE 0x70C5B TKW_VV_VV_UB 100.0 FORMULA_0003 0.0 255.0 /end CHARACTERISTIC
/begin CHARACTERISTIC K_ED_SK_TR_IGN.P_CODE_OPENLOAD "P-Code fuer die Art OPENLOAD" VALUE 0x70C56 TKW_VV_VV_UW 100.0 FORMULA_0010 0.0 65535.0 /end CHARACTERISTIC
/begin CHARACTERISTIC K_ED_SK_TR_IGN.P_CODE_SH_TO_GND "P-Code fuer die Art SH_TO_GND" VALUE 0x70C54 TKW_VV_VV_UW 100.0 FORMULA_0010 0.0 65535.0 /end CHARACTERISTIC
/begin CHARACTERISTIC K_ED_SK_TR_IGN.P_CODE_SH_TO_UB "P-Code fuer die Art SH_TO_UB" VALUE 0x70C52 TKW_VV_VV_UW 100.0 FORMULA_0010 0.0 65535.0 /end CHARACTERISTIC
/begin CHARACTERISTIC K_ED_SK_TR_IGN.P_CODE_UNPLAUSIBEL "P-Code fuer die Art UNPLAUSIBEL" VALUE 0x70C58 TKW_VV_VV_UW 100.0 FORMULA_0010 0.0 65535.0 /end CHARACTERISTIC
/begin CHARACTERISTIC K_ED_SMG_SCHALTAB.DEC_NACH_EINTRAG "Filterverringerung nach Fehlerspeichereintrag" VALUE 0x70EB5 TKW_VV_VV_UB 100.0 FORMULA_0003 0.0 255.0 /end CHARACTERISTIC
/begin CHARACTERISTIC K_ED_SMG_SCHALTAB.DEC_VOR_EINTRAG "Filterverringerung vorm Fehlerspeichereintrag" VALUE 0x70EB3 TKW_VV_VV_UB 100.0 FORMULA_0003 0.0 255.0 /end CHARACTERISTIC
/begin CHARACTERISTIC K_ED_SMG_SCHALTAB.FEHLERSCHWELLE "Filterschwelle fuer Fehlereintrag" VALUE 0x70EB0 TKW_VV_VV_UB 100.0 FORMULA_0003 0.0 255.0 /end CHARACTERISTIC
/begin CHARACTERISTIC K_ED_SMG_SCHALTAB.INC_NACH_EINTRAG "Filtererhoehung nach Fehlerspeichereintrag" VALUE 0x70EB4 TKW_VV_VV_UB 100.0 FORMULA_0003 0.0 255.0 /end CHARACTERISTIC
/begin CHARACTERISTIC K_ED_SMG_SCHALTAB.INC_VOR_EINTRAG "Filtererhoehung vorm Fehlerspeichereintrag" VALUE 0x70EB2 TKW_VV_VV_UB 100.0 FORMULA_0003 0.0 255.0 /end CHARACTERISTIC
/begin CHARACTERISTIC K_ED_SMG_SCHALTAB.KLASSENINDEX "Auswahl der Fehlerklasse" VALUE 0x70EB6 TKW_VV_VV_UB 100.0 FORMULA_0003 0.0 8.0 /end CHARACTERISTIC
/begin CHARACTERISTIC K_ED_SMG_SCHALTAB.OK_SCHWELLE "Filterschwelle fuer Fehleraustrag" VALUE 0x70EB1 TKW_VV_VV_UB 100.0 FORMULA_0003 0.0 255.0 /end CHARACTERISTIC
/begin CHARACTERISTIC K_ED_SMG_SCHALTAB.P_CODE_OPENLOAD "P-Code fuer die Art OPENLOAD" VALUE 0x70EAC TKW_VV_VV_UW 100.0 FORMULA_0010 0.0 65535.0 /end CHARACTERISTIC
/begin CHARACTERISTIC K_ED_SMG_SCHALTAB.P_CODE_SH_TO_GND "P-Code fuer die Art SH_TO_GND" VALUE 0x70EAA TKW_VV_VV_UW 100.0 FORMULA_0010 0.0 65535.0 /end CHARACTERISTIC
/begin CHARACTERISTIC K_ED_SMG_SCHALTAB.P_CODE_SH_TO_UB "P-Code fuer die Art SH_TO_UB" VALUE 0x70EA8 TKW_VV_VV_UW 100.0 FORMULA_0010 0.0 65535.0 /end CHARACTERISTIC
/begin CHARACTERISTIC K_ED_SMG_SCHALTAB.P_CODE_UNPLAUSIBEL "P-Code fuer die Art UNPLAUSIBEL" VALUE 0x70EAE TKW_VV_VV_UW 100.0 FORMULA_0010 0.0 65535.0 /end CHARACTERISTIC
/begin CHARACTERISTIC K_ED_SMG_SK.DEC_NACH_EINTRAG "Filterverringerung nach Fehlerspeichereintrag" VALUE 0x70ECF TKW_VV_VV_UB 100.0 FORMULA_0003 0.0 255.0 /end CHARACTERISTIC
/begin CHARACTERISTIC K_ED_SMG_SK.DEC_VOR_EINTRAG "Filterverringerung vorm Fehlerspeichereintrag" VALUE 0x70ECD TKW_VV_VV_UB 100.0 FORMULA_0003 0.0 255.0 /end CHARACTERISTIC
/begin CHARACTERISTIC K_ED_SMG_SK.FEHLERSCHWELLE "Filterschwelle fuer Fehlereintrag" VALUE 0x70ECA TKW_VV_VV_UB 100.0 FORMULA_0003 0.0 255.0 /end CHARACTERISTIC
/begin CHARACTERISTIC K_ED_SMG_SK.INC_NACH_EINTRAG "Filtererhoehung nach Fehlerspeichereintrag" VALUE 0x70ECE TKW_VV_VV_UB 100.0 FORMULA_0003 0.0 255.0 /end CHARACTERISTIC
/begin CHARACTERISTIC K_ED_SMG_SK.INC_VOR_EINTRAG "Filtererhoehung vorm Fehlerspeichereintrag" VALUE 0x70ECC TKW_VV_VV_UB 100.0 FORMULA_0003 0.0 255.0 /end CHARACTERISTIC
/begin CHARACTERISTIC K_ED_SMG_SK.KLASSENINDEX "Auswahl der Fehlerklasse" VALUE 0x70ED0 TKW_VV_VV_UB 100.0 FORMULA_0003 0.0 8.0 /end CHARACTERISTIC
/begin CHARACTERISTIC K_ED_SMG_SK.OK_SCHWELLE "Filterschwelle fuer Fehleraustrag" VALUE 0x70ECB TKW_VV_VV_UB 100.0 FORMULA_0003 0.0 255.0 /end CHARACTERISTIC
/begin CHARACTERISTIC K_ED_SMG_SK.P_CODE_OPENLOAD "P-Code fuer die Art OPENLOAD" VALUE 0x70EC6 TKW_VV_VV_UW 100.0 FORMULA_0010 0.0 65535.0 /end CHARACTERISTIC
/begin CHARACTERISTIC K_ED_SMG_SK.P_CODE_SH_TO_GND "P-Code fuer die Art SH_TO_GND" VALUE 0x70EC4 TKW_VV_VV_UW 100.0 FORMULA_0010 0.0 65535.0 /end CHARACTERISTIC
/begin CHARACTERISTIC K_ED_SMG_SK.P_CODE_SH_TO_UB "P-Code fuer die Art SH_TO_UB" VALUE 0x70EC2 TKW_VV_VV_UW 100.0 FORMULA_0010 0.0 65535.0 /end CHARACTERISTIC
/begin CHARACTERISTIC K_ED_SMG_SK.P_CODE_UNPLAUSIBEL "P-Code fuer die Art UNPLAUSIBEL" VALUE 0x70EC8 TKW_VV_VV_UW 100.0 FORMULA_0010 0.0 65535.0 /end CHARACTERISTIC
/begin CHARACTERISTIC K_ED_SMG_SK_N.DEC_NACH_EINTRAG "Filterverringerung nach Fehlerspeichereintrag" VALUE 0x70EE9 TKW_VV_VV_UB 100.0 FORMULA_0003 0.0 255.0 /end CHARACTERISTIC
/begin CHARACTERISTIC K_ED_SMG_SK_N.DEC_VOR_EINTRAG "Filterverringerung vorm Fehlerspeichereintrag" VALUE 0x70EE7 TKW_VV_VV_UB 100.0 FORMULA_0003 0.0 255.0 /end CHARACTERISTIC
/begin CHARACTERISTIC K_ED_SMG_SK_N.FEHLERSCHWELLE "Filterschwelle fuer Fehlereintrag" VALUE 0x70EE4 TKW_VV_VV_UB 100.0 FORMULA_0003 0.0 255.0 /end CHARACTERISTIC
/begin CHARACTERISTIC K_ED_SMG_SK_N.INC_NACH_EINTRAG "Filtererhoehung nach Fehlerspeichereintrag" VALUE 0x70EE8 TKW_VV_VV_UB 100.0 FORMULA_0003 0.0 255.0 /end CHARACTERISTIC
/begin CHARACTERISTIC K_ED_SMG_SK_N.INC_VOR_EINTRAG "Filtererhoehung vorm Fehlerspeichereintrag" VALUE 0x70EE6 TKW_VV_VV_UB 100.0 FORMULA_0003 0.0 255.0 /end CHARACTERISTIC
/begin CHARACTERISTIC K_ED_SMG_SK_N.KLASSENINDEX "Auswahl der Fehlerklasse" VALUE 0x70EEA TKW_VV_VV_UB 100.0 FORMULA_0003 0.0 8.0 /end CHARACTERISTIC
/begin CHARACTERISTIC K_ED_SMG_SK_N.OK_SCHWELLE "Filterschwelle fuer Fehleraustrag" VALUE 0x70EE5 TKW_VV_VV_UB 100.0 FORMULA_0003 0.0 255.0 /end CHARACTERISTIC
/begin CHARACTERISTIC K_ED_SMG_SK_N.P_CODE_OPENLOAD "P-Code fuer die Art OPENLOAD" VALUE 0x70EE0 TKW_VV_VV_UW 100.0 FORMULA_0010 0.0 65535.0 /end CHARACTERISTIC
/begin CHARACTERISTIC K_ED_SMG_SK_N.P_CODE_SH_TO_GND "P-Code fuer die Art SH_TO_GND" VALUE 0x70EDE TKW_VV_VV_UW 100.0 FORMULA_0010 0.0 65535.0 /end CHARACTERISTIC
/begin CHARACTERISTIC K_ED_SMG_SK_N.P_CODE_SH_TO_UB "P-Code fuer die Art SH_TO_UB" VALUE 0x70EDC TKW_VV_VV_UW 100.0 FORMULA_0010 0.0 65535.0 /end CHARACTERISTIC
/begin CHARACTERISTIC K_ED_SMG_SK_N.P_CODE_UNPLAUSIBEL "P-Code fuer die Art UNPLAUSIBEL" VALUE 0x70EE2 TKW_VV_VV_UW 100.0 FORMULA_0010 0.0 65535.0 /end CHARACTERISTIC
/begin CHARACTERISTIC K_ED_START_RL.DEC_NACH_EINTRAG "Filterverringerung nach Fehlerspeichereintrag" VALUE 0x716D5 TKW_VV_VV_UB 100.0 FORMULA_0003 0.0 255.0 /end CHARACTERISTIC
/begin CHARACTERISTIC K_ED_START_RL.DEC_VOR_EINTRAG "Filterverringerung vorm Fehlerspeichereintrag" VALUE 0x716D3 TKW_VV_VV_UB 100.0 FORMULA_0003 0.0 255.0 /end CHARACTERISTIC
/begin CHARACTERISTIC K_ED_START_RL.FEHLERSCHWELLE "Filterschwelle fuer Fehlereintrag" VALUE 0x716D0 TKW_VV_VV_UB 100.0 FORMULA_0003 0.0 255.0 /end CHARACTERISTIC
/begin CHARACTERISTIC K_ED_START_RL.INC_NACH_EINTRAG "Filtererhoehung nach Fehlerspeichereintrag" VALUE 0x716D4 TKW_VV_VV_UB 100.0 FORMULA_0003 0.0 255.0 /end CHARACTERISTIC
/begin CHARACTERISTIC K_ED_START_RL.INC_VOR_EINTRAG "Filtererhoehung vorm Fehlerspeichereintrag" VALUE 0x716D2 TKW_VV_VV_UB 100.0 FORMULA_0003 0.0 255.0 /end CHARACTERISTIC
/begin CHARACTERISTIC K_ED_START_RL.KLASSENINDEX "Auswahl der Fehlerklasse" VALUE 0x716D6 TKW_VV_VV_UB 100.0 FORMULA_0003 0.0 8.0 /end CHARACTERISTIC
/begin CHARACTERISTIC K_ED_START_RL.OK_SCHWELLE "Filterschwelle fuer Fehleraustrag" VALUE 0x716D1 TKW_VV_VV_UB 100.0 FORMULA_0003 0.0 255.0 /end CHARACTERISTIC
/begin CHARACTERISTIC K_ED_START_RL.P_CODE_OPENLOAD "P-Code fuer die Art OPENLOAD" VALUE 0x716CC TKW_VV_VV_UW 100.0 FORMULA_0010 0.0 65535.0 /end CHARACTERISTIC
/begin CHARACTERISTIC K_ED_START_RL.P_CODE_SH_TO_GND "P-Code fuer die Art SH_TO_GND" VALUE 0x716CA TKW_VV_VV_UW 100.0 FORMULA_0010 0.0 65535.0 /end CHARACTERISTIC
/begin CHARACTERISTIC K_ED_START_RL.P_CODE_SH_TO_UB "P-Code fuer die Art SH_TO_UB" VALUE 0x716C8 TKW_VV_VV_UW 100.0 FORMULA_0010 0.0 65535.0 /end CHARACTERISTIC
/begin CHARACTERISTIC K_ED_START_RL.P_CODE_UNPLAUSIBEL "P-Code fuer die Art UNPLAUSIBEL" VALUE 0x716CE TKW_VV_VV_UW 100.0 FORMULA_0010 0.0 65535.0 /end CHARACTERISTIC
/begin CHARACTERISTIC K_ED_TABG1.DEC_NACH_EINTRAG "Filterverringerung nach Fehlerspeichereintrag" VALUE 0x71021 TKW_VV_VV_UB 100.0 FORMULA_0003 0.0 255.0 /end CHARACTERISTIC
/begin CHARACTERISTIC K_ED_TABG1.DEC_VOR_EINTRAG "Filterverringerung vorm Fehlerspeichereintrag" VALUE 0x7101F TKW_VV_VV_UB 100.0 FORMULA_0003 0.0 255.0 /end CHARACTERISTIC
/begin CHARACTERISTIC K_ED_TABG1.FEHLERSCHWELLE "Filterschwelle fuer Fehlereintrag" VALUE 0x7101C TKW_VV_VV_UB 100.0 FORMULA_0003 0.0 255.0 /end CHARACTERISTIC
/begin CHARACTERISTIC K_ED_TABG1.INC_NACH_EINTRAG "Filtererhoehung nach Fehlerspeichereintrag" VALUE 0x71020 TKW_VV_VV_UB 100.0 FORMULA_0003 0.0 255.0 /end CHARACTERISTIC
/begin CHARACTERISTIC K_ED_TABG1.INC_VOR_EINTRAG "Filtererhoehung vorm Fehlerspeichereintrag" VALUE 0x7101E TKW_VV_VV_UB 100.0 FORMULA_0003 0.0 255.0 /end CHARACTERISTIC
/begin CHARACTERISTIC K_ED_TABG1.KLASSENINDEX "Auswahl der Fehlerklasse" VALUE 0x71022 TKW_VV_VV_UB 100.0 FORMULA_0003 0.0 8.0 /end CHARACTERISTIC
/begin CHARACTERISTIC K_ED_TABG1.OK_SCHWELLE "Filterschwelle fuer Fehleraustrag" VALUE 0x7101D TKW_VV_VV_UB 100.0 FORMULA_0003 0.0 255.0 /end CHARACTERISTIC
/begin CHARACTERISTIC K_ED_TABG1.P_CODE_OPENLOAD "P-Code fuer die Art OPENLOAD" VALUE 0x71018 TKW_VV_VV_UW 100.0 FORMULA_0010 0.0 65535.0 /end CHARACTERISTIC
/begin CHARACTERISTIC K_ED_TABG1.P_CODE_SH_TO_GND "P-Code fuer die Art SH_TO_GND" VALUE 0x71016 TKW_VV_VV_UW 100.0 FORMULA_0010 0.0 65535.0 /end CHARACTERISTIC
/begin CHARACTERISTIC K_ED_TABG1.P_CODE_SH_TO_UB "P-Code fuer die Art SH_TO_UB" VALUE 0x71014 TKW_VV_VV_UW 100.0 FORMULA_0010 0.0 65535.0 /end CHARACTERISTIC
/begin CHARACTERISTIC K_ED_TABG1.P_CODE_UNPLAUSIBEL "P-Code fuer die Art UNPLAUSIBEL" VALUE 0x7101A TKW_VV_VV_UW 100.0 FORMULA_0010 0.0 65535.0 /end CHARACTERISTIC
/begin CHARACTERISTIC K_ED_TABG2.DEC_NACH_EINTRAG "Filterverringerung nach Fehlerspeichereintrag" VALUE 0x7103B TKW_VV_VV_UB 100.0 FORMULA_0003 0.0 255.0 /end CHARACTERISTIC
/begin CHARACTERISTIC K_ED_TABG2.DEC_VOR_EINTRAG "Filterverringerung vorm Fehlerspeichereintrag" VALUE 0x71039 TKW_VV_VV_UB 100.0 FORMULA_0003 0.0 255.0 /end CHARACTERISTIC
/begin CHARACTERISTIC K_ED_TABG2.FEHLERSCHWELLE "Filterschwelle fuer Fehlereintrag" VALUE 0x71036 TKW_VV_VV_UB 100.0 FORMULA_0003 0.0 255.0 /end CHARACTERISTIC
/begin CHARACTERISTIC K_ED_TABG2.INC_NACH_EINTRAG "Filtererhoehung nach Fehlerspeichereintrag" VALUE 0x7103A TKW_VV_VV_UB 100.0 FORMULA_0003 0.0 255.0 /end CHARACTERISTIC
/begin CHARACTERISTIC K_ED_TABG2.INC_VOR_EINTRAG "Filtererhoehung vorm Fehlerspeichereintrag" VALUE 0x71038 TKW_VV_VV_UB 100.0 FORMULA_0003 0.0 255.0 /end CHARACTERISTIC
/begin CHARACTERISTIC K_ED_TABG2.KLASSENINDEX "Auswahl der Fehlerklasse" VALUE 0x7103C TKW_VV_VV_UB 100.0 FORMULA_0003 0.0 8.0 /end CHARACTERISTIC
/begin CHARACTERISTIC K_ED_TABG2.OK_SCHWELLE "Filterschwelle fuer Fehleraustrag" VALUE 0x71037 TKW_VV_VV_UB 100.0 FORMULA_0003 0.0 255.0 /end CHARACTERISTIC
/begin CHARACTERISTIC K_ED_TABG2.P_CODE_OPENLOAD "P-Code fuer die Art OPENLOAD" VALUE 0x71032 TKW_VV_VV_UW 100.0 FORMULA_0010 0.0 65535.0 /end CHARACTERISTIC
/begin CHARACTERISTIC K_ED_TABG2.P_CODE_SH_TO_GND "P-Code fuer die Art SH_TO_GND" VALUE 0x71030 TKW_VV_VV_UW 100.0 FORMULA_0010 0.0 65535.0 /end CHARACTERISTIC
/begin CHARACTERISTIC K_ED_TABG2.P_CODE_SH_TO_UB "P-Code fuer die Art SH_TO_UB" VALUE 0x7102E TKW_VV_VV_UW 100.0 FORMULA_0010 0.0 65535.0 /end CHARACTERISTIC
/begin CHARACTERISTIC K_ED_TABG2.P_CODE_UNPLAUSIBEL "P-Code fuer die Art UNPLAUSIBEL" VALUE 0x71034 TKW_VV_VV_UW 100.0 FORMULA_0010 0.0 65535.0 /end CHARACTERISTIC
/begin CHARACTERISTIC K_ED_TAN_OBD_B1.DEC_NACH_EINTRAG "Filterverringerung nach Fehlerspeichereintrag" VALUE 0x71535 TKW_VV_VV_UB 100.0 FORMULA_0003 0.0 255.0 /end CHARACTERISTIC
/begin CHARACTERISTIC K_ED_TAN_OBD_B1.DEC_VOR_EINTRAG "Filterverringerung vorm Fehlerspeichereintrag" VALUE 0x71533 TKW_VV_VV_UB 100.0 FORMULA_0003 0.0 255.0 /end CHARACTERISTIC
/begin CHARACTERISTIC K_ED_TAN_OBD_B1.FEHLERSCHWELLE "Filterschwelle fuer Fehlereintrag" VALUE 0x71530 TKW_VV_VV_UB 100.0 FORMULA_0003 0.0 255.0 /end CHARACTERISTIC
/begin CHARACTERISTIC K_ED_TAN_OBD_B1.INC_NACH_EINTRAG "Filtererhoehung nach Fehlerspeichereintrag" VALUE 0x71534 TKW_VV_VV_UB 100.0 FORMULA_0003 0.0 255.0 /end CHARACTERISTIC
/begin CHARACTERISTIC K_ED_TAN_OBD_B1.INC_VOR_EINTRAG "Filtererhoehung vorm Fehlerspeichereintrag" VALUE 0x71532 TKW_VV_VV_UB 100.0 FORMULA_0003 0.0 255.0 /end CHARACTERISTIC
/begin CHARACTERISTIC K_ED_TAN_OBD_B1.KLASSENINDEX "Auswahl der Fehlerklasse" VALUE 0x71536 TKW_VV_VV_UB 100.0 FORMULA_0003 0.0 8.0 /end CHARACTERISTIC
/begin CHARACTERISTIC K_ED_TAN_OBD_B1.OK_SCHWELLE "Filterschwelle fuer Fehleraustrag" VALUE 0x71531 TKW_VV_VV_UB 100.0 FORMULA_0003 0.0 255.0 /end CHARACTERISTIC
/begin CHARACTERISTIC K_ED_TAN_OBD_B1.P_CODE_OPENLOAD "P-Code fuer die Art OPENLOAD" VALUE 0x7152C TKW_VV_VV_UW 100.0 FORMULA_0010 0.0 65535.0 /end CHARACTERISTIC
/begin CHARACTERISTIC K_ED_TAN_OBD_B1.P_CODE_SH_TO_GND "P-Code fuer die Art SH_TO_GND" VALUE 0x7152A TKW_VV_VV_UW 100.0 FORMULA_0010 0.0 65535.0 /end CHARACTERISTIC
/begin CHARACTERISTIC K_ED_TAN_OBD_B1.P_CODE_SH_TO_UB "P-Code fuer die Art SH_TO_UB" VALUE 0x71528 TKW_VV_VV_UW 100.0 FORMULA_0010 0.0 65535.0 /end CHARACTERISTIC
/begin CHARACTERISTIC K_ED_TAN_OBD_B1.P_CODE_UNPLAUSIBEL "P-Code fuer die Art UNPLAUSIBEL" VALUE 0x7152E TKW_VV_VV_UW 100.0 FORMULA_0010 0.0 65535.0 /end CHARACTERISTIC
/begin CHARACTERISTIC K_ED_TAN_OBD_B2.DEC_NACH_EINTRAG "Filterverringerung nach Fehlerspeichereintrag" VALUE 0x71653 TKW_VV_VV_UB 100.0 FORMULA_0003 0.0 255.0 /end CHARACTERISTIC
/begin CHARACTERISTIC K_ED_TAN_OBD_B2.DEC_VOR_EINTRAG "Filterverringerung vorm Fehlerspeichereintrag" VALUE 0x71651 TKW_VV_VV_UB 100.0 FORMULA_0003 0.0 255.0 /end CHARACTERISTIC
/begin CHARACTERISTIC K_ED_TAN_OBD_B2.FEHLERSCHWELLE "Filterschwelle fuer Fehlereintrag" VALUE 0x7164E TKW_VV_VV_UB 100.0 FORMULA_0003 0.0 255.0 /end CHARACTERISTIC
/begin CHARACTERISTIC K_ED_TAN_OBD_B2.INC_NACH_EINTRAG "Filtererhoehung nach Fehlerspeichereintrag" VALUE 0x71652 TKW_VV_VV_UB 100.0 FORMULA_0003 0.0 255.0 /end CHARACTERISTIC
/begin CHARACTERISTIC K_ED_TAN_OBD_B2.INC_VOR_EINTRAG "Filtererhoehung vorm Fehlerspeichereintrag" VALUE 0x71650 TKW_VV_VV_UB 100.0 FORMULA_0003 0.0 255.0 /end CHARACTERISTIC
/begin CHARACTERISTIC K_ED_TAN_OBD_B2.KLASSENINDEX "Auswahl der Fehlerklasse" VALUE 0x71654 TKW_VV_VV_UB 100.0 FORMULA_0003 0.0 8.0 /end CHARACTERISTIC
/begin CHARACTERISTIC K_ED_TAN_OBD_B2.OK_SCHWELLE "Filterschwelle fuer Fehleraustrag" VALUE 0x7164F TKW_VV_VV_UB 100.0 FORMULA_0003 0.0 255.0 /end CHARACTERISTIC
/begin CHARACTERISTIC K_ED_TAN_OBD_B2.P_CODE_OPENLOAD "P-Code fuer die Art OPENLOAD" VALUE 0x7164A TKW_VV_VV_UW 100.0 FORMULA_0010 0.0 65535.0 /end CHARACTERISTIC
/begin CHARACTERISTIC K_ED_TAN_OBD_B2.P_CODE_SH_TO_GND "P-Code fuer die Art SH_TO_GND" VALUE 0x71648 TKW_VV_VV_UW 100.0 FORMULA_0010 0.0 65535.0 /end CHARACTERISTIC
/begin CHARACTERISTIC K_ED_TAN_OBD_B2.P_CODE_SH_TO_UB "P-Code fuer die Art SH_TO_UB" VALUE 0x71646 TKW_VV_VV_UW 100.0 FORMULA_0010 0.0 65535.0 /end CHARACTERISTIC
/begin CHARACTERISTIC K_ED_TAN_OBD_B2.P_CODE_UNPLAUSIBEL "P-Code fuer die Art UNPLAUSIBEL" VALUE 0x7164C TKW_VV_VV_UW 100.0 FORMULA_0010 0.0 65535.0 /end CHARACTERISTIC
/begin CHARACTERISTIC K_ED_TAN1.DEC_NACH_EINTRAG "Filterverringerung nach Fehlerspeichereintrag" VALUE 0x70CAD TKW_VV_VV_UB 100.0 FORMULA_0003 0.0 255.0 /end CHARACTERISTIC
/begin CHARACTERISTIC K_ED_TAN1.DEC_VOR_EINTRAG "Filterverringerung vorm Fehlerspeichereintrag" VALUE 0x70CAB TKW_VV_VV_UB 100.0 FORMULA_0003 0.0 255.0 /end CHARACTERISTIC
/begin CHARACTERISTIC K_ED_TAN1.FEHLERSCHWELLE "Filterschwelle fuer Fehlereintrag" VALUE 0x70CA8 TKW_VV_VV_UB 100.0 FORMULA_0003 0.0 255.0 /end CHARACTERISTIC
/begin CHARACTERISTIC K_ED_TAN1.INC_NACH_EINTRAG "Filtererhoehung nach Fehlerspeichereintrag" VALUE 0x70CAC TKW_VV_VV_UB 100.0 FORMULA_0003 0.0 255.0 /end CHARACTERISTIC
/begin CHARACTERISTIC K_ED_TAN1.INC_VOR_EINTRAG "Filtererhoehung vorm Fehlerspeichereintrag" VALUE 0x70CAA TKW_VV_VV_UB 100.0 FORMULA_0003 0.0 255.0 /end CHARACTERISTIC
/begin CHARACTERISTIC K_ED_TAN1.KLASSENINDEX "Auswahl der Fehlerklasse" VALUE 0x70CAE TKW_VV_VV_UB 100.0 FORMULA_0003 0.0 8.0 /end CHARACTERISTIC
/begin CHARACTERISTIC K_ED_TAN1.OK_SCHWELLE "Filterschwelle fuer Fehleraustrag" VALUE 0x70CA9 TKW_VV_VV_UB 100.0 FORMULA_0003 0.0 255.0 /end CHARACTERISTIC
/begin CHARACTERISTIC K_ED_TAN1.P_CODE_OPENLOAD "P-Code fuer die Art OPENLOAD" VALUE 0x70CA4 TKW_VV_VV_UW 100.0 FORMULA_0010 0.0 65535.0 /end CHARACTERISTIC
/begin CHARACTERISTIC K_ED_TAN1.P_CODE_SH_TO_GND "P-Code fuer die Art SH_TO_GND" VALUE 0x70CA2 TKW_VV_VV_UW 100.0 FORMULA_0010 0.0 65535.0 /end CHARACTERISTIC
/begin CHARACTERISTIC K_ED_TAN1.P_CODE_SH_TO_UB "P-Code fuer die Art SH_TO_UB" VALUE 0x70CA0 TKW_VV_VV_UW 100.0 FORMULA_0010 0.0 65535.0 /end CHARACTERISTIC
/begin CHARACTERISTIC K_ED_TAN1.P_CODE_UNPLAUSIBEL "P-Code fuer die Art UNPLAUSIBEL" VALUE 0x70CA6 TKW_VV_VV_UW 100.0 FORMULA_0010 0.0 65535.0 /end CHARACTERISTIC
/begin CHARACTERISTIC K_ED_TAN2.DEC_NACH_EINTRAG "Filterverringerung nach Fehlerspeichereintrag" VALUE 0x70CC7 TKW_VV_VV_UB 100.0 FORMULA_0003 0.0 255.0 /end CHARACTERISTIC
/begin CHARACTERISTIC K_ED_TAN2.DEC_VOR_EINTRAG "Filterverringerung vorm Fehlerspeichereintrag" VALUE 0x70CC5 TKW_VV_VV_UB 100.0 FORMULA_0003 0.0 255.0 /end CHARACTERISTIC
/begin CHARACTERISTIC K_ED_TAN2.FEHLERSCHWELLE "Filterschwelle fuer Fehlereintrag" VALUE 0x70CC2 TKW_VV_VV_UB 100.0 FORMULA_0003 0.0 255.0 /end CHARACTERISTIC
/begin CHARACTERISTIC K_ED_TAN2.INC_NACH_EINTRAG "Filtererhoehung nach Fehlerspeichereintrag" VALUE 0x70CC6 TKW_VV_VV_UB 100.0 FORMULA_0003 0.0 255.0 /end CHARACTERISTIC
/begin CHARACTERISTIC K_ED_TAN2.INC_VOR_EINTRAG "Filtererhoehung vorm Fehlerspeichereintrag" VALUE 0x70CC4 TKW_VV_VV_UB 100.0 FORMULA_0003 0.0 255.0 /end CHARACTERISTIC
/begin CHARACTERISTIC K_ED_TAN2.KLASSENINDEX "Auswahl der Fehlerklasse" VALUE 0x70CC8 TKW_VV_VV_UB 100.0 FORMULA_0003 0.0 8.0 /end CHARACTERISTIC
/begin CHARACTERISTIC K_ED_TAN2.OK_SCHWELLE "Filterschwelle fuer Fehleraustrag" VALUE 0x70CC3 TKW_VV_VV_UB 100.0 FORMULA_0003 0.0 255.0 /end CHARACTERISTIC
/begin CHARACTERISTIC K_ED_TAN2.P_CODE_OPENLOAD "P-Code fuer die Art OPENLOAD" VALUE 0x70CBE TKW_VV_VV_UW 100.0 FORMULA_0010 0.0 65535.0 /end CHARACTERISTIC
/begin CHARACTERISTIC K_ED_TAN2.P_CODE_SH_TO_GND "P-Code fuer die Art SH_TO_GND" VALUE 0x70CBC TKW_VV_VV_UW 100.0 FORMULA_0010 0.0 65535.0 /end CHARACTERISTIC
/begin CHARACTERISTIC K_ED_TAN2.P_CODE_SH_TO_UB "P-Code fuer die Art SH_TO_UB" VALUE 0x70CBA TKW_VV_VV_UW 100.0 FORMULA_0010 0.0 65535.0 /end CHARACTERISTIC
/begin CHARACTERISTIC K_ED_TAN2.P_CODE_UNPLAUSIBEL "P-Code fuer die Art UNPLAUSIBEL" VALUE 0x70CC0 TKW_VV_VV_UW 100.0 FORMULA_0010 0.0 65535.0 /end CHARACTERISTIC
/begin CHARACTERISTIC K_ED_TDME.DEC_NACH_EINTRAG "Filterverringerung nach Fehlerspeichereintrag" VALUE 0x70D2F TKW_VV_VV_UB 100.0 FORMULA_0003 0.0 255.0 /end CHARACTERISTIC
/begin CHARACTERISTIC K_ED_TDME.DEC_VOR_EINTRAG "Filterverringerung vorm Fehlerspeichereintrag" VALUE 0x70D2D TKW_VV_VV_UB 100.0 FORMULA_0003 0.0 255.0 /end CHARACTERISTIC
/begin CHARACTERISTIC K_ED_TDME.FEHLERSCHWELLE "Filterschwelle fuer Fehlereintrag" VALUE 0x70D2A TKW_VV_VV_UB 100.0 FORMULA_0003 0.0 255.0 /end CHARACTERISTIC
/begin CHARACTERISTIC K_ED_TDME.INC_NACH_EINTRAG "Filtererhoehung nach Fehlerspeichereintrag" VALUE 0x70D2E TKW_VV_VV_UB 100.0 FORMULA_0003 0.0 255.0 /end CHARACTERISTIC
/begin CHARACTERISTIC K_ED_TDME.INC_VOR_EINTRAG "Filtererhoehung vorm Fehlerspeichereintrag" VALUE 0x70D2C TKW_VV_VV_UB 100.0 FORMULA_0003 0.0 255.0 /end CHARACTERISTIC
/begin CHARACTERISTIC K_ED_TDME.KLASSENINDEX "Auswahl der Fehlerklasse" VALUE 0x70D30 TKW_VV_VV_UB 100.0 FORMULA_0003 0.0 8.0 /end CHARACTERISTIC
/begin CHARACTERISTIC K_ED_TDME.OK_SCHWELLE "Filterschwelle fuer Fehleraustrag" VALUE 0x70D2B TKW_VV_VV_UB 100.0 FORMULA_0003 0.0 255.0 /end CHARACTERISTIC
/begin CHARACTERISTIC K_ED_TDME.P_CODE_OPENLOAD "P-Code fuer die Art OPENLOAD" VALUE 0x70D26 TKW_VV_VV_UW 100.0 FORMULA_0010 0.0 65535.0 /end CHARACTERISTIC
/begin CHARACTERISTIC K_ED_TDME.P_CODE_SH_TO_GND "P-Code fuer die Art SH_TO_GND" VALUE 0x70D24 TKW_VV_VV_UW 100.0 FORMULA_0010 0.0 65535.0 /end CHARACTERISTIC
/begin CHARACTERISTIC K_ED_TDME.P_CODE_SH_TO_UB "P-Code fuer die Art SH_TO_UB" VALUE 0x70D22 TKW_VV_VV_UW 100.0 FORMULA_0010 0.0 65535.0 /end CHARACTERISTIC
/begin CHARACTERISTIC K_ED_TDME.P_CODE_UNPLAUSIBEL "P-Code fuer die Art UNPLAUSIBEL" VALUE 0x70D28 TKW_VV_VV_UW 100.0 FORMULA_0010 0.0 65535.0 /end CHARACTERISTIC
/begin CHARACTERISTIC K_ED_THERMOSTAT.DEC_NACH_EINTRAG "Filterverringerung nach Fehlerspeichereintrag" VALUE 0x71639 TKW_VV_VV_UB 100.0 FORMULA_0003 0.0 255.0 /end CHARACTERISTIC
/begin CHARACTERISTIC K_ED_THERMOSTAT.DEC_VOR_EINTRAG "Filterverringerung vorm Fehlerspeichereintrag" VALUE 0x71637 TKW_VV_VV_UB 100.0 FORMULA_0003 0.0 255.0 /end CHARACTERISTIC
/begin CHARACTERISTIC K_ED_THERMOSTAT.FEHLERSCHWELLE "Filterschwelle fuer Fehlereintrag" VALUE 0x71634 TKW_VV_VV_UB 100.0 FORMULA_0003 0.0 255.0 /end CHARACTERISTIC
/begin CHARACTERISTIC K_ED_THERMOSTAT.INC_NACH_EINTRAG "Filtererhoehung nach Fehlerspeichereintrag" VALUE 0x71638 TKW_VV_VV_UB 100.0 FORMULA_0003 0.0 255.0 /end CHARACTERISTIC
/begin CHARACTERISTIC K_ED_THERMOSTAT.INC_VOR_EINTRAG "Filtererhoehung vorm Fehlerspeichereintrag" VALUE 0x71636 TKW_VV_VV_UB 100.0 FORMULA_0003 0.0 255.0 /end CHARACTERISTIC
/begin CHARACTERISTIC K_ED_THERMOSTAT.KLASSENINDEX "Auswahl der Fehlerklasse" VALUE 0x7163A TKW_VV_VV_UB 100.0 FORMULA_0003 0.0 8.0 /end CHARACTERISTIC
/begin CHARACTERISTIC K_ED_THERMOSTAT.OK_SCHWELLE "Filterschwelle fuer Fehleraustrag" VALUE 0x71635 TKW_VV_VV_UB 100.0 FORMULA_0003 0.0 255.0 /end CHARACTERISTIC
/begin CHARACTERISTIC K_ED_THERMOSTAT.P_CODE_OPENLOAD "P-Code fuer die Art OPENLOAD" VALUE 0x71630 TKW_VV_VV_UW 100.0 FORMULA_0010 0.0 65535.0 /end CHARACTERISTIC
/begin CHARACTERISTIC K_ED_THERMOSTAT.P_CODE_SH_TO_GND "P-Code fuer die Art SH_TO_GND" VALUE 0x7162E TKW_VV_VV_UW 100.0 FORMULA_0010 0.0 65535.0 /end CHARACTERISTIC
/begin CHARACTERISTIC K_ED_THERMOSTAT.P_CODE_SH_TO_UB "P-Code fuer die Art SH_TO_UB" VALUE 0x7162C TKW_VV_VV_UW 100.0 FORMULA_0010 0.0 65535.0 /end CHARACTERISTIC
/begin CHARACTERISTIC K_ED_THERMOSTAT.P_CODE_UNPLAUSIBEL "P-Code fuer die Art UNPLAUSIBEL" VALUE 0x71632 TKW_VV_VV_UW 100.0 FORMULA_0010 0.0 65535.0 /end CHARACTERISTIC
/begin CHARACTERISTIC K_ED_TIME_REL_OBD.DEC_NACH_EINTRAG "Filterverringerung nach Fehlerspeichereintrag" VALUE 0x70CE1 TKW_VV_VV_UB 100.0 FORMULA_0003 0.0 255.0 /end CHARACTERISTIC
/begin CHARACTERISTIC K_ED_TIME_REL_OBD.DEC_VOR_EINTRAG "Filterverringerung vorm Fehlerspeichereintrag" VALUE 0x70CDF TKW_VV_VV_UB 100.0 FORMULA_0003 0.0 255.0 /end CHARACTERISTIC
/begin CHARACTERISTIC K_ED_TIME_REL_OBD.FEHLERSCHWELLE "Filterschwelle fuer Fehlereintrag" VALUE 0x70CDC TKW_VV_VV_UB 100.0 FORMULA_0003 0.0 255.0 /end CHARACTERISTIC
/begin CHARACTERISTIC K_ED_TIME_REL_OBD.INC_NACH_EINTRAG "Filtererhoehung nach Fehlerspeichereintrag" VALUE 0x70CE0 TKW_VV_VV_UB 100.0 FORMULA_0003 0.0 255.0 /end CHARACTERISTIC
/begin CHARACTERISTIC K_ED_TIME_REL_OBD.INC_VOR_EINTRAG "Filtererhoehung vorm Fehlerspeichereintrag" VALUE 0x70CDE TKW_VV_VV_UB 100.0 FORMULA_0003 0.0 255.0 /end CHARACTERISTIC
/begin CHARACTERISTIC K_ED_TIME_REL_OBD.KLASSENINDEX "Auswahl der Fehlerklasse" VALUE 0x70CE2 TKW_VV_VV_UB 100.0 FORMULA_0003 0.0 8.0 /end CHARACTERISTIC
/begin CHARACTERISTIC K_ED_TIME_REL_OBD.OK_SCHWELLE "Filterschwelle fuer Fehleraustrag" VALUE 0x70CDD TKW_VV_VV_UB 100.0 FORMULA_0003 0.0 255.0 /end CHARACTERISTIC
/begin CHARACTERISTIC K_ED_TIME_REL_OBD.P_CODE_OPENLOAD "P-Code fuer die Art OPENLOAD" VALUE 0x70CD8 TKW_VV_VV_UW 100.0 FORMULA_0010 0.0 65535.0 /end CHARACTERISTIC
/begin CHARACTERISTIC K_ED_TIME_REL_OBD.P_CODE_SH_TO_GND "P-Code fuer die Art SH_TO_GND" VALUE 0x70CD6 TKW_VV_VV_UW 100.0 FORMULA_0010 0.0 65535.0 /end CHARACTERISTIC
/begin CHARACTERISTIC K_ED_TIME_REL_OBD.P_CODE_SH_TO_UB "P-Code fuer die Art SH_TO_UB" VALUE 0x70CD4 TKW_VV_VV_UW 100.0 FORMULA_0010 0.0 65535.0 /end CHARACTERISTIC
/begin CHARACTERISTIC K_ED_TIME_REL_OBD.P_CODE_UNPLAUSIBEL "P-Code fuer die Art UNPLAUSIBEL" VALUE 0x70CDA TKW_VV_VV_UW 100.0 FORMULA_0010 0.0 65535.0 /end CHARACTERISTIC
/begin CHARACTERISTIC K_ED_TKA.DEC_NACH_EINTRAG "Filterverringerung nach Fehlerspeichereintrag" VALUE 0x70D15 TKW_VV_VV_UB 100.0 FORMULA_0003 0.0 255.0 /end CHARACTERISTIC
/begin CHARACTERISTIC K_ED_TKA.DEC_VOR_EINTRAG "Filterverringerung vorm Fehlerspeichereintrag" VALUE 0x70D13 TKW_VV_VV_UB 100.0 FORMULA_0003 0.0 255.0 /end CHARACTERISTIC
/begin CHARACTERISTIC K_ED_TKA.FEHLERSCHWELLE "Filterschwelle fuer Fehlereintrag" VALUE 0x70D10 TKW_VV_VV_UB 100.0 FORMULA_0003 0.0 255.0 /end CHARACTERISTIC
/begin CHARACTERISTIC K_ED_TKA.INC_NACH_EINTRAG "Filtererhoehung nach Fehlerspeichereintrag" VALUE 0x70D14 TKW_VV_VV_UB 100.0 FORMULA_0003 0.0 255.0 /end CHARACTERISTIC
/begin CHARACTERISTIC K_ED_TKA.INC_VOR_EINTRAG "Filtererhoehung vorm Fehlerspeichereintrag" VALUE 0x70D12 TKW_VV_VV_UB 100.0 FORMULA_0003 0.0 255.0 /end CHARACTERISTIC
/begin CHARACTERISTIC K_ED_TKA.KLASSENINDEX "Auswahl der Fehlerklasse" VALUE 0x70D16 TKW_VV_VV_UB 100.0 FORMULA_0003 0.0 8.0 /end CHARACTERISTIC
/begin CHARACTERISTIC K_ED_TKA.OK_SCHWELLE "Filterschwelle fuer Fehleraustrag" VALUE 0x70D11 TKW_VV_VV_UB 100.0 FORMULA_0003 0.0 255.0 /end CHARACTERISTIC
/begin CHARACTERISTIC K_ED_TKA.P_CODE_OPENLOAD "P-Code fuer die Art OPENLOAD" VALUE 0x70D0C TKW_VV_VV_UW 100.0 FORMULA_0010 0.0 65535.0 /end CHARACTERISTIC
/begin CHARACTERISTIC K_ED_TKA.P_CODE_SH_TO_GND "P-Code fuer die Art SH_TO_GND" VALUE 0x70D0A TKW_VV_VV_UW 100.0 FORMULA_0010 0.0 65535.0 /end CHARACTERISTIC
/begin CHARACTERISTIC K_ED_TKA.P_CODE_SH_TO_UB "P-Code fuer die Art SH_TO_UB" VALUE 0x70D08 TKW_VV_VV_UW 100.0 FORMULA_0010 0.0 65535.0 /end CHARACTERISTIC
/begin CHARACTERISTIC K_ED_TKA.P_CODE_UNPLAUSIBEL "P-Code fuer die Art UNPLAUSIBEL" VALUE 0x70D0E TKW_VV_VV_UW 100.0 FORMULA_0010 0.0 65535.0 /end CHARACTERISTIC
/begin CHARACTERISTIC K_ED_TKA_OBD.DEC_NACH_EINTRAG "Filterverringerung nach Fehlerspeichereintrag" VALUE 0x70D97 TKW_VV_VV_UB 100.0 FORMULA_0003 0.0 255.0 /end CHARACTERISTIC
/begin CHARACTERISTIC K_ED_TKA_OBD.DEC_VOR_EINTRAG "Filterverringerung vorm Fehlerspeichereintrag" VALUE 0x70D95 TKW_VV_VV_UB 100.0 FORMULA_0003 0.0 255.0 /end CHARACTERISTIC
/begin CHARACTERISTIC K_ED_TKA_OBD.FEHLERSCHWELLE "Filterschwelle fuer Fehlereintrag" VALUE 0x70D92 TKW_VV_VV_UB 100.0 FORMULA_0003 0.0 255.0 /end CHARACTERISTIC
/begin CHARACTERISTIC K_ED_TKA_OBD.INC_NACH_EINTRAG "Filtererhoehung nach Fehlerspeichereintrag" VALUE 0x70D96 TKW_VV_VV_UB 100.0 FORMULA_0003 0.0 255.0 /end CHARACTERISTIC
/begin CHARACTERISTIC K_ED_TKA_OBD.INC_VOR_EINTRAG "Filtererhoehung vorm Fehlerspeichereintrag" VALUE 0x70D94 TKW_VV_VV_UB 100.0 FORMULA_0003 0.0 255.0 /end CHARACTERISTIC
/begin CHARACTERISTIC K_ED_TKA_OBD.KLASSENINDEX "Auswahl der Fehlerklasse" VALUE 0x70D98 TKW_VV_VV_UB 100.0 FORMULA_0003 0.0 8.0 /end CHARACTERISTIC
/begin CHARACTERISTIC K_ED_TKA_OBD.OK_SCHWELLE "Filterschwelle fuer Fehleraustrag" VALUE 0x70D93 TKW_VV_VV_UB 100.0 FORMULA_0003 0.0 255.0 /end CHARACTERISTIC
/begin CHARACTERISTIC K_ED_TKA_OBD.P_CODE_OPENLOAD "P-Code fuer die Art OPENLOAD" VALUE 0x70D8E TKW_VV_VV_UW 100.0 FORMULA_0010 0.0 65535.0 /end CHARACTERISTIC
/begin CHARACTERISTIC K_ED_TKA_OBD.P_CODE_SH_TO_GND "P-Code fuer die Art SH_TO_GND" VALUE 0x70D8C TKW_VV_VV_UW 100.0 FORMULA_0010 0.0 65535.0 /end CHARACTERISTIC
/begin CHARACTERISTIC K_ED_TKA_OBD.P_CODE_SH_TO_UB "P-Code fuer die Art SH_TO_UB" VALUE 0x70D8A TKW_VV_VV_UW 100.0 FORMULA_0010 0.0 65535.0 /end CHARACTERISTIC
/begin CHARACTERISTIC K_ED_TKA_OBD.P_CODE_UNPLAUSIBEL "P-Code fuer die Art UNPLAUSIBEL" VALUE 0x70D90 TKW_VV_VV_UW 100.0 FORMULA_0010 0.0 65535.0 /end CHARACTERISTIC
/begin CHARACTERISTIC K_ED_TMOT.DEC_NACH_EINTRAG "Filterverringerung nach Fehlerspeichereintrag" VALUE 0x70C79 TKW_VV_VV_UB 100.0 FORMULA_0003 0.0 255.0 /end CHARACTERISTIC
/begin CHARACTERISTIC K_ED_TMOT.DEC_VOR_EINTRAG "Filterverringerung vorm Fehlerspeichereintrag" VALUE 0x70C77 TKW_VV_VV_UB 100.0 FORMULA_0003 0.0 255.0 /end CHARACTERISTIC
/begin CHARACTERISTIC K_ED_TMOT.FEHLERSCHWELLE "Filterschwelle fuer Fehlereintrag" VALUE 0x70C74 TKW_VV_VV_UB 100.0 FORMULA_0003 0.0 255.0 /end CHARACTERISTIC
/begin CHARACTERISTIC K_ED_TMOT.INC_NACH_EINTRAG "Filtererhoehung nach Fehlerspeichereintrag" VALUE 0x70C78 TKW_VV_VV_UB 100.0 FORMULA_0003 0.0 255.0 /end CHARACTERISTIC
/begin CHARACTERISTIC K_ED_TMOT.INC_VOR_EINTRAG "Filtererhoehung vorm Fehlerspeichereintrag" VALUE 0x70C76 TKW_VV_VV_UB 100.0 FORMULA_0003 0.0 255.0 /end CHARACTERISTIC
/begin CHARACTERISTIC K_ED_TMOT.KLASSENINDEX "Auswahl der Fehlerklasse" VALUE 0x70C7A TKW_VV_VV_UB 100.0 FORMULA_0003 0.0 8.0 /end CHARACTERISTIC
/begin CHARACTERISTIC K_ED_TMOT.OK_SCHWELLE "Filterschwelle fuer Fehleraustrag" VALUE 0x70C75 TKW_VV_VV_UB 100.0 FORMULA_0003 0.0 255.0 /end CHARACTERISTIC
/begin CHARACTERISTIC K_ED_TMOT.P_CODE_OPENLOAD "P-Code fuer die Art OPENLOAD" VALUE 0x70C70 TKW_VV_VV_UW 100.0 FORMULA_0010 0.0 65535.0 /end CHARACTERISTIC
/begin CHARACTERISTIC K_ED_TMOT.P_CODE_SH_TO_GND "P-Code fuer die Art SH_TO_GND" VALUE 0x70C6E TKW_VV_VV_UW 100.0 FORMULA_0010 0.0 65535.0 /end CHARACTERISTIC
/begin CHARACTERISTIC K_ED_TMOT.P_CODE_SH_TO_UB "P-Code fuer die Art SH_TO_UB" VALUE 0x70C6C TKW_VV_VV_UW 100.0 FORMULA_0010 0.0 65535.0 /end CHARACTERISTIC
/begin CHARACTERISTIC K_ED_TMOT.P_CODE_UNPLAUSIBEL "P-Code fuer die Art UNPLAUSIBEL" VALUE 0x70C72 TKW_VV_VV_UW 100.0 FORMULA_0010 0.0 65535.0 /end CHARACTERISTIC
/begin CHARACTERISTIC K_ED_TMOT_OBD.DEC_NACH_EINTRAG "Filterverringerung nach Fehlerspeichereintrag" VALUE 0x70C93 TKW_VV_VV_UB 100.0 FORMULA_0003 0.0 255.0 /end CHARACTERISTIC
/begin CHARACTERISTIC K_ED_TMOT_OBD.DEC_VOR_EINTRAG "Filterverringerung vorm Fehlerspeichereintrag" VALUE 0x70C91 TKW_VV_VV_UB 100.0 FORMULA_0003 0.0 255.0 /end CHARACTERISTIC
/begin CHARACTERISTIC K_ED_TMOT_OBD.FEHLERSCHWELLE "Filterschwelle fuer Fehlereintrag" VALUE 0x70C8E TKW_VV_VV_UB 100.0 FORMULA_0003 0.0 255.0 /end CHARACTERISTIC
/begin CHARACTERISTIC K_ED_TMOT_OBD.INC_NACH_EINTRAG "Filtererhoehung nach Fehlerspeichereintrag" VALUE 0x70C92 TKW_VV_VV_UB 100.0 FORMULA_0003 0.0 255.0 /end CHARACTERISTIC
/begin CHARACTERISTIC K_ED_TMOT_OBD.INC_VOR_EINTRAG "Filtererhoehung vorm Fehlerspeichereintrag" VALUE 0x70C90 TKW_VV_VV_UB 100.0 FORMULA_0003 0.0 255.0 /end CHARACTERISTIC
/begin CHARACTERISTIC K_ED_TMOT_OBD.KLASSENINDEX "Auswahl der Fehlerklasse" VALUE 0x70C94 TKW_VV_VV_UB 100.0 FORMULA_0003 0.0 8.0 /end CHARACTERISTIC
/begin CHARACTERISTIC K_ED_TMOT_OBD.OK_SCHWELLE "Filterschwelle fuer Fehleraustrag" VALUE 0x70C8F TKW_VV_VV_UB 100.0 FORMULA_0003 0.0 255.0 /end CHARACTERISTIC
/begin CHARACTERISTIC K_ED_TMOT_OBD.P_CODE_OPENLOAD "P-Code fuer die Art OPENLOAD" VALUE 0x70C8A TKW_VV_VV_UW 100.0 FORMULA_0010 0.0 65535.0 /end CHARACTERISTIC
/begin CHARACTERISTIC K_ED_TMOT_OBD.P_CODE_SH_TO_GND "P-Code fuer die Art SH_TO_GND" VALUE 0x70C88 TKW_VV_VV_UW 100.0 FORMULA_0010 0.0 65535.0 /end CHARACTERISTIC
/begin CHARACTERISTIC K_ED_TMOT_OBD.P_CODE_SH_TO_UB "P-Code fuer die Art SH_TO_UB" VALUE 0x70C86 TKW_VV_VV_UW 100.0 FORMULA_0010 0.0 65535.0 /end CHARACTERISTIC
/begin CHARACTERISTIC K_ED_TMOT_OBD.P_CODE_UNPLAUSIBEL "P-Code fuer die Art UNPLAUSIBEL" VALUE 0x70C8C TKW_VV_VV_UW 100.0 FORMULA_0010 0.0 65535.0 /end CHARACTERISTIC
/begin CHARACTERISTIC K_ED_TMOT_OBD_HIGH.DEC_NACH_EINTRAG "Filterverringerung nach Fehlerspeichereintrag" VALUE 0x7178B TKW_VV_VV_UB 100.0 FORMULA_0003 0.0 255.0 /end CHARACTERISTIC
/begin CHARACTERISTIC K_ED_TMOT_OBD_HIGH.DEC_VOR_EINTRAG "Filterverringerung vorm Fehlerspeichereintrag" VALUE 0x71789 TKW_VV_VV_UB 100.0 FORMULA_0003 0.0 255.0 /end CHARACTERISTIC
/begin CHARACTERISTIC K_ED_TMOT_OBD_HIGH.FEHLERSCHWELLE "Filterschwelle fuer Fehlereintrag" VALUE 0x71786 TKW_VV_VV_UB 100.0 FORMULA_0003 0.0 255.0 /end CHARACTERISTIC
/begin CHARACTERISTIC K_ED_TMOT_OBD_HIGH.INC_NACH_EINTRAG "Filtererhoehung nach Fehlerspeichereintrag" VALUE 0x7178A TKW_VV_VV_UB 100.0 FORMULA_0003 0.0 255.0 /end CHARACTERISTIC
/begin CHARACTERISTIC K_ED_TMOT_OBD_HIGH.INC_VOR_EINTRAG "Filtererhoehung vorm Fehlerspeichereintrag" VALUE 0x71788 TKW_VV_VV_UB 100.0 FORMULA_0003 0.0 255.0 /end CHARACTERISTIC
/begin CHARACTERISTIC K_ED_TMOT_OBD_HIGH.KLASSENINDEX "Auswahl der Fehlerklasse" VALUE 0x7178C TKW_VV_VV_UB 100.0 FORMULA_0003 0.0 8.0 /end CHARACTERISTIC
/begin CHARACTERISTIC K_ED_TMOT_OBD_HIGH.OK_SCHWELLE "Filterschwelle fuer Fehleraustrag" VALUE 0x71787 TKW_VV_VV_UB 100.0 FORMULA_0003 0.0 255.0 /end CHARACTERISTIC
/begin CHARACTERISTIC K_ED_TMOT_OBD_HIGH.P_CODE_OPENLOAD "P-Code fuer die Art OPENLOAD" VALUE 0x71782 TKW_VV_VV_UW 100.0 FORMULA_0010 0.0 65535.0 /end CHARACTERISTIC
/begin CHARACTERISTIC K_ED_TMOT_OBD_HIGH.P_CODE_SH_TO_GND "P-Code fuer die Art SH_TO_GND" VALUE 0x71780 TKW_VV_VV_UW 100.0 FORMULA_0010 0.0 65535.0 /end CHARACTERISTIC
/begin CHARACTERISTIC K_ED_TMOT_OBD_HIGH.P_CODE_SH_TO_UB "P-Code fuer die Art SH_TO_UB" VALUE 0x7177E TKW_VV_VV_UW 100.0 FORMULA_0010 0.0 65535.0 /end CHARACTERISTIC
/begin CHARACTERISTIC K_ED_TMOT_OBD_HIGH.P_CODE_UNPLAUSIBEL "P-Code fuer die Art UNPLAUSIBEL" VALUE 0x71784 TKW_VV_VV_UW 100.0 FORMULA_0010 0.0 65535.0 /end CHARACTERISTIC
/begin CHARACTERISTIC K_ED_TUMG.DEC_NACH_EINTRAG "Filterverringerung nach Fehlerspeichereintrag" VALUE 0x71757 TKW_VV_VV_UB 100.0 FORMULA_0003 0.0 255.0 /end CHARACTERISTIC
/begin CHARACTERISTIC K_ED_TUMG.DEC_VOR_EINTRAG "Filterverringerung vorm Fehlerspeichereintrag" VALUE 0x71755 TKW_VV_VV_UB 100.0 FORMULA_0003 0.0 255.0 /end CHARACTERISTIC
/begin CHARACTERISTIC K_ED_TUMG.FEHLERSCHWELLE "Filterschwelle fuer Fehlereintrag" VALUE 0x71752 TKW_VV_VV_UB 100.0 FORMULA_0003 0.0 255.0 /end CHARACTERISTIC
/begin CHARACTERISTIC K_ED_TUMG.INC_NACH_EINTRAG "Filtererhoehung nach Fehlerspeichereintrag" VALUE 0x71756 TKW_VV_VV_UB 100.0 FORMULA_0003 0.0 255.0 /end CHARACTERISTIC
/begin CHARACTERISTIC K_ED_TUMG.INC_VOR_EINTRAG "Filtererhoehung vorm Fehlerspeichereintrag" VALUE 0x71754 TKW_VV_VV_UB 100.0 FORMULA_0003 0.0 255.0 /end CHARACTERISTIC
/begin CHARACTERISTIC K_ED_TUMG.KLASSENINDEX "Auswahl der Fehlerklasse" VALUE 0x71758 TKW_VV_VV_UB 100.0 FORMULA_0003 0.0 8.0 /end CHARACTERISTIC
/begin CHARACTERISTIC K_ED_TUMG.OK_SCHWELLE "Filterschwelle fuer Fehleraustrag" VALUE 0x71753 TKW_VV_VV_UB 100.0 FORMULA_0003 0.0 255.0 /end CHARACTERISTIC
/begin CHARACTERISTIC K_ED_TUMG.P_CODE_OPENLOAD "P-Code fuer die Art OPENLOAD" VALUE 0x7174E TKW_VV_VV_UW 100.0 FORMULA_0010 0.0 65535.0 /end CHARACTERISTIC
/begin CHARACTERISTIC K_ED_TUMG.P_CODE_SH_TO_GND "P-Code fuer die Art SH_TO_GND" VALUE 0x7174C TKW_VV_VV_UW 100.0 FORMULA_0010 0.0 65535.0 /end CHARACTERISTIC
/begin CHARACTERISTIC K_ED_TUMG.P_CODE_SH_TO_UB "P-Code fuer die Art SH_TO_UB" VALUE 0x7174A TKW_VV_VV_UW 100.0 FORMULA_0010 0.0 65535.0 /end CHARACTERISTIC
/begin CHARACTERISTIC K_ED_TUMG.P_CODE_UNPLAUSIBEL "P-Code fuer die Art UNPLAUSIBEL" VALUE 0x71750 TKW_VV_VV_UW 100.0 FORMULA_0010 0.0 65535.0 /end CHARACTERISTIC
/begin CHARACTERISTIC K_ED_TUMG_OBD.DEC_NACH_EINTRAG "Filterverringerung nach Fehlerspeichereintrag" VALUE 0x70F03 TKW_VV_VV_UB 100.0 FORMULA_0003 0.0 255.0 /end CHARACTERISTIC
/begin CHARACTERISTIC K_ED_TUMG_OBD.DEC_VOR_EINTRAG "Filterverringerung vorm Fehlerspeichereintrag" VALUE 0x70F01 TKW_VV_VV_UB 100.0 FORMULA_0003 0.0 255.0 /end CHARACTERISTIC
/begin CHARACTERISTIC K_ED_TUMG_OBD.FEHLERSCHWELLE "Filterschwelle fuer Fehlereintrag" VALUE 0x70EFE TKW_VV_VV_UB 100.0 FORMULA_0003 0.0 255.0 /end CHARACTERISTIC
/begin CHARACTERISTIC K_ED_TUMG_OBD.INC_NACH_EINTRAG "Filtererhoehung nach Fehlerspeichereintrag" VALUE 0x70F02 TKW_VV_VV_UB 100.0 FORMULA_0003 0.0 255.0 /end CHARACTERISTIC
/begin CHARACTERISTIC K_ED_TUMG_OBD.INC_VOR_EINTRAG "Filtererhoehung vorm Fehlerspeichereintrag" VALUE 0x70F00 TKW_VV_VV_UB 100.0 FORMULA_0003 0.0 255.0 /end CHARACTERISTIC
/begin CHARACTERISTIC K_ED_TUMG_OBD.KLASSENINDEX "Auswahl der Fehlerklasse" VALUE 0x70F04 TKW_VV_VV_UB 100.0 FORMULA_0003 0.0 8.0 /end CHARACTERISTIC
/begin CHARACTERISTIC K_ED_TUMG_OBD.OK_SCHWELLE "Filterschwelle fuer Fehleraustrag" VALUE 0x70EFF TKW_VV_VV_UB 100.0 FORMULA_0003 0.0 255.0 /end CHARACTERISTIC
/begin CHARACTERISTIC K_ED_TUMG_OBD.P_CODE_OPENLOAD "P-Code fuer die Art OPENLOAD" VALUE 0x70EFA TKW_VV_VV_UW 100.0 FORMULA_0010 0.0 65535.0 /end CHARACTERISTIC
/begin CHARACTERISTIC K_ED_TUMG_OBD.P_CODE_SH_TO_GND "P-Code fuer die Art SH_TO_GND" VALUE 0x70EF8 TKW_VV_VV_UW 100.0 FORMULA_0010 0.0 65535.0 /end CHARACTERISTIC
/begin CHARACTERISTIC K_ED_TUMG_OBD.P_CODE_SH_TO_UB "P-Code fuer die Art SH_TO_UB" VALUE 0x70EF6 TKW_VV_VV_UW 100.0 FORMULA_0010 0.0 65535.0 /end CHARACTERISTIC
/begin CHARACTERISTIC K_ED_TUMG_OBD.P_CODE_UNPLAUSIBEL "P-Code fuer die Art UNPLAUSIBEL" VALUE 0x70EFC TKW_VV_VV_UW 100.0 FORMULA_0010 0.0 65535.0 /end CHARACTERISTIC
/begin CHARACTERISTIC K_ED_UB.DEC_NACH_EINTRAG "Filterverringerung nach Fehlerspeichereintrag" VALUE 0x70CFB TKW_VV_VV_UB 100.0 FORMULA_0003 0.0 255.0 /end CHARACTERISTIC
/begin CHARACTERISTIC K_ED_UB.DEC_VOR_EINTRAG "Filterverringerung vorm Fehlerspeichereintrag" VALUE 0x70CF9 TKW_VV_VV_UB 100.0 FORMULA_0003 0.0 255.0 /end CHARACTERISTIC
/begin CHARACTERISTIC K_ED_UB.FEHLERSCHWELLE "Filterschwelle fuer Fehlereintrag" VALUE 0x70CF6 TKW_VV_VV_UB 100.0 FORMULA_0003 0.0 255.0 /end CHARACTERISTIC
/begin CHARACTERISTIC K_ED_UB.INC_NACH_EINTRAG "Filtererhoehung nach Fehlerspeichereintrag" VALUE 0x70CFA TKW_VV_VV_UB 100.0 FORMULA_0003 0.0 255.0 /end CHARACTERISTIC
/begin CHARACTERISTIC K_ED_UB.INC_VOR_EINTRAG "Filtererhoehung vorm Fehlerspeichereintrag" VALUE 0x70CF8 TKW_VV_VV_UB 100.0 FORMULA_0003 0.0 255.0 /end CHARACTERISTIC
/begin CHARACTERISTIC K_ED_UB.KLASSENINDEX "Auswahl der Fehlerklasse" VALUE 0x70CFC TKW_VV_VV_UB 100.0 FORMULA_0003 0.0 8.0 /end CHARACTERISTIC
/begin CHARACTERISTIC K_ED_UB.OK_SCHWELLE "Filterschwelle fuer Fehleraustrag" VALUE 0x70CF7 TKW_VV_VV_UB 100.0 FORMULA_0003 0.0 255.0 /end CHARACTERISTIC
/begin CHARACTERISTIC K_ED_UB.P_CODE_OPENLOAD "P-Code fuer die Art OPENLOAD" VALUE 0x70CF2 TKW_VV_VV_UW 100.0 FORMULA_0010 0.0 65535.0 /end CHARACTERISTIC
/begin CHARACTERISTIC K_ED_UB.P_CODE_SH_TO_GND "P-Code fuer die Art SH_TO_GND" VALUE 0x70CF0 TKW_VV_VV_UW 100.0 FORMULA_0010 0.0 65535.0 /end CHARACTERISTIC
/begin CHARACTERISTIC K_ED_UB.P_CODE_SH_TO_UB "P-Code fuer die Art SH_TO_UB" VALUE 0x70CEE TKW_VV_VV_UW 100.0 FORMULA_0010 0.0 65535.0 /end CHARACTERISTIC
/begin CHARACTERISTIC K_ED_UB.P_CODE_UNPLAUSIBEL "P-Code fuer die Art UNPLAUSIBEL" VALUE 0x70CF4 TKW_VV_VV_UW 100.0 FORMULA_0010 0.0 65535.0 /end CHARACTERISTIC
/begin CHARACTERISTIC K_ED_UBMIN "untere UB-Schwelle fuer elektr. Diagnosen" VALUE 0x7196A TKW_VV_VV_SW 100.0 FORMULA_0008 0.0 28.0 FORMAT "%4.1" /end CHARACTERISTIC
/begin CHARACTERISTIC K_ED_UEXT_111219514.DEC_NACH_EINTRAG "Filterverringerung nach Fehlerspeichereintrag" VALUE 0x70D49 TKW_VV_VV_UB 100.0 FORMULA_0003 0.0 255.0 /end CHARACTERISTIC
/begin CHARACTERISTIC K_ED_UEXT_111219514.DEC_VOR_EINTRAG "Filterverringerung vorm Fehlerspeichereintrag" VALUE 0x70D47 TKW_VV_VV_UB 100.0 FORMULA_0003 0.0 255.0 /end CHARACTERISTIC
/begin CHARACTERISTIC K_ED_UEXT_111219514.FEHLERSCHWELLE "Filterschwelle fuer Fehlereintrag" VALUE 0x70D44 TKW_VV_VV_UB 100.0 FORMULA_0003 0.0 255.0 /end CHARACTERISTIC
/begin CHARACTERISTIC K_ED_UEXT_111219514.INC_NACH_EINTRAG "Filtererhoehung nach Fehlerspeichereintrag" VALUE 0x70D48 TKW_VV_VV_UB 100.0 FORMULA_0003 0.0 255.0 /end CHARACTERISTIC
/begin CHARACTERISTIC K_ED_UEXT_111219514.INC_VOR_EINTRAG "Filtererhoehung vorm Fehlerspeichereintrag" VALUE 0x70D46 TKW_VV_VV_UB 100.0 FORMULA_0003 0.0 255.0 /end CHARACTERISTIC
/begin CHARACTERISTIC K_ED_UEXT_111219514.KLASSENINDEX "Auswahl der Fehlerklasse" VALUE 0x70D4A TKW_VV_VV_UB 100.0 FORMULA_0003 0.0 8.0 /end CHARACTERISTIC
/begin CHARACTERISTIC K_ED_UEXT_111219514.OK_SCHWELLE "Filterschwelle fuer Fehleraustrag" VALUE 0x70D45 TKW_VV_VV_UB 100.0 FORMULA_0003 0.0 255.0 /end CHARACTERISTIC
/begin CHARACTERISTIC K_ED_UEXT_111219514.P_CODE_OPENLOAD "P-Code fuer die Art OPENLOAD" VALUE 0x70D40 TKW_VV_VV_UW 100.0 FORMULA_0010 0.0 65535.0 /end CHARACTERISTIC
/begin CHARACTERISTIC K_ED_UEXT_111219514.P_CODE_SH_TO_GND "P-Code fuer die Art SH_TO_GND" VALUE 0x70D3E TKW_VV_VV_UW 100.0 FORMULA_0010 0.0 65535.0 /end CHARACTERISTIC
/begin CHARACTERISTIC K_ED_UEXT_111219514.P_CODE_SH_TO_UB "P-Code fuer die Art SH_TO_UB" VALUE 0x70D3C TKW_VV_VV_UW 100.0 FORMULA_0010 0.0 65535.0 /end CHARACTERISTIC
/begin CHARACTERISTIC K_ED_UEXT_111219514.P_CODE_UNPLAUSIBEL "P-Code fuer die Art UNPLAUSIBEL" VALUE 0x70D42 TKW_VV_VV_UW 100.0 FORMULA_0010 0.0 65535.0 /end CHARACTERISTIC
/begin CHARACTERISTIC K_ED_UEXT_124_512.DEC_NACH_EINTRAG "Filterverringerung nach Fehlerspeichereintrag" VALUE 0x70D63 TKW_VV_VV_UB 100.0 FORMULA_0003 0.0 255.0 /end CHARACTERISTIC
/begin CHARACTERISTIC K_ED_UEXT_124_512.DEC_VOR_EINTRAG "Filterverringerung vorm Fehlerspeichereintrag" VALUE 0x70D61 TKW_VV_VV_UB 100.0 FORMULA_0003 0.0 255.0 /end CHARACTERISTIC
/begin CHARACTERISTIC K_ED_UEXT_124_512.FEHLERSCHWELLE "Filterschwelle fuer Fehlereintrag" VALUE 0x70D5E TKW_VV_VV_UB 100.0 FORMULA_0003 0.0 255.0 /end CHARACTERISTIC
/begin CHARACTERISTIC K_ED_UEXT_124_512.INC_NACH_EINTRAG "Filtererhoehung nach Fehlerspeichereintrag" VALUE 0x70D62 TKW_VV_VV_UB 100.0 FORMULA_0003 0.0 255.0 /end CHARACTERISTIC
/begin CHARACTERISTIC K_ED_UEXT_124_512.INC_VOR_EINTRAG "Filtererhoehung vorm Fehlerspeichereintrag" VALUE 0x70D60 TKW_VV_VV_UB 100.0 FORMULA_0003 0.0 255.0 /end CHARACTERISTIC
/begin CHARACTERISTIC K_ED_UEXT_124_512.KLASSENINDEX "Auswahl der Fehlerklasse" VALUE 0x70D64 TKW_VV_VV_UB 100.0 FORMULA_0003 0.0 8.0 /end CHARACTERISTIC
/begin CHARACTERISTIC K_ED_UEXT_124_512.OK_SCHWELLE "Filterschwelle fuer Fehleraustrag" VALUE 0x70D5F TKW_VV_VV_UB 100.0 FORMULA_0003 0.0 255.0 /end CHARACTERISTIC
/begin CHARACTERISTIC K_ED_UEXT_124_512.P_CODE_OPENLOAD "P-Code fuer die Art OPENLOAD" VALUE 0x70D5A TKW_VV_VV_UW 100.0 FORMULA_0010 0.0 65535.0 /end CHARACTERISTIC
/begin CHARACTERISTIC K_ED_UEXT_124_512.P_CODE_SH_TO_GND "P-Code fuer die Art SH_TO_GND" VALUE 0x70D58 TKW_VV_VV_UW 100.0 FORMULA_0010 0.0 65535.0 /end CHARACTERISTIC
/begin CHARACTERISTIC K_ED_UEXT_124_512.P_CODE_SH_TO_UB "P-Code fuer die Art SH_TO_UB" VALUE 0x70D56 TKW_VV_VV_UW 100.0 FORMULA_0010 0.0 65535.0 /end CHARACTERISTIC
/begin CHARACTERISTIC K_ED_UEXT_124_512.P_CODE_UNPLAUSIBEL "P-Code fuer die Art UNPLAUSIBEL" VALUE 0x70D5C TKW_VV_VV_UW 100.0 FORMULA_0010 0.0 65535.0 /end CHARACTERISTIC
/begin CHARACTERISTIC K_ED_V_DIREKT.DEC_NACH_EINTRAG "Filterverringerung nach Fehlerspeichereintrag" VALUE 0x70F1D TKW_VV_VV_UB 100.0 FORMULA_0003 0.0 255.0 /end CHARACTERISTIC
/begin CHARACTERISTIC K_ED_V_DIREKT.DEC_VOR_EINTRAG "Filterverringerung vorm Fehlerspeichereintrag" VALUE 0x70F1B TKW_VV_VV_UB 100.0 FORMULA_0003 0.0 255.0 /end CHARACTERISTIC
/begin CHARACTERISTIC K_ED_V_DIREKT.FEHLERSCHWELLE "Filterschwelle fuer Fehlereintrag" VALUE 0x70F18 TKW_VV_VV_UB 100.0 FORMULA_0003 0.0 255.0 /end CHARACTERISTIC
/begin CHARACTERISTIC K_ED_V_DIREKT.INC_NACH_EINTRAG "Filtererhoehung nach Fehlerspeichereintrag" VALUE 0x70F1C TKW_VV_VV_UB 100.0 FORMULA_0003 0.0 255.0 /end CHARACTERISTIC
/begin CHARACTERISTIC K_ED_V_DIREKT.INC_VOR_EINTRAG "Filtererhoehung vorm Fehlerspeichereintrag" VALUE 0x70F1A TKW_VV_VV_UB 100.0 FORMULA_0003 0.0 255.0 /end CHARACTERISTIC
/begin CHARACTERISTIC K_ED_V_DIREKT.KLASSENINDEX "Auswahl der Fehlerklasse" VALUE 0x70F1E TKW_VV_VV_UB 100.0 FORMULA_0003 0.0 8.0 /end CHARACTERISTIC
/begin CHARACTERISTIC K_ED_V_DIREKT.OK_SCHWELLE "Filterschwelle fuer Fehleraustrag" VALUE 0x70F19 TKW_VV_VV_UB 100.0 FORMULA_0003 0.0 255.0 /end CHARACTERISTIC
/begin CHARACTERISTIC K_ED_V_DIREKT.P_CODE_OPENLOAD "P-Code fuer die Art OPENLOAD" VALUE 0x70F14 TKW_VV_VV_UW 100.0 FORMULA_0010 0.0 65535.0 /end CHARACTERISTIC
/begin CHARACTERISTIC K_ED_V_DIREKT.P_CODE_SH_TO_GND "P-Code fuer die Art SH_TO_GND" VALUE 0x70F12 TKW_VV_VV_UW 100.0 FORMULA_0010 0.0 65535.0 /end CHARACTERISTIC
/begin CHARACTERISTIC K_ED_V_DIREKT.P_CODE_SH_TO_UB "P-Code fuer die Art SH_TO_UB" VALUE 0x70F10 TKW_VV_VV_UW 100.0 FORMULA_0010 0.0 65535.0 /end CHARACTERISTIC
/begin CHARACTERISTIC K_ED_V_DIREKT.P_CODE_UNPLAUSIBEL "P-Code fuer die Art UNPLAUSIBEL" VALUE 0x70F16 TKW_VV_VV_UW 100.0 FORMULA_0010 0.0 65535.0 /end CHARACTERISTIC
/begin CHARACTERISTIC K_ED_WUC_DELTA_TMOT "Min. Temperaturerhoehung fuer Warmupcycle" VALUE 0x71956 TKW_VV_VV_SW 100.0 FORMULA_0074 -1000.0 1000.0 FORMAT "%4.1" /end CHARACTERISTIC
/begin CHARACTERISTIC K_ED_WUC_TMOT_MIN "Min. Temperatur fuer Warmupcycle" VALUE 0x71954 TKW_VV_VV_SW 100.0 FORMULA_0023 -50.0 170.0 FORMAT "%4.1" /end CHARACTERISTIC
/begin CHARACTERISTIC K_ED_ZOELP1.DEC_NACH_EINTRAG "Filterverringerung nach Fehlerspeichereintrag" VALUE 0x71583 TKW_VV_VV_UB 100.0 FORMULA_0003 0.0 255.0 /end CHARACTERISTIC
/begin CHARACTERISTIC K_ED_ZOELP1.DEC_VOR_EINTRAG "Filterverringerung vorm Fehlerspeichereintrag" VALUE 0x71581 TKW_VV_VV_UB 100.0 FORMULA_0003 0.0 255.0 /end CHARACTERISTIC
/begin CHARACTERISTIC K_ED_ZOELP1.FEHLERSCHWELLE "Filterschwelle fuer Fehlereintrag" VALUE 0x7157E TKW_VV_VV_UB 100.0 FORMULA_0003 0.0 255.0 /end CHARACTERISTIC
/begin CHARACTERISTIC K_ED_ZOELP1.INC_NACH_EINTRAG "Filtererhoehung nach Fehlerspeichereintrag" VALUE 0x71582 TKW_VV_VV_UB 100.0 FORMULA_0003 0.0 255.0 /end CHARACTERISTIC
/begin CHARACTERISTIC K_ED_ZOELP1.INC_VOR_EINTRAG "Filtererhoehung vorm Fehlerspeichereintrag" VALUE 0x71580 TKW_VV_VV_UB 100.0 FORMULA_0003 0.0 255.0 /end CHARACTERISTIC
/begin CHARACTERISTIC K_ED_ZOELP1.KLASSENINDEX "Auswahl der Fehlerklasse" VALUE 0x71584 TKW_VV_VV_UB 100.0 FORMULA_0003 0.0 8.0 /end CHARACTERISTIC
/begin CHARACTERISTIC K_ED_ZOELP1.OK_SCHWELLE "Filterschwelle fuer Fehleraustrag" VALUE 0x7157F TKW_VV_VV_UB 100.0 FORMULA_0003 0.0 255.0 /end CHARACTERISTIC
/begin CHARACTERISTIC K_ED_ZOELP1.P_CODE_OPENLOAD "P-Code fuer die Art OPENLOAD" VALUE 0x7157A TKW_VV_VV_UW 100.0 FORMULA_0010 0.0 65535.0 /end CHARACTERISTIC
/begin CHARACTERISTIC K_ED_ZOELP1.P_CODE_SH_TO_GND "P-Code fuer die Art SH_TO_GND" VALUE 0x71578 TKW_VV_VV_UW 100.0 FORMULA_0010 0.0 65535.0 /end CHARACTERISTIC
/begin CHARACTERISTIC K_ED_ZOELP1.P_CODE_SH_TO_UB "P-Code fuer die Art SH_TO_UB" VALUE 0x71576 TKW_VV_VV_UW 100.0 FORMULA_0010 0.0 65535.0 /end CHARACTERISTIC
/begin CHARACTERISTIC K_ED_ZOELP1.P_CODE_UNPLAUSIBEL "P-Code fuer die Art UNPLAUSIBEL" VALUE 0x7157C TKW_VV_VV_UW 100.0 FORMULA_0010 0.0 65535.0 /end CHARACTERISTIC
/begin CHARACTERISTIC K_ED_ZOELP2.DEC_NACH_EINTRAG "Filterverringerung nach Fehlerspeichereintrag" VALUE 0x7159D TKW_VV_VV_UB 100.0 FORMULA_0003 0.0 255.0 /end CHARACTERISTIC
/begin CHARACTERISTIC K_ED_ZOELP2.DEC_VOR_EINTRAG "Filterverringerung vorm Fehlerspeichereintrag" VALUE 0x7159B TKW_VV_VV_UB 100.0 FORMULA_0003 0.0 255.0 /end CHARACTERISTIC
/begin CHARACTERISTIC K_ED_ZOELP2.FEHLERSCHWELLE "Filterschwelle fuer Fehlereintrag" VALUE 0x71598 TKW_VV_VV_UB 100.0 FORMULA_0003 0.0 255.0 /end CHARACTERISTIC
/begin CHARACTERISTIC K_ED_ZOELP2.INC_NACH_EINTRAG "Filtererhoehung nach Fehlerspeichereintrag" VALUE 0x7159C TKW_VV_VV_UB 100.0 FORMULA_0003 0.0 255.0 /end CHARACTERISTIC
/begin CHARACTERISTIC K_ED_ZOELP2.INC_VOR_EINTRAG "Filtererhoehung vorm Fehlerspeichereintrag" VALUE 0x7159A TKW_VV_VV_UB 100.0 FORMULA_0003 0.0 255.0 /end CHARACTERISTIC
/begin CHARACTERISTIC K_ED_ZOELP2.KLASSENINDEX "Auswahl der Fehlerklasse" VALUE 0x7159E TKW_VV_VV_UB 100.0 FORMULA_0003 0.0 8.0 /end CHARACTERISTIC
/begin CHARACTERISTIC K_ED_ZOELP2.OK_SCHWELLE "Filterschwelle fuer Fehleraustrag" VALUE 0x71599 TKW_VV_VV_UB 100.0 FORMULA_0003 0.0 255.0 /end CHARACTERISTIC
/begin CHARACTERISTIC K_ED_ZOELP2.P_CODE_OPENLOAD "P-Code fuer die Art OPENLOAD" VALUE 0x71594 TKW_VV_VV_UW 100.0 FORMULA_0010 0.0 65535.0 /end CHARACTERISTIC
/begin CHARACTERISTIC K_ED_ZOELP2.P_CODE_SH_TO_GND "P-Code fuer die Art SH_TO_GND" VALUE 0x71592 TKW_VV_VV_UW 100.0 FORMULA_0010 0.0 65535.0 /end CHARACTERISTIC
/begin CHARACTERISTIC K_ED_ZOELP2.P_CODE_SH_TO_UB "P-Code fuer die Art SH_TO_UB" VALUE 0x71590 TKW_VV_VV_UW 100.0 FORMULA_0010 0.0 65535.0 /end CHARACTERISTIC
/begin CHARACTERISTIC K_ED_ZOELP2.P_CODE_UNPLAUSIBEL "P-Code fuer die Art UNPLAUSIBEL" VALUE 0x71596 TKW_VV_VV_UW 100.0 FORMULA_0010 0.0 65535.0 /end CHARACTERISTIC
/begin CHARACTERISTIC K_FGR_A1 "Reglerkoeffizient a1" VALUE 0x726D8 TKW_VV_VV_UB 100.0 FORMULA_0662 0.0 10.0 /end CHARACTERISTIC
/begin CHARACTERISTIC K_FGR_AX_MAX "Max. Fahrzeuglängsbeschleunigung" VALUE 0x726AE TKW_VV_VV_SW 100.0 FORMULA_0123 -20.0 20.0 FORMAT "%5.2" /end CHARACTERISTIC
/begin CHARACTERISTIC K_FGR_AX_TAU "Filterkonstante Beschleunigung" VALUE 0x726D1 TKW_VV_VV_UB 100.0 FORMULA_0455 1.009999960660934e-002 2.559999942779541 /end CHARACTERISTIC
/begin CHARACTERISTIC K_FGR_BESCHL_KOMFORT "Sollbeschl. im Komfortmodus" VALUE 0x726C0 TKW_VV_VV_SW 100.0 FORMULA_0123 -20.0 20.0 FORMAT "%5.2" /end CHARACTERISTIC
/begin CHARACTERISTIC K_FGR_BESCHL_NORMAL "Sollbeschl. im Normalmodus" VALUE 0x726C4 TKW_VV_VV_SW 100.0 FORMULA_0123 -20.0 20.0 FORMAT "%5.2" /end CHARACTERISTIC
/begin CHARACTERISTIC K_FGR_BESCHL_SPORT "Sollbeschl. im Sportmodus" VALUE 0x726BC TKW_VV_VV_SW 100.0 FORMULA_0123 -20.0 20.0 FORMAT "%5.2" /end CHARACTERISTIC
/begin CHARACTERISTIC K_FGR_BESCHL_TIP "Sollbeschl. bei Tipp" VALUE 0x726C6 TKW_VV_VV_SW 100.0 FORMULA_0123 -20.0 20.0 FORMAT "%5.2" /end CHARACTERISTIC
/begin CHARACTERISTIC K_FGR_BESCHL_WA_KOMFORT "Sollbeschl. bei Wiederaufn. im Komfortmodus" VALUE 0x726BE TKW_VV_VV_SW 100.0 FORMULA_0123 -20.0 20.0 FORMAT "%5.2" /end CHARACTERISTIC
/begin CHARACTERISTIC K_FGR_BESCHL_WA_NORMAL "Sollbeschl. bei Wiederaufn. im Normalmodus" VALUE 0x726C2 TKW_VV_VV_SW 100.0 FORMULA_0123 -20.0 20.0 FORMAT "%5.2" /end CHARACTERISTIC
/begin CHARACTERISTIC K_FGR_BESCHL_WA_SPORT "Sollbeschl. bei Wiederaufn. im Sportmodus" VALUE 0x726BA TKW_VV_VV_SW 100.0 FORMULA_0123 -20.0 20.0 FORMAT "%5.2" /end CHARACTERISTIC
/begin CHARACTERISTIC K_FGR_CFG_V_IST "Auswahl V-Ist: Fahrzeuggeschw. oder Anzeigegeschw. " VALUE 0x726D0 TKW_VV_VV_UB 100.0 FORMULA_0660 0.0 1.0 /end CHARACTERISTIC
/begin CHARACTERISTIC K_FGR_CFG_V_MAX "Konfig FGR bis Vmax" VALUE 0x72672 TKW_VV_VV_UB 100.0 FORMULA_0656 0.0 1.0 /end CHARACTERISTIC
/begin CHARACTERISTIC K_FGR_CFG_VORST "FGR Vorsteuerung 1: Ein, 0: Aus " VALUE 0x7266F TKW_VV_VV_UB 100.0 FORMULA_0315 0.0 1.0 /end CHARACTERISTIC
/begin CHARACTERISTIC K_FGR_DSC_BLS_T "Max Zeitdauer eines kombinierten DSC-Eingriffs" VALUE 0x72690 TKW_VV_VV_UW 100.0 FORMULA_0021 0.0 655.0 FORMAT "%5.2" /end CHARACTERISTIC
/begin CHARACTERISTIC K_FGR_DSC_MD_BLS_T "Max Zeitdauer eines DSC Bremseneingriff" VALUE 0x7268E TKW_VV_VV_UW 100.0 FORMULA_0021 0.0 655.0 FORMAT "%5.2" /end CHARACTERISTIC
/begin CHARACTERISTIC K_FGR_DSC_MD_T "Max Zeitdauer eines DSC Momenteneingriff" VALUE 0x7268C TKW_VV_VV_UW 100.0 FORMULA_0021 0.0 655.0 FORMAT "%5.2" /end CHARACTERISTIC
/begin CHARACTERISTIC K_FGR_EIN "FGR Einschalten 1: Ein, 0: Aus " VALUE 0x7266C TKW_VV_VV_UB 100.0 FORMULA_0315 0.0 1.0 /end CHARACTERISTIC
/begin CHARACTERISTIC K_FGR_FAK_V_KOMFORT "Wichtung Bereich Komfort" VALUE 0x726AC TKW_VV_VV_UB 100.0 FORMULA_0493 0.0 1.0 /end CHARACTERISTIC
/begin CHARACTERISTIC K_FGR_FAK_V_MAX "Schwelle oberer Bereich" VALUE 0x726A2 TKW_VV_VV_SW 100.0 FORMULA_0076 -80.0 360.0 FORMAT "%4.1" /end CHARACTERISTIC
/begin CHARACTERISTIC K_FGR_FAK_V_MIN "Schwelle unterer Bereich" VALUE 0x726A4 TKW_VV_VV_SW 100.0 FORMULA_0076 -80.0 360.0 FORMAT "%4.1" /end CHARACTERISTIC
/begin CHARACTERISTIC K_FGR_FAK_V_NORMAL "Wichtung Bereich Normal" VALUE 0x726AB TKW_VV_VV_UB 100.0 FORMULA_0493 0.0 1.0 /end CHARACTERISTIC
/begin CHARACTERISTIC K_FGR_FAK_V_SPORT "Wichtung Bereich Sport" VALUE 0x726AA TKW_VV_VV_UB 100.0 FORMULA_0493 0.0 1.0 /end CHARACTERISTIC
/begin CHARACTERISTIC K_FGR_FAK_V_TIP "Wichtung Tippen" VALUE 0x726AD TKW_VV_VV_UB 100.0 FORMULA_0659 0.0 2.549999952316284 /end CHARACTERISTIC
/begin CHARACTERISTIC K_FGR_FSP_EIN "FGR Fehlerspeicher Einschalten 1: Ein, 0: Aus " VALUE 0x7266D TKW_VV_VV_UB 100.0 FORMULA_0315 0.0 1.0 /end CHARACTERISTIC
/begin CHARACTERISTIC K_FGR_MARKE_CFG "Konfig Markenanzeige während Beschleunigung" VALUE 0x72671 TKW_VV_VV_UB 100.0 FORMULA_0655 0.0 1.0 /end CHARACTERISTIC
/begin CHARACTERISTIC K_FGR_MD_DELTA "Änderungsbegrenzung Reglereingriff" VALUE 0x726D6 TKW_VV_VV_UW 100.0 FORMULA_0661 0.0 400.0 FORMAT "%7.4" /end CHARACTERISTIC
/begin CHARACTERISTIC K_FGR_MD_FW_HYS "Hysterese Überholerkennung " VALUE 0x726D4 TKW_VV_VV_SW 100.0 FORMULA_0022 -200.0 200.0 FORMAT "%5.2" /end CHARACTERISTIC
/begin CHARACTERISTIC K_FGR_MD_FW_LL_HYS "Hysterese Minimalschwelle " VALUE 0x726D2 TKW_VV_VV_SW 100.0 FORMULA_0022 -200.0 200.0 FORMAT "%5.2" /end CHARACTERISTIC
/begin CHARACTERISTIC K_FGR_MSW_T_MIN "Wartezeit für langes Drücken" VALUE 0x72673 TKW_VV_VV_UB 100.0 FORMULA_0306 0.0 2.549999952316284 /end CHARACTERISTIC
/begin CHARACTERISTIC K_FGR_N_DIF_DIAG_T "Max Zeitdauer eines DSC Bremseneingriff" VALUE 0x726B4 TKW_VV_VV_UW 100.0 FORMULA_0021 0.0 655.0 FORMAT "%5.2" /end CHARACTERISTIC
/begin CHARACTERISTIC K_FGR_N_DIF_MAX "N Dif. max Begrenzung" VALUE 0x726B2 TKW_VV_VV_SW 100.0 FORMULA_0006 0.0 10000.0 /end CHARACTERISTIC
/begin CHARACTERISTIC K_FGR_N_MAX "Nmax. Begrenzung" VALUE 0x726B8 TKW_VV_VV_SW 100.0 FORMULA_0006 0.0 10000.0 /end CHARACTERISTIC
/begin CHARACTERISTIC K_FGR_SMG_MCS "FGR Abschaltung durch SMG sperren" VALUE 0x72670 TKW_VV_VV_UB 100.0 FORMULA_0654 0.0 1.0 /end CHARACTERISTIC
/begin CHARACTERISTIC K_FGR_STATE_AG "FGR STATE AG 1: Ein, 0: Aus " VALUE 0x7266E TKW_VV_VV_UB 100.0 FORMULA_0315 0.0 1.0 /end CHARACTERISTIC
/begin CHARACTERISTIC K_FGR_STEP_T_MIN "Wartezeit für wiederholte Markensprünge" VALUE 0x72675 TKW_VV_VV_UB 100.0 FORMULA_0306 0.0 2.549999952316284 /end CHARACTERISTIC
/begin CHARACTERISTIC K_FGR_STUFE_KMH "Schrittweite Stufe in KM/H " VALUE 0x726E0 TKW_VV_VV_SW 100.0 FORMULA_0076 -360.0 360.0 FORMAT "%4.1" /end CHARACTERISTIC
/begin CHARACTERISTIC K_FGR_STUFE_MPH "Schrittweite Stufe in MPH " VALUE 0x726DE TKW_VV_VV_SW 100.0 FORMULA_0658 -360.0 360.0 FORMAT "%4.1" /end CHARACTERISTIC
/begin CHARACTERISTIC K_FGR_T_AUS "Wartezeit bis Erkennung HUD aus" VALUE 0x72676 TKW_VV_VV_UB 100.0 FORMULA_0306 0.0 2.549999952316284 /end CHARACTERISTIC
/begin CHARACTERISTIC K_FGR_T_CONSTF_RAMPE "Max Zeit bei Übertreten des FGR Eingriffs" VALUE 0x72680 TKW_VV_VV_UW 100.0 FORMULA_0021 0.0 655.0 FORMAT "%5.2" /end CHARACTERISTIC
/begin CHARACTERISTIC K_FGR_T_FEHLER_E2 "Wartezeit für Ebene 2 Fehlermeldung" VALUE 0x7B078 TKW_VV_VV_UB 100.0 FORMULA_0492 0.0 25.5 /end CHARACTERISTIC
/begin CHARACTERISTIC K_FGR_T_MIN_SA "min. Wartezeit vor SA bei Konstantfahrt" VALUE 0x726DA TKW_VV_VV_UW 100.0 FORMULA_0663 0.0 60.0 FORMAT "%5.2" /end CHARACTERISTIC
/begin CHARACTERISTIC K_FGR_T_STRICH "Zeit für HUD Anzeige Strich" VALUE 0x7267E TKW_VV_VV_UW 100.0 FORMULA_0021 0.0 655.0 FORMAT "%5.2" /end CHARACTERISTIC
/begin CHARACTERISTIC K_FGR_T_UEBERHOL_MAX "Max Zeit bei Übertreten des FGR Eingriffs" VALUE 0x7267C TKW_VV_VV_UW 100.0 FORMULA_0021 0.0 655.0 FORMAT "%5.2" /end CHARACTERISTIC
/begin CHARACTERISTIC K_FGR_TIP_T_MIN "Wartezeit für Entprellung Tipp" VALUE 0x72674 TKW_VV_VV_UB 100.0 FORMULA_0306 0.0 2.549999952316284 /end CHARACTERISTIC
/begin CHARACTERISTIC K_FGR_V_DIAG "Max. Abweichung V_RAD_HR und V_DIREKT " VALUE 0x726E2 TKW_VV_VV_SW 100.0 FORMULA_0076 -360.0 360.0 FORMAT "%4.1" /end CHARACTERISTIC
/begin CHARACTERISTIC K_FGR_V_DIAG_T "Wartezeit für V_RAD_HR/V_DIREKT Differenz Fehler" VALUE 0x726E4 TKW_VV_VV_UB 100.0 FORMULA_0306 0.0 2.549999952316284 /end CHARACTERISTIC
/begin CHARACTERISTIC K_FGR_V_DIF_MAX "Max Schwelle der Soll/Ist Regelabweichung" VALUE 0x72678 TKW_VV_VV_SW 100.0 FORMULA_0076 -360.0 360.0 FORMAT "%4.1" /end CHARACTERISTIC
/begin CHARACTERISTIC K_FGR_V_DIF_MAX_AUFST "Max. Regelabweichung bevor Rampe wartet" VALUE 0x7269E TKW_VV_VV_SW 100.0 FORMULA_0076 -80.0 360.0 FORMAT "%4.1" /end CHARACTERISTIC
/begin CHARACTERISTIC K_FGR_V_DIF_MAX_LL "Max. Reglerabweichung zur Auslösung SA" VALUE 0x726A8 TKW_VV_VV_SW 100.0 FORMULA_0076 -360.0 360.0 FORMAT "%4.1" /end CHARACTERISTIC
/begin CHARACTERISTIC K_FGR_V_DIF_MIN "Min Schwelle der Soll/Ist Regelabweichung" VALUE 0x7267A TKW_VV_VV_SW 100.0 FORMULA_0076 -360.0 360.0 FORMAT "%4.1" /end CHARACTERISTIC
/begin CHARACTERISTIC K_FGR_V_DIF_MIN_AUFST "Min. Regelabweichung bevor Rampe wartet" VALUE 0x726A0 TKW_VV_VV_SW 100.0 FORMULA_0076 -360.0 360.0 FORMAT "%4.1" /end CHARACTERISTIC
/begin CHARACTERISTIC K_FGR_V_DIF_MIN_LL "Min. Reglerabweichung zur Auslösung SA" VALUE 0x726A6 TKW_VV_VV_SW 100.0 FORMULA_0076 -360.0 360.0 FORMAT "%4.1" /end CHARACTERISTIC
/begin CHARACTERISTIC K_FGR_V_DIF_MIN_UEBERHOL "Schwelle für Wegbeschleunigung " VALUE 0x726DC TKW_VV_VV_SW 100.0 FORMULA_0076 -360.0 360.0 FORMAT "%4.1" /end CHARACTERISTIC
/begin CHARACTERISTIC K_FGR_V_FEHLER_T "Haltezeit für Signalfehler vor Abschaltung" VALUE 0x726CC TKW_VV_VV_UB 100.0 FORMULA_0306 0.0 2.549999952316284 /end CHARACTERISTIC
/begin CHARACTERISTIC K_FGR_V_IST_MIN "Min. Fahrzeuggeschwindigkeit" VALUE 0x72692 TKW_VV_VV_SW 100.0 FORMULA_0076 -360.0 360.0 FORMAT "%4.1" /end CHARACTERISTIC
/begin CHARACTERISTIC K_FGR_V_IST_TAU "Filterkonstante für Umschaltung Istgeschw." VALUE 0x726CE TKW_VV_VV_UW 100.0 FORMULA_0021 0.0 655.0 FORMAT "%5.2" /end CHARACTERISTIC
/begin CHARACTERISTIC K_FGR_V_MAX "Vmax. Begrenzung" VALUE 0x726B0 TKW_VV_VV_SW 100.0 FORMULA_0076 -80.0 360.0 FORMAT "%4.1" /end CHARACTERISTIC
/begin CHARACTERISTIC K_FGR_V_SOLL_DIF_KONST "Konstante Abweichung von Zielgeschw. bei Übertreten" VALUE 0x72686 TKW_VV_VV_SW 100.0 FORMULA_0076 -360.0 360.0 FORMAT "%4.1" /end CHARACTERISTIC
/begin CHARACTERISTIC K_FGR_V_SOLL_DIF_MAX "Max. Abweichung von Zielgeschw. bei Übertreten" VALUE 0x72682 TKW_VV_VV_SW 100.0 FORMULA_0076 -360.0 360.0 FORMAT "%4.1" /end CHARACTERISTIC
/begin CHARACTERISTIC K_FGR_V_SOLL_DIF_MIN "Min. Abweichung von Zielgeschw. bei Übertreten" VALUE 0x72684 TKW_VV_VV_SW 100.0 FORMULA_0076 -360.0 360.0 FORMAT "%4.1" /end CHARACTERISTIC
/begin CHARACTERISTIC K_FGR_V_SOLL_MAX_HYS "Vmax. Hysterese" VALUE 0x726B6 TKW_VV_VV_SW 100.0 FORMULA_0076 -80.0 360.0 FORMAT "%4.1" /end CHARACTERISTIC
/begin CHARACTERISTIC K_FGR_V_SOLL_MAX_KMH "Max. Ziel-/Sollgeschwindigkeit in km/h" VALUE 0x72696 TKW_VV_VV_SW 100.0 FORMULA_0076 -360.0 360.0 FORMAT "%4.1" /end CHARACTERISTIC
/begin CHARACTERISTIC K_FGR_V_SOLL_MAX_MPH "Max. Ziel-/Sollgeschwindigkeit in mph" VALUE 0x7269A TKW_VV_VV_SW 100.0 FORMULA_0658 -360.0 360.0 FORMAT "%4.1" /end CHARACTERISTIC
/begin CHARACTERISTIC K_FGR_V_SOLL_MAX_T "Max. Zeitdauer über max. Sollgeschwindigkeit" VALUE 0x7268A TKW_VV_VV_UW 100.0 FORMULA_0021 0.0 655.0 FORMAT "%5.2" /end CHARACTERISTIC
/begin CHARACTERISTIC K_FGR_V_SOLL_MIN_KMH "Min. Ziel-/Sollgeschwindigkeit in km/h" VALUE 0x72698 TKW_VV_VV_SW 100.0 FORMULA_0076 -360.0 360.0 FORMAT "%4.1" /end CHARACTERISTIC
/begin CHARACTERISTIC K_FGR_V_SOLL_MIN_KMH_E2 "E2 Min. Ziel-/Sollgeschwindigkeit in km/h" VALUE 0x7B074 TKW_VV_VV_SW 100.0 FORMULA_0076 -360.0 360.0 FORMAT "%4.1" /end CHARACTERISTIC
/begin CHARACTERISTIC K_FGR_V_SOLL_MIN_MPH "Min. Ziel-/Sollgeschwindigkeit in mph" VALUE 0x7269C TKW_VV_VV_SW 100.0 FORMULA_0658 -360.0 360.0 FORMAT "%4.1" /end CHARACTERISTIC
/begin CHARACTERISTIC K_FGR_V_SOLL_MIN_MPH_E2 "E2 Min. Ziel-/Sollgeschwindigkeit in mph" VALUE 0x7B076 TKW_VV_VV_SW 100.0 FORMULA_0658 -360.0 360.0 FORMAT "%4.1" /end CHARACTERISTIC
/begin CHARACTERISTIC K_FGR_V_SOLL_OFFSET "Konstante Abweichung vom Kombi" VALUE 0x72688 TKW_VV_VV_SB 100.0 FORMULA_0657 -5.0 5.0 /end CHARACTERISTIC
/begin CHARACTERISTIC K_FGR_V_TIP_INC_DEC "Tipp Fahrzeuggeschwindigkeit inc/dec" VALUE 0x72694 TKW_VV_VV_SW 100.0 FORMULA_0076 -80.0 360.0 FORMAT "%4.1" /end CHARACTERISTIC
/begin CHARACTERISTIC K_FGR_VAHA_DIAG_T "Wartezeit für V_VORNE/V_HINTEN Differenz Fehler" VALUE 0x726E5 TKW_VV_VV_UB 100.0 FORMULA_0306 0.0 2.549999952316284 /end CHARACTERISTIC
/begin CHARACTERISTIC K_FGR_VERZ "Sollverzögerung beim Verzögern" VALUE 0x726C8 TKW_VV_VV_SW 100.0 FORMULA_0123 -20.0 20.0 FORMAT "%5.2" /end CHARACTERISTIC
/begin CHARACTERISTIC K_FGR_VERZ_TIP "Sollverzögerung bei Tipp" VALUE 0x726CA TKW_VV_VV_SW 100.0 FORMULA_0123 -20.0 20.0 FORMAT "%5.2" /end CHARACTERISTIC
/begin CHARACTERISTIC K_FR_AQGRAD_MAX "Trigger Dynamik Deaktivierung." VALUE 0x72FF0 TKW_VV_VV_SW 100.0 FORMULA_0020 -655360.0 655340.0 /end CHARACTERISTIC
/begin CHARACTERISTIC K_FR_CFG "Konfiguration Rueckfuehrung" VALUE 0x72FCE TKW_VV_VV_UB 100.0 FORMULA_0674 0.0 255.0 /end CHARACTERISTIC
/begin CHARACTERISTIC K_FR_EDK_DIFF "max. Differenz Soll/-Istwertabweichung" VALUE 0x72FF4 TKW_VV_VV_SW 100.0 FORMULA_0001 -10.0 120.0 FORMAT "%4.1" /end CHARACTERISTIC
/begin CHARACTERISTIC K_FR_EINGER_HYS "Schwelle Eingeregelt" VALUE 0x72FDE TKW_VV_VV_SW 100.0 FORMULA_0676 0.0 99.99690246582031 FORMAT "%5.2" /end CHARACTERISTIC
/begin CHARACTERISTIC K_FR_EINGER_SCHW "Schwelle Eingeregelt" VALUE 0x72FDC TKW_VV_VV_SW 100.0 FORMULA_0676 0.0 99.99690246582031 FORMAT "%5.2" /end CHARACTERISTIC
/begin CHARACTERISTIC K_FR_IMAX "Maximaler I-Anteils" VALUE 0x72FD4 TKW_VV_VV_SW 100.0 FORMULA_0670 0.0 0.5 FORMAT "%7.4" /end CHARACTERISTIC
/begin CHARACTERISTIC K_FR_IMIN "Minimaler I-Anteils" VALUE 0x72FD2 TKW_VV_VV_SW 100.0 FORMULA_0670 -0.5 0.0 FORMAT "%7.4" /end CHARACTERISTIC
/begin CHARACTERISTIC K_FR_IN_CFG "Konfiguration fuer Reglereingang" VALUE 0x72FCF TKW_VV_VV_UB 100.0 FORMULA_0675 0.0 255.0 /end CHARACTERISTIC
/begin CHARACTERISTIC K_FR_MAX "Max-Anschlag Reglerausgang" VALUE 0x72FD8 TKW_VV_VV_SW 100.0 FORMULA_0670 0.0 0.5 FORMAT "%7.4" /end CHARACTERISTIC
/begin CHARACTERISTIC K_FR_MIN "Min-Anschlag Reglerausgang" VALUE 0x72FD6 TKW_VV_VV_SW 100.0 FORMULA_0670 -0.5 0.0 FORMAT "%7.4" /end CHARACTERISTIC
/begin CHARACTERISTIC K_FR_MVAC_RF_MAX "Maximallast Schwelle fuer FR Deaktivierung" VALUE 0x72FF2 TKW_VV_VV_SW 100.0 FORMULA_0007 0.0 2.0 FORMAT "%6.3" /end CHARACTERISTIC
/begin CHARACTERISTIC K_FR_PUMG_MAX "Sperrniveau fuer max Pumg" VALUE 0x72FE4 TKW_VV_VV_SW 100.0 FORMULA_0075 400.0 1200.0 FORMAT "%4.1" /end CHARACTERISTIC
/begin CHARACTERISTIC K_FR_PUMG_MIN "Sperrniveau fuer min Pumg" VALUE 0x72FE6 TKW_VV_VV_SW 100.0 FORMULA_0075 400.0 1200.0 FORMAT "%4.1" /end CHARACTERISTIC
/begin CHARACTERISTIC K_FR_START_DELAY "Verzoegerung nach Start" VALUE 0x72FDA TKW_VV_VV_UW 100.0 FORMULA_0021 0.0 655.0 FORMAT "%5.2" /end CHARACTERISTIC
/begin CHARACTERISTIC K_FR_T_ABREG "Schrittweite fuer Abrampen" VALUE 0x72FD0 TKW_VV_VV_UW 100.0 FORMULA_0671 0.0 0.5 FORMAT "%7.4" /end CHARACTERISTIC
/begin CHARACTERISTIC K_FR_TAN_MAX "max. zulaessige Ansaugtemperatur fuer FR" VALUE 0x72FE8 TKW_VV_VV_SW 100.0 FORMULA_0023 -50.0 170.0 FORMAT "%4.1" /end CHARACTERISTIC
/begin CHARACTERISTIC K_FR_TAN_MIN "min. zulaessige Ansaugtemperatur fuer FR" VALUE 0x72FEA TKW_VV_VV_SW 100.0 FORMULA_0023 -50.0 170.0 FORMAT "%4.1" /end CHARACTERISTIC
/begin CHARACTERISTIC K_FR_TE_C_AKF_MAX "max. Konzentration aus AKF" VALUE 0x72FF6 TKW_VV_VV_UW 100.0 FORMULA_0199 0.0 3.0 FORMAT "%7.4" /end CHARACTERISTIC
/begin CHARACTERISTIC K_FR_TE_X_ML_MIN "Minimaler Spuelluftanteil bei der FR aus" VALUE 0x72FF8 TKW_VV_VV_UW 100.0 FORMULA_0024 0.0 1.0 FORMAT "%7.4" /end CHARACTERISTIC
/begin CHARACTERISTIC K_FR_TKSM_MAX "max. zulaessige Krafstoffmodelltemp. fuer FR" VALUE 0x72FEC TKW_VV_VV_SW 100.0 FORMULA_0023 -50.0 170.0 FORMAT "%4.1" /end CHARACTERISTIC
/begin CHARACTERISTIC K_FR_TKSM_MIN "min. zulaessige Krafstoffmodelltemp fuer FR" VALUE 0x72FEE TKW_VV_VV_SW 100.0 FORMULA_0023 -50.0 170.0 FORMAT "%4.1" /end CHARACTERISTIC
/begin CHARACTERISTIC K_FR_TMOT_MAX "Temperaturschwelle fuer TMOT-MAX" VALUE 0x72FE0 TKW_VV_VV_SW 100.0 FORMULA_0023 -50.0 150.0 FORMAT "%4.1" /end CHARACTERISTIC
/begin CHARACTERISTIC K_FR_TMOT_MIN "Temperaturschwelle fuer TMOT-MIN" VALUE 0x72FE2 TKW_VV_VV_SW 100.0 FORMULA_0023 -50.0 150.0 FORMAT "%4.1" /end CHARACTERISTIC
/begin CHARACTERISTIC K_FRA_AQ_ADAPT_MAX "max. Adaptionswert" VALUE 0x730D0 TKW_VV_VV_SW 100.0 FORMULA_0424 0.0 50.0 FORMAT "%5.2" /end CHARACTERISTIC
/begin CHARACTERISTIC K_FRA_AQ_ADAPT_MIN "min. Adaptionswert" VALUE 0x730CE TKW_VV_VV_SW 100.0 FORMULA_0424 -50.0 0.0 FORMAT "%5.2" /end CHARACTERISTIC
/begin CHARACTERISTIC K_FRA_AQ_DELTA_FAST "Adaptionsschritt - Schnell" VALUE 0x730C8 TKW_VV_VV_SW 100.0 FORMULA_0424 0.0 50.0 FORMAT "%5.2" /end CHARACTERISTIC
/begin CHARACTERISTIC K_FRA_AQ_DELTA_SLOW "Adaptionsschritt - Langsam" VALUE 0x730C6 TKW_VV_VV_SW 100.0 FORMULA_0424 0.0 50.0 FORMAT "%5.2" /end CHARACTERISTIC
/begin CHARACTERISTIC K_FRA_AQ_MAX_FAST "Zunahme pro Adaptionszyklus - Schnell" VALUE 0x730CC TKW_VV_VV_SW 100.0 FORMULA_0424 0.0 50.0 FORMAT "%5.2" /end CHARACTERISTIC
/begin CHARACTERISTIC K_FRA_AQ_MAX_SLOW "Aenderung pro Adaptionszyklus - Langsam" VALUE 0x730CA TKW_VV_VV_SW 100.0 FORMULA_0424 0.0 50.0 FORMAT "%5.2" /end CHARACTERISTIC
/begin CHARACTERISTIC K_FRA_AQ_TMOT_TAU "Tau fuer die Grundleckluftadaption tmot" VALUE 0x730D2 TKW_VV_VV_UW 100.0 FORMULA_0681 0.1000000014901161 6553.5 FORMAT "%5.2" /end CHARACTERISTIC
/begin CHARACTERISTIC K_FRA_CFG "Konfiguration" VALUE 0x730BC TKW_VV_VV_UB 100.0 FORMULA_0680 0.0 255.0 /end CHARACTERISTIC
/begin CHARACTERISTIC K_FRA_FR_I_REG_SCHW "Schwelle I-Anteil (FR aktiv)" VALUE 0x730C2 TKW_VV_VV_SW 100.0 FORMULA_0024 0.0 0.5 FORMAT "%7.4" /end CHARACTERISTIC
/begin CHARACTERISTIC K_FRA_LOLI_ANZ "Anzahl Modelle für FRA-Lolimot-KNN" VALUE 0x732F5 TKW_VV_VV_UB 100.0 FORMULA_0037 0.0 15.0 /end CHARACTERISTIC
/begin CHARACTERISTIC K_FRA_LOLI_CFG "Konfigbyte für FRA-Lolimot-KNN" VALUE 0x732F6 TKW_VV_VV_UB 100.0 FORMULA_0689 0.0 255.0 /end CHARACTERISTIC
/begin CHARACTERISTIC K_FRA_LOLI_GEW_MAX "Maximalwert für Gewichte für FRA-Lolimot-KNN" VALUE 0x73304 TKW_VV_VV_SF 100.0 FORMULA_0044 -3.402823466385289e+038 3.402823466385289e+038 FORMAT "%5.2" /end CHARACTERISTIC
/begin CHARACTERISTIC K_FRA_LOLI_LERN_CFG "Konfigbyte fuer Lernen" VALUE 0x732F4 TKW_VV_VV_UB 100.0 FORMULA_0688 0.0 255.0 /end CHARACTERISTIC
/begin CHARACTERISTIC K_FRA_LOLI_LERN_FAK "Vektor fuer Gewichtung bzw. Geschwindigkeit fuer Lernfaktor, (bias, X1, X2)" VAL_BLK 0x73308 TKW_VV_VV_SF 100.0 FORMULA_0044 -3.402823466385289e+038 3.402823466385289e+038 FORMAT "%5.2" NUMBER 3 /end CHARACTERISTIC
/begin CHARACTERISTIC K_FRA_LOLI_MAX "Lolimot Maxgrenze FRA" VALUE 0x732F8 TKW_VV_VV_SF 100.0 FORMULA_0044 -3.402823466385289e+038 3.402823466385289e+038 FORMAT "%5.2" /end CHARACTERISTIC
/begin CHARACTERISTIC K_FRA_LOLI_MDRF_MIN "Minbegrenzung Lerneingang Lolimot mdrf" VALUE 0x73300 TKW_VV_VV_SW 100.0 FORMULA_0007 0.0 2.0 FORMAT "%6.3" /end CHARACTERISTIC
/begin CHARACTERISTIC K_FRA_LOLI_MIN "Lolimot Mingrenze FRA" VALUE 0x732FC TKW_VV_VV_SF 100.0 FORMULA_0044 -3.402823466385289e+038 3.402823466385289e+038 FORMAT "%5.2" /end CHARACTERISTIC
/begin CHARACTERISTIC K_FRA_LOLI_N_MIN "Minbegrenzung Lerneingang Lolimot n" VALUE 0x73302 TKW_VV_VV_SW 100.0 FORMULA_0006 0.0 10000.0 /end CHARACTERISTIC
/begin CHARACTERISTIC K_FRA_LOLI_X_NORM "Normierungsvektor der Eingaenge" VAL_BLK 0x73318 TKW_VV_VV_SF 100.0 FORMULA_0044 -3.402823466385289e+038 3.402823466385289e+038 FORMAT "%5.2" NUMBER 2 /end CHARACTERISTIC
/begin CHARACTERISTIC K_FRA_RF_DELTA_SCHW "Schwelle Regeldifferenz (FR aus)" VALUE 0x730C4 TKW_VV_VV_SW 100.0 FORMULA_0007 0.0 2.0 FORMAT "%6.3" /end CHARACTERISTIC
/begin CHARACTERISTIC K_FRA_RF_MAX "max. rf-Schwelle" VALUE 0x730C0 TKW_VV_VV_SW 100.0 FORMULA_0007 0.0 2.0 FORMAT "%6.3" /end CHARACTERISTIC
/begin CHARACTERISTIC K_FRA_TE_C_AKF_MAX "max. Konzentration aus AKF" VALUE 0x73316 TKW_VV_VV_UW 100.0 FORMULA_0199 0.0 2.0 FORMAT "%7.4" /end CHARACTERISTIC
/begin CHARACTERISTIC K_FRA_TMOT_MIN "Temperaturschwelle fuer TMOT-MIN" VALUE 0x73314 TKW_VV_VV_SW 100.0 FORMULA_0023 -50.0 150.0 FORMAT "%4.1" /end CHARACTERISTIC
/begin CHARACTERISTIC K_FRA_TMOT_SCHW "min. Temperaturschwelle" VALUE 0x730BE TKW_VV_VV_SW 100.0 FORMULA_0023 -50.0 170.0 FORMAT "%4.1" /end CHARACTERISTIC
/begin CHARACTERISTIC K_FRA_WAIT "Wartezeit" VALUE 0x730BD TKW_VV_VV_UB 100.0 FORMULA_0214 1.0 255.0 /end CHARACTERISTIC
/begin CHARACTERISTIC K_GANG_1_TIMER_MAX "Zeit bis Anzeige 1.Gang" VALUE 0x7348A TKW_VV_VV_SW 100.0 FORMULA_0691 -327680.0 327670.0 /end CHARACTERISTIC
/begin CHARACTERISTIC K_GANG_GLG_TIMER_MAX "Zeit bis Anzeige Getriebeleergasse" VALUE 0x73488 TKW_VV_VV_SW 100.0 FORMULA_0691 -327680.0 327670.0 /end CHARACTERISTIC
/begin CHARACTERISTIC K_GANG_I_HA_DKG "Uebersetzungsverhaeltnis Hinterachse DKG" VALUE 0x73482 TKW_VV_VV_SW 100.0 FORMULA_0073 -32.0 31.99900054931641 FORMAT "%6.3" /end CHARACTERISTIC
/begin CHARACTERISTIC K_GANG_I_HA_HS "Uebersetzungsverhaeltnis Hinterachse Handschalter" VALUE 0x73484 TKW_VV_VV_SW 100.0 FORMULA_0073 -32.0 31.99900054931641 FORMAT "%6.3" /end CHARACTERISTIC
/begin CHARACTERISTIC K_GANG_I_HA_SMG "Uebersetzungsverhaeltnis Hinterachse SMG" VALUE 0x73480 TKW_VV_VV_SW 100.0 FORMULA_0073 -32.0 31.99900054931641 FORMAT "%6.3" /end CHARACTERISTIC
/begin CHARACTERISTIC K_GANG_I_RW_DKG "Uebersetzungsverhaeltnis Rueckwaertsgang DKG" VALUE 0x7347C TKW_VV_VV_SW 100.0 FORMULA_0073 -32.0 31.99900054931641 FORMAT "%6.3" /end CHARACTERISTIC
/begin CHARACTERISTIC K_GANG_I_RW_HS "Uebersetzungsverhaeltnis Rueckwaertsgang Handschalter" VALUE 0x7347E TKW_VV_VV_SW 100.0 FORMULA_0073 -32.0 31.99900054931641 FORMAT "%6.3" /end CHARACTERISTIC
/begin CHARACTERISTIC K_GANG_I_RW_SMG "Uebersetzungsverhaeltnis Rueckwaertsgang SMG" VALUE 0x7347A TKW_VV_VV_SW 100.0 FORMULA_0073 -32.0 31.99900054931641 FORMAT "%6.3" /end CHARACTERISTIC
/begin CHARACTERISTIC K_GANG_N_VERH_MAX "Uebersetzungsverhaeltnis Maximum" VALUE 0x73478 TKW_VV_VV_SW 100.0 FORMULA_0073 -32.0 31.99900054931641 FORMAT "%6.3" /end CHARACTERISTIC
/begin CHARACTERISTIC K_GANG_N_VERH_MIN "Uebersetzungsverhaeltnis Minimum" VALUE 0x73476 TKW_VV_VV_SW 100.0 FORMULA_0073 -32.0 31.99900054931641 FORMAT "%6.3" /end CHARACTERISTIC
/begin CHARACTERISTIC K_GANG_R_RAD_DYN_NV "Radhalbmesser dynamisch adaptiert, temporaere Konstante" VALUE 0x73486 TKW_VV_VV_SW 100.0 FORMULA_0693 -32.0 31.99900054931641 FORMAT "%6.3" /end CHARACTERISTIC
/begin CHARACTERISTIC K_V_DIREKT_FAK "Umrechnungsfaktor" VALUE 0x7AE88 TKW_VV_VV_UL 100.0 FORMULA_0000 0.0 4294967295.0 /end CHARACTERISTIC
/begin CHARACTERISTIC K_V_DIREKT_TAU "TAU Geschwindigkeitserfassung" VALUE 0x7AE84 TKW_VV_VV_UB 100.0 FORMULA_0455 1.009999960660934e-002 2.559999942779541 /end CHARACTERISTIC
/begin CHARACTERISTIC K_V_MAX_E2 "max. Geschwindigkeit - Ebene 2" VALUE 0x7B510 TKW_VV_VV_SW 100.0 FORMULA_0076 -80.0 400.0 FORMAT "%4.1" /end CHARACTERISTIC
/begin CHARACTERISTIC K_V_MAX_NEG_GRAD_E2 "min. Aenderungsbegrenzung - Ebene 2" VALUE 0x7B50A TKW_VV_VV_SW 100.0 FORMULA_1051 -80.0 0.0 FORMAT "%4.1" /end CHARACTERISTIC
/begin CHARACTERISTIC K_V_MAX_POS_GRAD_E2 "max. Aenderungsbegrenzung - Ebene 2" VALUE 0x7B50C TKW_VV_VV_SW 100.0 FORMULA_1051 0.0 360.0 FORMAT "%4.1" /end CHARACTERISTIC
/begin CHARACTERISTIC K_V_MIN_E2 "min. Geschwindigkeit - Ebene 2" VALUE 0x7B50E TKW_VV_VV_SW 100.0 FORMULA_0076 -100.0 360.0 FORMAT "%4.1" /end CHARACTERISTIC
/begin CHARACTERISTIC K_VDIAG_DN_OHNE_V "dn-Schwelle fuer v-Diagnose" VALUE 0x7AE94 TKW_VV_VV_SW 100.0 FORMULA_0105 -10000.0 10000.0 /end CHARACTERISTIC
/begin CHARACTERISTIC K_VDIAG_GRAD_MAX "max. Geschwindigkeitssprung in 10ms" VALUE 0x7AE90 TKW_VV_VV_SW 100.0 FORMULA_1051 -80.0 360.0 FORMAT "%4.1" /end CHARACTERISTIC
/begin CHARACTERISTIC K_VDIAG_OFFSET "Diagnoseschwelle" VALUE 0x7AE8C TKW_VV_VV_SW 100.0 FORMULA_0076 -80.0 360.0 FORMAT "%4.1" /end CHARACTERISTIC
/begin CHARACTERISTIC K_VDIAG_SA_OHNE_V "Timer fuer v-Diagnose" VALUE 0x7AE92 TKW_VV_VV_UW 100.0 FORMULA_0021 0.0 655.0 FORMAT "%5.2" /end CHARACTERISTIC
/begin CHARACTERISTIC K_VDIAG_VMAX "max. Diagnoseschwelle" VALUE 0x7AE8E TKW_VV_VV_SW 100.0 FORMULA_0076 -80.0 400.0 FORMAT "%4.1" /end CHARACTERISTIC
/begin CHARACTERISTIC KF_FGR_FAK_V_WA "Wichtungsfaktor V-Wiederaufnahme" MAP 0x72F90 TKF_SW_SW_UB 100.0 FORMULA_0648 0.0 1.0
 /begin AXIS_DESCR STD_AXIS v FORMULA_0076 6 -360.0 360.0 MAX_GRAD 0.0 FORMAT "%4.1" /end AXIS_DESCR
 /begin AXIS_DESCR STD_AXIS md_rel FORMULA_0001 6 0.0 100.0 MAX_GRAD 0.0 FORMAT "%4.1" /end AXIS_DESCR
/end CHARACTERISTIC
/begin CHARACTERISTIC KF_FGR_KR "Reglerverstärkung" MAP 0x72A14 TKF_SW_SW_UW 100.0 FORMULA_0667 0.0 100.0 FORMAT "%6.3"
 /begin AXIS_DESCR STD_AXIS Geschwindigkeit FORMULA_0076 12 -360.0 360.0 MAX_GRAD 0.0 FORMAT "%4.1" /end AXIS_DESCR
 /begin AXIS_DESCR STD_AXIS gang FORMULA_0479 8 -1.0 10.0 MAX_GRAD 0.0 /end AXIS_DESCR
/end CHARACTERISTIC
/begin CHARACTERISTIC KF_FGR_KR_CONST "Reglerverstärkung Konstantfahrt" MAP 0x72AFE TKF_SW_SW_UW 100.0 FORMULA_0667 0.0 100.0 FORMAT "%6.3"
 /begin AXIS_DESCR STD_AXIS Geschwindigkeit FORMULA_0076 12 -360.0 360.0 MAX_GRAD 0.0 FORMAT "%4.1" /end AXIS_DESCR
 /begin AXIS_DESCR STD_AXIS gang FORMULA_0479 8 -1.0 10.0 MAX_GRAD 0.0 /end AXIS_DESCR
/end CHARACTERISTIC
/begin CHARACTERISTIC KF_FGR_TN "Nachstellzeit" MAP 0x72BE8 TKF_SW_SW_UW 100.0 FORMULA_0668 0.0 60.0 FORMAT "%6.3"
 /begin AXIS_DESCR STD_AXIS Geschwindigkeit FORMULA_0076 12 -360.0 360.0 MAX_GRAD 0.0 FORMAT "%4.1" /end AXIS_DESCR
 /begin AXIS_DESCR STD_AXIS gang FORMULA_0479 8 -1.0 10.0 MAX_GRAD 0.0 /end AXIS_DESCR
/end CHARACTERISTIC
/begin CHARACTERISTIC KF_FGR_TN_CONST "Nachstellzeit Konstantfahrt" MAP 0x72CD2 TKF_SW_SW_UW 100.0 FORMULA_0668 0.0 60.0 FORMAT "%6.3"
 /begin AXIS_DESCR STD_AXIS Geschwindigkeit FORMULA_0076 12 -360.0 360.0 MAX_GRAD 0.0 FORMAT "%4.1" /end AXIS_DESCR
 /begin AXIS_DESCR STD_AXIS gang FORMULA_0479 8 -1.0 10.0 MAX_GRAD 0.0 /end AXIS_DESCR
/end CHARACTERISTIC
/begin CHARACTERISTIC KF_FGR_TV "Vorhaltezeit" MAP 0x72DBC TKF_SW_SW_UW 100.0 FORMULA_0668 0.0 60.0 FORMAT "%6.3"
 /begin AXIS_DESCR STD_AXIS Geschwindigkeit FORMULA_0076 12 -360.0 360.0 MAX_GRAD 0.0 FORMAT "%4.1" /end AXIS_DESCR
 /begin AXIS_DESCR STD_AXIS gang FORMULA_0479 8 -1.0 10.0 MAX_GRAD 0.0 /end AXIS_DESCR
/end CHARACTERISTIC
/begin CHARACTERISTIC KF_FGR_TV_CONST "Vorhaltezeit Konstantfahrt" MAP 0x72EA6 TKF_SW_SW_UW 100.0 FORMULA_0668 0.0 60.0 FORMAT "%6.3"
 /begin AXIS_DESCR STD_AXIS Geschwindigkeit FORMULA_0076 12 -360.0 360.0 MAX_GRAD 0.0 FORMAT "%4.1" /end AXIS_DESCR
 /begin AXIS_DESCR STD_AXIS gang FORMULA_0479 8 -1.0 10.0 MAX_GRAD 0.0 /end AXIS_DESCR
/end CHARACTERISTIC
/begin CHARACTERISTIC KF_FGR_VORST "PID-Regler" MAP 0x72840 TKF_SW_SW_UW 100.0 FORMULA_0448 0.0 100.0 FORMAT "%6.3"
 /begin AXIS_DESCR STD_AXIS Geschwindigkeit FORMULA_0076 12 -360.0 360.0 MAX_GRAD 0.0 FORMAT "%4.1" /end AXIS_DESCR
 /begin AXIS_DESCR STD_AXIS gang FORMULA_0479 8 -1.0 10.0 MAX_GRAD 0.0 /end AXIS_DESCR
/end CHARACTERISTIC
/begin CHARACTERISTIC KF_FGR_VORST_UP "PID-Regler" MAP 0x7292A TKF_SW_SW_UW 100.0 FORMULA_0448 0.0 100.0 FORMAT "%6.3"
 /begin AXIS_DESCR STD_AXIS Geschwindigkeit FORMULA_0076 12 -360.0 360.0 MAX_GRAD 0.0 FORMAT "%4.1" /end AXIS_DESCR
 /begin AXIS_DESCR STD_AXIS gang FORMULA_0479 8 -1.0 10.0 MAX_GRAD 0.0 /end AXIS_DESCR
/end CHARACTERISTIC
/begin CHARACTERISTIC KF_FR_RF_DELTA_REL_HYS "Abschaltschwelle ueber Regeldifferenz" MAP 0x73058 TKF_SW_SW_SW 100.0 FORMULA_0677 -1.0 1.0 FORMAT "%4.1" /begin AXIS_DESCR STD_AXIS n FORMULA_0006 4 0.0 10000.0 MAX_GRAD 0.0 /end AXIS_DESCR
 /begin AXIS_DESCR STD_AXIS rf FORMULA_0007 4 0.0 2.0 MAX_GRAD 0.0 FORMAT "%6.3" /end AXIS_DESCR
/end CHARACTERISTIC
/begin CHARACTERISTIC KF_FR_SA_DELAY "Sperrzeit nach SA" MAP 0x7308A TKF_SW_SW_UW 100.0 FORMULA_0021 9.999999776482582e-003 655.0 FORMAT "%5.2" /begin AXIS_DESCR STD_AXIS n FORMULA_0006 4 0.0 10000.0 MAX_GRAD 0.0 /end AXIS_DESCR
 /begin AXIS_DESCR STD_AXIS rf FORMULA_0007 4 0.0 2.0 MAX_GRAD 0.0 FORMAT "%6.3" /end AXIS_DESCR
/end CHARACTERISTIC
/begin CHARACTERISTIC KF_FRA_PROV_B1 "Provisiorische FRA Bank1" MAP 0x73110 TKF_SW_SW_UW 100.0 FORMULA_0024 0.0 1.999899983406067 FORMAT "%7.4" /begin AXIS_DESCR STD_AXIS n_lw_m FORMULA_0006 10 0.0 10000.0 MAX_GRAD 0.0 /end AXIS_DESCR
 /begin AXIS_DESCR STD_AXIS md_rf_soll_pt_rg FORMULA_0007 10 0.0 2.0 MAX_GRAD 0.0 FORMAT "%6.3" /end AXIS_DESCR
/end CHARACTERISTIC
/begin CHARACTERISTIC KF_FRA_PROV_B2 "Provisiorische FRA Bank2" MAP 0x73202 TKF_SW_SW_UW 100.0 FORMULA_0024 0.0 1.999899983406067 FORMAT "%7.4" /begin AXIS_DESCR STD_AXIS n_lw_m FORMULA_0006 10 0.0 10000.0 MAX_GRAD 0.0 /end AXIS_DESCR
 /begin AXIS_DESCR STD_AXIS md_rf_soll_pt_rg FORMULA_0007 10 0.0 2.0 MAX_GRAD 0.0 FORMAT "%6.3" /end AXIS_DESCR
/end CHARACTERISTIC
/begin CHARACTERISTIC KL_FGR_FAK_T_BESCHL "Zeitabhänige Wichtungsfaktoren für Beschleunigung" CURVE 0x72734 TKL_UB_VV_UB 100.0 FORMULA_0649 0.0 1.99210000038147
 /begin AXIS_DESCR STD_AXIS Zeit FORMULA_0664 6 0.0 1.99210000038147 MAX_GRAD 0.0 /end AXIS_DESCR
/end CHARACTERISTIC
/begin CHARACTERISTIC KL_FGR_FAK_T_VERZ "Zeitabhänige Wichtungsfaktoren für Verzögerung" CURVE 0x72742 TKL_UB_VV_UB 100.0 FORMULA_0649 0.0 1.99210000038147
 /begin AXIS_DESCR STD_AXIS Zeit FORMULA_0664 6 0.0 1.99210000038147 MAX_GRAD 0.0 /end AXIS_DESCR
/end CHARACTERISTIC
/begin CHARACTERISTIC KL_FGR_FAK_T_WA "Zeitabhänige Wichtungsfaktoren für Wiederaufnahme" CURVE 0x72726 TKL_UB_VV_UB 100.0 FORMULA_0649 0.0 1.99210000038147
 /begin AXIS_DESCR STD_AXIS Zeit FORMULA_0664 6 0.0 1.99210000038147 MAX_GRAD 0.0 /end AXIS_DESCR
/end CHARACTERISTIC
/begin CHARACTERISTIC KL_FGR_FAK_V_TIP "Wichtungsfaktor V-Tipp" CURVE 0x72712 TKL_SW_VV_UB 100.0 FORMULA_0648 0.0 1.0
 /begin AXIS_DESCR STD_AXIS v FORMULA_0076 6 -360.0 360.0 MAX_GRAD 0.0 FORMAT "%4.1" /end AXIS_DESCR
/end CHARACTERISTIC
/begin CHARACTERISTIC KL_FGR_KOEFF_WICHT "Regler Koeffizienten Wichtung" CURVE 0x727FA TKL_UW_VV_UW 100.0 FORMULA_0650 0.0 655.3499755859375 FORMAT "%6.3"
 /begin AXIS_DESCR STD_AXIS t FORMULA_0021 4 0.0 655.3499755859375 MAX_GRAD 0.0 FORMAT "%5.2" /end AXIS_DESCR
/end CHARACTERISTIC
/begin CHARACTERISTIC KL_FGR_KR_FAK "Wichtung Regelverstärkung" CURVE 0x72750 TKL_SW_VV_UB 100.0 FORMULA_0665 0.0 25.5
 /begin AXIS_DESCR STD_AXIS v FORMULA_0076 6 -360.0 360.0 MAX_GRAD 0.0 FORMAT "%4.1" /end AXIS_DESCR
/end CHARACTERISTIC
/begin CHARACTERISTIC KL_FGR_MD_FW_LL "Minimalschwelle zur Vermeidung SA-Auslösung" CURVE 0x7278C TKL_SW_VV_UB 100.0 FORMULA_0666 0.0 25.5 /begin AXIS_DESCR STD_AXIS n FORMULA_0006 6 0.0 10000.0 MAX_GRAD 0.0 /end AXIS_DESCR /end CHARACTERISTIC
/begin CHARACTERISTIC KL_FGR_MD_RAMPE_DELTA "Schrittweite der Absteuerrampe" CURVE 0x726F8 TKL_SW_VV_UW 100.0 FORMULA_0661 0.0 4000.0 FORMAT "%7.4" /begin AXIS_DESCR STD_AXIS n FORMULA_0006 6 0.0 10000.0 MAX_GRAD 0.0 /end AXIS_DESCR /end CHARACTERISTIC
/begin CHARACTERISTIC KL_FGR_TN_FAK "Wichtung Nachstellzeit" CURVE 0x72764 TKL_SW_VV_UB 100.0 FORMULA_0665 0.0 25.5
 /begin AXIS_DESCR STD_AXIS v FORMULA_0076 6 -360.0 360.0 MAX_GRAD 0.0 FORMAT "%4.1" /end AXIS_DESCR
/end CHARACTERISTIC
/begin CHARACTERISTIC KL_FGR_TV_FAK "Wichtung Vorhaltezeit" CURVE 0x72778 TKL_SW_VV_UB 100.0 FORMULA_0665 0.0 25.5
 /begin AXIS_DESCR STD_AXIS v FORMULA_0076 6 -360.0 360.0 MAX_GRAD 0.0 FORMAT "%4.1" /end AXIS_DESCR
/end CHARACTERISTIC
/begin CHARACTERISTIC KL_FGR_V_FIL_A1 "Filterkonstante A1 für V Filter" CURVE 0x727A0 TKL_UW_VV_SW 100.0 FORMULA_0199 -2.0 1.999899983406067 FORMAT "%7.4"
 /begin AXIS_DESCR STD_AXIS t FORMULA_0021 7 0.0 655.3499755859375 MAX_GRAD 0.0 FORMAT "%5.2" /end AXIS_DESCR
/end CHARACTERISTIC
/begin CHARACTERISTIC KL_FGR_V_FIL_B1 "Filterkonstante B1 für V Filter" CURVE 0x727BE TKL_UW_VV_UW 100.0 FORMULA_0652 0.0 0.2498999983072281 FORMAT "%7.4"
 /begin AXIS_DESCR STD_AXIS t FORMULA_0021 7 0.0 655.3499755859375 MAX_GRAD 0.0 FORMAT "%5.2" /end AXIS_DESCR
/end CHARACTERISTIC
/begin CHARACTERISTIC KL_FGR_V_FIL_B2 "Filterkonstante B2 für V Filter" CURVE 0x727DC TKL_UW_VV_UW 100.0 FORMULA_0652 0.0 0.2498999983072281 FORMAT "%7.4"
 /begin AXIS_DESCR STD_AXIS t FORMULA_0021 7 0.0 655.3499755859375 MAX_GRAD 0.0 FORMAT "%5.2" /end AXIS_DESCR
/end CHARACTERISTIC
/begin CHARACTERISTIC KL_FGR_V_SA_SPERRE "Geschwindigkeitsgrenze für SA Sperre" CURVE 0x7281E TKL_SW_VV_SW 100.0 FORMULA_0076 -360.0 360.0 FORMAT "%4.1" /begin AXIS_DESCR STD_AXIS gang FORMULA_0479 8 -1.0 10.0 MAX_GRAD 0.0 /end AXIS_DESCR /end CHARACTERISTIC
/begin CHARACTERISTIC KL_FGR_VAHA_DIAG "Differenz Geschw. VA/HA " CURVE 0x7280C TKL_SW_VV_SW 100.0 FORMULA_0076 0.0 360.0 FORMAT "%4.1"
 /begin AXIS_DESCR STD_AXIS v FORMULA_0076 4 -360.0 360.0 MAX_GRAD 0.0 FORMAT "%4.1" /end AXIS_DESCR
/end CHARACTERISTIC
/begin CHARACTERISTIC KL_FGR_VERZ_WA "Sollverzögerung bei Wiederaufnahme" CURVE 0x726E6 TKL_SW_VV_SW 100.0 FORMULA_0123 -20.0 20.0 FORMAT "%5.2" /begin AXIS_DESCR STD_AXIS n FORMULA_0006 4 0.0 10000.0 MAX_GRAD 0.0 /end AXIS_DESCR /end CHARACTERISTIC
/begin CHARACTERISTIC KL_FR_IANT "Schrittweite I-Anteil" CURVE 0x72FFA TKL_SW_VV_SW 100.0 FORMULA_0671 -1.0 1.0 FORMAT "%7.4"
 /begin AXIS_DESCR STD_AXIS fr_abw_b1 FORMULA_0670 8 -1.0 1.0 MAX_GRAD 0.0 FORMAT "%7.4" /end AXIS_DESCR
/end CHARACTERISTIC
/begin CHARACTERISTIC KL_FR_MDRFSOLLPT_MAX_N "md_rf_soll_pt-Schwelle zum Einfrieren FR-Regler" CURVE 0x7303E TKL_SW_VV_SW 100.0 FORMULA_0007 0.0 2.0 FORMAT "%6.3" /begin AXIS_DESCR STD_AXIS n FORMULA_0006 6 0.0 10000.0 MAX_GRAD 0.0 /end AXIS_DESCR /end CHARACTERISTIC
/begin CHARACTERISTIC KL_FR_PANT "P-Anteil" CURVE 0x7301C TKL_SW_VV_SW 100.0 FORMULA_0670 -1.0 1.0 FORMAT "%7.4"
 /begin AXIS_DESCR STD_AXIS fr_abw_b1 FORMULA_0670 8 -1.0 1.0 MAX_GRAD 0.0 FORMAT "%7.4" /end AXIS_DESCR
/end CHARACTERISTIC
/begin CHARACTERISTIC KL_FRA_GRUNDLECKLUFT "Korrekturwert fuer Leckluft" CURVE 0x730F6 TKL_SW_VV_SW 100.0 FORMULA_0143 -100.0 0.0 FORMAT "%4.1"
 /begin AXIS_DESCR STD_AXIS tmot FORMULA_0023 6 -50.0 170.0 MAX_GRAD 0.0 FORMAT "%4.1" /end AXIS_DESCR
/end CHARACTERISTIC
/begin CHARACTERISTIC KL_FRA_LOLI_C_N "Zentren Lolimot-Modelle Eingang N, FRA-Zweig" CURVE 0x73330 TGL_VV_VV_SW 10000.0 FORMULA_0006 0.0 10000.0
 /begin AXIS_DESCR COM_AXIS Modelle FORMULA_0037 15 0.0 255.0 AXIS_PTS_REF GAX_15MODELLE MAX_GRAD 0.0 /end AXIS_DESCR
/end CHARACTERISTIC
/begin CHARACTERISTIC KL_FRA_LOLI_C_RF "Zentren Lolimot-Modelle Eingang RF, FRA-Zweig" CURVE 0x7334E TGL_VV_VV_SW 2.0 FORMULA_0007 0.0 2.0 FORMAT "%6.3"
 /begin AXIS_DESCR COM_AXIS Modelle FORMULA_0037 15 0.0 255.0 AXIS_PTS_REF GAX_15MODELLE MAX_GRAD 0.0 /end AXIS_DESCR
/end CHARACTERISTIC
/begin CHARACTERISTIC KL_FRA_LOLI_DEF_W_BIAS "Default Paramter fuer BIAS" CURVE 0x73420 TGL_VV_VV_SF 3.402823466385289e+038 FORMULA_0044 -3.402823466385289e+038 3.402823466385289e+038 FORMAT "%5.2"
 /begin AXIS_DESCR COM_AXIS Modelle FORMULA_0037 15 0.0 255.0 AXIS_PTS_REF GAX_15MODELLE MAX_GRAD 0.0 /end AXIS_DESCR
/end CHARACTERISTIC
/begin CHARACTERISTIC KL_FRA_LOLI_DEF_W_N "Default Paramter fuer N" CURVE 0x733A8 TGL_VV_VV_SF 3.402823466385289e+038 FORMULA_0044 -3.402823466385289e+038 3.402823466385289e+038 FORMAT "%5.2"
 /begin AXIS_DESCR COM_AXIS Modelle FORMULA_0037 15 0.0 255.0 AXIS_PTS_REF GAX_15MODELLE MAX_GRAD 0.0 /end AXIS_DESCR
/end CHARACTERISTIC
/begin CHARACTERISTIC KL_FRA_LOLI_DEF_W_RF "Default Paramter fuer RF" CURVE 0x733E4 TGL_VV_VV_SF 3.402823466385289e+038 FORMULA_0044 -3.402823466385289e+038 3.402823466385289e+038 FORMAT "%5.2"
 /begin AXIS_DESCR COM_AXIS Modelle FORMULA_0037 15 0.0 255.0 AXIS_PTS_REF GAX_15MODELLE MAX_GRAD 0.0 /end AXIS_DESCR
/end CHARACTERISTIC
/begin CHARACTERISTIC KL_FRA_LOLI_S_N "Breiten Lolimot-Modelle Eingang N, FRA-Zweig" CURVE 0x7336C TGL_VV_VV_SW 10000.0 FORMULA_0006 0.0 10000.0
 /begin AXIS_DESCR COM_AXIS Modelle FORMULA_0037 15 0.0 255.0 AXIS_PTS_REF GAX_15MODELLE MAX_GRAD 0.0 /end AXIS_DESCR
/end CHARACTERISTIC
/begin CHARACTERISTIC KL_FRA_LOLI_S_RF "Breiten Lolimot-Modelle Eingang RF, FRA-Zweig" CURVE 0x7338A TGL_VV_VV_SW 2.0 FORMULA_0007 0.0 2.0 FORMAT "%6.3"
 /begin AXIS_DESCR COM_AXIS Modelle FORMULA_0037 15 0.0 255.0 AXIS_PTS_REF GAX_15MODELLE MAX_GRAD 0.0 /end AXIS_DESCR
/end CHARACTERISTIC
/begin CHARACTERISTIC KL_FRA_MDRFSOLL_MIN_N "md_rf_soll_pt-Minschwelle" CURVE 0x7345C TKL_SW_VV_SW 100.0 FORMULA_0007 0.0 2.0 FORMAT "%6.3" /begin AXIS_DESCR STD_AXIS n FORMULA_0006 6 0.0 10000.0 MAX_GRAD 0.0 /end AXIS_DESCR /end CHARACTERISTIC
/begin CHARACTERISTIC KL_FRA_XSI_PSAU "Korrekturwert fuer Leckluft" CURVE 0x730D4 TKL_SW_VV_UW 100.0 FORMULA_0073 0.0 4.0 FORMAT "%6.3"
 /begin AXIS_DESCR STD_AXIS psau_rel FORMULA_0106 8 0.0 120.0 MAX_GRAD 0.0 FORMAT "%5.2" /end AXIS_DESCR
/end CHARACTERISTIC
/begin CHARACTERISTIC KL_GANG_I_DKG "DKG Gang entsprechend Getriebeuebersetzung" CURVE 0x734B2 TKL_SW_VV_SW 100.0 FORMULA_0694 -32.0 31.99900054931641
 /begin AXIS_DESCR STD_AXIS DKG_Getr_I FORMULA_0073 9 -32.0 31.99900054931641 MAX_GRAD 0.0 FORMAT "%6.3" /end AXIS_DESCR
/end CHARACTERISTIC
/begin CHARACTERISTIC KL_GANG_I_HS "HS Gang entsprechend Getriebeuebersetzung" CURVE 0x734D8 TKL_SW_VV_SW 100.0 FORMULA_0694 -32.0 31.99900054931641
 /begin AXIS_DESCR STD_AXIS HS_Getr_I FORMULA_0073 8 -32.0 31.99900054931641 MAX_GRAD 0.0 FORMAT "%6.3" /end AXIS_DESCR
/end CHARACTERISTIC
/begin CHARACTERISTIC KL_GANG_I_SMG "SMG Gang entsprechend Getriebeuebersetzung" CURVE 0x7348C TKL_SW_VV_SW 100.0 FORMULA_0694 -32.0 31.99900054931641
 /begin AXIS_DESCR STD_AXIS SMG_Getr_I FORMULA_0073 9 -32.0 31.99900054931641 MAX_GRAD 0.0 FORMAT "%6.3" /end AXIS_DESCR
/end CHARACTERISTIC
/begin AXIS_PTS GAX_15MODELLE "Modelle eines LOLIMOT-KNN mit 15 Neuronen (Zähler)" 0x73320 Modelle TAD_UB_VV_UB 255.0 FORMULA_0037 15 0.0 255.0 /end AXIS_PTS
/begin MEASUREMENT ccp_aramStatus "CCP RAM-Status" UBYTE FORMULA_0364 0 0.0 0.0 255.0 READ_WRITE ECU_ADDRESS 0x3FA78C /end MEASUREMENT
/begin MEASUREMENT ccp_checksum "CCP ChkSum" UWORD FORMULA_0010 0 0.0 0.0 65535.0 READ_WRITE ECU_ADDRESS 0x3FA7A4 /end MEASUREMENT
/begin MEASUREMENT ccp_moveStatus "CCP Move-Status" UBYTE FORMULA_0366 0 0.0 0.0 255.0 READ_WRITE ECU_ADDRESS 0x3FA7B0 /end MEASUREMENT
/begin MEASUREMENT ccp_reqSwitch "CCP Umschalt-Status" UBYTE FORMULA_0365 0 0.0 0.0 255.0 READ_WRITE ECU_ADDRESS 0x3FA78D /end MEASUREMENT
/begin MEASUREMENT ccp_stateChecksum "CCP ChkSum-Status" UBYTE FORMULA_0366 0 0.0 0.0 255.0 READ_WRITE ECU_ADDRESS 0x3FA7A0 /end MEASUREMENT
/begin MEASUREMENT fgr_a1 "Reglerkoeffizient a1" SWORD FORMULA_0488 0 0.0 -327.6799926757813 327.6700134277344 READ_WRITE ECU_ADDRESS 0x3FB95C /end MEASUREMENT
/begin MEASUREMENT fgr_ax_ist "Fahrzeug Längsbeschleunigung" SWORD FORMULA_0123 0 0.0 -20.0 20.0 READ_WRITE ECU_ADDRESS 0x3FB954 /end MEASUREMENT
/begin MEASUREMENT fgr_ax_neg_soll "Sollverzögerung" SWORD FORMULA_0123 0 0.0 -20.0 20.0 READ_WRITE ECU_ADDRESS 0x3FB958 /end MEASUREMENT
/begin MEASUREMENT fgr_ax_pos_soll "Sollbeschleunigung" SWORD FORMULA_0123 0 0.0 -20.0 20.0 READ_WRITE ECU_ADDRESS 0x3FB956 /end MEASUREMENT
/begin MEASUREMENT fgr_b_dsc_eingriff "DSC Eingriff" UBYTE FORMULA_0633 0 0.0 0.0 255.0 READ_WRITE ECU_ADDRESS 0x3FB901 /end MEASUREMENT
/begin MEASUREMENT fgr_b_dsc_reg_abs_asc_msr "DSC im Regelbetrieb ABS,ASC,MSR" UBYTE FORMULA_0635 0 0.0 0.0 255.0 READ_WRITE ECU_ADDRESS 0x3FB904 /end MEASUREMENT
/begin MEASUREMENT fgr_b_dsc_reg_dsc "DSC im Regelbetrieb DSC" UBYTE FORMULA_0632 0 0.0 0.0 255.0 READ_WRITE ECU_ADDRESS 0x3FB900 /end MEASUREMENT
/begin MEASUREMENT fgr_b_dsc_reg_eingriff "DSC Regelung/Eingriff" UBYTE FORMULA_0634 0 0.0 0.0 255.0 READ_WRITE ECU_ADDRESS 0x3FB902 /end MEASUREMENT
/begin MEASUREMENT fgr_b_dsc_soft_off "FGR soft off wegen DSC" UBYTE FORMULA_0629 0 0.0 0.0 255.0 READ_WRITE ECU_ADDRESS 0x3FB906 /end MEASUREMENT
/begin MEASUREMENT fgr_b_fehler_e2 "FGR Fehler Ebene 2" UBYTE FORMULA_0629 0 0.0 0.0 255.0 READ_WRITE ECU_ADDRESS 0x3FC804 /end MEASUREMENT
/begin MEASUREMENT fgr_b_rgl_init "Init Regler" UBYTE FORMULA_0629 0 0.0 0.0 255.0 READ_WRITE ECU_ADDRESS 0x3FB8F8 /end MEASUREMENT
/begin MEASUREMENT fgr_b_smg_rs "SMG Rennstart aktiv" UBYTE FORMULA_0315 0 0.0 0.0 255.0 READ_WRITE ECU_ADDRESS 0x3FB915 /end MEASUREMENT
/begin MEASUREMENT fgr_b_ueberhol_anf "Anforderung Überholen " UBYTE FORMULA_0315 0 0.0 0.0 255.0 READ_WRITE ECU_ADDRESS 0x3FB976 /end MEASUREMENT
/begin MEASUREMENT fgr_b_wa_first "First WA" UBYTE FORMULA_0629 0 0.0 0.0 255.0 READ_WRITE ECU_ADDRESS 0x3FB8FE /end MEASUREMENT
/begin MEASUREMENT fgr_b0 "Reglerkoeffizient b0" SWORD FORMULA_0488 0 0.0 -327.6799926757813 327.6700134277344 READ_WRITE ECU_ADDRESS 0x3FB95E /end MEASUREMENT
/begin MEASUREMENT fgr_b1 "Reglerkoeffizient b1" SWORD FORMULA_0488 0 0.0 -327.6799926757813 327.6700134277344 READ_WRITE ECU_ADDRESS 0x3FB960 /end MEASUREMENT
/begin MEASUREMENT fgr_b2 "Reglerkoeffizient b2" SWORD FORMULA_0488 0 0.0 -327.6799926757813 327.6700134277344 READ_WRITE ECU_ADDRESS 0x3FB962 /end MEASUREMENT
/begin MEASUREMENT fgr_can_stat_msw "Fgr CAN-Empfangsstatus" UBYTE FORMULA_0636 0 0.0 0.0 255.0 READ_WRITE ECU_ADDRESS 0x3FB907 /end MEASUREMENT
/begin MEASUREMENT fgr_fak_t_aktiv "Zeitabhäniger Wichtungsfaktor " UBYTE FORMULA_0649 0 0.0 0.0 1.99210000038147 READ_WRITE ECU_ADDRESS 0x3FB94D /end MEASUREMENT
/begin MEASUREMENT fgr_fak_v_veh_soll "V-Soll Wichtungsfaktor " UBYTE FORMULA_0648 0 0.0 0.0 1.0 READ_WRITE ECU_ADDRESS 0x3FB94C /end MEASUREMENT
/begin MEASUREMENT fgr_fil_a1 "Filterkoeffizient a1" SWORD FORMULA_0199 0 0.0 -2.0 1.999899983406067 READ_WRITE ECU_ADDRESS 0x3FB96A /end MEASUREMENT
/begin MEASUREMENT fgr_fil_b1 "Filterkoeffizient b1" UWORD FORMULA_0652 0 0.0 0.0 0.2498999983072281 READ_WRITE ECU_ADDRESS 0x3FB96C /end MEASUREMENT
/begin MEASUREMENT fgr_fil_b2 "Filterkoeffizient b2" UWORD FORMULA_0652 0 0.0 0.0 0.2498999983072281 READ_WRITE ECU_ADDRESS 0x3FB96E /end MEASUREMENT
/begin MEASUREMENT fgr_fsp_code "Fehlerspeicher Code" UBYTE FORMULA_0631 0 0.0 0.0 255.0 READ_WRITE ECU_ADDRESS 0x3FB8FF /end MEASUREMENT
/begin MEASUREMENT fgr_hud_aus "FGR HUD Anzeige" UBYTE FORMULA_0643 0 0.0 0.0 255.0 READ_WRITE ECU_ADDRESS 0x3FB912 /end MEASUREMENT
/begin MEASUREMENT fgr_hud_bedien "FGR HUD Bedienbefehl abgesetzt" UBYTE FORMULA_0645 0 0.0 0.0 255.0 READ_WRITE ECU_ADDRESS 0x3FB914 /end MEASUREMENT
/begin MEASUREMENT fgr_hud_state "FGR HUD State" UBYTE FORMULA_0644 0 0.0 0.0 255.0 READ_WRITE ECU_ADDRESS 0x3FB913 /end MEASUREMENT
/begin MEASUREMENT fgr_init_beschl_set "Init Beschl. -> Set" UBYTE FORMULA_0629 0 0.0 0.0 255.0 READ_WRITE ECU_ADDRESS 0x3FB8F9 /end MEASUREMENT
/begin MEASUREMENT fgr_init_verzoeg_set "Init Verzoeg. -> Set" UBYTE FORMULA_0629 0 0.0 0.0 255.0 READ_WRITE ECU_ADDRESS 0x3FB8FA /end MEASUREMENT
/begin MEASUREMENT fgr_kr "Regler Zwischenfaktor kr" SWORD FORMULA_0488 0 0.0 -327.6799926757813 327.6700134277344 READ_WRITE ECU_ADDRESS 0x3FB964 /end MEASUREMENT
/begin MEASUREMENT fgr_kw "Koeffizienten Wichtungsfaktor" SWORD FORMULA_0650 0 0.0 -327.6799926757813 327.6700134277344 READ_WRITE ECU_ADDRESS 0x3FB952 /end MEASUREMENT
/begin MEASUREMENT fgr_md_fw_fgr_sum "Regler Summenwert" UWORD FORMULA_0630 0 0.0 0.0 100.0 READ_WRITE ECU_ADDRESS 0x3FB8FC /end MEASUREMENT
/begin MEASUREMENT fgr_md_fw_roh "Rohwert des Reglereingriffs" UWORD FORMULA_0630 0 0.0 0.0 100.0 READ_WRITE ECU_ADDRESS 0x3FB970 /end MEASUREMENT
/begin MEASUREMENT fgr_md_fw_sa "Rohwert des Reglereingriffs incl. SA" UWORD FORMULA_0630 0 0.0 0.0 100.0 READ_WRITE ECU_ADDRESS 0x3FB972 /end MEASUREMENT
/begin MEASUREMENT fgr_n_dif "n dif. Getriebeeingang" SWORD FORMULA_0651 0 0.0 -32768.0 32767.0 READ_WRITE ECU_ADDRESS 0x3FB95A /end MEASUREMENT
/begin MEASUREMENT fgr_pwg "PWG Moment vom FGR" SWORD FORMULA_0001 0 0.0 0.0 100.0 READ_WRITE ECU_ADDRESS 0x3FB974 /end MEASUREMENT
/begin MEASUREMENT fgr_stat_abschalten "Fgr Status Abschalten" UBYTE FORMULA_0638 0 0.0 0.0 255.0 READ_WRITE ECU_ADDRESS 0x3FB90A /end MEASUREMENT
/begin MEASUREMENT fgr_stat_anf_msw "Fgr Status Anforderung" UBYTE FORMULA_0637 0 0.0 0.0 255.0 READ_WRITE ECU_ADDRESS 0x3FB908 /end MEASUREMENT
/begin MEASUREMENT fgr_stat_hard_off_irr "Fgr Status harter Abwurf irreversibel" UBYTE FORMULA_0641 0 0.0 0.0 255.0 READ_WRITE ECU_ADDRESS 0x3FB90D /end MEASUREMENT
/begin MEASUREMENT fgr_stat_hard_off_irr_old "Fgr Status harter Abwurf irreversibel old" UBYTE FORMULA_0641 0 0.0 0.0 255.0 READ_WRITE ECU_ADDRESS 0x3FB90E /end MEASUREMENT
/begin MEASUREMENT fgr_stat_hard_off_rev "Fgr Status harter Abwurf reversibel" UBYTE FORMULA_0640 0 0.0 0.0 255.0 READ_WRITE ECU_ADDRESS 0x3FB90C /end MEASUREMENT
/begin MEASUREMENT fgr_stat_soft_off_rev "Fgr Status weiches Abschalten" UBYTE FORMULA_0639 0 0.0 0.0 255.0 READ_WRITE ECU_ADDRESS 0x3FB90B /end MEASUREMENT
/begin MEASUREMENT fgr_status_can "Fgr CAN Status" UBYTE FORMULA_0314 0 0.0 0.0 255.0 READ_WRITE ECU_ADDRESS 0x3FB910 /end MEASUREMENT
/begin MEASUREMENT fgr_status_stufe "FGR Status Stufe" UBYTE FORMULA_0642 0 0.0 0.0 255.0 READ_WRITE ECU_ADDRESS 0x3FB90F /end MEASUREMENT
/begin MEASUREMENT fgr_t_aktiv "Zeit FGR aktiv" ULONG FORMULA_0653 0 0.0 0.0 42949672.95 READ_WRITE ECU_ADDRESS 0x3FB980 /end MEASUREMENT
/begin MEASUREMENT fgr_t_constfahrt "Zeit Konstantfahrt" ULONG FORMULA_0653 0 0.0 0.0 42949672.95 READ_WRITE ECU_ADDRESS 0x3FB978 /end MEASUREMENT
/begin MEASUREMENT fgr_t_err_v_veh "Fehlzeit eines Geschwindigkeitssignals" UWORD FORMULA_0021 0 0.0 0.0 655.0 READ_WRITE ECU_ADDRESS 0x3FB94E /end MEASUREMENT
/begin MEASUREMENT fgr_t_kli "Zeit für Kennlineninterpolation" UWORD FORMULA_0021 0 0.0 0.0 655.0 READ_WRITE ECU_ADDRESS 0x3FB950 /end MEASUREMENT
/begin MEASUREMENT fgr_t_ueberhol "Zeit Überholen" ULONG FORMULA_0653 0 0.0 0.0 42949672.95 READ_WRITE ECU_ADDRESS 0x3FB97C /end MEASUREMENT
/begin MEASUREMENT fgr_tn "Regler Zwischenfaktor tn" SWORD FORMULA_0488 0 0.0 -327.6799926757813 327.6700134277344 READ_WRITE ECU_ADDRESS 0x3FB966 /end MEASUREMENT
/begin MEASUREMENT fgr_tv "Regler Zwischenfaktor tv" SWORD FORMULA_0488 0 0.0 -327.6799926757813 327.6700134277344 READ_WRITE ECU_ADDRESS 0x3FB968 /end MEASUREMENT
/begin MEASUREMENT fgr_v_soll_max "maximale Geschwindigkeit FGR" SWORD FORMULA_0076 0 0.0 -80.0 360.0 READ_WRITE ECU_ADDRESS 0x3FB91C /end MEASUREMENT
/begin MEASUREMENT fgr_v_soll_min "minimale Geschwindigkeit FGR" SWORD FORMULA_0076 0 0.0 -80.0 360.0 READ_WRITE ECU_ADDRESS 0x3FB91A /end MEASUREMENT
/begin MEASUREMENT fgr_v_tacho_fil "Kombi Geschwindigkeit gefiltert" SWORD FORMULA_0076 0 0.0 -80.0 360.0 READ_WRITE ECU_ADDRESS 0x3FB916 /end MEASUREMENT
/begin MEASUREMENT fgr_v_veh_dif "Geschwindigkeitsabweichung PID Regler" SLONG FORMULA_0646 0 0.0 -360.0 360.0 READ_WRITE ECU_ADDRESS 0x3FB930 /end MEASUREMENT
/begin MEASUREMENT fgr_v_veh_fil "Gefilterte Geschwindigkeit" SLONG FORMULA_0646 0 0.0 -360.0 360.0 READ_WRITE ECU_ADDRESS 0x3FB93C /end MEASUREMENT
/begin MEASUREMENT fgr_v_veh_ist "Ist Geschwindigkeit" SLONG FORMULA_0646 0 0.0 -360.0 360.0 READ_WRITE ECU_ADDRESS 0x3FB920 /end MEASUREMENT
/begin MEASUREMENT fgr_v_veh_kombi "FGR Geschw. für Anzeige Kombi" SWORD FORMULA_0317 0 0.0 -80.0 360.0 READ_WRITE ECU_ADDRESS 0x3FB918 /end MEASUREMENT
/begin MEASUREMENT fgr_v_veh_soll "Soll Geschwindigkeit" SLONG FORMULA_0646 0 0.0 -360.0 360.0 READ_WRITE ECU_ADDRESS 0x3FB928 /end MEASUREMENT
/begin MEASUREMENT fgr_v_veh_soll_dec "Rampendekrement bei Absteuerung" UWORD FORMULA_0647 0 0.0 0.0 3.999900102615356 READ_WRITE ECU_ADDRESS 0x3FB948 /end MEASUREMENT
/begin MEASUREMENT fgr_v_veh_soll_dec_akt "Rampendekrement bei Absteuerung gewichtet " UWORD FORMULA_0647 0 0.0 0.0 3.999900102615356 READ_WRITE ECU_ADDRESS 0x3FB94A /end MEASUREMENT
/begin MEASUREMENT fgr_v_veh_soll_dif "Soll Geschwindigkeit PID Regler" SLONG FORMULA_0646 0 0.0 -360.0 360.0 READ_WRITE ECU_ADDRESS 0x3FB92C /end MEASUREMENT
/begin MEASUREMENT fgr_v_veh_soll_dif_roh "Geschwindigkeits Rohwert Ziel-/ Sollabweichung" SLONG FORMULA_0646 0 0.0 -360.0 360.0 READ_WRITE ECU_ADDRESS 0x3FB934 /end MEASUREMENT
/begin MEASUREMENT fgr_v_veh_soll_inc "Rampeninkrement bei Aufsteuerung" UWORD FORMULA_0647 0 0.0 0.0 3.999900102615356 READ_WRITE ECU_ADDRESS 0x3FB944 /end MEASUREMENT
/begin MEASUREMENT fgr_v_veh_soll_inc_akt "Rampeninkrement bei Aufsteuerung gewichtet" UWORD FORMULA_0647 0 0.0 0.0 3.999900102615356 READ_WRITE ECU_ADDRESS 0x3FB946 /end MEASUREMENT
/begin MEASUREMENT fgr_v_veh_soll_roh "Geschwindigkeits Rohwert" SLONG FORMULA_0646 0 0.0 -360.0 360.0 READ_WRITE ECU_ADDRESS 0x3FB938 /end MEASUREMENT
/begin MEASUREMENT fgr_v_veh_stufe "Geschwindigkeit Stufe" SLONG FORMULA_0646 0 0.0 -360.0 360.0 READ_WRITE ECU_ADDRESS 0x3FB940 /end MEASUREMENT
/begin MEASUREMENT fgr_v_veh_ziel "Ziel Geschwindigkeit" SLONG FORMULA_0646 0 0.0 -360.0 360.0 READ_WRITE ECU_ADDRESS 0x3FB924 /end MEASUREMENT
/begin MEASUREMENT fr_abs_abw_b1 "Regelabweichung absolut" SWORD FORMULA_0670 0 0.0 -1.0 1.0 READ_WRITE ECU_ADDRESS 0x3FB99C /end MEASUREMENT
/begin MEASUREMENT fr_abs_abw_b2 "Regelabweichung absolut" SWORD FORMULA_0670 0 0.0 -1.0 1.0 READ_WRITE ECU_ADDRESS 0x3FB99E /end MEASUREMENT
/begin MEASUREMENT fr_abw_b1 "Regelabweichung (Soll-Ist)" SWORD FORMULA_0670 0 0.0 -1.0 1.0 READ_WRITE ECU_ADDRESS 0x3FB986 /end MEASUREMENT
/begin MEASUREMENT fr_abw_b2 "Regelabweichung (Soll-Ist)" SWORD FORMULA_0670 0 0.0 -1.0 1.0 READ_WRITE ECU_ADDRESS 0x3FB988 /end MEASUREMENT
/begin MEASUREMENT fr_halt_t "Zaehler fuer die Verzoegerung beim Halten vom fr" UWORD FORMULA_0109 0 0.0 0.0 325.0 READ_WRITE ECU_ADDRESS 0x3FB9A8 /end MEASUREMENT
/begin MEASUREMENT fr_iant_b1 "I-Anteil" SWORD FORMULA_0671 0 0.0 -0.5 0.5 READ_WRITE ECU_ADDRESS 0x3FB98A /end MEASUREMENT
/begin MEASUREMENT fr_iant_b2 "I-Anteil" SWORD FORMULA_0671 0 0.0 -0.5 0.5 READ_WRITE ECU_ADDRESS 0x3FB98C /end MEASUREMENT
/begin MEASUREMENT fr_in_b1 "Fuellungsregler Eingang" UWORD FORMULA_0024 0 0.0 0.0 1.999899983406067 READ_WRITE ECU_ADDRESS 0x3FB9A0 /end MEASUREMENT
/begin MEASUREMENT fr_in_b2 "Fuellungsregler Eingang" UWORD FORMULA_0024 0 0.0 0.0 1.999899983406067 READ_WRITE ECU_ADDRESS 0x3FB9A2 /end MEASUREMENT
/begin MEASUREMENT fr_md_rf_soll_pt_schw "md_rf_soll_pt-Schwelle zum Einfrieren FR-Regler" SWORD FORMULA_0007 0 0.0 0.0 2.0 READ_WRITE ECU_ADDRESS 0x3FB9A4 /end MEASUREMENT
/begin MEASUREMENT fr_pant_b1 "P-Anteil" SWORD FORMULA_0672 0 0.0 -0.5 0.5 READ_WRITE ECU_ADDRESS 0x3FB98E /end MEASUREMENT
/begin MEASUREMENT fr_pant_b2 "P-Anteil" SWORD FORMULA_0672 0 0.0 -0.5 0.5 READ_WRITE ECU_ADDRESS 0x3FB990 /end MEASUREMENT
/begin MEASUREMENT fr_ramp_t "Zaehler fuer die Verzoegerung beim Abrampen vom fr" UWORD FORMULA_0021 0 0.0 0.0 655.0 READ_WRITE ECU_ADDRESS 0x3FB9A6 /end MEASUREMENT
/begin MEASUREMENT fr_reg_i_b1 "I-Anteil FR-Regler" SWORD FORMULA_0670 0 0.0 -0.5 0.5 READ_WRITE ECU_ADDRESS 0x3FB992 /end MEASUREMENT
/begin MEASUREMENT fr_reg_i_b2 "I-Anteil FR-Regler" SWORD FORMULA_0670 0 0.0 -0.5 0.5 READ_WRITE ECU_ADDRESS 0x3FB994 /end MEASUREMENT
/begin MEASUREMENT fr_reg_out_b1 "Korrekturfaktor FR-Regler" UWORD FORMULA_0024 0 0.0 0.5 1.5 READ_WRITE ECU_ADDRESS 0x3FB996 /end MEASUREMENT
/begin MEASUREMENT fr_reg_out_b2 "Korrekturfaktor FR-Regler" UWORD FORMULA_0024 0 0.0 0.5 1.5 READ_WRITE ECU_ADDRESS 0x3FB998 /end MEASUREMENT
/begin MEASUREMENT fr_rf_delta_b1 "Regelabweichung (Soll-Ist)" SWORD FORMULA_0024 0 0.0 -1.0 1.0 READ_WRITE ECU_ADDRESS 0x3FB9AA /end MEASUREMENT
/begin MEASUREMENT fr_rf_delta_b2 "Regelabweichung (Soll-Ist)" SWORD FORMULA_0024 0 0.0 -1.0 1.0 READ_WRITE ECU_ADDRESS 0x3FB9AC /end MEASUREMENT
/begin MEASUREMENT fr_rf_delta_rel_hys "Schwelle rel. Regelabweichung" SWORD FORMULA_0670 0 0.0 -1.0 1.0 READ_WRITE ECU_ADDRESS 0x3FB99A /end MEASUREMENT
/begin MEASUREMENT fr_status "Allgemeiner FR-Status" UBYTE FORMULA_0673 0 0.0 0.0 255.0 READ_WRITE ECU_ADDRESS 0x3FB9AE /end MEASUREMENT
/begin MEASUREMENT fr_zust_b1 "FR-Zustand" UBYTE FORMULA_0669 0 0.0 0.0 255.0 READ_WRITE ECU_ADDRESS 0x3FB984 /end MEASUREMENT
/begin MEASUREMENT fr_zust_b2 "FR-Zustand" UBYTE FORMULA_0669 0 0.0 0.0 255.0 READ_WRITE ECU_ADDRESS 0x3FB985 /end MEASUREMENT
/begin MEASUREMENT fra_aq_adapt_b1 "gewicht. Leckluft plus Grund" SWORD FORMULA_0143 0 0.0 -100.0 100.0 READ_WRITE ECU_ADDRESS 0x3FB9BC /end MEASUREMENT
/begin MEASUREMENT fra_aq_adapt_b2 "gewicht. Leckluft plus Grund" SWORD FORMULA_0143 0 0.0 -100.0 100.0 READ_WRITE ECU_ADDRESS 0x3FB9BE /end MEASUREMENT
/begin MEASUREMENT fra_aqmax "Zunahme pro Adaptionszyklus" SWORD FORMULA_0424 0 0.0 0.0 50.0 READ_WRITE ECU_ADDRESS 0x3FB9B4 /end MEASUREMENT
/begin MEASUREMENT fra_loli_lern_ein_b1 "FRA Lolimot Eingang fuer Lernen, Rohwert - ohne Faktoren fuer die Lerngeschw." FLOAT32_IEEE FORMULA_0044 0 0.0 -3.402823466385289e+038 3.402823466385289e+038 READ_WRITE ECU_ADDRESS 0x3FBA88 /end MEASUREMENT
/begin MEASUREMENT fra_loli_lern_ein_b2 "FRA Lolimot Eingang fuer Lernen, Rohwert - ohne Faktoren fuer die Lerngeschw." FLOAT32_IEEE FORMULA_0044 0 0.0 -3.402823466385289e+038 3.402823466385289e+038 READ_WRITE ECU_ADDRESS 0x3FBA8C /end MEASUREMENT
/begin MEASUREMENT fra_loli_lern_f_b1 "FRA Lolimot Lernausgang" FLOAT32_IEEE FORMULA_0044 0 0.0 -3.402823466385289e+038 3.402823466385289e+038 READ_WRITE ECU_ADDRESS 0x3FBA74 /end MEASUREMENT
/begin MEASUREMENT fra_loli_lern_f_b2 "FRA Lolimot Lernausgang" FLOAT32_IEEE FORMULA_0044 0 0.0 -3.402823466385289e+038 3.402823466385289e+038 READ_WRITE ECU_ADDRESS 0x3FBA78 /end MEASUREMENT
/begin MEASUREMENT fra_loli_lern_st "diverse Aktivierung Bits fuer Feuellungsregeleradaption" UBYTE FORMULA_0003 0 0.0 0.0 255.0 READ_WRITE ECU_ADDRESS 0x3FBACC /end MEASUREMENT
/begin MEASUREMENT fra_loli_lern_st.cfg_aus "Deaktivierung ueber Konfigschalter aus" UBYTE FORMULA_0686 0 0 0.0 255.0 READ_WRITE BIT_MASK 0x10 ECU_ADDRESS 0x3FBACC /end MEASUREMENT
/begin MEASUREMENT fra_loli_lern_st.cfg_reset "Deaktivierung ueber Konfigschalter reset" UBYTE FORMULA_0687 0 0 0.0 255.0 READ_WRITE BIT_MASK 0x20 ECU_ADDRESS 0x3FBACC /end MEASUREMENT
/begin MEASUREMENT fra_loli_lern_st.fr_status "Deaktivierung ueber fr_status" UBYTE FORMULA_0682 0 0 0.0 255.0 READ_WRITE BIT_MASK 0x1 ECU_ADDRESS 0x3FBACC /end MEASUREMENT
/begin MEASUREMENT fra_loli_lern_st.md_rf_soll "Deaktivierung ueber md_rf_soll" UBYTE FORMULA_0684 0 0 0.0 255.0 READ_WRITE BIT_MASK 0x4 ECU_ADDRESS 0x3FBACC /end MEASUREMENT
/begin MEASUREMENT fra_loli_lern_st.te_c_akf "Deaktivierung ueber te_c_akf" UBYTE FORMULA_0685 0 0 0.0 255.0 READ_WRITE BIT_MASK 0x8 ECU_ADDRESS 0x3FBACC /end MEASUREMENT
/begin MEASUREMENT fra_loli_lern_st.tmot "Deaktivierung ueber tmot" UBYTE FORMULA_0683 0 0 0.0 255.0 READ_WRITE BIT_MASK 0x2 ECU_ADDRESS 0x3FBACC /end MEASUREMENT
/begin MEASUREMENT fra_loli_out_b1 "FRA Lolimot Ausgang" UWORD FORMULA_0024 0 0.0 0.0 1.999899983406067 READ_WRITE ECU_ADDRESS 0x3FBA84 /end MEASUREMENT
/begin MEASUREMENT fra_loli_out_b2 "FRA Lolimot Ausgang" UWORD FORMULA_0024 0 0.0 0.0 1.999899983406067 READ_WRITE ECU_ADDRESS 0x3FBA86 /end MEASUREMENT
/begin MEASUREMENT fra_loli_out_f_b1 "FRA Lolimot Ausgang" FLOAT32_IEEE FORMULA_0044 0 0.0 -3.402823466385289e+038 3.402823466385289e+038 READ_WRITE ECU_ADDRESS 0x3FBA7C /end MEASUREMENT
/begin MEASUREMENT fra_loli_out_f_b2 "FRA Lolimot Ausgang" FLOAT32_IEEE FORMULA_0044 0 0.0 -3.402823466385289e+038 3.402823466385289e+038 READ_WRITE ECU_ADDRESS 0x3FBA80 /end MEASUREMENT
/begin MEASUREMENT fra_loli_z_norm "Standart float32" FLOAT32_IEEE FORMULA_0044 0 0.0 -3.402823466385289e+038 3.402823466385289e+038 READ_WRITE ARRAY_SIZE 15 ECU_ADDRESS 0x3FBA90 MATRIX_DIM 15 1 1 /end MEASUREMENT
/begin MEASUREMENT fra_out_b1 "FRA Output rf" UWORD FORMULA_0024 0 0.0 0.0 1.999899983406067 READ_WRITE ECU_ADDRESS 0x3FB9C4 /end MEASUREMENT
/begin MEASUREMENT fra_out_b2 "FRA Output rf" UWORD FORMULA_0024 0 0.0 0.0 1.999899983406067 READ_WRITE ECU_ADDRESS 0x3FB9C6 /end MEASUREMENT
/begin MEASUREMENT fra_sperr_st_b1 "Sperrstatus" UBYTE FORMULA_0678 0 0.0 0.0 255.0 READ_WRITE ECU_ADDRESS 0x3FB9B6 /end MEASUREMENT
/begin MEASUREMENT fra_sperr_st_b2 "Sperrstatus" UBYTE FORMULA_0678 0 0.0 0.0 255.0 READ_WRITE ECU_ADDRESS 0x3FB9B7 /end MEASUREMENT
/begin MEASUREMENT fra_tmot_fil "Gefiltertes tmot fuer die Grundleckluftbestimmung" SWORD FORMULA_0023 0 0.0 -50.0 170.0 READ_WRITE ECU_ADDRESS 0x3FB9C8 /end MEASUREMENT
/begin MEASUREMENT fra_wait_b1 "Wartezeit" UBYTE FORMULA_0214 0 0.0 0.0 255.0 READ_WRITE ECU_ADDRESS 0x3FB9BA /end MEASUREMENT
/begin MEASUREMENT fra_wait_b2 "Wartezeit" UBYTE FORMULA_0214 0 0.0 0.0 255.0 READ_WRITE ECU_ADDRESS 0x3FB9BB /end MEASUREMENT
/begin MEASUREMENT fra_zust_b1 "Zustand" UBYTE FORMULA_0679 0 0.0 0.0 255.0 READ_WRITE ECU_ADDRESS 0x3FB9B8 /end MEASUREMENT
/begin MEASUREMENT fra_zust_b2 "Zustand" UBYTE FORMULA_0679 0 0.0 0.0 255.0 READ_WRITE ECU_ADDRESS 0x3FB9B9 /end MEASUREMENT
/begin MEASUREMENT gang_1_timer "aktuelles Delay fuer Anzeige 1.Gang" SWORD FORMULA_0691 0 0.0 -327680.0 327670.0 READ_WRITE ECU_ADDRESS 0x3FBAD0 /end MEASUREMENT
/begin MEASUREMENT gang_berech_kl "berechneter Gang aus Kennlinie" SWORD FORMULA_0010 0 0.0 -32768.0 32767.0 READ_WRITE ECU_ADDRESS 0x3FBAD4 /end MEASUREMENT
/begin MEASUREMENT gang_berech_neu_verz "vorhergehende Schalterstellung Gang neu berechnen" UWORD FORMULA_0010 0 0.0 0.0 65535.0 READ_WRITE ECU_ADDRESS 0x3FBAD2 /end MEASUREMENT
/begin MEASUREMENT gang_berech_roh "berechneter Gang ohne R und N" SBYTE FORMULA_0135 0 0.0 -1.0 10.0 READ_WRITE ECU_ADDRESS 0x3FBAD6 /end MEASUREMENT
/begin MEASUREMENT gang_can_sperre_irre "irreversible Sperre fuer Ganganzeige" UBYTE FORMULA_0692 0 0.0 0.0 255.0 READ_WRITE ECU_ADDRESS 0x3FBAD8 /end MEASUREMENT
/begin MEASUREMENT gang_can_sperre_irre_cnt "Counter fuer irreversible Sperre Ganganzeige" UBYTE FORMULA_0003 0 0.0 0.0 255.0 READ_WRITE ECU_ADDRESS 0x3FBAD7 /end MEASUREMENT
/begin MEASUREMENT gang_glg_getr_verz "vorhergehende Schalterstellung Getriebeleergasse" UWORD FORMULA_0010 0 0.0 0.0 65535.0 READ_WRITE ECU_ADDRESS 0x3FBAE8 /end MEASUREMENT
/begin MEASUREMENT gang_glg_timer "aktuelles Delay fuer Anzeige Getriebeleergasse" SWORD FORMULA_0691 0 0.0 -327680.0 327670.0 READ_WRITE ECU_ADDRESS 0x3FBAE6 /end MEASUREMENT
/begin MEASUREMENT gang_i "aktuelles Getriebeuebersetzungsverhaeltnis" SWORD FORMULA_0073 0 0.0 -32.0 31.99900054931641 READ_WRITE ECU_ADDRESS 0x3FBADE /end MEASUREMENT
/begin MEASUREMENT gang_i_ha "Getriebeuebersetzungsverhaeltnis Hinterachse" SWORD FORMULA_0073 0 0.0 -32.0 31.99900054931641 READ_WRITE ECU_ADDRESS 0x3FBAE0 /end MEASUREMENT
/begin MEASUREMENT gang_i_rad "Getriebeuebersetzungsverhaeltnis Strang" SWORD FORMULA_0073 0 0.0 -32.0 31.99900054931641 READ_WRITE ECU_ADDRESS 0x3FBAE2 /end MEASUREMENT
/begin MEASUREMENT gang_ik "kuerzestes Getriebeuebersetzungsverhaeltnis" SWORD FORMULA_0073 0 0.0 -32.0 31.99900054931641 READ_WRITE ECU_ADDRESS 0x3FBADA /end MEASUREMENT
/begin MEASUREMENT gang_il "laengstes Getriebeuebersetzungsverhaeltnis" SWORD FORMULA_0073 0 0.0 -32.0 31.99900054931641 READ_WRITE ECU_ADDRESS 0x3FBADC /end MEASUREMENT
/begin MEASUREMENT gang_r_rad_dyn_nv "Radhalbmesser dynamisch adaptiert" SWORD FORMULA_0693 0 0.0 -32.0 31.99900054931641 READ_WRITE ECU_ADDRESS 0x3FBAE4 /end MEASUREMENT
/begin MEASUREMENT gang_richtung "ermittelte Fahrtrichtung fuer Ganganzeige" UBYTE FORMULA_0690 0 0.0 0.0 255.0 READ_WRITE ECU_ADDRESS 0x3FBACE /end MEASUREMENT
/begin MEASUREMENT gang_richtung_cnt "ermittelte Fahrtrichtung fuer Ganganzeige" SBYTE FORMULA_0003 0 0.0 -128.0 127.0 READ_WRITE ECU_ADDRESS 0x3FBACF /end MEASUREMENT
/begin MEASUREMENT stack_status "Stackstatus" ULONG FORMULA_0000 0 0.0 0.0 1000.0 READ_WRITE ECU_ADDRESS 0x3F8E08 /end MEASUREMENT
/begin MEASUREMENT stack_usedErcosek "Ercosekstack" ULONG FORMULA_0000 0 0.0 0.0 1000.0 READ_WRITE ECU_ADDRESS 0x3F8E10 /end MEASUREMENT
/begin MEASUREMENT stack_usedUser "Userstack" ULONG FORMULA_0000 0 0.0 0.0 1000.0 READ_WRITE ECU_ADDRESS 0x3F8E0C /end MEASUREMENT
/begin MEASUREMENT tm_100ms.dT "Maxzeit" ULONG FORMULA_0363 0 0.0 0.0 1000.0 READ_WRITE ECU_ADDRESS 0x3F8C98 /end MEASUREMENT
/begin MEASUREMENT tm_100ms.lastTask "vorherige Task" ULONG FORMULA_0000 0 0.0 0.0 1000.0 READ_WRITE ECU_ADDRESS 0x3F8C9C /end MEASUREMENT
/begin MEASUREMENT tm_100ms.maxTime "Maxzeit" ULONG FORMULA_0363 0 0.0 0.0 1000.0 READ_WRITE ECU_ADDRESS 0x3F8C94 /end MEASUREMENT
/begin MEASUREMENT tm_100ms.netTime "Netozeit" ULONG FORMULA_0363 0 0.0 0.0 1000.0 READ_WRITE ECU_ADDRESS 0x3F8C8C /end MEASUREMENT
/begin MEASUREMENT tm_10ms.dT "Maxzeit" ULONG FORMULA_0363 0 0.0 0.0 1000.0 READ_WRITE ECU_ADDRESS 0x3F8C70 /end MEASUREMENT
/begin MEASUREMENT tm_10ms.lastTask "vorherige Task" ULONG FORMULA_0000 0 0.0 0.0 1000.0 READ_WRITE ECU_ADDRESS 0x3F8C74 /end MEASUREMENT
/begin MEASUREMENT tm_10ms.maxTime "Maxzeit" ULONG FORMULA_0363 0 0.0 0.0 1000.0 READ_WRITE ECU_ADDRESS 0x3F8C6C /end MEASUREMENT
/begin MEASUREMENT tm_10ms.netTime "Netozeit" ULONG FORMULA_0363 0 0.0 0.0 1000.0 READ_WRITE ECU_ADDRESS 0x3F8C64 /end MEASUREMENT
/begin MEASUREMENT tm_5ms.dT "Maxzeit" ULONG FORMULA_0363 0 0.0 0.0 1000.0 READ_WRITE ECU_ADDRESS 0x3F8C48 /end MEASUREMENT
/begin MEASUREMENT tm_5ms.lastTask "vorherige Task" ULONG FORMULA_0000 0 0.0 0.0 1000.0 READ_WRITE ECU_ADDRESS 0x3F8C4C /end MEASUREMENT
/begin MEASUREMENT tm_5ms.maxTime "Maxzeit" ULONG FORMULA_0363 0 0.0 0.0 1000.0 READ_WRITE ECU_ADDRESS 0x3F8C44 /end MEASUREMENT
/begin MEASUREMENT tm_5ms.netTime "Netozeit" ULONG FORMULA_0363 0 0.0 0.0 1000.0 READ_WRITE ECU_ADDRESS 0x3F8C3C /end MEASUREMENT
/begin MEASUREMENT tm_bgnd.dT "Maxzeit" ULONG FORMULA_0363 0 0.0 0.0 1000.0 READ_WRITE ECU_ADDRESS 0x3F8CE8 /end MEASUREMENT
/begin MEASUREMENT tm_bgnd.grossRunTime "grossRunTime" ULONG FORMULA_0363 0 0.0 0.0 1000.0 READ_WRITE ECU_ADDRESS 0x3F8CD8 /end MEASUREMENT
/begin MEASUREMENT tm_bgnd.lastTask "vorherige Task" ULONG FORMULA_0000 0 0.0 0.0 1000.0 READ_WRITE ECU_ADDRESS 0x3F8CEC /end MEASUREMENT
/begin MEASUREMENT tm_bgnd.maxTime "Maxzeit" ULONG FORMULA_0363 0 0.0 0.0 1000.0 READ_WRITE ECU_ADDRESS 0x3F8CE4 /end MEASUREMENT
/begin MEASUREMENT tm_bgnd.netTime "Netozeit" ULONG FORMULA_0363 0 0.0 0.0 1000.0 READ_WRITE ECU_ADDRESS 0x3F8CDC /end MEASUREMENT
/begin MEASUREMENT tm_Sync1_S65.dT "Maxzeit" ULONG FORMULA_0363 0 0.0 0.0 1000.0 READ_WRITE ECU_ADDRESS 0x3F8B58 /end MEASUREMENT
/begin MEASUREMENT tm_Sync1_S65.lastTask "vorherige Task" ULONG FORMULA_0000 0 0.0 0.0 1000.0 READ_WRITE ECU_ADDRESS 0x3F8B5C /end MEASUREMENT
/begin MEASUREMENT tm_Sync1_S65.maxTime "Maxzeit" ULONG FORMULA_0363 0 0.0 0.0 1000.0 READ_WRITE ECU_ADDRESS 0x3F8B54 /end MEASUREMENT
/begin MEASUREMENT tm_Sync1_S65.netTime "Netozeit" ULONG FORMULA_0363 0 0.0 0.0 1000.0 READ_WRITE ECU_ADDRESS 0x3F8B4C /end MEASUREMENT
/begin MEASUREMENT tm_Sync1_S85.dT "Maxzeit" ULONG FORMULA_0363 0 0.0 0.0 1000.0 READ_WRITE ECU_ADDRESS 0x3F8B80 /end MEASUREMENT
/begin MEASUREMENT tm_Sync1_S85.lastTask "vorherige Task" ULONG FORMULA_0000 0 0.0 0.0 1000.0 READ_WRITE ECU_ADDRESS 0x3F8B84 /end MEASUREMENT
/begin MEASUREMENT tm_Sync1_S85.maxTime "Maxzeit" ULONG FORMULA_0363 0 0.0 0.0 1000.0 READ_WRITE ECU_ADDRESS 0x3F8B7C /end MEASUREMENT
/begin MEASUREMENT tm_Sync1_S85.netTime "Netozeit" ULONG FORMULA_0363 0 0.0 0.0 1000.0 READ_WRITE ECU_ADDRESS 0x3F8B74 /end MEASUREMENT
/begin MEASUREMENT tm_Sync2_S65.dT "Maxzeit" ULONG FORMULA_0363 0 0.0 0.0 1000.0 READ_WRITE ECU_ADDRESS 0x3F8BA8 /end MEASUREMENT
/begin MEASUREMENT tm_Sync2_S65.lastTask "vorherige Task" ULONG FORMULA_0000 0 0.0 0.0 1000.0 READ_WRITE ECU_ADDRESS 0x3F8BAC /end MEASUREMENT
/begin MEASUREMENT tm_Sync2_S65.maxTime "Maxzeit" ULONG FORMULA_0363 0 0.0 0.0 1000.0 READ_WRITE ECU_ADDRESS 0x3F8BA4 /end MEASUREMENT
/begin MEASUREMENT tm_Sync2_S65.netTime "Netozeit" ULONG FORMULA_0363 0 0.0 0.0 1000.0 READ_WRITE ECU_ADDRESS 0x3F8B9C /end MEASUREMENT
/begin MEASUREMENT tm_Sync2_S85.dT "Maxzeit" ULONG FORMULA_0363 0 0.0 0.0 1000.0 READ_WRITE ECU_ADDRESS 0x3F8BD0 /end MEASUREMENT
/begin MEASUREMENT tm_Sync2_S85.lastTask "vorherige Task" ULONG FORMULA_0000 0 0.0 0.0 1000.0 READ_WRITE ECU_ADDRESS 0x3F8BD4 /end MEASUREMENT
/begin MEASUREMENT tm_Sync2_S85.maxTime "Maxzeit" ULONG FORMULA_0363 0 0.0 0.0 1000.0 READ_WRITE ECU_ADDRESS 0x3F8BCC /end MEASUREMENT
/begin MEASUREMENT tm_Sync2_S85.netTime "Netozeit" ULONG FORMULA_0363 0 0.0 0.0 1000.0 READ_WRITE ECU_ADDRESS 0x3F8BC4 /end MEASUREMENT
/begin MEASUREMENT v_direkt_fil "gefilterte Geschwindigkeit" SWORD FORMULA_0076 0 0.0 -80.0 360.0 READ_WRITE ECU_ADDRESS 0x3FC740 /end MEASUREMENT
/begin MEASUREMENT v_direkt_period "Periode" UWORD FORMULA_0010 0 0.0 0.0 65535.0 READ_WRITE ECU_ADDRESS 0x3FC73C /end MEASUREMENT
/begin MEASUREMENT v_direkt_roh "diskrete Geschwindigkeit" SWORD FORMULA_0076 0 0.0 -80.0 360.0 READ_WRITE ECU_ADDRESS 0x3FC73E /end MEASUREMENT
/begin MEASUREMENT v_direkt_t_sa "Timer fuer v-Diagnose" UWORD FORMULA_0021 0 0.0 0.0 655.0 READ_WRITE ECU_ADDRESS 0x3FC742 /end MEASUREMENT
/begin MEASUREMENT v_direkt_timeout "Timeout v-Erfassung" UWORD FORMULA_0021 0 0.0 0.0 655.0 READ_WRITE ECU_ADDRESS 0x3FC744 /end MEASUREMENT
/begin MEASUREMENT v_direkt_weg "Timeout v-Erfassung" ULONG FORMULA_1050 0 0.0 0.0 2684354.5593 READ_WRITE ECU_ADDRESS 0x3FC748 /end MEASUREMENT
/begin MEASUREMENT v_e2 "Geschwindigkeit - Ebene 2" SWORD FORMULA_0076 0 0.0 -80.0 360.0 READ_WRITE ECU_ADDRESS 0x3FC902 /end MEASUREMENT
/begin COMPU_METHOD FORMULA_0000 "FORMULA_0000" RAT_FUNC "%7.0" "-" COEFFS 0 1 0 0 0 1 /end COMPU_METHOD
/begin COMPU_METHOD FORMULA_0001 "FORMULA_0001" RAT_FUNC "%6.1" "%" COEFFS 0 10.0 0.0 0 0.0 1.0 /end COMPU_METHOD
/begin COMPU_METHOD FORMULA_0003 "FORMULA_0003" RAT_FUNC "%3.0" "-" COEFFS 0 1 0 0 0 1 /end COMPU_METHOD
/begin COMPU_METHOD FORMULA_0006 "FORMULA_0006" RAT_FUNC "%5.0" "Upm" COEFFS 0 1 0 0 0 1 /end COMPU_METHOD
/begin COMPU_METHOD FORMULA_0007 "FORMULA_0007" RAT_FUNC "%8.3" "-" COEFFS 0 10000.0 0.0 0 0.0 1.0 /end COMPU_METHOD
/begin COMPU_METHOD FORMULA_0008 "FORMULA_0008" RAT_FUNC "%6.1" "V" COEFFS 0 10.0 0.0 0 0.0 1.0 /end COMPU_METHOD
/begin COMPU_METHOD FORMULA_0010 "FORMULA_0010" RAT_FUNC "%5.0" "-" COEFFS 0 1 0 0 0 1 /end COMPU_METHOD
/begin COMPU_METHOD FORMULA_0020 "FORMULA_0020" RAT_FUNC "%5.0" "qmm/s" COEFFS 0 5.e-002 0.0 0 0.0 1.0 /end COMPU_METHOD
/begin COMPU_METHOD FORMULA_0021 "FORMULA_0021" RAT_FUNC "%7.2" "s" COEFFS 0 100.0 0.0 0 0.0 1.0 /end COMPU_METHOD
/begin COMPU_METHOD FORMULA_0022 "FORMULA_0022" RAT_FUNC "%7.2" "%" COEFFS 0 100.0 0.0 0 0.0 1.0 /end COMPU_METHOD
/begin COMPU_METHOD FORMULA_0023 "FORMULA_0023" RAT_FUNC "%6.1" "°C" COEFFS 0 10.0 2732.0 0 0.0 1.0 /end COMPU_METHOD
/begin COMPU_METHOD FORMULA_0024 "FORMULA_0024" RAT_FUNC "%9.4" "-" COEFFS 0 32768.0 0.0 0 0.0 1.0 /end COMPU_METHOD
/begin COMPU_METHOD FORMULA_0037 "FORMULA_0037" RAT_FUNC "%5.2" "-" COEFFS 0 1 0 0 0 1 /end COMPU_METHOD
/begin COMPU_METHOD FORMULA_0044 "FORMULA_0044" RAT_FUNC "%9.2" "-" COEFFS 0 1 0 0 0 1 /end COMPU_METHOD
/begin COMPU_METHOD FORMULA_0071 "FORMULA_0071" RAT_FUNC "%6.1" "s" COEFFS 0 10.0 0.0 0 0.0 1.0 /end COMPU_METHOD
/begin COMPU_METHOD FORMULA_0073 "FORMULA_0073" RAT_FUNC "%8.3" "-" COEFFS 0 1024.0 0.0 0 0.0 1.0 /end COMPU_METHOD
/begin COMPU_METHOD FORMULA_0074 "FORMULA_0074" RAT_FUNC "%6.1" "Kelvin" COEFFS 0 10.0 0.0 0 0.0 1.0 /end COMPU_METHOD
/begin COMPU_METHOD FORMULA_0075 "FORMULA_0075" RAT_FUNC "%6.1" "mbar" COEFFS 0 16.0 0.0 0 0.0 1.0 /end COMPU_METHOD
/begin COMPU_METHOD FORMULA_0076 "FORMULA_0076" RAT_FUNC "%6.1" "km/h" COEFFS 0 16.0 0.0 0 0.0 1.0 /end COMPU_METHOD
/begin COMPU_METHOD FORMULA_0105 "FORMULA_0105" RAT_FUNC "%5.0" "Upm/s" COEFFS 0 1 0 0 0 1 /end COMPU_METHOD
/begin COMPU_METHOD FORMULA_0106 "FORMULA_0106" RAT_FUNC "%7.2" "%" COEFFS 0 163.84 0.0 0 0.0 1.0 /end COMPU_METHOD
/begin COMPU_METHOD FORMULA_0109 "FORMULA_0109" RAT_FUNC "%7.2" "s" COEFFS 0 200.0 0.0 0 0.0 1.0 /end COMPU_METHOD
/begin COMPU_METHOD FORMULA_0123 "FORMULA_0123" RAT_FUNC "%7.2" "m/(s*s)" COEFFS 0 40.0 0.0 0 0.0 1.0 /end COMPU_METHOD
/begin COMPU_METHOD FORMULA_0135 "FORMULA_0135" RAT_FUNC "%3.0" ".Gang" COEFFS 0 1 0 0 0 1 /end COMPU_METHOD
/begin COMPU_METHOD FORMULA_0143 "FORMULA_0143" RAT_FUNC "%6.1" "qmm" COEFFS 0 10.0 0.0 0 0.0 1.0 /end COMPU_METHOD
/begin COMPU_METHOD FORMULA_0199 "FORMULA_0199" RAT_FUNC "%9.4" "-" COEFFS 0 16384.0 0.0 0 0.0 1.0 /end COMPU_METHOD
/begin COMPU_METHOD FORMULA_0214 "FORMULA_0214" RAT_FUNC "%3.0" "s" COEFFS 0 1 0 0 0 1 /end COMPU_METHOD
/begin COMPU_METHOD FORMULA_0306 "FORMULA_0306" RAT_FUNC "%5.2" "s" COEFFS 0 100.0 0.0 0 0.0 1.0 /end COMPU_METHOD
/begin COMPU_METHOD FORMULA_0314 "FORMULA_0314" TAB_VERB "%3.0" "-" COMPU_TAB_REF FORMULA_0314_VTAB /end COMPU_METHOD
/begin COMPU_METHOD FORMULA_0315 "FORMULA_0315" TAB_VERB "%3.0" "-" COMPU_TAB_REF FORMULA_0315_VTAB /end COMPU_METHOD
/begin COMPU_METHOD FORMULA_0317 "FORMULA_0317" RAT_FUNC "%6.1" "km/h" COEFFS 0 10.0 0.0 0 0.0 1.0 /end COMPU_METHOD
/begin COMPU_METHOD FORMULA_0363 "FORMULA_0363" RAT_FUNC "%9.2" "ms" COEFFS 0 1000.0 0.0 0 0.0 1.0 /end COMPU_METHOD
/begin COMPU_METHOD FORMULA_0364 "FORMULA_0364" TAB_VERB "%5.2" "-" COMPU_TAB_REF FORMULA_0364_VTAB /end COMPU_METHOD
/begin COMPU_METHOD FORMULA_0365 "FORMULA_0365" TAB_VERB "%5.2" "-" COMPU_TAB_REF FORMULA_0365_VTAB /end COMPU_METHOD
/begin COMPU_METHOD FORMULA_0366 "FORMULA_0366" TAB_VERB "%5.2" "-" COMPU_TAB_REF FORMULA_0366_VTAB /end COMPU_METHOD
/begin COMPU_METHOD FORMULA_0424 "FORMULA_0424" RAT_FUNC "%7.2" "qmm" COEFFS 0 100.0 0.0 0 0.0 1.0 /end COMPU_METHOD
/begin COMPU_METHOD FORMULA_0448 "FORMULA_0448" RAT_FUNC "%8.3" "%" COEFFS 0 640.0 0.0 0 0.0 1.0 /end COMPU_METHOD
/begin COMPU_METHOD FORMULA_0455 "FORMULA_0455" RAT_FUNC "%5.2" "s" COEFFS 0 0 2.56 0 1 0 /end COMPU_METHOD
/begin COMPU_METHOD FORMULA_0479 "FORMULA_0479" RAT_FUNC "%5.0" ".Gang" COEFFS 0 1 0 0 0 1 /end COMPU_METHOD
/begin COMPU_METHOD FORMULA_0488 "FORMULA_0488" RAT_FUNC "%7.2" "-" COEFFS 0 100.0 0.0 0 0.0 1.0 /end COMPU_METHOD
/begin COMPU_METHOD FORMULA_0492 "FORMULA_0492" RAT_FUNC "%4.1" "s" COEFFS 0 10.0 0.0 0 0.0 1.0 /end COMPU_METHOD
/begin COMPU_METHOD FORMULA_0493 "FORMULA_0493" RAT_FUNC "%5.2" "-" COEFFS 0 255.0 0.0 0 0.0 1.0 /end COMPU_METHOD
/begin COMPU_METHOD FORMULA_0629 "FORMULA_0629" TAB_VERB "%4.1" "-" COMPU_TAB_REF FORMULA_0629_VTAB /end COMPU_METHOD
/begin COMPU_METHOD FORMULA_0630 "FORMULA_0630" RAT_FUNC "%6.1" "%" COEFFS 0 640.0 0.0 0 0.0 1.0 /end COMPU_METHOD
/begin COMPU_METHOD FORMULA_0631 "FORMULA_0631" TAB_VERB "%4.1" "-" COMPU_TAB_REF FORMULA_0631_VTAB /end COMPU_METHOD
/begin COMPU_METHOD FORMULA_0632 "FORMULA_0632" TAB_VERB "%4.1" "-" COMPU_TAB_REF FORMULA_0632_VTAB /end COMPU_METHOD
/begin COMPU_METHOD FORMULA_0633 "FORMULA_0633" TAB_VERB "%4.1" "-" COMPU_TAB_REF FORMULA_0633_VTAB /end COMPU_METHOD
/begin COMPU_METHOD FORMULA_0634 "FORMULA_0634" TAB_VERB "%4.1" "-" COMPU_TAB_REF FORMULA_0634_VTAB /end COMPU_METHOD
/begin COMPU_METHOD FORMULA_0635 "FORMULA_0635" TAB_VERB "%4.1" "-" COMPU_TAB_REF FORMULA_0635_VTAB /end COMPU_METHOD
/begin COMPU_METHOD FORMULA_0636 "FORMULA_0636" TAB_VERB "%3.0" "-" COMPU_TAB_REF FORMULA_0636_VTAB /end COMPU_METHOD
/begin COMPU_METHOD FORMULA_0637 "FORMULA_0637" TAB_VERB "%3.0" "-" COMPU_TAB_REF FORMULA_0637_VTAB /end COMPU_METHOD
/begin COMPU_METHOD FORMULA_0638 "FORMULA_0638" TAB_VERB "%3.0" "-" COMPU_TAB_REF FORMULA_0638_VTAB /end COMPU_METHOD
/begin COMPU_METHOD FORMULA_0639 "FORMULA_0639" TAB_VERB "%3.0" "-" COMPU_TAB_REF FORMULA_0639_VTAB /end COMPU_METHOD
/begin COMPU_METHOD FORMULA_0640 "FORMULA_0640" TAB_VERB "%3.0" "-" COMPU_TAB_REF FORMULA_0640_VTAB /end COMPU_METHOD
/begin COMPU_METHOD FORMULA_0641 "FORMULA_0641" TAB_VERB "%3.0" "-" COMPU_TAB_REF FORMULA_0641_VTAB /end COMPU_METHOD
/begin COMPU_METHOD FORMULA_0642 "FORMULA_0642" TAB_VERB "%3.0" "-" COMPU_TAB_REF FORMULA_0642_VTAB /end COMPU_METHOD
/begin COMPU_METHOD FORMULA_0643 "FORMULA_0643" TAB_VERB "%3.0" "-" COMPU_TAB_REF FORMULA_0643_VTAB /end COMPU_METHOD
/begin COMPU_METHOD FORMULA_0644 "FORMULA_0644" TAB_VERB "%3.0" "-" COMPU_TAB_REF FORMULA_0644_VTAB /end COMPU_METHOD
/begin COMPU_METHOD FORMULA_0645 "FORMULA_0645" TAB_VERB "%3.0" "-" COMPU_TAB_REF FORMULA_0645_VTAB /end COMPU_METHOD
/begin COMPU_METHOD FORMULA_0646 "FORMULA_0646" RAT_FUNC "%9.2" "km/h" COEFFS 0 16384.0 0.0 0 0.0 1.0 /end COMPU_METHOD
/begin COMPU_METHOD FORMULA_0647 "FORMULA_0647" RAT_FUNC "%9.4" "kmh/10mS" COEFFS 0 16384.0 0.0 0 0.0 1.0 /end COMPU_METHOD
/begin COMPU_METHOD FORMULA_0648 "FORMULA_0648" RAT_FUNC "%6.3" "-" COEFFS 0 255.0 0.0 0 0.0 1.0 /end COMPU_METHOD
/begin COMPU_METHOD FORMULA_0649 "FORMULA_0649" RAT_FUNC "%6.3" "-" COEFFS 0 128.0 0.0 0 0.0 1.0 /end COMPU_METHOD
/begin COMPU_METHOD FORMULA_0650 "FORMULA_0650" RAT_FUNC "%8.3" "-" COEFFS 0 100.0 0.0 0 0.0 1.0 /end COMPU_METHOD
/begin COMPU_METHOD FORMULA_0651 "FORMULA_0651" RAT_FUNC "%6.1" "n" COEFFS 0 1 0 0 0 1 /end COMPU_METHOD
/begin COMPU_METHOD FORMULA_0652 "FORMULA_0652" RAT_FUNC "%9.4" "-" COEFFS 0 262144.0 0.0 0 0.0 1.0 /end COMPU_METHOD
/begin COMPU_METHOD FORMULA_0653 "FORMULA_0653" RAT_FUNC "%9.2" "sec" COEFFS 0 100.0 0.0 0 0.0 1.0 /end COMPU_METHOD
/begin COMPU_METHOD FORMULA_0654 "FORMULA_0654" TAB_VERB "%3.0" "-" COMPU_TAB_REF FORMULA_0654_VTAB /end COMPU_METHOD
/begin COMPU_METHOD FORMULA_0655 "FORMULA_0655" TAB_VERB "%3.0" "-" COMPU_TAB_REF FORMULA_0655_VTAB /end COMPU_METHOD
/begin COMPU_METHOD FORMULA_0656 "FORMULA_0656" TAB_VERB "%3.0" "-" COMPU_TAB_REF FORMULA_0656_VTAB /end COMPU_METHOD
/begin COMPU_METHOD FORMULA_0657 "FORMULA_0657" RAT_FUNC "%5.2" "km/h" COEFFS 0 16.0 0.0 0 0.0 1.0 /end COMPU_METHOD
/begin COMPU_METHOD FORMULA_0658 "FORMULA_0658" RAT_FUNC "%6.1" "mph" COEFFS 0 16.0 0.0 0 0.0 1.0 /end COMPU_METHOD
/begin COMPU_METHOD FORMULA_0659 "FORMULA_0659" RAT_FUNC "%5.2" "-" COEFFS 0 100.0 0.0 0 0.0 1.0 /end COMPU_METHOD
/begin COMPU_METHOD FORMULA_0660 "FORMULA_0660" TAB_VERB "%3.0" "-" COMPU_TAB_REF FORMULA_0660_VTAB /end COMPU_METHOD
/begin COMPU_METHOD FORMULA_0661 "FORMULA_0661" RAT_FUNC "%9.4" "%/sek" COEFFS 0 10.0 0.0 0 0.0 1.0 /end COMPU_METHOD
/begin COMPU_METHOD FORMULA_0662 "FORMULA_0662" RAT_FUNC "%5.2" "-" COEFFS 0 10.0 0.0 0 0.0 1.0 /end COMPU_METHOD
/begin COMPU_METHOD FORMULA_0663 "FORMULA_0663" RAT_FUNC "%7.2" "sek" COEFFS 0 100.0 0.0 0 0.0 1.0 /end COMPU_METHOD
/begin COMPU_METHOD FORMULA_0664 "FORMULA_0664" RAT_FUNC "%6.3" "sek" COEFFS 0 128.0 0.0 0 0.0 1.0 /end COMPU_METHOD
/begin COMPU_METHOD FORMULA_0665 "FORMULA_0665" RAT_FUNC "%6.3" "-" COEFFS 0 10.0 0.0 0 0.0 1.0 /end COMPU_METHOD
/begin COMPU_METHOD FORMULA_0666 "FORMULA_0666" RAT_FUNC "%6.3" "%" COEFFS 0 10.0 0.0 0 0.0 1.0 /end COMPU_METHOD
/begin COMPU_METHOD FORMULA_0667 "FORMULA_0667" RAT_FUNC "%8.3" "%/km/h" COEFFS 0 640.0 0.0 0 0.0 1.0 /end COMPU_METHOD
/begin COMPU_METHOD FORMULA_0668 "FORMULA_0668" RAT_FUNC "%8.3" "sek" COEFFS 0 640.0 0.0 0 0.0 1.0 /end COMPU_METHOD
/begin COMPU_METHOD FORMULA_0669 "FORMULA_0669" TAB_VERB "%3.0" "-" COMPU_TAB_REF FORMULA_0669_VTAB /end COMPU_METHOD
/begin COMPU_METHOD FORMULA_0670 "FORMULA_0670" RAT_FUNC "%9.4" "-" COEFFS 0 32767.0 0.0 0 0.0 1.0 /end COMPU_METHOD
/begin COMPU_METHOD FORMULA_0671 "FORMULA_0671" RAT_FUNC "%9.4" "1/s" COEFFS 0 327.68 0.0 0 0.0 1.0 /end COMPU_METHOD
/begin COMPU_METHOD FORMULA_0672 "FORMULA_0672" RAT_FUNC "%9.4" "1/s" COEFFS 0 32767.0 0.0 0 0.0 1.0 /end COMPU_METHOD
/begin COMPU_METHOD FORMULA_0673 "FORMULA_0673" TAB_VERB "%5.2" "-" COMPU_TAB_REF FORMULA_0673_VTAB /end COMPU_METHOD
/begin COMPU_METHOD FORMULA_0674 "FORMULA_0674" TAB_VERB "%5.2" "-" COMPU_TAB_REF FORMULA_0674_VTAB /end COMPU_METHOD
/begin COMPU_METHOD FORMULA_0675 "FORMULA_0675" TAB_VERB "%5.2" "-" COMPU_TAB_REF FORMULA_0675_VTAB /end COMPU_METHOD
/begin COMPU_METHOD FORMULA_0676 "FORMULA_0676" RAT_FUNC "%7.2" "%" COEFFS 0 327.68 0.0 0 0.0 1.0 /end COMPU_METHOD
/begin COMPU_METHOD FORMULA_0677 "FORMULA_0677" RAT_FUNC "%6.1" "-" COEFFS 0 32767.0 0.0 0 0.0 1.0 /end COMPU_METHOD
/begin COMPU_METHOD FORMULA_0678 "FORMULA_0678" TAB_VERB "%3.0" "-" COMPU_TAB_REF FORMULA_0678_VTAB /end COMPU_METHOD
/begin COMPU_METHOD FORMULA_0679 "FORMULA_0679" TAB_VERB "%3.0" "-" COMPU_TAB_REF FORMULA_0679_VTAB /end COMPU_METHOD
/begin COMPU_METHOD FORMULA_0680 "FORMULA_0680" TAB_VERB "%5.2" "-" COMPU_TAB_REF FORMULA_0680_VTAB /end COMPU_METHOD
/begin COMPU_METHOD FORMULA_0681 "FORMULA_0681" RAT_FUNC "%7.2" "s" COEFFS 0 0 6553.5 0 1 0 /end COMPU_METHOD
/begin COMPU_METHOD FORMULA_0682 "FORMULA_0682" TAB_VERB "%5.2" "-" COMPU_TAB_REF FORMULA_0682_VTAB /end COMPU_METHOD
/begin COMPU_METHOD FORMULA_0683 "FORMULA_0683" TAB_VERB "%5.2" "-" COMPU_TAB_REF FORMULA_0683_VTAB /end COMPU_METHOD
/begin COMPU_METHOD FORMULA_0684 "FORMULA_0684" TAB_VERB "%5.2" "-" COMPU_TAB_REF FORMULA_0684_VTAB /end COMPU_METHOD
/begin COMPU_METHOD FORMULA_0685 "FORMULA_0685" TAB_VERB "%5.2" "-" COMPU_TAB_REF FORMULA_0685_VTAB /end COMPU_METHOD
/begin COMPU_METHOD FORMULA_0686 "FORMULA_0686" TAB_VERB "%5.2" "-" COMPU_TAB_REF FORMULA_0686_VTAB /end COMPU_METHOD
/begin COMPU_METHOD FORMULA_0687 "FORMULA_0687" TAB_VERB "%5.2" "-" COMPU_TAB_REF FORMULA_0687_VTAB /end COMPU_METHOD
/begin COMPU_METHOD FORMULA_0688 "FORMULA_0688" TAB_VERB "%5.2" "-" COMPU_TAB_REF FORMULA_0688_VTAB /end COMPU_METHOD
/begin COMPU_METHOD FORMULA_0689 "FORMULA_0689" TAB_VERB "%5.2" "-" COMPU_TAB_REF FORMULA_0689_VTAB /end COMPU_METHOD
/begin COMPU_METHOD FORMULA_0690 "FORMULA_0690" TAB_VERB "%5.2" "-" COMPU_TAB_REF FORMULA_0690_VTAB /end COMPU_METHOD
/begin COMPU_METHOD FORMULA_0691 "FORMULA_0691" RAT_FUNC "%5.0" "ms" COEFFS 0 0.1 0.0 0 0.0 1.0 /end COMPU_METHOD
/begin COMPU_METHOD FORMULA_0692 "FORMULA_0692" TAB_VERB "%5.2" "-" COMPU_TAB_REF FORMULA_0692_VTAB /end COMPU_METHOD
/begin COMPU_METHOD FORMULA_0693 "FORMULA_0693" RAT_FUNC "%8.3" "m" COEFFS 0 1024.0 0.0 0 0.0 1.0 /end COMPU_METHOD
/begin COMPU_METHOD FORMULA_0694 "FORMULA_0694" RAT_FUNC "%5.0" "-" COEFFS 0 1024.0 0.0 0 0.0 1.0 /end COMPU_METHOD
/begin COMPU_METHOD FORMULA_1050 "FORMULA_1050" RAT_FUNC "%8.1" "m" COEFFS 0 1600.0 0.0 0 0.0 1.0 /end COMPU_METHOD
/begin COMPU_METHOD FORMULA_1051 "FORMULA_1051" RAT_FUNC "%6.1" "km/h*10ms" COEFFS 0 16.0 0.0 0 0.0 1.0 /end COMPU_METHOD
/begin COMPU_VTAB FORMULA_0314_VTAB "FORMULA_0314_VTAB" TAB_VERB 3 0 "aus" 1 "inaktiv" 2 "aktiv" /end COMPU_VTAB
/begin COMPU_VTAB FORMULA_0315_VTAB "FORMULA_0315_VTAB" TAB_VERB 2 0 "aus" 1 "ein" /end COMPU_VTAB
/begin COMPU_VTAB FORMULA_0364_VTAB "FORMULA_0364_VTAB" TAB_VERB 2 0 "WorkPage" 16 "RefPage" DEFAULT_VALUE "Err/RefP" /end COMPU_VTAB
/begin COMPU_VTAB FORMULA_0365_VTAB "FORMULA_0365_VTAB" TAB_VERB 4 0 "idle" 1 "to WorkPage" 2 "to RefPage" 4 "ready" /end COMPU_VTAB
/begin COMPU_VTAB FORMULA_0366_VTAB "FORMULA_0366_VTAB" TAB_VERB 3 0 "idle" 1 "loop" 2 "ready" /end COMPU_VTAB
/begin COMPU_VTAB FORMULA_0629_VTAB "FORMULA_0629_VTAB" TAB_VERB 2 0 "nein" 1 "ja" /end COMPU_VTAB
/begin COMPU_VTAB FORMULA_0631_VTAB "FORMULA_0631_VTAB" TAB_VERB 19 0 "Kein Abwurf" 1 "Reglerabweichung zu gross" 2 "Ueberholen zu lang" 3 "Geschw. zu gross" 4 "DSC-Eingriff" 5 "Geschw. zu gering" 6 "Hochlaufsperre" 7 "Nmax Begrenzer" 8 "Vmax Begrenzer" 9 "Beschl. zu gross" 10 "SMG Abwurf" 11 "VAHA Plausi" 12 "Rennstart" 13 "SK Manager" 14 "FGR Fehler E2" 15 "BLS PWG Fehler" 16 "Kupplungs Fehler" 17 "CAN Fehler" 18 "Tuner Plausi" DEFAULT_VALUE "undefiniert" /end COMPU_VTAB
/begin COMPU_VTAB FORMULA_0632_VTAB "FORMULA_0632_VTAB" TAB_VERB 2 0 "DSC inaktiv" 1 "DSC regelt" /end COMPU_VTAB
/begin COMPU_VTAB FORMULA_0633_VTAB "FORMULA_0633_VTAB" TAB_VERB 2 0 "DSC inaktiv" 1 "DSC Eingriff" /end COMPU_VTAB
/begin COMPU_VTAB FORMULA_0634_VTAB "FORMULA_0634_VTAB" TAB_VERB 2 0 "DSC inaktiv" 1 "DSC Reg./Eingriff" /end COMPU_VTAB
/begin COMPU_VTAB FORMULA_0635_VTAB "FORMULA_0635_VTAB" TAB_VERB 2 0 "DSC inaktiv" 1 "DSC ABS/ASC/MSR" /end COMPU_VTAB
/begin COMPU_VTAB FORMULA_0636_VTAB "FORMULA_0636_VTAB" TAB_VERB 8 0 "Keine Aktion" 1 "Tippen vorn" 2 "Ueberdruecken vorn" 4 "Tippen hinten" 8 "Ueberdruecken hinten" 16 "Tippen oben/unten" 64 "Tippen axial" 127 "ungueltig" DEFAULT_VALUE "undef" /end COMPU_VTAB
/begin COMPU_VTAB FORMULA_0637_VTAB "FORMULA_0637_VTAB" TAB_VERB 10 0 "hart aus" 1 "weich aus" 2 "tip plus" 3 "tip minus" 4 "set beschl" 5 "wieder aufnehmen" 6 "set verzoegern" 7 "keine Aktion" 8 "Marke hoch" 9 "Marke runter" DEFAULT_VALUE "undef" /end COMPU_VTAB
/begin COMPU_VTAB FORMULA_0638_VTAB "FORMULA_0638_VTAB" TAB_VERB 4 0 "keine Abschaltung" 1 "weiche Abschaltung rev." 2 "harte Abschaltung rev." 3 "harte Abschaltung irrev." DEFAULT_VALUE "undef" /end COMPU_VTAB
/begin COMPU_VTAB FORMULA_0639_VTAB "FORMULA_0639_VTAB" TAB_VERB 6 0 "keine Abschaltung" 1 "Fahrereingabe" 2 "Regelabweichung zu gross" 3 "Ueberholfunktion" 4 "Geschwindigkeit zu gross" 5 "DSC-Eingriff" DEFAULT_VALUE "undef" /end COMPU_VTAB
/begin COMPU_VTAB FORMULA_0640_VTAB "FORMULA_0640_VTAB" TAB_VERB 14 0 "keine Abschaltung" 1 "Fahrereingabe" 2 "Bremse" 3 "Kupplung HS" 4 "Neutralgang SMG" 5 "Geschw. zu gering" 6 "Motorzustand" 7 "Hochlaufsperre HS" 8 "Drehzahlbegrenzer" 9 "Geschw. Begrenzer" 10 "Beschl. zu gross" 11 "Abschaltung SMG" 12 "VAHA-Plausi" 13 "Rennstart" /end COMPU_VTAB
/begin COMPU_VTAB FORMULA_0641_VTAB "FORMULA_0641_VTAB" TAB_VERB 8 0 "keine Abschaltung" 1 "SK Manager" 2 "FGR Fehler Ebene 2" 3 "BLS PWG Plausi" 4 "Fehler Kupplung" 5 "CAN-Fehler" 6 "Tuner Plausi" 7 "KL15 aus" /end COMPU_VTAB
/begin COMPU_VTAB FORMULA_0642_VTAB "FORMULA_0642_VTAB" TAB_VERB 3 0 "keine Aktion" 1 "Stufe hoch" 2 "Stufe runter" /end COMPU_VTAB
/begin COMPU_VTAB FORMULA_0643_VTAB "FORMULA_0643_VTAB" TAB_VERB 2 0 "beibehalten" 1 "ausschalten" /end COMPU_VTAB
/begin COMPU_VTAB FORMULA_0644_VTAB "FORMULA_0644_VTAB" TAB_VERB 3 0 "aus" 1 "ein" 2 "verweigert" /end COMPU_VTAB
/begin COMPU_VTAB FORMULA_0645_VTAB "FORMULA_0645_VTAB" TAB_VERB 2 0 "kein" 1 "erkannt" /end COMPU_VTAB
/begin COMPU_VTAB FORMULA_0654_VTAB "FORMULA_0654_VTAB" TAB_VERB 2 0 "nicht sperren" 1 "sperren" /end COMPU_VTAB
/begin COMPU_VTAB FORMULA_0655_VTAB "FORMULA_0655_VTAB" TAB_VERB 2 0 "Marke = Sollgeschw." 1 "Marke = Istgeschw." /end COMPU_VTAB
/begin COMPU_VTAB FORMULA_0656_VTAB "FORMULA_0656_VTAB" TAB_VERB 2 0 "FGR bis 250Km/h" 1 "FGR bis Vmax" /end COMPU_VTAB
/begin COMPU_VTAB FORMULA_0660_VTAB "FORMULA_0660_VTAB" TAB_VERB 2 0 "Fahrzeuggeschw." 1 "Anzeigegeschw." /end COMPU_VTAB
/begin COMPU_VTAB FORMULA_0669_VTAB "FORMULA_0669_VTAB" TAB_VERB 3 0 "Inaktiv" 1 "Aktiv" 2 "Gesperrt" /end COMPU_VTAB
/begin COMPU_VTAB FORMULA_0673_VTAB "FORMULA_0673_VTAB" TAB_VERB 5 0 "aktive" 1 "rampen" 2 "halten" 4 "wait" 8 "rampen erl." DEFAULT_VALUE "undef." /end COMPU_VTAB
/begin COMPU_VTAB FORMULA_0674_VTAB "FORMULA_0674_VTAB" TAB_VERB 3 0 "AUS" 1 "LAM" 2 "HFM" DEFAULT_VALUE "ungeueltig" /end COMPU_VTAB
/begin COMPU_VTAB FORMULA_0675_VTAB "FORMULA_0675_VTAB" TAB_VERB 2 0 "aus laz_md_rf_soll" 1 "aus laz_aq_rf" /end COMPU_VTAB
/begin COMPU_VTAB FORMULA_0678_VTAB "FORMULA_0678_VTAB" TAB_VERB 7 0 "Freigabe" 1 "FRA aus" 2 "KH" 4 "Tmot" 8 "Egas/SK" 16 "Rf" 32 "TE" /end COMPU_VTAB
/begin COMPU_VTAB FORMULA_0679_VTAB "FORMULA_0679_VTAB" TAB_VERB 5 0 "Inaktiv" 1 "Warten" 3 "Adaption" 7 "Adapt+nBegr" 11 "Adapt+pBegr" /end COMPU_VTAB
/begin COMPU_VTAB FORMULA_0680_VTAB "FORMULA_0680_VTAB" TAB_VERB 2 0 "FRA aus" 1 "FRA aktiv" DEFAULT_VALUE "undef" /end COMPU_VTAB
/begin COMPU_VTAB FORMULA_0682_VTAB "FORMULA_0682_VTAB" TAB_VERB 2 0 "FALSE" 1 "TRUE" DEFAULT_VALUE "TRUE" /end COMPU_VTAB
/begin COMPU_VTAB FORMULA_0683_VTAB "FORMULA_0683_VTAB" TAB_VERB 2 0 "FALSE" 1 "TRUE" DEFAULT_VALUE "TRUE" /end COMPU_VTAB
/begin COMPU_VTAB FORMULA_0684_VTAB "FORMULA_0684_VTAB" TAB_VERB 2 0 "FALSE" 1 "TRUE" DEFAULT_VALUE "TRUE" /end COMPU_VTAB
/begin COMPU_VTAB FORMULA_0685_VTAB "FORMULA_0685_VTAB" TAB_VERB 2 0 "FALSE" 1 "TRUE" DEFAULT_VALUE "TRUE" /end COMPU_VTAB
/begin COMPU_VTAB FORMULA_0686_VTAB "FORMULA_0686_VTAB" TAB_VERB 2 0 "FALSE" 1 "TRUE" DEFAULT_VALUE "TRUE" /end COMPU_VTAB
/begin COMPU_VTAB FORMULA_0687_VTAB "FORMULA_0687_VTAB" TAB_VERB 2 0 "FALSE" 1 "TRUE" DEFAULT_VALUE "TRUE" /end COMPU_VTAB
/begin COMPU_VTAB FORMULA_0688_VTAB "FORMULA_0688_VTAB" TAB_VERB 3 0 "sperren" 1 "aktive" 2 "reset" DEFAULT_VALUE "undef" /end COMPU_VTAB
/begin COMPU_VTAB FORMULA_0689_VTAB "FORMULA_0689_VTAB" TAB_VERB 3 0 "loli" 1 "prov" 2 "aus" DEFAULT_VALUE "ungueltig" /end COMPU_VTAB
/begin COMPU_VTAB FORMULA_0690_VTAB "FORMULA_0690_VTAB" TAB_VERB 3 0 "unbekannt" 1 "vorwaerts" 2 "rueckwaerts" /end COMPU_VTAB
/begin COMPU_VTAB FORMULA_0692_VTAB "FORMULA_0692_VTAB" TAB_VERB 2 0 "Sperre aus" 1 "Sperre ein" /end COMPU_VTAB
/begin FUNCTION Eigendiagnose ""
 /begin DEF_CHARACTERISTIC K_ED_PCTRL_IGN.DEC_VOR_EINTRAG K_ED_PCTRL_IGN.FEHLERSCHWELLE K_ED_PCTRL_IGN.INC_NACH_EINTRAG K_ED_PCTRL_IGN.INC_VOR_EINTRAG K_ED_PCTRL_IGN.KLASSENINDEX K_ED_PCTRL_IGN.OK_SCHWELLE K_ED_PCTRL_IGN.P_CODE_OPENLOAD K_ED_PCTRL_IGN.P_CODE_SH_TO_GND K_ED_PCTRL_IGN.P_CODE_SH_TO_UB K_ED_PCTRL_IGN.P_CODE_UNPLAUSIBEL K_ED_PWG_BLS.DEC_NACH_EINTRAG K_ED_PWG_BLS.DEC_VOR_EINTRAG K_ED_PWG_BLS.FEHLERSCHWELLE K_ED_PWG_BLS.INC_NACH_EINTRAG K_ED_PWG_BLS.INC_VOR_EINTRAG K_ED_PWG_BLS.KLASSENINDEX K_ED_PWG_BLS.OK_SCHWELLE K_ED_PWG_BLS.P_CODE_OPENLOAD K_ED_PWG_BLS.P_CODE_SH_TO_GND K_ED_PWG_BLS.P_CODE_SH_TO_UB K_ED_PWG_BLS.P_CODE_UNPLAUSIBEL K_ED_PWG_VGL.DEC_NACH_EINTRAG K_ED_PWG_VGL.DEC_VOR_EINTRAG K_ED_PWG_VGL.FEHLERSCHWELLE K_ED_PWG_VGL.INC_NACH_EINTRAG K_ED_PWG_VGL.INC_VOR_EINTRAG K_ED_PWG_VGL.KLASSENINDEX K_ED_PWG_VGL.OK_SCHWELLE K_ED_PWG_VGL.P_CODE_OPENLOAD K_ED_PWG_VGL.P_CODE_SH_TO_GND K_ED_PWG_VGL.P_CODE_SH_TO_UB K_ED_PWG_VGL.P_CODE_UNPLAUSIBEL K_ED_PWG1.DEC_NACH_EINTRAG K_ED_PWG1.DEC_VOR_EINTRAG K_ED_PWG1.FEHLERSCHWELLE K_ED_PWG1.INC_NACH_EINTRAG K_ED_PWG1.INC_VOR_EINTRAG K_ED_PWG1.KLASSENINDEX K_ED_PWG1.OK_SCHWELLE K_ED_PWG1.P_CODE_OPENLOAD K_ED_PWG1.P_CODE_SH_TO_GND K_ED_PWG1.P_CODE_SH_TO_UB K_ED_PWG1.P_CODE_UNPLAUSIBEL K_ED_PWG2.DEC_NACH_EINTRAG K_ED_PWG2.DEC_VOR_EINTRAG K_ED_PWG2.FEHLERSCHWELLE K_ED_PWG2.INC_NACH_EINTRAG K_ED_PWG2.INC_VOR_EINTRAG K_ED_PWG2.KLASSENINDEX K_ED_PWG2.OK_SCHWELLE K_ED_PWG2.P_CODE_OPENLOAD K_ED_PWG2.P_CODE_SH_TO_GND K_ED_PWG2.P_CODE_SH_TO_UB K_ED_PWG2.P_CODE_UNPLAUSIBEL K_ED_RBM_EVAP_MAX K_ED_RBM_EVAP_MIN K_ED_RBM_EVAP_TEMP_DELTA K_ED_RBM_PUMG_MIN K_ED_RBM_TIME K_ED_RBM_TIME_LL K_ED_RBM_TIME_V K_ED_RBM_TUMG_MIN K_ED_RBM_V_MIN K_ED_SC_BUSOFF.DEC_NACH_EINTRAG K_ED_SC_BUSOFF.DEC_VOR_EINTRAG K_ED_SC_BUSOFF.FEHLERSCHWELLE K_ED_SC_BUSOFF.INC_NACH_EINTRAG K_ED_SC_BUSOFF.INC_VOR_EINTRAG K_ED_SC_BUSOFF.KLASSENINDEX K_ED_SC_BUSOFF.OK_SCHWELLE K_ED_SC_BUSOFF.P_CODE_OPENLOAD K_ED_SC_BUSOFF.P_CODE_SH_TO_GND K_ED_SC_BUSOFF.P_CODE_SH_TO_UB K_ED_SC_BUSOFF.P_CODE_UNPLAUSIBEL K_ED_SC_PKS.DEC_NACH_EINTRAG K_ED_SC_PKS.DEC_VOR_EINTRAG K_ED_SC_PKS.FEHLERSCHWELLE K_ED_SC_PKS.INC_NACH_EINTRAG K_ED_SC_PKS.INC_VOR_EINTRAG K_ED_SC_PKS.KLASSENINDEX K_ED_SC_PKS.OK_SCHWELLE K_ED_SC_PKS.P_CODE_OPENLOAD K_ED_SC_PKS.P_CODE_SH_TO_GND K_ED_SC_PKS.P_CODE_SH_TO_UB K_ED_SC_PKS.P_CODE_UNPLAUSIBEL K_ED_SC_SMG1.DEC_NACH_EINTRAG K_ED_SC_SMG1.DEC_VOR_EINTRAG K_ED_SC_SMG1.FEHLERSCHWELLE K_ED_SC_SMG1.INC_NACH_EINTRAG K_ED_SC_SMG1.INC_VOR_EINTRAG K_ED_SC_SMG1.KLASSENINDEX K_ED_SC_SMG1.OK_SCHWELLE K_ED_SC_SMG1.P_CODE_OPENLOAD K_ED_SC_SMG1.P_CODE_SH_TO_GND K_ED_SC_SMG1.P_CODE_SH_TO_UB K_ED_SC_SMG1.P_CODE_UNPLAUSIBEL K_ED_SC_SMG2.DEC_NACH_EINTRAG K_ED_SC_SMG2.DEC_VOR_EINTRAG K_ED_SC_SMG2.FEHLERSCHWELLE K_ED_SC_SMG2.INC_NACH_EINTRAG K_ED_SC_SMG2.INC_VOR_EINTRAG K_ED_SC_SMG2.KLASSENINDEX K_ED_SC_SMG2.OK_SCHWELLE K_ED_SC_SMG2.P_CODE_OPENLOAD K_ED_SC_SMG2.P_CODE_SH_TO_GND K_ED_SC_SMG2.P_CODE_SH_TO_UB K_ED_SC_SMG2.P_CODE_UNPLAUSIBEL K_ED_SC_SMG3.DEC_NACH_EINTRAG K_ED_SC_SMG3.DEC_VOR_EINTRAG K_ED_SC_SMG3.FEHLERSCHWELLE K_ED_SC_SMG3.INC_NACH_EINTRAG K_ED_SC_SMG3.INC_VOR_EINTRAG K_ED_SC_SMG3.KLASSENINDEX K_ED_SC_SMG3.OK_SCHWELLE K_ED_SC_SMG3.P_CODE_OPENLOAD K_ED_SC_SMG3.P_CODE_SH_TO_GND K_ED_SC_SMG3.P_CODE_SH_TO_UB K_ED_SC_SMG3.P_CODE_UNPLAUSIBEL K_ED_SCDN_ABDECKUNG_AUSTRAG K_ED_SCDN_ABDECKUNG_EINTRAG K_ED_SERVO_I.DEC_NACH_EINTRAG K_ED_SERVO_I.DEC_VOR_EINTRAG K_ED_SERVO_I.FEHLERSCHWELLE K_ED_SERVO_I.INC_NACH_EINTRAG K_ED_SERVO_I.INC_VOR_EINTRAG K_ED_SERVO_I.KLASSENINDEX K_ED_SERVO_I.OK_SCHWELLE K_ED_SERVO_I.P_CODE_OPENLOAD K_ED_SERVO_I.P_CODE_SH_TO_GND K_ED_SERVO_I.P_CODE_SH_TO_UB K_ED_SERVO_I.P_CODE_UNPLAUSIBEL K_ED_SERVO_V.DEC_NACH_EINTRAG K_ED_SERVO_V.DEC_VOR_EINTRAG K_ED_SERVO_V.FEHLERSCHWELLE K_ED_SERVO_V.INC_NACH_EINTRAG K_ED_SERVO_V.INC_VOR_EINTRAG K_ED_SERVO_V.KLASSENINDEX K_ED_SERVO_V.OK_SCHWELLE K_ED_SERVO_V.P_CODE_OPENLOAD K_ED_SERVO_V.P_CODE_SH_TO_GND K_ED_SERVO_V.P_CODE_SH_TO_UB K_ED_SERVO_V.P_CODE_UNPLAUSIBEL K_ED_SG_IGN.DEC_NACH_EINTRAG K_ED_SG_IGN.DEC_VOR_EINTRAG K_ED_SG_IGN.FEHLERSCHWELLE K_ED_SG_IGN.INC_NACH_EINTRAG K_ED_SG_IGN.INC_VOR_EINTRAG K_ED_SG_IGN.KLASSENINDEX K_ED_SG_IGN.OK_SCHWELLE K_ED_SG_IGN.P_CODE_OPENLOAD K_ED_SG_IGN.P_CODE_SH_TO_GND K_ED_SG_IGN.P_CODE_SH_TO_UB K_ED_SG_IGN.P_CODE_UNPLAUSIBEL K_ED_SK_MANAGER_IGN.DEC_NACH_EINTRAG K_ED_SK_MANAGER_IGN.DEC_VOR_EINTRAG K_ED_SK_MANAGER_IGN.FEHLERSCHWELLE K_ED_SK_MANAGER_IGN.INC_NACH_EINTRAG K_ED_SK_MANAGER_IGN.INC_VOR_EINTRAG K_ED_SK_MANAGER_IGN.KLASSENINDEX K_ED_SK_MANAGER_IGN.OK_SCHWELLE K_ED_SK_MANAGER_IGN.P_CODE_OPENLOAD K_ED_SK_MANAGER_IGN.P_CODE_SH_TO_GND K_ED_SK_MANAGER_IGN.P_CODE_SH_TO_UB K_ED_SK_MANAGER_IGN.P_CODE_UNPLAUSIBEL K_ED_SK_TR_IGN.DEC_NACH_EINTRAG K_ED_SK_TR_IGN.DEC_VOR_EINTRAG K_ED_SK_TR_IGN.FEHLERSCHWELLE K_ED_SK_TR_IGN.INC_NACH_EINTRAG K_ED_SK_TR_IGN.INC_VOR_EINTRAG K_ED_SK_TR_IGN.KLASSENINDEX K_ED_SK_TR_IGN.OK_SCHWELLE K_ED_SK_TR_IGN.P_CODE_OPENLOAD K_ED_SK_TR_IGN.P_CODE_SH_TO_GND K_ED_SK_TR_IGN.P_CODE_SH_TO_UB K_ED_SK_TR_IGN.P_CODE_UNPLAUSIBEL K_ED_SMG_SCHALTAB.DEC_NACH_EINTRAG K_ED_SMG_SCHALTAB.DEC_VOR_EINTRAG K_ED_SMG_SCHALTAB.FEHLERSCHWELLE K_ED_SMG_SCHALTAB.INC_NACH_EINTRAG K_ED_SMG_SCHALTAB.INC_VOR_EINTRAG K_ED_SMG_SCHALTAB.KLASSENINDEX K_ED_SMG_SCHALTAB.OK_SCHWELLE K_ED_SMG_SCHALTAB.P_CODE_OPENLOAD K_ED_SMG_SCHALTAB.P_CODE_SH_TO_GND K_ED_SMG_SCHALTAB.P_CODE_SH_TO_UB K_ED_SMG_SCHALTAB.P_CODE_UNPLAUSIBEL K_ED_SMG_SK.DEC_NACH_EINTRAG K_ED_SMG_SK.DEC_VOR_EINTRAG K_ED_SMG_SK.FEHLERSCHWELLE K_ED_SMG_SK.INC_NACH_EINTRAG K_ED_SMG_SK.INC_VOR_EINTRAG K_ED_SMG_SK.KLASSENINDEX K_ED_SMG_SK.OK_SCHWELLE K_ED_SMG_SK.P_CODE_OPENLOAD K_ED_SMG_SK.P_CODE_SH_TO_GND K_ED_SMG_SK.P_CODE_SH_TO_UB K_ED_SMG_SK.P_CODE_UNPLAUSIBEL K_ED_SMG_SK_N.DEC_NACH_EINTRAG K_ED_SMG_SK_N.DEC_VOR_EINTRAG K_ED_SMG_SK_N.FEHLERSCHWELLE K_ED_SMG_SK_N.INC_NACH_EINTRAG K_ED_SMG_SK_N.INC_VOR_EINTRAG K_ED_SMG_SK_N.KLASSENINDEX K_ED_SMG_SK_N.OK_SCHWELLE K_ED_SMG_SK_N.P_CODE_OPENLOAD K_ED_SMG_SK_N.P_CODE_SH_TO_GND K_ED_SMG_SK_N.P_CODE_SH_TO_UB K_ED_SMG_SK_N.P_CODE_UNPLAUSIBEL K_ED_START_RL.DEC_NACH_EINTRAG K_ED_START_RL.DEC_VOR_EINTRAG K_ED_START_RL.FEHLERSCHWELLE K_ED_START_RL.INC_NACH_EINTRAG K_ED_START_RL.INC_VOR_EINTRAG K_ED_START_RL.KLASSENINDEX K_ED_START_RL.OK_SCHWELLE K_ED_START_RL.P_CODE_OPENLOAD K_ED_START_RL.P_CODE_SH_TO_GND K_ED_START_RL.P_CODE_SH_TO_UB K_ED_START_RL.P_CODE_UNPLAUSIBEL K_ED_TABG1.DEC_NACH_EINTRAG K_ED_TABG1.DEC_VOR_EINTRAG K_ED_TABG1.FEHLERSCHWELLE K_ED_TABG1.INC_NACH_EINTRAG K_ED_TABG1.INC_VOR_EINTRAG K_ED_TABG1.KLASSENINDEX K_ED_TABG1.OK_SCHWELLE K_ED_TABG1.P_CODE_OPENLOAD K_ED_TABG1.P_CODE_SH_TO_GND K_ED_TABG1.P_CODE_SH_TO_UB K_ED_TABG1.P_CODE_UNPLAUSIBEL K_ED_TABG2.DEC_NACH_EINTRAG K_ED_TABG2.DEC_VOR_EINTRAG K_ED_TABG2.FEHLERSCHWELLE K_ED_TABG2.INC_NACH_EINTRAG K_ED_TABG2.INC_VOR_EINTRAG K_ED_TABG2.KLASSENINDEX K_ED_TABG2.OK_SCHWELLE K_ED_TABG2.P_CODE_OPENLOAD K_ED_TABG2.P_CODE_SH_TO_GND K_ED_TABG2.P_CODE_SH_TO_UB K_ED_TABG2.P_CODE_UNPLAUSIBEL K_ED_TAN_OBD_B1.DEC_NACH_EINTRAG K_ED_TAN_OBD_B1.DEC_VOR_EINTRAG K_ED_TAN_OBD_B1.FEHLERSCHWELLE K_ED_TAN_OBD_B1.INC_NACH_EINTRAG K_ED_TAN_OBD_B1.INC_VOR_EINTRAG K_ED_TAN_OBD_B1.KLASSENINDEX K_ED_TAN_OBD_B1.OK_SCHWELLE K_ED_TAN_OBD_B1.P_CODE_OPENLOAD K_ED_TAN_OBD_B1.P_CODE_SH_TO_GND K_ED_TAN_OBD_B1.P_CODE_SH_TO_UB K_ED_TAN_OBD_B1.P_CODE_UNPLAUSIBEL K_ED_TAN_OBD_B2.DEC_NACH_EINTRAG K_ED_TAN_OBD_B2.DEC_VOR_EINTRAG K_ED_TAN_OBD_B2.FEHLERSCHWELLE K_ED_TAN_OBD_B2.INC_NACH_EINTRAG K_ED_TAN_OBD_B2.INC_VOR_EINTRAG K_ED_TAN_OBD_B2.KLASSENINDEX K_ED_TAN_OBD_B2.OK_SCHWELLE K_ED_TAN_OBD_B2.P_CODE_OPENLOAD K_ED_TAN_OBD_B2.P_CODE_SH_TO_GND K_ED_TAN_OBD_B2.P_CODE_SH_TO_UB K_ED_TAN_OBD_B2.P_CODE_UNPLAUSIBEL K_ED_TAN1.DEC_NACH_EINTRAG K_ED_TAN1.DEC_VOR_EINTRAG K_ED_TAN1.FEHLERSCHWELLE K_ED_TAN1.INC_NACH_EINTRAG K_ED_TAN1.INC_VOR_EINTRAG K_ED_TAN1.KLASSENINDEX K_ED_TAN1.OK_SCHWELLE K_ED_TAN1.P_CODE_OPENLOAD K_ED_TAN1.P_CODE_SH_TO_GND K_ED_TAN1.P_CODE_SH_TO_UB K_ED_TAN1.P_CODE_UNPLAUSIBEL K_ED_TAN2.DEC_NACH_EINTRAG K_ED_TAN2.DEC_VOR_EINTRAG K_ED_TAN2.FEHLERSCHWELLE K_ED_TAN2.INC_NACH_EINTRAG K_ED_TAN2.INC_VOR_EINTRAG K_ED_TAN2.KLASSENINDEX K_ED_TAN2.OK_SCHWELLE K_ED_TAN2.P_CODE_OPENLOAD K_ED_TAN2.P_CODE_SH_TO_GND K_ED_TAN2.P_CODE_SH_TO_UB K_ED_TAN2.P_CODE_UNPLAUSIBEL K_ED_TDME.DEC_NACH_EINTRAG K_ED_TDME.DEC_VOR_EINTRAG K_ED_TDME.FEHLERSCHWELLE K_ED_TDME.INC_NACH_EINTRAG K_ED_TDME.INC_VOR_EINTRAG K_ED_TDME.KLASSENINDEX K_ED_TDME.OK_SCHWELLE K_ED_TDME.P_CODE_OPENLOAD K_ED_TDME.P_CODE_SH_TO_GND K_ED_TDME.P_CODE_SH_TO_UB K_ED_TDME.P_CODE_UNPLAUSIBEL K_ED_THERMOSTAT.DEC_NACH_EINTRAG K_ED_THERMOSTAT.DEC_VOR_EINTRAG K_ED_THERMOSTAT.FEHLERSCHWELLE K_ED_THERMOSTAT.INC_NACH_EINTRAG K_ED_THERMOSTAT.INC_VOR_EINTRAG K_ED_THERMOSTAT.KLASSENINDEX K_ED_THERMOSTAT.OK_SCHWELLE K_ED_THERMOSTAT.P_CODE_OPENLOAD K_ED_THERMOSTAT.P_CODE_SH_TO_GND K_ED_THERMOSTAT.P_CODE_SH_TO_UB K_ED_THERMOSTAT.P_CODE_UNPLAUSIBEL K_ED_TIME_REL_OBD.DEC_NACH_EINTRAG K_ED_TIME_REL_OBD.DEC_VOR_EINTRAG K_ED_TIME_REL_OBD.FEHLERSCHWELLE K_ED_TIME_REL_OBD.INC_NACH_EINTRAG K_ED_TIME_REL_OBD.INC_VOR_EINTRAG K_ED_TIME_REL_OBD.KLASSENINDEX K_ED_TIME_REL_OBD.OK_SCHWELLE K_ED_TIME_REL_OBD.P_CODE_OPENLOAD K_ED_TIME_REL_OBD.P_CODE_SH_TO_GND K_ED_TIME_REL_OBD.P_CODE_SH_TO_UB K_ED_TIME_REL_OBD.P_CODE_UNPLAUSIBEL K_ED_TKA.DEC_NACH_EINTRAG K_ED_TKA.DEC_VOR_EINTRAG K_ED_TKA.FEHLERSCHWELLE K_ED_TKA.INC_NACH_EINTRAG K_ED_TKA.INC_VOR_EINTRAG K_ED_TKA.KLASSENINDEX K_ED_TKA.OK_SCHWELLE K_ED_TKA.P_CODE_OPENLOAD K_ED_TKA.P_CODE_SH_TO_GND K_ED_TKA.P_CODE_SH_TO_UB K_ED_TKA.P_CODE_UNPLAUSIBEL K_ED_TKA_OBD.DEC_NACH_EINTRAG K_ED_TKA_OBD.DEC_VOR_EINTRAG K_ED_TKA_OBD.FEHLERSCHWELLE K_ED_TKA_OBD.INC_NACH_EINTRAG K_ED_TKA_OBD.INC_VOR_EINTRAG K_ED_TKA_OBD.KLASSENINDEX K_ED_TKA_OBD.OK_SCHWELLE K_ED_TKA_OBD.P_CODE_OPENLOAD K_ED_TKA_OBD.P_CODE_SH_TO_GND K_ED_TKA_OBD.P_CODE_SH_TO_UB K_ED_TKA_OBD.P_CODE_UNPLAUSIBEL K_ED_TMOT.DEC_NACH_EINTRAG K_ED_TMOT.DEC_VOR_EINTRAG K_ED_TMOT.FEHLERSCHWELLE K_ED_TMOT.INC_NACH_EINTRAG K_ED_TMOT.INC_VOR_EINTRAG K_ED_TMOT.KLASSENINDEX K_ED_TMOT.OK_SCHWELLE K_ED_TMOT.P_CODE_OPENLOAD K_ED_TMOT.P_CODE_SH_TO_GND K_ED_TMOT.P_CODE_SH_TO_UB K_ED_TMOT.P_CODE_UNPLAUSIBEL K_ED_TMOT_OBD.DEC_NACH_EINTRAG K_ED_TMOT_OBD.DEC_VOR_EINTRAG K_ED_TMOT_OBD.FEHLERSCHWELLE K_ED_TMOT_OBD.INC_NACH_EINTRAG K_ED_TMOT_OBD.INC_VOR_EINTRAG K_ED_TMOT_OBD.KLASSENINDEX K_ED_TMOT_OBD.OK_SCHWELLE K_ED_TMOT_OBD.P_CODE_OPENLOAD K_ED_TMOT_OBD.P_CODE_SH_TO_GND K_ED_TMOT_OBD.P_CODE_SH_TO_UB K_ED_TMOT_OBD.P_CODE_UNPLAUSIBEL K_ED_TMOT_OBD_HIGH.DEC_NACH_EINTRAG K_ED_TMOT_OBD_HIGH.DEC_VOR_EINTRAG K_ED_TMOT_OBD_HIGH.FEHLERSCHWELLE K_ED_TMOT_OBD_HIGH.INC_NACH_EINTRAG K_ED_TMOT_OBD_HIGH.INC_VOR_EINTRAG K_ED_TMOT_OBD_HIGH.KLASSENINDEX K_ED_TMOT_OBD_HIGH.OK_SCHWELLE K_ED_TMOT_OBD_HIGH.P_CODE_OPENLOAD K_ED_TMOT_OBD_HIGH.P_CODE_SH_TO_GND K_ED_TMOT_OBD_HIGH.P_CODE_SH_TO_UB K_ED_TMOT_OBD_HIGH.P_CODE_UNPLAUSIBEL K_ED_TUMG.DEC_NACH_EINTRAG K_ED_TUMG.DEC_VOR_EINTRAG K_ED_TUMG.FEHLERSCHWELLE K_ED_TUMG.INC_NACH_EINTRAG K_ED_TUMG.INC_VOR_EINTRAG K_ED_TUMG.KLASSENINDEX K_ED_TUMG.OK_SCHWELLE K_ED_TUMG.P_CODE_OPENLOAD K_ED_TUMG.P_CODE_SH_TO_GND K_ED_TUMG.P_CODE_SH_TO_UB K_ED_TUMG.P_CODE_UNPLAUSIBEL K_ED_TUMG_OBD.DEC_NACH_EINTRAG K_ED_TUMG_OBD.DEC_VOR_EINTRAG K_ED_TUMG_OBD.FEHLERSCHWELLE K_ED_TUMG_OBD.INC_NACH_EINTRAG K_ED_TUMG_OBD.INC_VOR_EINTRAG K_ED_TUMG_OBD.KLASSENINDEX K_ED_TUMG_OBD.OK_SCHWELLE K_ED_TUMG_OBD.P_CODE_OPENLOAD K_ED_TUMG_OBD.P_CODE_SH_TO_GND K_ED_TUMG_OBD.P_CODE_SH_TO_UB K_ED_TUMG_OBD.P_CODE_UNPLAUSIBEL K_ED_UB.DEC_NACH_EINTRAG K_ED_UB.DEC_VOR_EINTRAG K_ED_UB.FEHLERSCHWELLE K_ED_UB.INC_NACH_EINTRAG K_ED_UB.INC_VOR_EINTRAG K_ED_UB.KLASSENINDEX K_ED_UB.OK_SCHWELLE K_ED_UB.P_CODE_OPENLOAD K_ED_UB.P_CODE_SH_TO_GND K_ED_UB.P_CODE_SH_TO_UB K_ED_UB.P_CODE_UNPLAUSIBEL K_ED_UBMIN K_ED_UEXT_111219514.DEC_NACH_EINTRAG K_ED_UEXT_111219514.DEC_VOR_EINTRAG K_ED_UEXT_111219514.FEHLERSCHWELLE K_ED_UEXT_111219514.INC_NACH_EINTRAG K_ED_UEXT_111219514.INC_VOR_EINTRAG K_ED_UEXT_111219514.KLASSENINDEX K_ED_UEXT_111219514.OK_SCHWELLE K_ED_UEXT_111219514.P_CODE_OPENLOAD K_ED_UEXT_111219514.P_CODE_SH_TO_GND K_ED_UEXT_111219514.P_CODE_SH_TO_UB K_ED_UEXT_111219514.P_CODE_UNPLAUSIBEL K_ED_UEXT_124_512.DEC_NACH_EINTRAG K_ED_UEXT_124_512.DEC_VOR_EINTRAG K_ED_UEXT_124_512.FEHLERSCHWELLE K_ED_UEXT_124_512.INC_NACH_EINTRAG K_ED_UEXT_124_512.INC_VOR_EINTRAG K_ED_UEXT_124_512.KLASSENINDEX K_ED_UEXT_124_512.OK_SCHWELLE K_ED_UEXT_124_512.P_CODE_OPENLOAD K_ED_UEXT_124_512.P_CODE_SH_TO_GND K_ED_UEXT_124_512.P_CODE_SH_TO_UB K_ED_UEXT_124_512.P_CODE_UNPLAUSIBEL K_ED_V_DIREKT.DEC_NACH_EINTRAG K_ED_V_DIREKT.DEC_VOR_EINTRAG K_ED_V_DIREKT.FEHLERSCHWELLE K_ED_V_DIREKT.INC_NACH_EINTRAG K_ED_V_DIREKT.INC_VOR_EINTRAG K_ED_V_DIREKT.KLASSENINDEX K_ED_V_DIREKT.OK_SCHWELLE K_ED_V_DIREKT.P_CODE_OPENLOAD K_ED_V_DIREKT.P_CODE_SH_TO_GND K_ED_V_DIREKT.P_CODE_SH_TO_UB K_ED_V_DIREKT.P_CODE_UNPLAUSIBEL K_ED_WUC_DELTA_TMOT K_ED_WUC_TMOT_MIN K_ED_ZOELP1.DEC_NACH_EINTRAG K_ED_ZOELP1.DEC_VOR_EINTRAG K_ED_ZOELP1.FEHLERSCHWELLE K_ED_ZOELP1.INC_NACH_EINTRAG K_ED_ZOELP1.INC_VOR_EINTRAG K_ED_ZOELP1.KLASSENINDEX K_ED_ZOELP1.OK_SCHWELLE K_ED_ZOELP1.P_CODE_OPENLOAD K_ED_ZOELP1.P_CODE_SH_TO_GND K_ED_ZOELP1.P_CODE_SH_TO_UB K_ED_ZOELP1.P_CODE_UNPLAUSIBEL K_ED_ZOELP2.DEC_NACH_EINTRAG K_ED_ZOELP2.DEC_VOR_EINTRAG K_ED_ZOELP2.FEHLERSCHWELLE K_ED_ZOELP2.INC_NACH_EINTRAG K_ED_ZOELP2.INC_VOR_EINTRAG K_ED_ZOELP2.KLASSENINDEX K_ED_ZOELP2.OK_SCHWELLE K_ED_ZOELP2.P_CODE_OPENLOAD K_ED_ZOELP2.P_CODE_SH_TO_GND K_ED_ZOELP2.P_CODE_SH_TO_UB K_ED_ZOELP2.P_CODE_UNPLAUSIBEL /end DEF_CHARACTERISTIC
/end FUNCTION
/begin FUNCTION Ercosek_SC "" /begin DEF_CHARACTERISTIC K_CODIER_INDEX K_DIAGNOSE_INDEX_HI K_DIAGNOSE_INDEX_LO /end DEF_CHARACTERISTIC
 /begin OUT_MEASUREMENT ccp_aramStatus ccp_checksum ccp_moveStatus ccp_reqSwitch ccp_stateChecksum stack_status stack_usedErcosek stack_usedUser tm_100ms.dT tm_100ms.lastTask tm_100ms.maxTime tm_100ms.netTime tm_10ms.dT tm_10ms.lastTask tm_10ms.maxTime tm_10ms.netTime tm_5ms.dT tm_5ms.lastTask tm_5ms.maxTime tm_5ms.netTime tm_bgnd.dT tm_bgnd.grossRunTime tm_bgnd.lastTask tm_bgnd.maxTime tm_bgnd.netTime tm_Sync1_S65.dT tm_Sync1_S65.lastTask tm_Sync1_S65.maxTime tm_Sync1_S65.netTime tm_Sync1_S85.dT tm_Sync1_S85.lastTask tm_Sync1_S85.maxTime tm_Sync1_S85.netTime tm_Sync2_S65.dT tm_Sync2_S65.lastTask tm_Sync2_S65.maxTime tm_Sync2_S65.netTime tm_Sync2_S85.dT tm_Sync2_S85.lastTask tm_Sync2_S85.maxTime tm_Sync2_S85.netTime /end OUT_MEASUREMENT
/end FUNCTION
/begin FUNCTION Fahrzeuggeschwindigkeit ""
 /begin DEF_CHARACTERISTIC K_V_DIREKT_FAK K_V_DIREKT_TAU K_V_MAX_E2 K_V_MAX_NEG_GRAD_E2 K_V_MAX_POS_GRAD_E2 K_V_MIN_E2 K_VDIAG_DN_OHNE_V K_VDIAG_GRAD_MAX K_VDIAG_OFFSET K_VDIAG_SA_OHNE_V K_VDIAG_VMAX /end DEF_CHARACTERISTIC
 /begin OUT_MEASUREMENT v_direkt_fil v_direkt_period v_direkt_roh v_direkt_t_sa v_direkt_timeout v_direkt_weg v_e2 /end OUT_MEASUREMENT
/end FUNCTION
/begin FUNCTION FGR ""
 /begin DEF_CHARACTERISTIC K_FGR_A1 K_FGR_AX_MAX K_FGR_AX_TAU K_FGR_BESCHL_KOMFORT K_FGR_BESCHL_NORMAL K_FGR_BESCHL_SPORT K_FGR_BESCHL_TIP K_FGR_BESCHL_WA_KOMFORT K_FGR_BESCHL_WA_NORMAL K_FGR_BESCHL_WA_SPORT K_FGR_CFG_V_IST K_FGR_CFG_V_MAX K_FGR_CFG_VORST K_FGR_DSC_BLS_T K_FGR_DSC_MD_BLS_T K_FGR_DSC_MD_T K_FGR_EIN K_FGR_FAK_V_KOMFORT K_FGR_FAK_V_MAX K_FGR_FAK_V_MIN K_FGR_FAK_V_NORMAL K_FGR_FAK_V_SPORT K_FGR_FAK_V_TIP K_FGR_FSP_EIN K_FGR_MARKE_CFG K_FGR_MD_DELTA K_FGR_MD_FW_HYS K_FGR_MD_FW_LL_HYS K_FGR_MSW_T_MIN K_FGR_N_DIF_DIAG_T K_FGR_N_DIF_MAX K_FGR_N_MAX K_FGR_SMG_MCS K_FGR_STATE_AG K_FGR_STEP_T_MIN K_FGR_STUFE_KMH K_FGR_STUFE_MPH K_FGR_T_AUS K_FGR_T_CONSTF_RAMPE K_FGR_T_FEHLER_E2 K_FGR_T_MIN_SA K_FGR_T_STRICH K_FGR_T_UEBERHOL_MAX K_FGR_TIP_T_MIN K_FGR_V_DIAG K_FGR_V_DIAG_T K_FGR_V_DIF_MAX K_FGR_V_DIF_MAX_AUFST K_FGR_V_DIF_MAX_LL K_FGR_V_DIF_MIN K_FGR_V_DIF_MIN_AUFST K_FGR_V_DIF_MIN_LL K_FGR_V_DIF_MIN_UEBERHOL K_FGR_V_FEHLER_T K_FGR_V_IST_MIN K_FGR_V_IST_TAU K_FGR_V_MAX K_FGR_V_SOLL_DIF_KONST K_FGR_V_SOLL_DIF_MAX K_FGR_V_SOLL_DIF_MIN K_FGR_V_SOLL_MAX_HYS K_FGR_V_SOLL_MAX_KMH K_FGR_V_SOLL_MAX_MPH K_FGR_V_SOLL_MAX_T K_FGR_V_SOLL_MIN_KMH K_FGR_V_SOLL_MIN_KMH_E2 K_FGR_V_SOLL_MIN_MPH K_FGR_V_SOLL_MIN_MPH_E2 K_FGR_V_SOLL_OFFSET K_FGR_V_TIP_INC_DEC K_FGR_VAHA_DIAG_T K_FGR_VERZ K_FGR_VERZ_TIP KF_FGR_FAK_V_WA KF_FGR_KR KF_FGR_KR_CONST KF_FGR_TN KF_FGR_TN_CONST KF_FGR_TV KF_FGR_TV_CONST KF_FGR_VORST KF_FGR_VORST_UP KL_FGR_FAK_T_BESCHL KL_FGR_FAK_T_VERZ KL_FGR_FAK_T_WA KL_FGR_FAK_V_TIP KL_FGR_KOEFF_WICHT KL_FGR_KR_FAK KL_FGR_MD_FW_LL KL_FGR_MD_RAMPE_DELTA KL_FGR_TN_FAK KL_FGR_TV_FAK KL_FGR_V_FIL_A1 KL_FGR_V_FIL_B1 KL_FGR_V_FIL_B2 KL_FGR_V_SA_SPERRE KL_FGR_VAHA_DIAG KL_FGR_VERZ_WA /end DEF_CHARACTERISTIC
 /begin OUT_MEASUREMENT fgr_a1 fgr_ax_ist fgr_ax_neg_soll fgr_ax_pos_soll fgr_b_dsc_eingriff fgr_b_dsc_reg_abs_asc_msr fgr_b_dsc_reg_dsc fgr_b_dsc_reg_eingriff fgr_b_dsc_soft_off fgr_b_fehler_e2 fgr_b_rgl_init fgr_b_smg_rs fgr_b_ueberhol_anf fgr_b_wa_first fgr_b0 fgr_b1 fgr_b2 fgr_can_stat_msw fgr_fak_t_aktiv fgr_fak_v_veh_soll fgr_fil_a1 fgr_fil_b1 fgr_fil_b2 fgr_fsp_code fgr_hud_aus fgr_hud_bedien fgr_hud_state fgr_init_beschl_set fgr_init_verzoeg_set fgr_kr fgr_kw fgr_md_fw_fgr_sum fgr_md_fw_roh fgr_md_fw_sa fgr_n_dif fgr_pwg fgr_stat_abschalten fgr_stat_anf_msw fgr_stat_hard_off_irr fgr_stat_hard_off_irr_old fgr_stat_hard_off_rev fgr_stat_soft_off_rev fgr_status_can fgr_status_stufe fgr_t_aktiv fgr_t_constfahrt fgr_t_err_v_veh fgr_t_kli fgr_t_ueberhol fgr_tn fgr_tv fgr_v_soll_max fgr_v_soll_min fgr_v_tacho_fil fgr_v_veh_dif fgr_v_veh_fil fgr_v_veh_ist fgr_v_veh_kombi fgr_v_veh_soll fgr_v_veh_soll_dec fgr_v_veh_soll_dec_akt fgr_v_veh_soll_dif fgr_v_veh_soll_dif_roh fgr_v_veh_soll_inc fgr_v_veh_soll_inc_akt fgr_v_veh_soll_roh fgr_v_veh_stufe fgr_v_veh_ziel /end OUT_MEASUREMENT
/end FUNCTION
/begin FUNCTION Flashservice "" /end FUNCTION
/begin FUNCTION fra_loli ""
 /begin DEF_CHARACTERISTIC GAX_15MODELLE K_FRA_LOLI_ANZ K_FRA_LOLI_CFG K_FRA_LOLI_GEW_MAX K_FRA_LOLI_LERN_CFG K_FRA_LOLI_LERN_FAK K_FRA_LOLI_MAX K_FRA_LOLI_MDRF_MIN K_FRA_LOLI_MIN K_FRA_LOLI_N_MIN K_FRA_LOLI_X_NORM K_FRA_TE_C_AKF_MAX K_FRA_TMOT_MIN KL_FRA_LOLI_C_N KL_FRA_LOLI_C_RF KL_FRA_LOLI_DEF_W_BIAS KL_FRA_LOLI_DEF_W_N KL_FRA_LOLI_DEF_W_RF KL_FRA_LOLI_S_N KL_FRA_LOLI_S_RF KL_FRA_MDRFSOLL_MIN_N /end DEF_CHARACTERISTIC
 /begin OUT_MEASUREMENT fra_loli_lern_ein_b1 fra_loli_lern_ein_b2 fra_loli_lern_f_b1 fra_loli_lern_f_b2 fra_loli_lern_st fra_loli_lern_st.cfg_aus fra_loli_lern_st.cfg_reset fra_loli_lern_st.fr_status fra_loli_lern_st.md_rf_soll fra_loli_lern_st.te_c_akf fra_loli_lern_st.tmot fra_loli_out_b1 fra_loli_out_b2 fra_loli_out_f_b1 fra_loli_out_f_b2 fra_loli_z_norm /end OUT_MEASUREMENT
/end FUNCTION
/begin FUNCTION Fuellungsadaption ""
 /begin DEF_CHARACTERISTIC K_FRA_AQ_ADAPT_MAX K_FRA_AQ_ADAPT_MIN K_FRA_AQ_DELTA_FAST K_FRA_AQ_DELTA_SLOW K_FRA_AQ_MAX_FAST K_FRA_AQ_MAX_SLOW K_FRA_AQ_TMOT_TAU K_FRA_CFG K_FRA_FR_I_REG_SCHW K_FRA_RF_DELTA_SCHW K_FRA_RF_MAX K_FRA_TMOT_SCHW K_FRA_WAIT KF_FRA_PROV_B1 KF_FRA_PROV_B2 KL_FRA_GRUNDLECKLUFT KL_FRA_XSI_PSAU /end DEF_CHARACTERISTIC
 /begin OUT_MEASUREMENT fra_aq_adapt_b1 fra_aq_adapt_b2 fra_aqmax fra_out_b1 fra_out_b2 fra_sperr_st_b1 fra_sperr_st_b2 fra_tmot_fil fra_wait_b1 fra_wait_b2 fra_zust_b1 fra_zust_b2 /end OUT_MEASUREMENT
/end FUNCTION
/begin FUNCTION Fuellungsregler ""
 /begin DEF_CHARACTERISTIC K_FR_AQGRAD_MAX K_FR_CFG K_FR_EDK_DIFF K_FR_EINGER_HYS K_FR_EINGER_SCHW K_FR_IMAX K_FR_IMIN K_FR_IN_CFG K_FR_MAX K_FR_MIN K_FR_MVAC_RF_MAX K_FR_PUMG_MAX K_FR_PUMG_MIN K_FR_START_DELAY K_FR_T_ABREG K_FR_TAN_MAX K_FR_TAN_MIN K_FR_TE_C_AKF_MAX K_FR_TE_X_ML_MIN K_FR_TKSM_MAX K_FR_TKSM_MIN K_FR_TMOT_MAX K_FR_TMOT_MIN KF_FR_RF_DELTA_REL_HYS KF_FR_SA_DELAY KL_FR_IANT KL_FR_MDRFSOLLPT_MAX_N KL_FR_PANT /end DEF_CHARACTERISTIC
 /begin OUT_MEASUREMENT fr_abs_abw_b1 fr_abs_abw_b2 fr_abw_b1 fr_abw_b2 fr_halt_t fr_iant_b1 fr_iant_b2 fr_in_b1 fr_in_b2 fr_md_rf_soll_pt_schw fr_pant_b1 fr_pant_b2 fr_ramp_t fr_reg_i_b1 fr_reg_i_b2 fr_reg_out_b1 fr_reg_out_b2 fr_rf_delta_b1 fr_rf_delta_b2 fr_rf_delta_rel_hys fr_status fr_zust_b1 fr_zust_b2 /end OUT_MEASUREMENT
/end FUNCTION
/begin FUNCTION Gangerkennung ""
 /begin DEF_CHARACTERISTIC K_GANG_1_TIMER_MAX K_GANG_GLG_TIMER_MAX K_GANG_I_HA_DKG K_GANG_I_HA_HS K_GANG_I_HA_SMG K_GANG_I_RW_DKG K_GANG_I_RW_HS K_GANG_I_RW_SMG K_GANG_N_VERH_MAX K_GANG_N_VERH_MIN K_GANG_R_RAD_DYN_NV KL_GANG_I_DKG KL_GANG_I_HS KL_GANG_I_SMG /end DEF_CHARACTERISTIC
 /begin OUT_MEASUREMENT gang_1_timer gang_berech_kl gang_berech_neu_verz gang_berech_roh gang_can_sperre_irre gang_can_sperre_irre_cnt gang_glg_getr_verz gang_glg_timer gang_i gang_i_ha gang_i_rad gang_ik gang_il gang_r_rad_dyn_nv gang_richtung gang_richtung_cnt /end OUT_MEASUREMENT
/end FUNCTION
/begin RECORD_LAYOUT TAD_UB_VV_UB AXIS_PTS_X 2 UBYTE INDEX_INCR DIRECT NO_AXIS_PTS_X 1 UBYTE /end RECORD_LAYOUT
/begin RECORD_LAYOUT TGL_VV_VV_SF FNC_VALUES 1 FLOAT32_IEEE COLUMN_DIR DIRECT /end RECORD_LAYOUT
/begin RECORD_LAYOUT TGL_VV_VV_SW FNC_VALUES 1 SWORD COLUMN_DIR DIRECT /end RECORD_LAYOUT
/begin RECORD_LAYOUT TKF_SW_SW_SW FNC_VALUES 5 SWORD COLUMN_DIR DIRECT AXIS_PTS_X 3 SWORD INDEX_INCR DIRECT AXIS_PTS_Y 4 SWORD INDEX_INCR DIRECT NO_AXIS_PTS_X 1 UBYTE NO_AXIS_PTS_Y 2 UBYTE /end RECORD_LAYOUT
/begin RECORD_LAYOUT TKF_SW_SW_UB FNC_VALUES 5 UBYTE COLUMN_DIR DIRECT AXIS_PTS_X 3 SWORD INDEX_INCR DIRECT AXIS_PTS_Y 4 SWORD INDEX_INCR DIRECT NO_AXIS_PTS_X 1 UBYTE NO_AXIS_PTS_Y 2 UBYTE /end RECORD_LAYOUT
/begin RECORD_LAYOUT TKF_SW_SW_UW FNC_VALUES 5 UWORD COLUMN_DIR DIRECT AXIS_PTS_X 3 SWORD INDEX_INCR DIRECT AXIS_PTS_Y 4 SWORD INDEX_INCR DIRECT NO_AXIS_PTS_X 1 UBYTE NO_AXIS_PTS_Y 2 UBYTE /end RECORD_LAYOUT
/begin RECORD_LAYOUT TKL_SW_VV_SW FNC_VALUES 4 SWORD COLUMN_DIR DIRECT AXIS_PTS_X 3 SWORD INDEX_INCR DIRECT NO_AXIS_PTS_X 1 UBYTE RESERVED 2 BYTE /end RECORD_LAYOUT
/begin RECORD_LAYOUT TKL_SW_VV_UB FNC_VALUES 4 UBYTE COLUMN_DIR DIRECT AXIS_PTS_X 3 SWORD INDEX_INCR DIRECT NO_AXIS_PTS_X 1 UBYTE RESERVED 2 BYTE /end RECORD_LAYOUT
/begin RECORD_LAYOUT TKL_SW_VV_UW FNC_VALUES 4 UWORD COLUMN_DIR DIRECT AXIS_PTS_X 3 SWORD INDEX_INCR DIRECT NO_AXIS_PTS_X 1 UBYTE RESERVED 2 BYTE /end RECORD_LAYOUT
/begin RECORD_LAYOUT TKL_UB_VV_UB FNC_VALUES 4 UBYTE COLUMN_DIR DIRECT AXIS_PTS_X 3 UBYTE INDEX_INCR DIRECT NO_AXIS_PTS_X 1 UBYTE RESERVED 2 BYTE /end RECORD_LAYOUT
/begin RECORD_LAYOUT TKL_UW_VV_SW FNC_VALUES 4 SWORD COLUMN_DIR DIRECT AXIS_PTS_X 3 UWORD INDEX_INCR DIRECT NO_AXIS_PTS_X 1 UBYTE RESERVED 2 BYTE /end RECORD_LAYOUT
/begin RECORD_LAYOUT TKL_UW_VV_UW FNC_VALUES 4 UWORD COLUMN_DIR DIRECT AXIS_PTS_X 3 UWORD INDEX_INCR DIRECT NO_AXIS_PTS_X 1 UBYTE RESERVED 2 BYTE /end RECORD_LAYOUT
/begin RECORD_LAYOUT TKW_VV_VV_SB FNC_VALUES 1 SBYTE COLUMN_DIR DIRECT /end RECORD_LAYOUT
/begin RECORD_LAYOUT TKW_VV_VV_SF FNC_VALUES 1 FLOAT32_IEEE COLUMN_DIR DIRECT /end RECORD_LAYOUT
/begin RECORD_LAYOUT TKW_VV_VV_SW FNC_VALUES 1 SWORD COLUMN_DIR DIRECT /end RECORD_LAYOUT
/begin RECORD_LAYOUT TKW_VV_VV_UB FNC_VALUES 1 UBYTE COLUMN_DIR DIRECT /end RECORD_LAYOUT
/begin RECORD_LAYOUT TKW_VV_VV_UL FNC_VALUES 1 ULONG COLUMN_DIR DIRECT /end RECORD_LAYOUT
/begin RECORD_LAYOUT TKW_VV_VV_UW FNC_VALUES 1 UWORD COLUMN_DIR DIRECT /end RECORD_LAYOUT
/end MODULE
/end PROJECT
