ASAP2_VERSION 1 41
/begin PROJECT MSD85 "Spray Guided DI-System with Piezo Injectors for 8-Cylinder"
/begin HEADER "_default_HeaderComment" PROJECT_NO _91 /end HEADER
/begin MODULE _default_ModuleName "_default_ModuleLongIdentifier"
/begin MOD_COMMON "_default_ModCommonComment" DEPOSIT ABSOLUTE BYTE_ORDER MSB_LAST ALIGNMENT_BYTE 1 ALIGNMENT_WORD 2 ALIGNMENT_LONG 2 ALIGNMENT_FLOAT32_IEEE 2 ALIGNMENT_FLOAT64_IEEE 4 /end MOD_COMMON
/begin MEASUREMENT All_kh "" UBYTE _CNV_R_R_Def_spr_ub_558_CM 1 100. 0. 204. DISPLAY_IDENTIFIER ALL_KH ECU_ADDRESS 0xd000e406 FORMAT "%5.2" /end MEASUREMENT
/begin MEASUREMENT All_kh_2 "" UBYTE _CNV_R_R_Def_spr_ub_558_CM 1 100. 0. 204. DISPLAY_IDENTIFIER ALL_KH_2 ECU_ADDRESS 0xd000e407 FORMAT "%5.2" /end MEASUREMENT
/begin MEASUREMENT All_kh_3 "" UBYTE _CNV_R_R_Def_spr_ub_558_CM 1 100. 0. 204. DISPLAY_IDENTIFIER ALL_KH_3 ECU_ADDRESS 0xd000e408 FORMAT "%5.2" /end MEASUREMENT
/begin MEASUREMENT Allk "Leerlauf Auslassspreizung gedrosselt kalt zum Katheizen" UBYTE _CNV_R_R_Def_spr_ub_558_CM 1 100. 0. 204. DISPLAY_IDENTIFIER ALLK ECU_ADDRESS 0xd000e422 FORMAT "%5.2" /end MEASUREMENT
/begin MEASUREMENT Allk_2 "" UBYTE _CNV_R_R_Def_spr_ub_558_CM 1 100. 0. 204. DISPLAY_IDENTIFIER ALLK_2 ECU_ADDRESS 0xd000e409 FORMAT "%5.2" /end MEASUREMENT
/begin MEASUREMENT Allw "Leerlauf Auslassspreizung gedrosselt warm zum Katheizen" UBYTE _CNV_R_R_Def_spr_ub_558_CM 1 100. 0. 204. DISPLAY_IDENTIFIER ALLW ECU_ADDRESS 0xd000e423 FORMAT "%5.2" /end MEASUREMENT
/begin MEASUREMENT Allw_2 "" UBYTE _CNV_R_R_Def_spr_ub_558_CM 1 100. 0. 204. DISPLAY_IDENTIFIER ALLW_2 ECU_ADDRESS 0xd000e40a FORMAT "%5.2" /end MEASUREMENT
/begin MEASUREMENT As "Hier koennte ihr Langbezeichner stehen" UBYTE _CNV_R_R_Def_spr_ub_558_CM 1 100. 0. 204. DISPLAY_IDENTIFIER AS ECU_ADDRESS 0xd000e425 FORMAT "%5.2" /end MEASUREMENT
/begin MEASUREMENT Ask "optimale Auslassspreizung kalt ungedrosselt" UBYTE _CNV_R_R_Def_spr_ub_558_CM 1 100. 0. 204. DISPLAY_IDENTIFIER ASK ECU_ADDRESS 0xd000e424 FORMAT "%5.2" /end MEASUREMENT
/begin MEASUREMENT Aspr "Sollwert Auslassspreizung" UBYTE _CNV_R_R_Def_spr_ub_558_CM 1 100. 0. 204. DISPLAY_IDENTIFIER ASPR ECU_ADDRESS 0xd000e3ec FORMAT "%5.2" /end MEASUREMENT
/begin MEASUREMENT Aspr_last "" UBYTE _CNV_R_R_Def_spr_ub_558_CM 1 100. 0. 204. DISPLAY_IDENTIFIER ASPR_LAST ECU_ADDRESS 0xd000e41e FORMAT "%5.2" /end MEASUREMENT
/begin MEASUREMENT Aspr_norm "" UBYTE _CNV_R_R_Def_spr_ub_558_CM 1 100. 0. 204. DISPLAY_IDENTIFIER ASPR_NORM ECU_ADDRESS 0xd000e417 FORMAT "%5.2" /end MEASUREMENT
/begin MEASUREMENT Aspr_ramp "" SWORD _CNV_R_R_Def_spr_sw_561_CM 1 100. 0. 180. DISPLAY_IDENTIFIER ASPR_RAMP ECU_ADDRESS 0xd000e456 FORMAT "%7.2" /end MEASUREMENT
/begin MEASUREMENT Aspr_vl1 "" UBYTE _CNV_R_R_Def_spr_ub_558_CM 1 100. 0. 204. DISPLAY_IDENTIFIER ASPR_VL1 ECU_ADDRESS 0xd000e41a FORMAT "%5.2" /end MEASUREMENT
/begin MEASUREMENT Aspr_vl2 "" UBYTE _CNV_R_R_Def_spr_ub_558_CM 1 100. 0. 204. DISPLAY_IDENTIFIER ASPR_VL2 ECU_ADDRESS 0xd000e41b FORMAT "%5.2" /end MEASUREMENT
/begin MEASUREMENT Aspr_vs "Normspreizung Auslass" UWORD _CNV_R_R_Def_spr_sw_561_CM 1 100. 0. 6553.5 DISPLAY_IDENTIFIER ASPR_VS ECU_ADDRESS 0xd000e452 FORMAT "%7.2" /end MEASUREMENT
/begin MEASUREMENT Asprhs "Auslassspreizung Teillast, Homogen_Schicht" UBYTE _CNV_R_R_Def_spr_ub_558_CM 1 100. 0. 204. DISPLAY_IDENTIFIER ASPRHS ECU_ADDRESS 0xd000e44e FORMAT "%5.2" /end MEASUREMENT
/begin MEASUREMENT Asprimx "Max. der Istauslassspreizung" UWORD _CNV_R_R_Def_spr_sw_561_CM 1 100. 0. 6553.5 DISPLAY_IDENTIFIER ASPRIMX ECU_ADDRESS 0xd000e428 FORMAT "%7.2" /end MEASUREMENT
/begin MEASUREMENT Asprl "Auslassspreizung im Leerlauf gedrosselt" UBYTE _CNV_R_R_Def_spr_ub_558_CM 1 100. 0. 204. DISPLAY_IDENTIFIER ASPRL ECU_ADDRESS 0xd000e3e8 FORMAT "%5.2" /end MEASUREMENT
/begin MEASUREMENT Asprlast "" UBYTE _CNV_R_R_Def_spr_ub_558_CM 1 100. 0. 204. DISPLAY_IDENTIFIER ASPRLAST ECU_ADDRESS 0xd000e41f FORMAT "%5.2" /end MEASUREMENT
/begin MEASUREMENT Asprlhs "Auslassspreizung Leerlauf, Homogen_Schicht" UBYTE _CNV_R_R_Def_spr_ub_558_CM 1 100. 0. 204. DISPLAY_IDENTIFIER ASPRLHS ECU_ADDRESS 0xd000e44d FORMAT "%5.2" /end MEASUREMENT
/begin MEASUREMENT Asprll "" UBYTE _CNV_R_R_Def_spr_ub_558_CM 1 100. 0. 204. DISPLAY_IDENTIFIER ASPRLL ECU_ADDRESS 0xd000e421 FORMAT "%5.2" /end MEASUREMENT
/begin MEASUREMENT Asprll_kh "KH-Spreizung AUSLASS-LL" UBYTE _CNV_R_R_Def_spr_ub_558_CM 1 100. 0. 204. DISPLAY_IDENTIFIER ASPRLL_KH ECU_ADDRESS 0xd000e414 FORMAT "%5.2" /end MEASUREMENT
/begin MEASUREMENT Asprlu "Auslassspreizung im Leerlauf ungedrosselt" UBYTE _CNV_R_R_Def_spr_ub_558_CM 1 100. 0. 204. DISPLAY_IDENTIFIER ASPRLU ECU_ADDRESS 0xd000e3e9 FORMAT "%5.2" /end MEASUREMENT
/begin MEASUREMENT Asprt "Auslassspreizung teilgedrosselt" UBYTE _CNV_R_R_Def_spr_ub_558_CM 1 100. 0. 204. DISPLAY_IDENTIFIER ASPRT ECU_ADDRESS 0xd000e42a FORMAT "%5.2" /end MEASUREMENT
/begin MEASUREMENT Asprtl_kh "KH-Spreizung AUSLASS-TL" UBYTE _CNV_R_R_Def_spr_ub_558_CM 1 100. 0. 204. DISPLAY_IDENTIFIER ASPRTL_KH ECU_ADDRESS 0xd000e415 FORMAT "%5.2" /end MEASUREMENT
/begin MEASUREMENT Aspru "Auslassspreizung ungedrosselt" UBYTE _CNV_R_R_Def_spr_ub_558_CM 1 100. 0. 204. DISPLAY_IDENTIFIER ASPRU ECU_ADDRESS 0xd000e42b FORMAT "%5.2" /end MEASUREMENT
/begin MEASUREMENT Astk "optimale Auslassspreizung teilgedrosselt kalt" UBYTE _CNV_R_R_Def_spr_ub_558_CM 1 100. 0. 204. DISPLAY_IDENTIFIER ASTK ECU_ADDRESS 0xd000e42c FORMAT "%5.2" /end MEASUREMENT
/begin MEASUREMENT Astw "optimale Auslassspreizung teilgedrosselt warm" UBYTE _CNV_R_R_Def_spr_ub_558_CM 1 100. 0. 204. DISPLAY_IDENTIFIER ASTW ECU_ADDRESS 0xd000e42d FORMAT "%5.2" /end MEASUREMENT
/begin MEASUREMENT Asuesp "Hier koennte ihr Langbezeichner stehen" UBYTE _CNV_R_R_Def_spr_ub_558_CM 1 100. 0. 204. DISPLAY_IDENTIFIER ASUESP ECU_ADDRESS 0xd000e426 FORMAT "%5.2" /end MEASUREMENT
/begin MEASUREMENT Asw "optimale Auslassspreizung ungedrosselt warm" UBYTE _CNV_R_R_Def_spr_ub_558_CM 1 100. 0. 204. DISPLAY_IDENTIFIER ASW ECU_ADDRESS 0xd000e42e FORMAT "%5.2" /end MEASUREMENT
/begin MEASUREMENT Aswll "optimale Auslassspreizung ungedrosselt warm im Leerlauf" UBYTE _CNV_R_R_Def_spr_ub_558_CM 1 100. 0. 204. DISPLAY_IDENTIFIER ASWLL ECU_ADDRESS 0xd000e42f FORMAT "%5.2" /end MEASUREMENT
/begin MEASUREMENT Atl_kh "" UBYTE _CNV_R_R_Def_spr_ub_558_CM 1 100. 0. 204. DISPLAY_IDENTIFIER ATL_KH ECU_ADDRESS 0xd000e40f FORMAT "%5.2" /end MEASUREMENT
/begin MEASUREMENT Atl_kh_2 "" UBYTE _CNV_R_R_Def_spr_ub_558_CM 1 100. 0. 204. DISPLAY_IDENTIFIER ATL_KH_2 ECU_ADDRESS 0xd000e410 FORMAT "%5.2" /end MEASUREMENT
/begin MEASUREMENT Atl_kh_3 "" UBYTE _CNV_R_R_Def_spr_ub_558_CM 1 100. 0. 204. DISPLAY_IDENTIFIER ATL_KH_3 ECU_ADDRESS 0xd000e411 FORMAT "%5.2" /end MEASUREMENT
/begin MEASUREMENT Atlk_kh "" UBYTE _CNV_R_R_Def_spr_ub_558_CM 1 100. 0. 204. DISPLAY_IDENTIFIER ATLK_KH ECU_ADDRESS 0xd000e40b FORMAT "%5.2" /end MEASUREMENT
/begin MEASUREMENT Atlk_kh_2 "" UBYTE _CNV_R_R_Def_spr_ub_558_CM 1 100. 0. 204. DISPLAY_IDENTIFIER ATLK_KH_2 ECU_ADDRESS 0xd000e40d FORMAT "%5.2" /end MEASUREMENT
/begin MEASUREMENT Atlw_kh "" UBYTE _CNV_R_R_Def_spr_ub_558_CM 1 100. 0. 204. DISPLAY_IDENTIFIER ATLW_KH ECU_ADDRESS 0xd000e40c FORMAT "%5.2" /end MEASUREMENT
/begin MEASUREMENT Atlw_kh_2 "" UBYTE _CNV_R_R_Def_spr_ub_558_CM 1 100. 0. 204. DISPLAY_IDENTIFIER ATLW_KH_2 ECU_ADDRESS 0xd000e40e FORMAT "%5.2" /end MEASUREMENT
/begin MEASUREMENT Bszsi "Betriebsstundenzähler" ULONG _CNV_R_R_Def_dez_sl_551_CM 1 100. 0. 4294967000. DISPLAY_IDENTIFIER BSZSI ECU_ADDRESS 0xc00046b6 FORMAT "%7.0" /end MEASUREMENT
/begin MEASUREMENT Bsztemp "temporärer Betriebsstundenzähler" UWORD _CNV_R_R_Def_dez_sl_551_CM 1 100. 0. 65535. DISPLAY_IDENTIFIER BSZTEMP ECU_ADDRESS 0xc00046ba FORMAT "%5.0" /end MEASUREMENT
/begin MEASUREMENT Deltadff "Gradient des vom Generator empfangenen Lastsignals" SBYTE _CNV_R_R_Def_f_sb_b_584_CM 1 100. -64. 63.5 DISPLAY_IDENTIFIER DELTADFF ECU_ADDRESS 0xc0007a6a FORMAT "%5.2" /end MEASUREMENT
/begin MEASUREMENT Dfdp "Primärkennfeld FASTA Generatorauslastung " UWORD _CNV_R_R_Def_dez_sl_551_CM 1 100. 0. 65535. DISPLAY_IDENTIFIER DFDP ECU_ADDRESS 0xc00046d0 FORMAT "%5.0" ARRAY_SIZE 16 MATRIX_DIM 16 1 1 /end MEASUREMENT
/begin MEASUREMENT Dfds "Sekundärkennfeld FASTA Generatorauslastung" UBYTE _CNV_R_R_Def_dez_sl_551_CM 1 100. 0. 255. DISPLAY_IDENTIFIER DFDS ECU_ADDRESS 0xc00046bc FORMAT "%3.0" ARRAY_SIZE 16 MATRIX_DIM 16 1 1 /end MEASUREMENT
/begin MEASUREMENT Dffgen "ss_msv.dat" UBYTE _CNV_R_R_Def_f_ub_b_586_CM 1 100. 0. 99.60930000000001 DISPLAY_IDENTIFIER DFFGEN ECU_ADDRESS 0xd000d89c FORMAT "%5.2" /end MEASUREMENT
/begin MEASUREMENT Dffgen_dt "Ableitung Dffgensignal" SWORD _CNV_R_R_Def_dt_sw__587_CM 1 100. -4096. 4095.875 DISPLAY_IDENTIFIER DFFGEN_DT ECU_ADDRESS 0xd000d860 FORMAT "%7.2" /end MEASUREMENT
/begin MEASUREMENT Dffgen_f "Gefiltertes Dffgen" UBYTE _CNV_R_R_Def_f_ub_b_586_CM 1 100. 0. 99.60930000000001 DISPLAY_IDENTIFIER DFFGEN_F ECU_ADDRESS 0xd000d872 FORMAT "%5.2" /end MEASUREMENT
/begin MEASUREMENT Dffgenschz "Zähler für Generatorlastschwnkungen zur Leerlauf-Solldrehzahlanhebung" UBYTE _CNV_R_R_Def_dez_sl_551_CM 1 100. 0. 255. DISPLAY_IDENTIFIER DFFGENSCHZ ECU_ADDRESS 0xc0007a6b FORMAT "%3.0" /end MEASUREMENT
/begin MEASUREMENT Dfmonitor "DF-Monitor für FASTA" UBYTE _CNV_R_R_Def_f_ub_b_586_CM 1 100. 0. 99.60930000000001 DISPLAY_IDENTIFIER DFMONITOR ECU_ADDRESS 0xc00046cc FORMAT "%5.2" /end MEASUREMENT
/begin MEASUREMENT Dfpropval "Verhältnis ierr zu dfsiggen für Generator-dffgen-Berechnung" UWORD _CNV_R_R_Def_f_uw_b_588_CM 1 100. 0. 31.9995 DISPLAY_IDENTIFIER DFPROPVAL ECU_ADDRESS 0xd000d898 FORMAT "%9.4" /end MEASUREMENT
/begin MEASUREMENT Dfsumme "DFMonitor Summe FASTA" FLOAT32_IEEE _CNV_R_R_Def_dez_sl_551_CM 1 100. 1. 3.e+038 DISPLAY_IDENTIFIER DFSUMME ECU_ADDRESS 0xc00046aa FORMAT "%14.7" /end MEASUREMENT
/begin MEASUREMENT Dfwanzahl "DF-Wertezähler" FLOAT32_IEEE _CNV_R_R_Def_dez_sl_551_CM 1 100. 1. 3.e+038 DISPLAY_IDENTIFIER DFWANZAHL ECU_ADDRESS 0xc00046ae FORMAT "%14.7" /end MEASUREMENT
/begin MEASUREMENT Dnkw "Drehzahlabweichung bei Leerlaufregelung" SWORD _CNV_R_R_Def_n_sw_q_595_CM 1 100. -32768. 32767. DISPLAY_IDENTIFIER DNKW ECU_ADDRESS 0xc0007a66 FORMAT "%5.0" /end MEASUREMENT
/begin MEASUREMENT Dvsa_ramp "" SWORD _CNV_R_R_Def_spr_sw_561_CM 1 100. -3276.8 3276.7 DISPLAY_IDENTIFIER DVSA_RAMP ECU_ADDRESS 0xd000e3f2 FORMAT "%7.2" /end MEASUREMENT
/begin MEASUREMENT Dvse_ramp "" SWORD _CNV_R_R_Def_spr_sw_561_CM 1 100. -3276.8 3276.7 DISPLAY_IDENTIFIER DVSE_RAMP ECU_ADDRESS 0xd000e3f0 FORMAT "%7.2" /end MEASUREMENT
/begin MEASUREMENT Ell_kh "" UBYTE _CNV_R_R_Def_spr_ub_558_CM 1 100. 0. 204. DISPLAY_IDENTIFIER ELL_KH ECU_ADDRESS 0xd000e3fa FORMAT "%5.2" /end MEASUREMENT
/begin MEASUREMENT Ell_kh_2 "" UBYTE _CNV_R_R_Def_spr_ub_558_CM 1 100. 0. 204. DISPLAY_IDENTIFIER ELL_KH_2 ECU_ADDRESS 0xd000e3fb FORMAT "%5.2" /end MEASUREMENT
/begin MEASUREMENT Ell_kh_3 "" UBYTE _CNV_R_R_Def_spr_ub_558_CM 1 100. 0. 204. DISPLAY_IDENTIFIER ELL_KH_3 ECU_ADDRESS 0xd000e3fc FORMAT "%5.2" /end MEASUREMENT
/begin MEASUREMENT Ellk "Leerlaufeinlassspreizung gedrosselt kalt zum Katheizen" UBYTE _CNV_R_R_Def_spr_ub_558_CM 1 100. 0. 204. DISPLAY_IDENTIFIER ELLK ECU_ADDRESS 0xd000e430 FORMAT "%5.2" /end MEASUREMENT
/begin MEASUREMENT Ellk_2 "" UBYTE _CNV_R_R_Def_spr_ub_558_CM 1 100. 0. 204. DISPLAY_IDENTIFIER ELLK_2 ECU_ADDRESS 0xd000e3fd FORMAT "%5.2" /end MEASUREMENT
/begin MEASUREMENT Ellw "Leerlaufeinlassspreizung gedrosselt warm zum Katheizen" UBYTE _CNV_R_R_Def_spr_ub_558_CM 1 100. 0. 204. DISPLAY_IDENTIFIER ELLW ECU_ADDRESS 0xd000e431 FORMAT "%5.2" /end MEASUREMENT
/begin MEASUREMENT Ellw_2 "" UBYTE _CNV_R_R_Def_spr_ub_558_CM 1 100. 0. 204. DISPLAY_IDENTIFIER ELLW_2 ECU_ADDRESS 0xd000e3fe FORMAT "%5.2" /end MEASUREMENT
/begin MEASUREMENT Es "Hier koennte ihr Langbezeichner stehen" UBYTE _CNV_R_R_Def_spr_ub_558_CM 1 100. 0. 204. DISPLAY_IDENTIFIER ES ECU_ADDRESS 0xd000e433 FORMAT "%5.2" /end MEASUREMENT
/begin MEASUREMENT Esk "optimale Einlassspreizung ungedrosselt kalt" UBYTE _CNV_R_R_Def_spr_ub_558_CM 1 100. 0. 204. DISPLAY_IDENTIFIER ESK ECU_ADDRESS 0xd000e432 FORMAT "%5.2" /end MEASUREMENT
/begin MEASUREMENT Espr "Sollwert Einlassspreizung" UBYTE _CNV_R_R_Def_spr_ub_558_CM 1 100. 0. 204. DISPLAY_IDENTIFIER ESPR ECU_ADDRESS 0xd000e3ed FORMAT "%5.2" /end MEASUREMENT
/begin MEASUREMENT Espr_last "" UBYTE _CNV_R_R_Def_spr_ub_558_CM 1 100. 0. 204. DISPLAY_IDENTIFIER ESPR_LAST ECU_ADDRESS 0xd000e41c FORMAT "%5.2" /end MEASUREMENT
/begin MEASUREMENT Espr_norm "" UBYTE _CNV_R_R_Def_spr_ub_558_CM 1 100. 0. 204. DISPLAY_IDENTIFIER ESPR_NORM ECU_ADDRESS 0xd000e416 FORMAT "%5.2" /end MEASUREMENT
/begin MEASUREMENT Espr_ramp "" SWORD _CNV_R_R_Def_spr_sw_561_CM 1 100. 0. 180. DISPLAY_IDENTIFIER ESPR_RAMP ECU_ADDRESS 0xd000e454 FORMAT "%7.2" /end MEASUREMENT
/begin MEASUREMENT Espr_vl1 "" UBYTE _CNV_R_R_Def_spr_ub_558_CM 1 100. 0. 204. DISPLAY_IDENTIFIER ESPR_VL1 ECU_ADDRESS 0xd000e418 FORMAT "%5.2" /end MEASUREMENT
/begin MEASUREMENT Espr_vl2 "" UBYTE _CNV_R_R_Def_spr_ub_558_CM 1 100. 0. 204. DISPLAY_IDENTIFIER ESPR_VL2 ECU_ADDRESS 0xd000e419 FORMAT "%5.2" /end MEASUREMENT
/begin MEASUREMENT Espr_vs "" UWORD _CNV_R_R_Def_spr_sw_561_CM 1 100. 0. 6553.5 DISPLAY_IDENTIFIER ESPR_VS ECU_ADDRESS 0xd000e450 FORMAT "%7.2" /end MEASUREMENT
/begin MEASUREMENT Esprhs "Einlassspreizung Teillast, Homogen_Schicht" UBYTE _CNV_R_R_Def_spr_ub_558_CM 1 100. 0. 204. DISPLAY_IDENTIFIER ESPRHS ECU_ADDRESS 0xd000e44c FORMAT "%5.2" /end MEASUREMENT
/begin MEASUREMENT Esprimx "Max. der Isteinlassspreizung" UWORD _CNV_R_R_Def_spr_sw_561_CM 1 100. 0. 6553.5 DISPLAY_IDENTIFIER ESPRIMX ECU_ADDRESS 0xd000e436 FORMAT "%7.2" /end MEASUREMENT
/begin MEASUREMENT Esprl "Einlassspreizung im Leerlauf gedrosselt" UBYTE _CNV_R_R_Def_spr_ub_558_CM 1 100. 0. 204. DISPLAY_IDENTIFIER ESPRL ECU_ADDRESS 0xd000e3ea FORMAT "%5.2" /end MEASUREMENT
/begin MEASUREMENT Esprlast "" UBYTE _CNV_R_R_Def_spr_ub_558_CM 1 100. 0. 204. DISPLAY_IDENTIFIER ESPRLAST ECU_ADDRESS 0xd000e41d FORMAT "%5.2" /end MEASUREMENT
/begin MEASUREMENT Esprlhs "Einlassspreizung Leerlauf, Homogen_Schicht" UBYTE _CNV_R_R_Def_spr_ub_558_CM 1 100. 0. 204. DISPLAY_IDENTIFIER ESPRLHS ECU_ADDRESS 0xd000e44b FORMAT "%5.2" /end MEASUREMENT
/begin MEASUREMENT Esprll "" UBYTE _CNV_R_R_Def_spr_ub_558_CM 1 100. 0. 204. DISPLAY_IDENTIFIER ESPRLL ECU_ADDRESS 0xd000e420 FORMAT "%5.2" /end MEASUREMENT
/begin MEASUREMENT Esprll_kh "KH-Spreizung EINLASS-LL" UBYTE _CNV_R_R_Def_spr_ub_558_CM 1 100. 0. 204. DISPLAY_IDENTIFIER ESPRLL_KH ECU_ADDRESS 0xd000e412 FORMAT "%5.2" /end MEASUREMENT
/begin MEASUREMENT Esprlu "Einlassspreizung im Leerlauf ungedrosselt" UBYTE _CNV_R_R_Def_spr_ub_558_CM 1 100. 0. 204. DISPLAY_IDENTIFIER ESPRLU ECU_ADDRESS 0xd000e3eb FORMAT "%5.2" /end MEASUREMENT
/begin MEASUREMENT Esprt "Einlassspreizung teilgedrosselt" UBYTE _CNV_R_R_Def_spr_ub_558_CM 1 100. 0. 204. DISPLAY_IDENTIFIER ESPRT ECU_ADDRESS 0xd000e438 FORMAT "%5.2" /end MEASUREMENT
/begin MEASUREMENT Esprtl_kh "KH-Spreizung EINLASS-TL" UBYTE _CNV_R_R_Def_spr_ub_558_CM 1 100. 0. 204. DISPLAY_IDENTIFIER ESPRTL_KH ECU_ADDRESS 0xd000e413 FORMAT "%5.2" /end MEASUREMENT
/begin MEASUREMENT Espru "Einlassspreizung ungedrosselt" UBYTE _CNV_R_R_Def_spr_ub_558_CM 1 100. 0. 204. DISPLAY_IDENTIFIER ESPRU ECU_ADDRESS 0xd000e439 FORMAT "%5.2" /end MEASUREMENT
/begin MEASUREMENT Estk "optimale Einlassspreizung teilgedrosselt kalt" UBYTE _CNV_R_R_Def_spr_ub_558_CM 1 100. 0. 204. DISPLAY_IDENTIFIER ESTK ECU_ADDRESS 0xd000e43a FORMAT "%5.2" /end MEASUREMENT
/begin MEASUREMENT Estw "optimale Einlassspreizung teilgedrosselt warm" UBYTE _CNV_R_R_Def_spr_ub_558_CM 1 100. 0. 204. DISPLAY_IDENTIFIER ESTW ECU_ADDRESS 0xd000e43b FORMAT "%5.2" /end MEASUREMENT
/begin MEASUREMENT Esuesp "Hier koennte ihr Langbezeichner stehen" UBYTE _CNV_R_R_Def_spr_ub_558_CM 1 100. 0. 204. DISPLAY_IDENTIFIER ESUESP ECU_ADDRESS 0xd000e434 FORMAT "%5.2" /end MEASUREMENT
/begin MEASUREMENT Esw "optimale Einlassspreizung ungedrosselt warm" UBYTE _CNV_R_R_Def_spr_ub_558_CM 1 100. 0. 204. DISPLAY_IDENTIFIER ESW ECU_ADDRESS 0xd000e43c FORMAT "%5.2" /end MEASUREMENT
/begin MEASUREMENT Eswll "optimale Einlassspreizung ungedrosselt warm im Leerlauf" UBYTE _CNV_R_R_Def_spr_ub_558_CM 1 100. 0. 204. DISPLAY_IDENTIFIER ESWLL ECU_ADDRESS 0xd000e43d FORMAT "%5.2" /end MEASUREMENT
/begin MEASUREMENT Eta_mdkh "Wirkungsgrad bei Katheizen" SWORD _CNV_R_R_Def_eta_sw_599_CM 1 100. -200. 199.9938 DISPLAY_IDENTIFIER ETA_MDKH ECU_ADDRESS 0xc0007b5a FORMAT "%8.3" /end MEASUREMENT
/begin MEASUREMENT Etl_kh "" UBYTE _CNV_R_R_Def_spr_ub_558_CM 1 100. 0. 204. DISPLAY_IDENTIFIER ETL_KH ECU_ADDRESS 0xd000e403 FORMAT "%5.2" /end MEASUREMENT
/begin MEASUREMENT Etl_kh_2 "" UBYTE _CNV_R_R_Def_spr_ub_558_CM 1 100. 0. 204. DISPLAY_IDENTIFIER ETL_KH_2 ECU_ADDRESS 0xd000e404 FORMAT "%5.2" /end MEASUREMENT
/begin MEASUREMENT Etl_kh_3 "" UBYTE _CNV_R_R_Def_spr_ub_558_CM 1 100. 0. 204. DISPLAY_IDENTIFIER ETL_KH_3 ECU_ADDRESS 0xd000e405 FORMAT "%5.2" /end MEASUREMENT
/begin MEASUREMENT Etlk_kh "" UBYTE _CNV_R_R_Def_spr_ub_558_CM 1 100. 0. 204. DISPLAY_IDENTIFIER ETLK_KH ECU_ADDRESS 0xd000e3ff FORMAT "%5.2" /end MEASUREMENT
/begin MEASUREMENT Etlk_kh_2 "" UBYTE _CNV_R_R_Def_spr_ub_558_CM 1 100. 0. 204. DISPLAY_IDENTIFIER ETLK_KH_2 ECU_ADDRESS 0xd000e401 FORMAT "%5.2" /end MEASUREMENT
/begin MEASUREMENT Etlw_kh "" UBYTE _CNV_R_R_Def_spr_ub_558_CM 1 100. 0. 204. DISPLAY_IDENTIFIER ETLW_KH ECU_ADDRESS 0xd000e400 FORMAT "%5.2" /end MEASUREMENT
/begin MEASUREMENT Etlw_kh_2 "" UBYTE _CNV_R_R_Def_spr_ub_558_CM 1 100. 0. 204. DISPLAY_IDENTIFIER ETLW_KH_2 ECU_ADDRESS 0xd000e402 FORMAT "%5.2" /end MEASUREMENT
/begin MEASUREMENT F_easwll "" UBYTE _CNV_R_R_Def_f_ub_b_553_CM 1 100. 0. 0.996 DISPLAY_IDENTIFIER F_EASWLL ECU_ADDRESS 0xc0007b58 /end MEASUREMENT
/begin MEASUREMENT F_easwll_hs "" UBYTE _CNV_R_R_Def_f_ub_b_553_CM 1 100. 0. 0.996 DISPLAY_IDENTIFIER F_EASWLL_HS ECU_ADDRESS 0xd000e448 /end MEASUREMENT
/begin MEASUREMENT F_easwll_s "" UBYTE _CNV_R_R_Def_f_ub_b_553_CM 1 100. 0. 0.996 DISPLAY_IDENTIFIER F_EASWLL_S ECU_ADDRESS 0xc0007b59 /end MEASUREMENT
/begin MEASUREMENT F_wnwkh_aus "" UBYTE _CNV_R_R_Def_f_ub_b_553_CM 1 100. 0. 0.996 DISPLAY_IDENTIFIER F_WNWKH_AUS ECU_ADDRESS 0xc0007b5c /end MEASUREMENT
/begin MEASUREMENT Fashsw_aus "" UBYTE _CNV_R_R_Def_f_ub_b_553_CM 1 100. 0. 0.996 DISPLAY_IDENTIFIER FASHSW_AUS ECU_ADDRESS 0xd000e44a /end MEASUREMENT
/begin MEASUREMENT Fastw_aus "Faktor Auslass teilgedrosselt" UBYTE _CNV_R_R_Def_f_ub_b_553_CM 1 100. 0. 0.996 DISPLAY_IDENTIFIER FASTW_AUS ECU_ADDRESS 0xc0007b5d /end MEASUREMENT
/begin MEASUREMENT Fasw_aus "Faktor Auslass ungedrosselt" UBYTE _CNV_R_R_Def_f_ub_b_553_CM 1 100. 0. 0.996 DISPLAY_IDENTIFIER FASW_AUS ECU_ADDRESS 0xc0007b5f /end MEASUREMENT
/begin MEASUREMENT Feshsw_aus "" UBYTE _CNV_R_R_Def_f_ub_b_553_CM 1 100. 0. 0.996 DISPLAY_IDENTIFIER FESHSW_AUS ECU_ADDRESS 0xd000e449 /end MEASUREMENT
/begin MEASUREMENT Festw_aus "Faktor Einlass teilgedrosselt" UBYTE _CNV_R_R_Def_f_ub_b_553_CM 1 100. 0. 0.996 DISPLAY_IDENTIFIER FESTW_AUS ECU_ADDRESS 0xc0007b5e /end MEASUREMENT
/begin MEASUREMENT Fesw_aus "Faktor Einlass ungedrosselt" UBYTE _CNV_R_R_Def_f_ub_b_553_CM 1 100. 0. 0.996 DISPLAY_IDENTIFIER FESW_AUS ECU_ADDRESS 0xc0007b60 /end MEASUREMENT
/begin MEASUREMENT Gen_arraycnt_nv "" UBYTE _CNV_R_R_Def_dez_sl_551_CM 1 100. 0. 29. DISPLAY_IDENTIFIER GEN_ARRAYCNT_NV ECU_ADDRESS 0xc000456e FORMAT "%3.0" /end MEASUREMENT
/begin MEASUREMENT Gen_arraycntx "" UBYTE _CNV_R_R_Def_dez_sl_551_CM 1 100. 0. 255. DISPLAY_IDENTIFIER GEN_ARRAYCNTX ECU_ADDRESS 0xc000092e FORMAT "%3.0" /end MEASUREMENT
/begin MEASUREMENT Gen_arraycnty "" UBYTE _CNV_R_R_Def_dez_sl_551_CM 1 100. 0. 255. DISPLAY_IDENTIFIER GEN_ARRAYCNTY ECU_ADDRESS 0xc000092f FORMAT "%3.0" /end MEASUREMENT
/begin MEASUREMENT Gen_arraycntz "" UBYTE _CNV_R_R_Def_dez_sl_551_CM 1 100. 0. 255. DISPLAY_IDENTIFIER GEN_ARRAYCNTZ ECU_ADDRESS 0xc0000930 FORMAT "%3.0" /end MEASUREMENT
/begin MEASUREMENT Gen_arrayerr_nv "" UBYTE _CNV_R_R_Def_dez_sl_551_CM 1 100. 0. 255. DISPLAY_IDENTIFIER GEN_ARRAYERR_NV ECU_ADDRESS 0xc0004570 FORMAT "%3.0" ARRAY_SIZE 30 MATRIX_DIM 30 1 1 /end MEASUREMENT
/begin MEASUREMENT Gen_arraygrenzerrnz "" UBYTE _CNV_R_R_Def_dez_sl_551_CM 1 100. 0. 255. DISPLAY_IDENTIFIER GEN_ARRAYGRENZERRNZ ECU_ADDRESS 0xc0000931 FORMAT "%3.0" /end MEASUREMENT
/begin MEASUREMENT Gen_arraygrenzerrxy "" UBYTE _CNV_R_R_Def_dez_sl_551_CM 1 100. 0. 255. DISPLAY_IDENTIFIER GEN_ARRAYGRENZERRXY ECU_ADDRESS 0xc0000932 FORMAT "%3.0" /end MEASUREMENT
/begin MEASUREMENT Gen_arraygrenzn_sum "" UWORD _CNV_R_R_Def_i_uw_q_630_CM 1 100. 0. 8191.875 DISPLAY_IDENTIFIER GEN_ARRAYGRENZN_SUM ECU_ADDRESS 0xc0000908 FORMAT "%8.3" /end MEASUREMENT
/begin MEASUREMENT Gen_arraygrenznerrn "" UBYTE _CNV_R_R_Def_dez_sl_551_CM 1 100. 0. 255. DISPLAY_IDENTIFIER GEN_ARRAYGRENZNERRN ECU_ADDRESS 0xc0000933 FORMAT "%3.0" /end MEASUREMENT
/begin MEASUREMENT Gen_arraygrenznz_sum "" UWORD _CNV_R_R_Def_i_uw_q_630_CM 1 100. 0. 8191.875 DISPLAY_IDENTIFIER GEN_ARRAYGRENZNZ_SUM ECU_ADDRESS 0xc000090a FORMAT "%8.3" /end MEASUREMENT
/begin MEASUREMENT Gen_arraygrenzxy_sum "" UWORD _CNV_R_R_Def_i_uw_q_630_CM 1 100. 0. 8191.875 DISPLAY_IDENTIFIER GEN_ARRAYGRENZXY_SUM ECU_ADDRESS 0xc000090c FORMAT "%8.3" /end MEASUREMENT
/begin MEASUREMENT Gen_arrayierrg_nv "" UBYTE _CNV_R_R_Def_i_uw_q_630_CM 1 100. 0. 31.875 DISPLAY_IDENTIFIER GEN_ARRAYIERRG_NV ECU_ADDRESS 0xc0004590 ARRAY_SIZE 30 MATRIX_DIM 30 1 1 /end MEASUREMENT
/begin MEASUREMENT Gen_arrayub_nv "" UBYTE _CNV_R_R_Def_u_ub_q_631_CM 1 100. 0. 25.5 DISPLAY_IDENTIFIER GEN_ARRAYUB_NV ECU_ADDRESS 0xc00045b0 FORMAT "%5.2" ARRAY_SIZE 30 MATRIX_DIM 30 1 1 /end MEASUREMENT
/begin MEASUREMENT Gen_arrayuberrn "" UBYTE _CNV_R_R_Def_dez_sl_551_CM 1 100. 0. 255. DISPLAY_IDENTIFIER GEN_ARRAYUBERRN ECU_ADDRESS 0xc0000934 FORMAT "%3.0" /end MEASUREMENT
/begin MEASUREMENT Gen_arrayuberrnz "" UBYTE _CNV_R_R_Def_dez_sl_551_CM 1 100. 0. 255. DISPLAY_IDENTIFIER GEN_ARRAYUBERRNZ ECU_ADDRESS 0xc0000935 FORMAT "%3.0" /end MEASUREMENT
/begin MEASUREMENT Gen_arrayuberrxy "" UBYTE _CNV_R_R_Def_dez_sl_551_CM 1 100. 0. 255. DISPLAY_IDENTIFIER GEN_ARRAYUBERRXY ECU_ADDRESS 0xc0000936 FORMAT "%3.0" /end MEASUREMENT
/begin MEASUREMENT Gen_arrayubn_sum "" UWORD _CNV_R_R_Def_u_ub_q_631_CM 1 100. 0. 6553.5 DISPLAY_IDENTIFIER GEN_ARRAYUBN_SUM ECU_ADDRESS 0xc000090e FORMAT "%8.3" /end MEASUREMENT
/begin MEASUREMENT Gen_arrayubnz_sum "" UWORD _CNV_R_R_Def_u_ub_q_631_CM 1 100. 0. 6553.5 DISPLAY_IDENTIFIER GEN_ARRAYUBNZ_SUM ECU_ADDRESS 0xc0000910 FORMAT "%8.3" /end MEASUREMENT
/begin MEASUREMENT Gen_arrayubxy_sum "" UWORD _CNV_R_R_Def_u_ub_q_631_CM 1 100. 0. 6553.5 DISPLAY_IDENTIFIER GEN_ARRAYUBXY_SUM ECU_ADDRESS 0xc0000912 FORMAT "%8.3" /end MEASUREMENT
/begin MEASUREMENT Gen_arrayugen_nv "" UBYTE _CNV_R_R_Def_u_ub_q_631_CM 1 100. 0. 25.5 DISPLAY_IDENTIFIER GEN_ARRAYUGEN_NV ECU_ADDRESS 0xc00045d0 FORMAT "%5.2" ARRAY_SIZE 30 MATRIX_DIM 30 1 1 /end MEASUREMENT
/begin MEASUREMENT Gen_arrayugenerrn "" UBYTE _CNV_R_R_Def_dez_sl_551_CM 1 100. 0. 255. DISPLAY_IDENTIFIER GEN_ARRAYUGENERRN ECU_ADDRESS 0xc0000937 FORMAT "%3.0" /end MEASUREMENT
/begin MEASUREMENT Gen_arrayugenerrnz "" UBYTE _CNV_R_R_Def_dez_sl_551_CM 1 100. 0. 255. DISPLAY_IDENTIFIER GEN_ARRAYUGENERRNZ ECU_ADDRESS 0xc0000938 FORMAT "%3.0" /end MEASUREMENT
/begin MEASUREMENT Gen_arrayugenerrxy "" UBYTE _CNV_R_R_Def_dez_sl_551_CM 1 100. 0. 255. DISPLAY_IDENTIFIER GEN_ARRAYUGENERRXY ECU_ADDRESS 0xc0000939 FORMAT "%3.0" /end MEASUREMENT
/begin MEASUREMENT Gen_arrayugenn_sum "" UWORD _CNV_R_R_Def_u_ub_q_631_CM 1 100. 0. 6553.5 DISPLAY_IDENTIFIER GEN_ARRAYUGENN_SUM ECU_ADDRESS 0xc0000914 FORMAT "%8.3" /end MEASUREMENT
/begin MEASUREMENT Gen_arrayugennz_sum "" UWORD _CNV_R_R_Def_u_ub_q_631_CM 1 100. 0. 6553.5 DISPLAY_IDENTIFIER GEN_ARRAYUGENNZ_SUM ECU_ADDRESS 0xc0000916 FORMAT "%8.3" /end MEASUREMENT
/begin MEASUREMENT Gen_arrayugenxy_sum "" UWORD _CNV_R_R_Def_u_ub_q_631_CM 1 100. 0. 6553.5 DISPLAY_IDENTIFIER GEN_ARRAYUGENXY_SUM ECU_ADDRESS 0xc0000918 FORMAT "%8.3" /end MEASUREMENT
/begin MEASUREMENT Gen_awnumm "Generatorkennfeldnummer" UBYTE _CNV_R_R_Def_dez_sl_551_CM 1 100. 1. 7. DISPLAY_IDENTIFIER GEN_AWNUMM ECU_ADDRESS 0xc00045f8 FORMAT "%3.0" /end MEASUREMENT
/begin MEASUREMENT Gen_count "" UBYTE _CNV_R_R_Def_dez_sl_551_CM 1 100. 0. 255. DISPLAY_IDENTIFIER GEN_COUNT ECU_ADDRESS 0xc000093a FORMAT "%3.0" /end MEASUREMENT
/begin MEASUREMENT Gen_count_1min "" UBYTE _CNV_R_R_Def_dez_sl_551_CM 1 100. 0. 255. DISPLAY_IDENTIFIER GEN_COUNT_1MIN ECU_ADDRESS 0xc000093b FORMAT "%3.0" /end MEASUREMENT
/begin MEASUREMENT Gen_fbsak "BSD Uebertragungsfehler kodiert fuer FSPVDGEN" UBYTE _CNV_R_R_Def_dez_sl_551_CM 1 100. 0. 255. DISPLAY_IDENTIFIER GEN_FBSAK ECU_ADDRESS 0xc000093c FORMAT "%3.0" /end MEASUREMENT
/begin MEASUREMENT Gen_ierrgrenz "" UWORD _CNV_R_R_Def_i_uw_q_630_CM 1 100. 0. 8191.875 DISPLAY_IDENTIFIER GEN_IERRGRENZ ECU_ADDRESS 0xc000091a FORMAT "%8.3" /end MEASUREMENT
/begin MEASUREMENT Gen_ierrgrenz_1min "" UWORD _CNV_R_R_Def_i_uw_q_630_CM 1 100. 0. 8191.875 DISPLAY_IDENTIFIER GEN_IERRGRENZ_1MIN ECU_ADDRESS 0xc000091c FORMAT "%8.3" /end MEASUREMENT
/begin MEASUREMENT Gen_stat2_div "Divisor für Statistik2" UBYTE _CNV_R_R_Def_dez_sl_551_CM 1 100. 0. 255. DISPLAY_IDENTIFIER GEN_STAT2_DIV ECU_ADDRESS 0xc000093d FORMAT "%3.0" /end MEASUREMENT
/begin MEASUREMENT Gen_statroh "Generatorfehler kodiert fuer FSPVDGEN" UBYTE _CNV_R_R_Def_dez_sl_551_CM 1 100. 0. 255. DISPLAY_IDENTIFIER GEN_STATROH ECU_ADDRESS 0xc000093e FORMAT "%3.0" /end MEASUREMENT
/begin MEASUREMENT Gen_ub "" UWORD _CNV_R_R_Def_u_sb_q_583_CM 1 100. 0. 6173.397 DISPLAY_IDENTIFIER GEN_UB ECU_ADDRESS 0xc000091e FORMAT "%6.1" /end MEASUREMENT
/begin MEASUREMENT Gen_ub_1min "" UWORD _CNV_R_R_Def_u_sb_q_583_CM 1 100. 0. 6173.397 DISPLAY_IDENTIFIER GEN_UB_1MIN ECU_ADDRESS 0xc0000920 FORMAT "%6.1" /end MEASUREMENT
/begin MEASUREMENT Gen_uebsetz "Generatoruebersetzung" UBYTE _CNV_R_R_Def_f_ub_b_632_CM 1 100. 1.57e-002 3.9843 DISPLAY_IDENTIFIER GEN_UEBSETZ ECU_ADDRESS 0xd000d85c FORMAT "%5.2" /end MEASUREMENT
/begin MEASUREMENT Gen_ugen "" UWORD _CNV_R_R_Def_u_ub_q_631_CM 1 100. 0. 6553.5 DISPLAY_IDENTIFIER GEN_UGEN ECU_ADDRESS 0xc0000922 FORMAT "%8.3" /end MEASUREMENT
/begin MEASUREMENT Gen_ugen_1min "" UWORD _CNV_R_R_Def_u_ub_q_631_CM 1 100. 0. 6553.5 DISPLAY_IDENTIFIER GEN_UGEN_1MIN ECU_ADDRESS 0xc0000924 FORMAT "%8.3" /end MEASUREMENT
/begin MEASUREMENT Genitest_tol "" UBYTE _CNV_R_R_Def_f_ub_b_586_CM 1 100. 0. 99.60930000000001 DISPLAY_IDENTIFIER GENITEST_TOL ECU_ADDRESS 0xc0000bba FORMAT "%5.2" /end MEASUREMENT
/begin MEASUREMENT Geniutest_ab "" UBYTE _CNV_R_R_Def_dez_sl_551_CM 1 100. 0. 255. DISPLAY_IDENTIFIER GENIUTEST_AB ECU_ADDRESS 0xc0000bbb FORMAT "%3.0" /end MEASUREMENT
/begin MEASUREMENT Geniutest_err "" UBYTE _CNV_R_R_Def_dez_sl_551_CM 1 100. 0. 255. DISPLAY_IDENTIFIER GENIUTEST_ERR ECU_ADDRESS 0xc0000bbc FORMAT "%3.0" /end MEASUREMENT
/begin MEASUREMENT Gensatzsum_akt "" UWORD _CNV_R_R_Def_dez_sl_551_CM 1 100. 0. 65535. DISPLAY_IDENTIFIER GENSATZSUM_AKT ECU_ADDRESS 0xc0000926 FORMAT "%5.0" /end MEASUREMENT
/begin MEASUREMENT Gensatzsum_eintrag "" UWORD _CNV_R_R_Def_dez_sl_551_CM 1 100. 0. 65535. DISPLAY_IDENTIFIER GENSATZSUM_EINTRAG ECU_ADDRESS 0xc0000928 FORMAT "%5.0" /end MEASUREMENT
/begin MEASUREMENT Genutest_tol "" UBYTE _CNV_R_R_Def_f_ub_b_586_CM 1 100. 0. 99.60930000000001 DISPLAY_IDENTIFIER GENUTEST_TOL ECU_ADDRESS 0xc0000bbd FORMAT "%5.2" /end MEASUREMENT
/begin MEASUREMENT I_gen "Generatorstrom" UBYTE _CNV_R_R_Def_ql_ub__573_CM 1 100. 0. 255. DISPLAY_IDENTIFIER I_GEN ECU_ADDRESS 0xd000d85d /end MEASUREMENT
/begin MEASUREMENT I_gen_g "Generatorstrom gesamt" UBYTE _CNV_R_R_Def_ql_ub__573_CM 1 100. 0. 255. DISPLAY_IDENTIFIER I_GEN_G ECU_ADDRESS 0xd000d873 /end MEASUREMENT
/begin MEASUREMENT I_gen_nafil "Generatorstrom nach Filter" UWORD _CNV_R_R_Def_i_uw_q_638_CM 1 100. 0. 256. DISPLAY_IDENTIFIER I_GEN_NAFIL ECU_ADDRESS 0xd000d868 FORMAT "%8.3" /end MEASUREMENT
/begin MEASUREMENT I_gen_vorfil "Generatorstrom vor Filter" UWORD _CNV_R_R_Def_i_uw_q_638_CM 1 100. 0. 256. DISPLAY_IDENTIFIER I_GEN_VORFIL ECU_ADDRESS 0xd000d86a FORMAT "%8.3" /end MEASUREMENT
/begin MEASUREMENT I_genm "" UBYTE _CNV_R_R_Def_ql_ub__573_CM 1 100. 0. 255. DISPLAY_IDENTIFIER I_GENM ECU_ADDRESS 0xc0000bbe /end MEASUREMENT
/begin MEASUREMENT I_genmax "korrigiertes DF Signal ueber Temperatur, Generatordrehzahl, Generatorspannung" UBYTE _CNV_R_R_Def_ql_ub__573_CM 1 100. 0. 255. DISPLAY_IDENTIFIER I_GENMAX ECU_ADDRESS 0xd000d85e /end MEASUREMENT
/begin MEASUREMENT I_gentest "" UBYTE _CNV_R_R_Def_ql_ub__573_CM 1 100. 0. 255. DISPLAY_IDENTIFIER I_GENTEST ECU_ADDRESS 0xc0000bbf /end MEASUREMENT
/begin MEASUREMENT I_gentmp "Temporäre Größe zur Generatorstromberechnung" UWORD _CNV_R_R_Def_i_uw_q_638_CM 1 100. 0. 256. DISPLAY_IDENTIFIER I_GENTMP ECU_ADDRESS 0xd000d86c FORMAT "%8.3" /end MEASUREMENT
/begin MEASUREMENT I_gentp "Temporäre Größe zur Generatorstromberechnung" UWORD _CNV_R_R_Def_i_uw_q_638_CM 1 100. 0. 256. DISPLAY_IDENTIFIER I_GENTP ECU_ADDRESS 0xd000d86e FORMAT "%8.3" /end MEASUREMENT
/begin MEASUREMENT Ierr_fil "Gefilterter Erregerstrom" UBYTE _CNV_R_R_Def_i_uw_q_630_CM 1 100. 0. 31.875 DISPLAY_IDENTIFIER IERR_FIL ECU_ADDRESS 0xc0007a24 /end MEASUREMENT
/begin MEASUREMENT Ierrgrenz_ht "Grenzerregerstrom durch Überhitzung Dioden" UBYTE _CNV_R_R_Def_i_uw_q_630_CM 1 100. 0. 31.875 DISPLAY_IDENTIFIER IERRGRENZ_HT ECU_ADDRESS 0xd000d8f8 /end MEASUREMENT
/begin MEASUREMENT Ierrgrenz_ll "Grenzerregerstrombegrenzung Generator" UBYTE _CNV_R_R_Def_i_uw_q_630_CM 1 100. 0. 31.875 DISPLAY_IDENTIFIER IERRGRENZ_LL ECU_ADDRESS 0xd000d8b1 /end MEASUREMENT
/begin MEASUREMENT Igenk "Generatorstrom aufsummiert im Sekundentakt" FLOAT32_IEEE _CNV_R_R_Def_dez_sl_551_CM 1 100. -3.e+038 3.e+038 DISPLAY_IDENTIFIER IGENK ECU_ADDRESS 0xc00046b2 FORMAT "%14.7" /end MEASUREMENT
/begin MEASUREMENT Kf_iu1 "Ausgang Kennfeldipol 1" SWORD _CNV_R_R_Def_i_sw_q_645_CM 1 100. -1024. 1023.9687 DISPLAY_IDENTIFIER KF_IU1 ECU_ADDRESS 0xc0000950 FORMAT "%8.3" /end MEASUREMENT
/begin MEASUREMENT Kf_iu2 "Ausgang Kennfeldipol 2" SWORD _CNV_R_R_Def_i_sw_q_645_CM 1 100. -1024. 1023.9687 DISPLAY_IDENTIFIER KF_IU2 ECU_ADDRESS 0xc0000952 FORMAT "%8.3" /end MEASUREMENT
/begin MEASUREMENT Kf_iu3 "Ausgang Kennfeldipol 3" SWORD _CNV_R_R_Def_i_sw_q_645_CM 1 100. -1024. 1023.9687 DISPLAY_IDENTIFIER KF_IU3 ECU_ADDRESS 0xc0000954 FORMAT "%8.3" /end MEASUREMENT
/begin MEASUREMENT Md_gen_roh "Rohwert Generatormoment vor Filterung" SWORD _CNV_R_R_Def_m_sw_q_554_CM 1 100. -3276.8 3276.7 DISPLAY_IDENTIFIER MD_GEN_ROH ECU_ADDRESS 0xd000d862 FORMAT "%7.2" /end MEASUREMENT
/begin MEASUREMENT Md_genfil "gefiltertes Generatormoment absolut" SWORD _CNV_R_R_Def_m_sw_q_554_CM 1 100. -3276.8 3276.7 DISPLAY_IDENTIFIER MD_GENFIL ECU_ADDRESS 0xd000d864 FORMAT "%7.2" /end MEASUREMENT
/begin MEASUREMENT Md_gennm "gefiltertes Generatormoment absolut Ausgang" SWORD _CNV_R_R_Def_m_sw_q_554_CM 1 100. -3276.8 3276.7 DISPLAY_IDENTIFIER MD_GENNM ECU_ADDRESS 0xd000d84e FORMAT "%7.2" /end MEASUREMENT
/begin MEASUREMENT Md_gennm_end "temporäre Grösse Generatormomentberechnung" SWORD _CNV_R_R_Def_m_sw_q_554_CM 1 100. -3276.8 3276.7 DISPLAY_IDENTIFIER MD_GENNM_END ECU_ADDRESS 0xd000d866 FORMAT "%7.2" /end MEASUREMENT
/begin MEASUREMENT Md_gennmtp "Ungefiltertes unkorrigiertes Generatormoment" SWORD _CNV_R_R_Def_m_sw_q_554_CM 1 100. -3276.8 3276.7 DISPLAY_IDENTIFIER MD_GENNMTP ECU_ADDRESS 0xd000d850 FORMAT "%7.2" /end MEASUREMENT
/begin MEASUREMENT Md_genrel "relatives Generatormoment Ausgang" UWORD _CNV_R_R_Def_f_uw_b_555_CM 1 100. 0. 99.9984 DISPLAY_IDENTIFIER MD_GENREL ECU_ADDRESS 0xd000d870 FORMAT "%8.3" /end MEASUREMENT
/begin MEASUREMENT Md_genvf "relatives Generatordrehmoment" UWORD _CNV_R_R_Def_f_uw_b_555_CM 1 100. 0. 99.9984 DISPLAY_IDENTIFIER MD_GENVF ECU_ADDRESS 0xd000d858 FORMAT "%8.3" /end MEASUREMENT
/begin MEASUREMENT N_gen "Generatordrehzahl" SWORD _CNV_R_R_Def_n_sw_q_595_CM 1 100. 0. 32767. DISPLAY_IDENTIFIER N_GEN ECU_ADDRESS 0xd000d852 FORMAT "%5.0" /end MEASUREMENT
/begin MEASUREMENT N_gen_tmp "Temporäre Generatordrehzahl" SWORD _CNV_R_R_Def_n_sw_q_595_CM 1 100. 0. 32767. DISPLAY_IDENTIFIER N_GEN_TMP ECU_ADDRESS 0xd000d854 FORMAT "%5.0" /end MEASUREMENT
/begin MEASUREMENT N_nstart "Motordrehzahl nach Motorstart" SWORD _CNV_R_R_Def_n_sw_q_595_CM 1 100. -32768. 32767. DISPLAY_IDENTIFIER N_NSTART ECU_ADDRESS 0xd000d896 FORMAT "%5.0" /end MEASUREMENT
/begin MEASUREMENT Nelueft_gen "Drehzahlanforderung E-Lüfter Generator" UBYTE _CNV_R_R_Def_f_ub_b_586_CM 1 100. 0. 99.60930000000001 DISPLAY_IDENTIFIER NELUEFT_GEN ECU_ADDRESS 0xc0007aa1 FORMAT "%5.2" /end MEASUREMENT
/begin MEASUREMENT Nslb "N_soll Korrektur von Ladebilanz Batterie" SWORD _CNV_R_R_Def_n_sw_q_595_CM 1 100. 0. 32767. DISPLAY_IDENTIFIER NSLB ECU_ADDRESS 0xc0007a28 FORMAT "%5.0" /end MEASUREMENT
/begin MEASUREMENT Oz_anztoe "Anzahl Werte von Töns in der Sekunde" UBYTE _CNV_R_R_Def_dez_sl_551_CM 1 100. 0. 255. DISPLAY_IDENTIFIER OZ_ANZTOE ECU_ADDRESS 0xc00078b6 FORMAT "%3.0" /end MEASUREMENT
/begin MEASUREMENT Oz_diagtoens "Töns Diagnose Byte" UWORD _CNV_R_R_Def_dez_sl_551_CM 1 100. 0. 65535. DISPLAY_IDENTIFIER OZ_DIAGTOENS ECU_ADDRESS 0xc00078a0 FORMAT "%5.0" /end MEASUREMENT
/begin MEASUREMENT Oz_niv "Ölniveau ungefiltert" UBYTE _CNV_R_R_Def_niv_ub_667_CM 1 100. 0. 74.70699999999999 DISPLAY_IDENTIFIER OZ_NIV ECU_ADDRESS 0xc00078ae FORMAT "%5.2" /end MEASUREMENT
/begin MEASUREMENT Oz_nivqlt "Ölniveau QLT ungefiltert" UBYTE _CNV_R_R_Def_niv_ub_667_CM 1 100. 0. 74.70699999999999 DISPLAY_IDENTIFIER OZ_NIVQLT ECU_ADDRESS 0xc00078b7 FORMAT "%5.2" /end MEASUREMENT
/begin MEASUREMENT Oz_nivrers "Ersatzniveau-Rohwert" UBYTE _CNV_R_R_Def_dez_sl_551_CM 1 100. 0. 255. DISPLAY_IDENTIFIER OZ_NIVRERS ECU_ADDRESS 0xc00078b8 FORMAT "%3.0" /end MEASUREMENT
/begin MEASUREMENT Oz_nivt "begrenzter Niveau-Rohwert" UBYTE _CNV_R_R_Def_dez_sl_551_CM 1 100. 0. 255. DISPLAY_IDENTIFIER OZ_NIVT ECU_ADDRESS 0xc00078b9 FORMAT "%3.0" /end MEASUREMENT
/begin MEASUREMENT Oz_nivtoe "Ölniveau Töns ungefiltert" UBYTE _CNV_R_R_Def_niv_ub_667_CM 1 100. 0. 74.70699999999999 DISPLAY_IDENTIFIER OZ_NIVTOE ECU_ADDRESS 0xc000071a FORMAT "%5.2" /end MEASUREMENT
/begin MEASUREMENT Oz_perm "Permittivität ungefiltert" UWORD _CNV_R_R_Def_perm_u_674_CM 1 100. 0. 5.9999 DISPLAY_IDENTIFIER OZ_PERM ECU_ADDRESS 0xc00078aa FORMAT "%14.5" /end MEASUREMENT
/begin MEASUREMENT Oz_permakt "Permittivität für den Tester" UWORD _CNV_R_R_Def_perm_u_674_CM 1 100. 0. 5.9999 DISPLAY_IDENTIFIER OZ_PERMAKT ECU_ADDRESS 0xc00078ac FORMAT "%14.5" /end MEASUREMENT
/begin MEASUREMENT Oz_permerrz "Fehler-Zähler Permittivität" UBYTE _CNV_R_R_Def_dez_sl_551_CM 1 100. 0. 255. DISPLAY_IDENTIFIER OZ_PERMERRZ ECU_ADDRESS 0xc00040b0 FORMAT "%3.0" /end MEASUREMENT
/begin MEASUREMENT Oz_permt "begrenzter Permittivitäts-Rohwert" UWORD _CNV_R_R_Def_dez_sl_551_CM 1 100. 0. 1024. DISPLAY_IDENTIFIER OZ_PERMT ECU_ADDRESS 0xc00078b2 FORMAT "%5.0" /end MEASUREMENT
/begin MEASUREMENT Oz_perref "Ersatzpermittivität" UWORD _CNV_R_R_Def_dez_sl_551_CM 1 100. 0. 1024. DISPLAY_IDENTIFIER OZ_PERREF ECU_ADDRESS 0xc00040b4 FORMAT "%5.0" /end MEASUREMENT
/begin MEASUREMENT Oz_temp "Öltemperatur ungefiltert" SWORD _CNV_R_R_Def_t_sw_q_578_CM 1 100. -3276.8 3276.7 DISPLAY_IDENTIFIER OZ_TEMP ECU_ADDRESS 0xc00078a8 FORMAT "%6.1" /end MEASUREMENT
/begin MEASUREMENT Oz_tempakt "Ausgabe Öltemperatur für den Tester" SWORD _CNV_R_R_Def_t_sw_q_578_CM 1 100. -3276.8 3276.7 DISPLAY_IDENTIFIER OZ_TEMPAKT ECU_ADDRESS 0xc00078a4 FORMAT "%6.1" /end MEASUREMENT
/begin MEASUREMENT Oz_tempplz "Anzahl der unplausibel Sprünge QLT Temperatur" UBYTE _CNV_R_R_Def_dez_sl_551_CM 1 100. 0. 255. DISPLAY_IDENTIFIER OZ_TEMPPLZ ECU_ADDRESS 0xc00078a2 FORMAT "%3.0" /end MEASUREMENT
/begin MEASUREMENT Oz_tempqlt "Öltemperatur qlt ungefiltert" SWORD _CNV_R_R_Def_t_sw_q_578_CM 1 100. -3276.8 3276.7 DISPLAY_IDENTIFIER OZ_TEMPQLT ECU_ADDRESS 0xc00078b0 FORMAT "%6.1" /end MEASUREMENT
/begin MEASUREMENT Oz_temprold "Alte QLT Temperatur für die Plausibilisierung" UBYTE _CNV_R_R_Def_dez_sl_551_CM 1 100. 0. 255. DISPLAY_IDENTIFIER OZ_TEMPROLD ECU_ADDRESS 0xc00078a3 FORMAT "%3.0" /end MEASUREMENT
/begin MEASUREMENT Oz_tempt "begrenzter Temperatur-Rohwert" UWORD _CNV_R_R_Def_dez_sl_551_CM 1 100. 0. 65535. DISPLAY_IDENTIFIER OZ_TEMPT ECU_ADDRESS 0xc00078b4 FORMAT "%5.0" /end MEASUREMENT
/begin MEASUREMENT Oz_temptoe "Öltemperatur Töns ungefiltert" SWORD _CNV_R_R_Def_t_sw_q_578_CM 1 100. -3276.8 3276.7 DISPLAY_IDENTIFIER OZ_TEMPTOE ECU_ADDRESS 0xc0000718 FORMAT "%6.1" /end MEASUREMENT
/begin MEASUREMENT P_totdiode "Verlustleistung der Diode" UWORD _CNV_R_R_Def_f_uw_b_621_CM 1 100. 0. 255.996 DISPLAY_IDENTIFIER P_TOTDIODE ECU_ADDRESS 0xc0007ace FORMAT "%8.3" /end MEASUREMENT
/begin MEASUREMENT Pr_ierrllred "Prio Erregerstrombegrenzung durch LL Sägen" UBYTE _CNV_R_R_Def_dez_sl_551_CM 1 100. 0. 255. DISPLAY_IDENTIFIER PR_IERRLLRED ECU_ADDRESS 0xd000d8b2 FORMAT "%3.0" /end MEASUREMENT
/begin MEASUREMENT Pr_ierrtred "Prio Erregerstromanforderung wegen Hochtemperatur" UBYTE _CNV_R_R_Def_dez_sl_551_CM 1 100. 0. 255. DISPLAY_IDENTIFIER PR_IERRTRED ECU_ADDRESS 0xd000d8f9 FORMAT "%3.0" /end MEASUREMENT
/begin MEASUREMENT St_bldstg "Statuswort" UBYTE _CNV_R_R_Def_dez_sl_551_CM 1 100. 0. 255. DISPLAY_IDENTIFIER ST_BLDSTG ECU_ADDRESS 0xd000d894 FORMAT "%3.0" /end MEASUREMENT
/begin MEASUREMENT St_bldstg.B_ubeb_start "Bed. Motorstart für Startauswertung PM durch Erkennung Spannngseinbruch" UBYTE _CNV_S_2_Def_bit_ub_563_CM 1 100. 0. 1. DISPLAY_IDENTIFIER B_UBEB_START ECU_ADDRESS 0xd000d894 BIT_MASK 0x1 /end MEASUREMENT
/begin MEASUREMENT St_dgen0 "Statuswort" UBYTE _CNV_R_R_Def_dez_sl_551_CM 1 100. 0. 255. DISPLAY_IDENTIFIER ST_DGEN0 ECU_ADDRESS 0xd000d840 FORMAT "%3.0" /end MEASUREMENT
/begin MEASUREMENT St_dgen0.B_1stbsder "Statuswort" UBYTE _CNV_S_2_Def_bit_ub_563_CM 1 100. 0. 1. DISPLAY_IDENTIFIER B_1STBSDER ECU_ADDRESS 0xd000d840 BIT_MASK 0x1 /end MEASUREMENT
/begin MEASUREMENT St_dgen0.B_genfprl "Bedingung Generatorfehler entprellt" UBYTE _CNV_S_2_Def_bit_ub_563_CM 1 100. 0. 1. DISPLAY_IDENTIFIER B_GENFPRL ECU_ADDRESS 0xd000d840 BIT_MASK 0x4 /end MEASUREMENT
/begin MEASUREMENT St_dgen0.B_gfbsupak "Generator Typ unplausibel^aus Fehlerspeicher" UBYTE _CNV_S_2_Def_bit_ub_563_CM 1 100. 0. 1. DISPLAY_IDENTIFIER B_GFBSUPAK ECU_ADDRESS 0xd000d840 BIT_MASK 0x8 /end MEASUREMENT
/begin MEASUREMENT St_dgen0.B_gfelak "Generatorfehler elektrisch aus Fehlerspeicher" UBYTE _CNV_S_2_Def_bit_ub_563_CM 1 100. 0. 1. DISPLAY_IDENTIFIER B_GFELAK ECU_ADDRESS 0xd000d840 BIT_MASK 0x10 /end MEASUREMENT
/begin MEASUREMENT St_dgen0.B_gfhtak "Generatorfehler Uebertemperatur aus Fehlerspeicher" UBYTE _CNV_S_2_Def_bit_ub_563_CM 1 100. 0. 1. DISPLAY_IDENTIFIER B_GFHTAK ECU_ADDRESS 0xd000d840 BIT_MASK 0x20 /end MEASUREMENT
/begin MEASUREMENT St_dgen0.B_gfmeak "Generatorfehler mechanisch aus Fehlerspeicher" UBYTE _CNV_S_2_Def_bit_ub_563_CM 1 100. 0. 1. DISPLAY_IDENTIFIER B_GFMEAK ECU_ADDRESS 0xd000d840 BIT_MASK 0x40 /end MEASUREMENT
/begin MEASUREMENT St_dgen0.B_gfnobsak "Generator BSD Kommunikationsverlust aus Fehlerspeicher" UBYTE _CNV_S_2_Def_bit_ub_563_CM 1 100. 0. 1. DISPLAY_IDENTIFIER B_GFNOBSAK ECU_ADDRESS 0xd000d840 BIT_MASK 0x80 /end MEASUREMENT
/begin MEASUREMENT St_dgen0.B_kl61 "Bedingung Ladekontroll Laempchen an" UBYTE _CNV_S_2_Def_bit_ub_563_CM 1 100. 0. 1. DISPLAY_IDENTIFIER B_KL61 ECU_ADDRESS 0xd000d840 BIT_MASK 0x2 /end MEASUREMENT
/begin MEASUREMENT St_dgen1 "Statuswort" UBYTE _CNV_R_R_Def_dez_sl_551_CM 1 100. 0. 255. DISPLAY_IDENTIFIER ST_DGEN1 ECU_ADDRESS 0xd000d841 FORMAT "%3.0" /end MEASUREMENT
/begin MEASUREMENT St_dgen1.B_genudiag "Bedingung Unterspannung Generator" UBYTE _CNV_S_2_Def_bit_ub_563_CM 1 100. 0. 1. DISPLAY_IDENTIFIER B_GENUDIAG ECU_ADDRESS 0xd000d841 BIT_MASK 0x1 /end MEASUREMENT
/begin MEASUREMENT St_dgen_neu "Statuswort" UBYTE _CNV_R_R_Def_dez_sl_551_CM 1 100. 0. 255. DISPLAY_IDENTIFIER ST_DGEN_NEU ECU_ADDRESS 0xd000d842 FORMAT "%3.0" /end MEASUREMENT
/begin MEASUREMENT St_dgen_neu.B_dgenub2_err "Statuswort" UBYTE _CNV_S_2_Def_bit_ub_563_CM 1 100. 0. 1. DISPLAY_IDENTIFIER B_DGENUB2_ERR ECU_ADDRESS 0xd000d842 BIT_MASK 0x1 /end MEASUREMENT
/begin MEASUREMENT St_dgen_neu.B_en_gendiag "Disgnose Freigabe Gen.Fehler" UBYTE _CNV_S_2_Def_bit_ub_563_CM 1 100. 0. 1. DISPLAY_IDENTIFIER B_EN_GENDIAG ECU_ADDRESS 0xd000d842 BIT_MASK 0x2 /end MEASUREMENT
/begin MEASUREMENT St_dgen_neu.B_genfel_fs "Statuswort" UBYTE _CNV_S_2_Def_bit_ub_563_CM 1 100. 0. 1. DISPLAY_IDENTIFIER B_GENFEL_FS ECU_ADDRESS 0xd000d842 BIT_MASK 0x4 /end MEASUREMENT
/begin MEASUREMENT St_dgen_neu.B_genfht_fs "Statuswort" UBYTE _CNV_S_2_Def_bit_ub_563_CM 1 100. 0. 1. DISPLAY_IDENTIFIER B_GENFHT_FS ECU_ADDRESS 0xd000d842 BIT_MASK 0x8 /end MEASUREMENT
/begin MEASUREMENT St_dgen_neu.B_genfme_fs "Statuswort" UBYTE _CNV_S_2_Def_bit_ub_563_CM 1 100. 0. 1. DISPLAY_IDENTIFIER B_GENFME_FS ECU_ADDRESS 0xd000d842 BIT_MASK 0x10 /end MEASUREMENT
/begin MEASUREMENT St_dgen_neu.B_genhtb_fs "Statuswort" UBYTE _CNV_S_2_Def_bit_ub_563_CM 1 100. 0. 1. DISPLAY_IDENTIFIER B_GENHTB_FS ECU_ADDRESS 0xd000d842 BIT_MASK 0x20 /end MEASUREMENT
/begin MEASUREMENT St_dgen_neu.B_genregupl "Statuswort" UBYTE _CNV_S_2_Def_bit_ub_563_CM 1 100. 0. 1. DISPLAY_IDENTIFIER B_GENREGUPL ECU_ADDRESS 0xd000d842 BIT_MASK 0x40 /end MEASUREMENT
/begin MEASUREMENT St_dgen_neu.B_gensatz "Statuswort" UBYTE _CNV_S_2_Def_bit_ub_563_CM 1 100. 0. 1. DISPLAY_IDENTIFIER B_GENSATZ ECU_ADDRESS 0xd000d842 BIT_MASK 0x80 /end MEASUREMENT
/begin MEASUREMENT St_dgen_neu2 "Statuswort" UBYTE _CNV_R_R_Def_dez_sl_551_CM 1 100. 0. 255. DISPLAY_IDENTIFIER ST_DGEN_NEU2 ECU_ADDRESS 0xd000d843 FORMAT "%3.0" /end MEASUREMENT
/begin MEASUREMENT St_dgen_neu2.B_genhtb "Statuswort" UBYTE _CNV_S_2_Def_bit_ub_563_CM 1 100. 0. 1. DISPLAY_IDENTIFIER B_GENHTB ECU_ADDRESS 0xd000d843 BIT_MASK 0x80 /end MEASUREMENT
/begin MEASUREMENT St_dgen_neu2.B_genudiag_fs "Statuswort" UBYTE _CNV_S_2_Def_bit_ub_563_CM 1 100. 0. 1. DISPLAY_IDENTIFIER B_GENUDIAG_FS ECU_ADDRESS 0xd000d843 BIT_MASK 0x4 /end MEASUREMENT
/begin MEASUREMENT St_dgen_neu2.B_stat_calc "Statuswort" UBYTE _CNV_S_2_Def_bit_ub_563_CM 1 100. 0. 1. DISPLAY_IDENTIFIER B_STAT_CALC ECU_ADDRESS 0xd000d843 BIT_MASK 0x8 /end MEASUREMENT
/begin MEASUREMENT St_dgen_neu2.B_tdgenerr "Statuswort" UBYTE _CNV_S_2_Def_bit_ub_563_CM 1 100. 0. 1. DISPLAY_IDENTIFIER B_TDGENERR ECU_ADDRESS 0xd000d843 BIT_MASK 0x10 /end MEASUREMENT
/begin MEASUREMENT St_dgen_neu2.B_tdgenerr_1min "Statuswort" UBYTE _CNV_S_2_Def_bit_ub_563_CM 1 100. 0. 1. DISPLAY_IDENTIFIER B_TDGENERR_1MIN ECU_ADDRESS 0xd000d843 BIT_MASK 0x20 /end MEASUREMENT
/begin MEASUREMENT St_dgen_neu2.B_tdgenfbsd "Statuswort" UBYTE _CNV_S_2_Def_bit_ub_563_CM 1 100. 0. 1. DISPLAY_IDENTIFIER B_TDGENFBSD ECU_ADDRESS 0xd000d843 BIT_MASK 0x40 /end MEASUREMENT
/begin MEASUREMENT St_dgen_neu3 "Statuswort" UBYTE _CNV_R_R_Def_dez_sl_551_CM 1 100. 0. 255. DISPLAY_IDENTIFIER ST_DGEN_NEU3 ECU_ADDRESS 0xd000d844 FORMAT "%3.0" /end MEASUREMENT
/begin MEASUREMENT St_dgen_neu3.B_genfsulev "Statuswort" UBYTE _CNV_S_2_Def_bit_ub_563_CM 1 100. 0. 1. DISPLAY_IDENTIFIER B_GENFSULEV ECU_ADDRESS 0xd000d844 BIT_MASK 0x10 /end MEASUREMENT
/begin MEASUREMENT St_dgen_neu3.B_genfsulev_fs "Statuswort" UBYTE _CNV_S_2_Def_bit_ub_563_CM 1 100. 0. 1. DISPLAY_IDENTIFIER B_GENFSULEV_FS ECU_ADDRESS 0xd000d844 BIT_MASK 0x20 /end MEASUREMENT
/begin MEASUREMENT St_dgen_neu3.B_genplaus "Statuswort" UBYTE _CNV_S_2_Def_bit_ub_563_CM 1 100. 0. 1. DISPLAY_IDENTIFIER B_GENPLAUS ECU_ADDRESS 0xd000d844 BIT_MASK 0x1 /end MEASUREMENT
/begin MEASUREMENT St_dgen_neu3.B_gfhtbak "Statuswort" UBYTE _CNV_S_2_Def_bit_ub_563_CM 1 100. 0. 1. DISPLAY_IDENTIFIER B_GFHTBAK ECU_ADDRESS 0xd000d844 BIT_MASK 0x2 /end MEASUREMENT
/begin MEASUREMENT St_dgen_neu3.B_gfsulevak "Bedingung Sulev aus Fehlerspeicher" UBYTE _CNV_S_2_Def_bit_ub_563_CM 1 100. 0. 1. DISPLAY_IDENTIFIER B_GFSULEVAK ECU_ADDRESS 0xd000d844 BIT_MASK 0x40 /end MEASUREMENT
/begin MEASUREMENT St_dgen_neu3.B_gfudiagak "Statuswort" UBYTE _CNV_S_2_Def_bit_ub_563_CM 1 100. 0. 1. DISPLAY_IDENTIFIER B_GFUDIAGAK ECU_ADDRESS 0xd000d844 BIT_MASK 0x4 /end MEASUREMENT
/begin MEASUREMENT St_dgen_neu3.B_gfwregak "Statuswort" UBYTE _CNV_S_2_Def_bit_ub_563_CM 1 100. 0. 1. DISPLAY_IDENTIFIER B_GFWREGAK ECU_ADDRESS 0xd000d844 BIT_MASK 0x8 /end MEASUREMENT
/begin MEASUREMENT St_dgen_nv "Statuswort" UBYTE _CNV_R_R_Def_dez_sl_551_CM 1 100. 0. 255. DISPLAY_IDENTIFIER ST_DGEN_NV ECU_ADDRESS 0xc0004544 FORMAT "%3.0" /end MEASUREMENT
/begin MEASUREMENT St_dgen_nv.B_gensatz1_bel "Statuswort" UBYTE _CNV_S_2_Def_bit_ub_563_CM 1 100. 0. 1. DISPLAY_IDENTIFIER B_GENSATZ1_BEL ECU_ADDRESS 0xc0004544 BIT_MASK 0x1 /end MEASUREMENT
/begin MEASUREMENT St_dgen_nv.B_gensatz2_bel "Statuswort" UBYTE _CNV_S_2_Def_bit_ub_563_CM 1 100. 0. 1. DISPLAY_IDENTIFIER B_GENSATZ2_BEL ECU_ADDRESS 0xc0004544 BIT_MASK 0x2 /end MEASUREMENT
/begin MEASUREMENT St_dgenerrst_md1 "" UWORD _CNV_R_R_Def_dez_sl_551_CM 1 100. 0. 65535. DISPLAY_IDENTIFIER ST_DGENERRST_MD1 ECU_ADDRESS 0xc0004546 FORMAT "%5.0" /end MEASUREMENT
/begin MEASUREMENT St_dgenerrst_md2 "" UWORD _CNV_R_R_Def_dez_sl_551_CM 1 100. 0. 65535. DISPLAY_IDENTIFIER ST_DGENERRST_MD2 ECU_ADDRESS 0xc0004562 FORMAT "%5.0" /end MEASUREMENT
/begin MEASUREMENT St_dgengrenz1 "" UBYTE _CNV_R_R_Def_i_uw_q_630_CM 1 100. 0. 31.875 DISPLAY_IDENTIFIER ST_DGENGRENZ1 ECU_ADDRESS 0xc0000900 /end MEASUREMENT
/begin MEASUREMENT St_dgengrenz1_md1 "" UBYTE _CNV_R_R_Def_i_uw_q_630_CM 1 100. 0. 31.875 DISPLAY_IDENTIFIER ST_DGENGRENZ1_MD1 ECU_ADDRESS 0xc0004554 /end MEASUREMENT
/begin MEASUREMENT St_dgengrenz1_md2 "" UBYTE _CNV_R_R_Def_i_uw_q_630_CM 1 100. 0. 31.875 DISPLAY_IDENTIFIER ST_DGENGRENZ1_MD2 ECU_ADDRESS 0xc000455f /end MEASUREMENT
/begin MEASUREMENT St_dgengrenz2 "" UBYTE _CNV_R_R_Def_i_uw_q_630_CM 1 100. 0. 31.875 DISPLAY_IDENTIFIER ST_DGENGRENZ2 ECU_ADDRESS 0xc0000901 /end MEASUREMENT
/begin MEASUREMENT St_dgengrenz2_md1 "" UBYTE _CNV_R_R_Def_i_uw_q_630_CM 1 100. 0. 31.875 DISPLAY_IDENTIFIER ST_DGENGRENZ2_MD1 ECU_ADDRESS 0xc0004555 /end MEASUREMENT
/begin MEASUREMENT St_dgengrenz2_md2 "" UBYTE _CNV_R_R_Def_i_uw_q_630_CM 1 100. 0. 31.875 DISPLAY_IDENTIFIER ST_DGENGRENZ2_MD2 ECU_ADDRESS 0xc0004560 /end MEASUREMENT
/begin MEASUREMENT St_dgengrenzerr "" UBYTE _CNV_R_R_Def_dez_sl_551_CM 1 100. 0. 255. DISPLAY_IDENTIFIER ST_DGENGRENZERR ECU_ADDRESS 0xc0000902 FORMAT "%3.0" /end MEASUREMENT
/begin MEASUREMENT St_dgengrenzerr_md1 "" UBYTE _CNV_R_R_Def_dez_sl_551_CM 1 100. 0. 255. DISPLAY_IDENTIFIER ST_DGENGRENZERR_MD1 ECU_ADDRESS 0xc0004556 FORMAT "%3.0" /end MEASUREMENT
/begin MEASUREMENT St_dgengrenzerr_md2 "" UBYTE _CNV_R_R_Def_dez_sl_551_CM 1 100. 0. 255. DISPLAY_IDENTIFIER ST_DGENGRENZERR_MD2 ECU_ADDRESS 0xc000455d FORMAT "%3.0" /end MEASUREMENT
/begin MEASUREMENT St_dgengrenznz "" UBYTE _CNV_R_R_Def_i_uw_q_630_CM 1 100. 0. 31.875 DISPLAY_IDENTIFIER ST_DGENGRENZNZ ECU_ADDRESS 0xc0000903 /end MEASUREMENT
/begin MEASUREMENT St_dgengrenznz_md1 "" UBYTE _CNV_R_R_Def_i_uw_q_630_CM 1 100. 0. 31.875 DISPLAY_IDENTIFIER ST_DGENGRENZNZ_MD1 ECU_ADDRESS 0xc0004557 /end MEASUREMENT
/begin MEASUREMENT St_dgengrenznz_md2 "" UBYTE _CNV_R_R_Def_i_uw_q_630_CM 1 100. 0. 31.875 DISPLAY_IDENTIFIER ST_DGENGRENZNZ_MD2 ECU_ADDRESS 0xc000455e /end MEASUREMENT
/begin MEASUREMENT St_dgenub1 "" UWORD _CNV_R_R_Def_u_ub_q_631_CM 1 100. 0. 6553.5 DISPLAY_IDENTIFIER ST_DGENUB1 ECU_ADDRESS 0xc00008f4 FORMAT "%8.3" /end MEASUREMENT
/begin MEASUREMENT St_dgenub1_md1 "" UWORD _CNV_R_R_Def_u_sb_q_583_CM 1 100. 0. 6173.397 DISPLAY_IDENTIFIER ST_DGENUB1_MD1 ECU_ADDRESS 0xc0004548 FORMAT "%6.1" /end MEASUREMENT
/begin MEASUREMENT St_dgenub1_md2 "" UWORD _CNV_R_R_Def_u_sb_q_583_CM 1 100. 0. 6173.397 DISPLAY_IDENTIFIER ST_DGENUB1_MD2 ECU_ADDRESS 0xc0004566 FORMAT "%6.1" /end MEASUREMENT
/begin MEASUREMENT St_dgenub2 "" UWORD _CNV_R_R_Def_u_ub_q_631_CM 1 100. 0. 6553.5 DISPLAY_IDENTIFIER ST_DGENUB2 ECU_ADDRESS 0xc00008f6 FORMAT "%8.3" /end MEASUREMENT
/begin MEASUREMENT St_dgenub2_md1 "" UWORD _CNV_R_R_Def_u_sb_q_583_CM 1 100. 0. 6173.397 DISPLAY_IDENTIFIER ST_DGENUB2_MD1 ECU_ADDRESS 0xc000454a FORMAT "%6.1" /end MEASUREMENT
/begin MEASUREMENT St_dgenub2_md2 "" UWORD _CNV_R_R_Def_u_sb_q_583_CM 1 100. 0. 6173.397 DISPLAY_IDENTIFIER ST_DGENUB2_MD2 ECU_ADDRESS 0xc0004568 FORMAT "%6.1" /end MEASUREMENT
/begin MEASUREMENT St_dgenuberr "" UBYTE _CNV_R_R_Def_dez_sl_551_CM 1 100. 0. 255. DISPLAY_IDENTIFIER ST_DGENUBERR ECU_ADDRESS 0xc0000904 FORMAT "%3.0" /end MEASUREMENT
/begin MEASUREMENT St_dgenuberr_md1 "" UBYTE _CNV_R_R_Def_dez_sl_551_CM 1 100. 0. 255. DISPLAY_IDENTIFIER ST_DGENUBERR_MD1 ECU_ADDRESS 0xc0004558 FORMAT "%3.0" /end MEASUREMENT
/begin MEASUREMENT St_dgenuberr_md2 "" UBYTE _CNV_R_R_Def_dez_sl_551_CM 1 100. 0. 255. DISPLAY_IDENTIFIER ST_DGENUBERR_MD2 ECU_ADDRESS 0xc000455a FORMAT "%3.0" /end MEASUREMENT
/begin MEASUREMENT St_dgenubnz "" UWORD _CNV_R_R_Def_u_ub_q_631_CM 1 100. 0. 6553.5 DISPLAY_IDENTIFIER ST_DGENUBNZ ECU_ADDRESS 0xc00008f8 FORMAT "%8.3" /end MEASUREMENT
/begin MEASUREMENT St_dgenubnz_md1 "" UWORD _CNV_R_R_Def_u_sb_q_583_CM 1 100. 0. 6173.397 DISPLAY_IDENTIFIER ST_DGENUBNZ_MD1 ECU_ADDRESS 0xc000454c FORMAT "%6.1" /end MEASUREMENT
/begin MEASUREMENT St_dgenubnz_md2 "" UWORD _CNV_R_R_Def_u_sb_q_583_CM 1 100. 0. 6173.397 DISPLAY_IDENTIFIER ST_DGENUBNZ_MD2 ECU_ADDRESS 0xc0004564 FORMAT "%6.1" /end MEASUREMENT
/begin MEASUREMENT St_dgenugen1 "" UWORD _CNV_R_R_Def_u_ub_q_631_CM 1 100. 0. 6553.5 DISPLAY_IDENTIFIER ST_DGENUGEN1 ECU_ADDRESS 0xc00008fa FORMAT "%8.3" /end MEASUREMENT
/begin MEASUREMENT St_dgenugen1_md1 "" UWORD _CNV_R_R_Def_u_ub_q_631_CM 1 100. 0. 6553.5 DISPLAY_IDENTIFIER ST_DGENUGEN1_MD1 ECU_ADDRESS 0xc000454e FORMAT "%8.3" /end MEASUREMENT
/begin MEASUREMENT St_dgenugen1_md2 "" UWORD _CNV_R_R_Def_u_ub_q_631_CM 1 100. 0. 6553.5 DISPLAY_IDENTIFIER ST_DGENUGEN1_MD2 ECU_ADDRESS 0xc000456c FORMAT "%8.3" /end MEASUREMENT
/begin MEASUREMENT St_dgenugen2 "" UWORD _CNV_R_R_Def_u_ub_q_631_CM 1 100. 0. 6553.5 DISPLAY_IDENTIFIER ST_DGENUGEN2 ECU_ADDRESS 0xc00008fc FORMAT "%8.3" /end MEASUREMENT
/begin MEASUREMENT St_dgenugen2_md1 "" UWORD _CNV_R_R_Def_u_ub_q_631_CM 1 100. 0. 6553.5 DISPLAY_IDENTIFIER ST_DGENUGEN2_MD1 ECU_ADDRESS 0xc0004550 FORMAT "%8.3" /end MEASUREMENT
/begin MEASUREMENT St_dgenugen2_md2 "" UBYTE _CNV_R_R_Def_u_ub_q_631_CM 1 100. 0. 25.5 DISPLAY_IDENTIFIER ST_DGENUGEN2_MD2 ECU_ADDRESS 0xc000455c FORMAT "%5.2" /end MEASUREMENT
/begin MEASUREMENT St_dgenugenerr "" UBYTE _CNV_R_R_Def_dez_sl_551_CM 1 100. 0. 255. DISPLAY_IDENTIFIER ST_DGENUGENERR ECU_ADDRESS 0xc0000905 FORMAT "%3.0" /end MEASUREMENT
/begin MEASUREMENT St_dgenugenerr_md1 "" UBYTE _CNV_R_R_Def_dez_sl_551_CM 1 100. 0. 255. DISPLAY_IDENTIFIER ST_DGENUGENERR_MD1 ECU_ADDRESS 0xc0004559 FORMAT "%3.0" /end MEASUREMENT
/begin MEASUREMENT St_dgenugenerr_md2 "" UBYTE _CNV_R_R_Def_dez_sl_551_CM 1 100. 0. 255. DISPLAY_IDENTIFIER ST_DGENUGENERR_MD2 ECU_ADDRESS 0xc000455b FORMAT "%3.0" /end MEASUREMENT
/begin MEASUREMENT St_dgenugennz "" UWORD _CNV_R_R_Def_u_ub_q_631_CM 1 100. 0. 6553.5 DISPLAY_IDENTIFIER ST_DGENUGENNZ ECU_ADDRESS 0xc00008fe FORMAT "%8.3" /end MEASUREMENT
/begin MEASUREMENT St_dgenugennz_md1 "" UWORD _CNV_R_R_Def_u_ub_q_631_CM 1 100. 0. 6553.5 DISPLAY_IDENTIFIER ST_DGENUGENNZ_MD1 ECU_ADDRESS 0xc0004552 FORMAT "%8.3" /end MEASUREMENT
/begin MEASUREMENT St_dgenugennz_md2 "" UWORD _CNV_R_R_Def_u_ub_q_631_CM 1 100. 0. 6553.5 DISPLAY_IDENTIFIER ST_DGENUGENNZ_MD2 ECU_ADDRESS 0xc000456a FORMAT "%8.3" /end MEASUREMENT
/begin MEASUREMENT St_dqlt0 "Statuswort" UBYTE _CNV_R_R_Def_dez_sl_551_CM 1 100. 0. 255. DISPLAY_IDENTIFIER ST_DQLT0 ECU_ADDRESS 0xd000cf6c FORMAT "%3.0" /end MEASUREMENT
/begin MEASUREMENT St_dqlt0.B_ozdiagnmotok "Motordrehzahl ok für die Diagnose" UBYTE _CNV_S_2_Def_bit_ub_563_CM 1 100. 0. 1. DISPLAY_IDENTIFIER B_OZDIAGNMOTOK ECU_ADDRESS 0xd000cf6c BIT_MASK 0x80 /end MEASUREMENT
/begin MEASUREMENT St_dqlt0.B_ozerrbsd "BSD global Fehler" UBYTE _CNV_S_2_Def_bit_ub_563_CM 1 100. 0. 1. DISPLAY_IDENTIFIER B_OZERRBSD ECU_ADDRESS 0xd000cf6c BIT_MASK 0x40 /end MEASUREMENT
/begin MEASUREMENT St_dqlt0.B_ozkttoens "Töns-Sensor verbaut" UBYTE _CNV_S_2_Def_bit_ub_563_CM 1 100. 0. 1. DISPLAY_IDENTIFIER B_OZKTTOENS ECU_ADDRESS 0xd000cf6c BIT_MASK 0x20 /end MEASUREMENT
/begin MEASUREMENT St_dqlt0.B_ozlerr "Messfehler Ölniveau" UBYTE _CNV_S_2_Def_bit_ub_563_CM 1 100. 0. 1. DISPLAY_IDENTIFIER B_OZLERR ECU_ADDRESS 0xd000cf6c BIT_MASK 0x1 /end MEASUREMENT
/begin MEASUREMENT St_dqlt0.B_ozqerr "Messfehler Ölzustand" UBYTE _CNV_S_2_Def_bit_ub_563_CM 1 100. 0. 1. DISPLAY_IDENTIFIER B_OZQERR ECU_ADDRESS 0xd000cf6c BIT_MASK 0x2 /end MEASUREMENT
/begin MEASUREMENT St_dqlt0.B_ozterr "Messfehler Öltemperatur" UBYTE _CNV_S_2_Def_bit_ub_563_CM 1 100. 0. 1. DISPLAY_IDENTIFIER B_OZTERR ECU_ADDRESS 0xd000cf6c BIT_MASK 0x4 /end MEASUREMENT
/begin MEASUREMENT St_dqlt0.B_td_ogerr "Signalfehler Toens" UBYTE _CNV_S_2_Def_bit_ub_563_CM 1 100. 0. 1. DISPLAY_IDENTIFIER B_TD_OGERR ECU_ADDRESS 0xd000cf6c BIT_MASK 0x8 /end MEASUREMENT
/begin MEASUREMENT St_dqlt0.B_td_ogupl "Unplausibelfehler Toens" UBYTE _CNV_S_2_Def_bit_ub_563_CM 1 100. 0. 1. DISPLAY_IDENTIFIER B_TD_OGUPL ECU_ADDRESS 0xd000cf6c BIT_MASK 0x10 /end MEASUREMENT
/begin MEASUREMENT St_dqlt1 "Statuswort" UBYTE _CNV_R_R_Def_dez_sl_551_CM 1 100. 0. 255. DISPLAY_IDENTIFIER ST_DQLT1 ECU_ADDRESS 0xd000cf6d FORMAT "%3.0" /end MEASUREMENT
/begin MEASUREMENT St_dqlt1.B_ozerr "Sensorfehler in FS eingetragen" UBYTE _CNV_S_2_Def_bit_ub_563_CM 1 100. 0. 1. DISPLAY_IDENTIFIER B_OZERR ECU_ADDRESS 0xd000cf6d BIT_MASK 0x1 /end MEASUREMENT
/begin MEASUREMENT St_dqlt1.B_ozfbsd2 "BSD Sensor Fehler von FI_BSD_4" UBYTE _CNV_S_2_Def_bit_ub_563_CM 1 100. 0. 1. DISPLAY_IDENTIFIER B_OZFBSD2 ECU_ADDRESS 0xd000cf6d BIT_MASK 0x2 /end MEASUREMENT
/begin MEASUREMENT St_dqlt1.B_oztemppl "QLT Temperatur unplausibel" UBYTE _CNV_S_2_Def_bit_ub_563_CM 1 100. 0. 1. DISPLAY_IDENTIFIER B_OZTEMPPL ECU_ADDRESS 0xd000cf6d BIT_MASK 0x4 /end MEASUREMENT
/begin MEASUREMENT St_gen "Generatorstatus" UBYTE _CNV_R_R_Def_dez_sl_551_CM 1 100. 0. 255. DISPLAY_IDENTIFIER ST_GEN ECU_ADDRESS 0xc0000906 FORMAT "%3.0" /end MEASUREMENT
/begin MEASUREMENT St_genbsd "" UWORD _CNV_R_R_Def_dez_sl_551_CM 1 100. 0. 65535. DISPLAY_IDENTIFIER ST_GENBSD ECU_ADDRESS 0xc000092a FORMAT "%5.0" /end MEASUREMENT
/begin MEASUREMENT St_gengen "" UWORD _CNV_R_R_Def_dez_sl_551_CM 1 100. 0. 65535. DISPLAY_IDENTIFIER ST_GENGEN ECU_ADDRESS 0xc000092c FORMAT "%5.0" /end MEASUREMENT
/begin MEASUREMENT St_gentest "" UBYTE _CNV_R_R_Def_dez_sl_551_CM 1 100. 0. 255. DISPLAY_IDENTIFIER ST_GENTEST ECU_ADDRESS 0xc0000bc0 FORMAT "%3.0" /end MEASUREMENT
/begin MEASUREMENT St_imdgen0 "Statuswort" UBYTE _CNV_R_R_Def_dez_sl_551_CM 1 100. 0. 255. DISPLAY_IDENTIFIER ST_IMDGEN0 ECU_ADDRESS 0xd000d84c FORMAT "%3.0" /end MEASUREMENT
/begin MEASUREMENT St_imdgen0.B_gene "Generatormoment enable/disable" UBYTE _CNV_S_2_Def_bit_ub_563_CM 1 100. 0. 1. DISPLAY_IDENTIFIER B_GENE ECU_ADDRESS 0xd000d84c BIT_MASK 0x2 /end MEASUREMENT
/begin MEASUREMENT St_imdgen0.B_generken "Generatorerkennung noch nicht erfolgt" UBYTE _CNV_S_2_Def_bit_ub_563_CM 1 100. 0. 1. DISPLAY_IDENTIFIER B_GENERKEN ECU_ADDRESS 0xd000d84c BIT_MASK 0x4 /end MEASUREMENT
/begin MEASUREMENT St_imdgen0.B_im0 "Aktivierung Generatormomentberechnung außerhalb BSD-Koordinator" UBYTE _CNV_S_2_Def_bit_ub_563_CM 1 100. 0. 1. DISPLAY_IDENTIFIER B_IM0 ECU_ADDRESS 0xd000d84c BIT_MASK 0x1 /end MEASUREMENT
/begin MEASUREMENT St_imdgen0.B_mod_calc "Bedingung Momentenmodell muß gerechnet werden" UBYTE _CNV_S_2_Def_bit_ub_563_CM 1 100. 0. 1. DISPLAY_IDENTIFIER B_MOD_CALC ECU_ADDRESS 0xd000d84c BIT_MASK 0x8 /end MEASUREMENT
/begin MEASUREMENT St_imdgen_nv0 "Statuswort" UBYTE _CNV_R_R_Def_dez_sl_551_CM 1 100. 0. 255. DISPLAY_IDENTIFIER ST_IMDGEN_NV0 ECU_ADDRESS 0xd000d84d FORMAT "%3.0" /end MEASUREMENT
/begin MEASUREMENT St_imdgen_nv0.B_genfkupl "Generatortyp unplausibel" UBYTE _CNV_S_2_Def_bit_ub_563_CM 1 100. 0. 1. DISPLAY_IDENTIFIER B_GENFKUPL ECU_ADDRESS 0xd000d84d BIT_MASK 0x1 /end MEASUREMENT
/begin MEASUREMENT St_imdgen_nv1 "Statuswort" UBYTE _CNV_R_R_Def_dez_sl_551_CM 1 100. 0. 255. DISPLAY_IDENTIFIER ST_IMDGEN_NV1 ECU_ADDRESS 0xc00046a8 FORMAT "%3.0" /end MEASUREMENT
/begin MEASUREMENT St_imdgen_nv1.B_bszsichok "Abspeichern Fasta Daten in Hauptkennfeld erfolgreich" UBYTE _CNV_S_2_Def_bit_ub_563_CM 1 100. 0. 1. DISPLAY_IDENTIFIER B_BSZSICHOK ECU_ADDRESS 0xc00046a8 BIT_MASK 0x1 /end MEASUREMENT
/begin MEASUREMENT St_ldstgen "Lastzustand Generator elektrisch/thermisch" UBYTE _CNV_R_R_Def_dez_sl_551_CM 1 100. 0. 255. DISPLAY_IDENTIFIER ST_LDSTGEN ECU_ADDRESS 0xd000d89d FORMAT "%3.0" /end MEASUREMENT
/begin MEASUREMENT St_llranh0 "Statuswort" UBYTE _CNV_R_R_Def_dez_sl_551_CM 1 100. 0. 255. DISPLAY_IDENTIFIER ST_LLRANH0 ECU_ADDRESS 0xd000d8a0 FORMAT "%3.0" /end MEASUREMENT
/begin MEASUREMENT St_llranh0.B_idl_tp "Temporäres Berechnungsbit" UBYTE _CNV_S_2_Def_bit_ub_563_CM 1 100. 0. 1. DISPLAY_IDENTIFIER B_IDL_TP ECU_ADDRESS 0xd000d8a0 BIT_MASK 0x4 /end MEASUREMENT
/begin MEASUREMENT St_llranh0.B_idlgspec "Kein Langbezeichner vergeben" UBYTE _CNV_S_2_Def_bit_ub_563_CM 1 100. 0. 1. DISPLAY_IDENTIFIER B_IDLGSPEC ECU_ADDRESS 0xd000d8a0 BIT_MASK 0x1 /end MEASUREMENT
/begin MEASUREMENT St_llranh0.B_nsub "Bedingung für Solldrehzahlanhebung bei niedriger Batteriespannung" UBYTE _CNV_S_2_Def_bit_ub_563_CM 1 100. 0. 1. DISPLAY_IDENTIFIER B_NSUB ECU_ADDRESS 0xd000d8a0 BIT_MASK 0x2 /end MEASUREMENT
/begin MEASUREMENT St_llranh0.B_nsub_tmp "temporäre Größe zur Berechnung B_nsub" UBYTE _CNV_S_2_Def_bit_ub_563_CM 1 100. 0. 1. DISPLAY_IDENTIFIER B_NSUB_TMP ECU_ADDRESS 0xd000d8a0 BIT_MASK 0x8 /end MEASUREMENT
/begin MEASUREMENT St_oz_o "Statuswort" UBYTE _CNV_R_R_Def_dez_sl_551_CM 1 100. 0. 255. DISPLAY_IDENTIFIER ST_OZ_O ECU_ADDRESS 0xd000cf6e FORMAT "%3.0" /end MEASUREMENT
/begin MEASUREMENT St_oz_o.B_mol_sf "Sensorfehler in FS eingetragen für CC-Meldung" UBYTE _CNV_S_2_Def_bit_ub_563_CM 1 100. 0. 1. DISPLAY_IDENTIFIER B_MOL_SF ECU_ADDRESS 0xd000cf6e BIT_MASK 0x2 /end MEASUREMENT
/begin MEASUREMENT St_oz_o.B_oztemic "QLT-Temic verbaut" UBYTE _CNV_S_2_Def_bit_ub_563_CM 1 100. 0. 1. DISPLAY_IDENTIFIER B_OZTEMIC ECU_ADDRESS 0xd000cf6e BIT_MASK 0x1 /end MEASUREMENT
/begin MEASUREMENT St_ozbg0 "Statuswort" UBYTE _CNV_R_R_Def_dez_sl_551_CM 1 100. 0. 255. DISPLAY_IDENTIFIER ST_OZBG0 ECU_ADDRESS 0xd000cf70 FORMAT "%3.0" /end MEASUREMENT
/begin MEASUREMENT St_ozbg0.B_mol_vb "Bedingung Ölverbrauchswarnung" UBYTE _CNV_S_2_Def_bit_ub_563_CM 1 100. 0. 1. DISPLAY_IDENTIFIER B_MOL_VB ECU_ADDRESS 0xd000cf70 BIT_MASK 0x2 /end MEASUREMENT
/begin MEASUREMENT St_ozbg0.B_mol_vl "Bedingung Ölverlustwarnung" UBYTE _CNV_S_2_Def_bit_ub_563_CM 1 100. 0. 1. DISPLAY_IDENTIFIER B_MOL_VL ECU_ADDRESS 0xd000cf70 BIT_MASK 0x4 /end MEASUREMENT
/begin MEASUREMENT St_ozbg0.B_oeltemp "Bedingung für CAN-Ausgabe der Öltemperatur" UBYTE _CNV_S_2_Def_bit_ub_563_CM 1 100. 0. 1. DISPLAY_IDENTIFIER B_OELTEMP ECU_ADDRESS 0xd000cf70 BIT_MASK 0x8 /end MEASUREMENT
/begin MEASUREMENT St_ozgg0 "Statuswort" UBYTE _CNV_R_R_Def_dez_sl_551_CM 1 100. 0. 255. DISPLAY_IDENTIFIER ST_OZGG0 ECU_ADDRESS 0xd000cf74 FORMAT "%3.0" /end MEASUREMENT
/begin MEASUREMENT St_ozgg0.B_ozniv "Bedingung Niveausignal in Ordnung" UBYTE _CNV_S_2_Def_bit_ub_563_CM 1 100. 0. 1. DISPLAY_IDENTIFIER B_OZNIV ECU_ADDRESS 0xd000cf74 BIT_MASK 0x1 /end MEASUREMENT
/begin MEASUREMENT St_ozgg0.B_oznivqlt "Bedingung Niveausignal QLT in Ordnung" UBYTE _CNV_S_2_Def_bit_ub_563_CM 1 100. 0. 1. DISPLAY_IDENTIFIER B_OZNIVQLT ECU_ADDRESS 0xd000cf74 BIT_MASK 0x10 /end MEASUREMENT
/begin MEASUREMENT St_ozgg0.B_oznivtoe "Bedingung Niveausignal Töns in Ordnung" UBYTE _CNV_S_2_Def_bit_ub_563_CM 1 100. 0. 1. DISPLAY_IDENTIFIER B_OZNIVTOE ECU_ADDRESS 0xd000cf74 BIT_MASK 0x8 /end MEASUREMENT
/begin MEASUREMENT St_ozgg0.B_ozperm "Bedingung Permittivitätssignal in Ordnung" UBYTE _CNV_S_2_Def_bit_ub_563_CM 1 100. 0. 1. DISPLAY_IDENTIFIER B_OZPERM ECU_ADDRESS 0xd000cf74 BIT_MASK 0x2 /end MEASUREMENT
/begin MEASUREMENT St_ozgg0.B_oztemp "Bedingung Temperatursignal in Ordnung" UBYTE _CNV_S_2_Def_bit_ub_563_CM 1 100. 0. 1. DISPLAY_IDENTIFIER B_OZTEMP ECU_ADDRESS 0xd000cf74 BIT_MASK 0x4 /end MEASUREMENT
/begin MEASUREMENT St_ozgg0.B_oztempqlt "Bedingung Temperatursignal QLT in Ordnung" UBYTE _CNV_S_2_Def_bit_ub_563_CM 1 100. 0. 1. DISPLAY_IDENTIFIER B_OZTEMPQLT ECU_ADDRESS 0xd000cf74 BIT_MASK 0x20 /end MEASUREMENT
/begin MEASUREMENT St_ozgg0.B_oztemptoe "Bedingung Temperatursignal Töns in Ordnung" UBYTE _CNV_S_2_Def_bit_ub_563_CM 1 100. 0. 1. DISPLAY_IDENTIFIER B_OZTEMPTOE ECU_ADDRESS 0xd000cf74 BIT_MASK 0x40 /end MEASUREMENT
/begin MEASUREMENT St_ozgg0.B_oztoeok "Bedingung kein Fehler Töns" UBYTE _CNV_S_2_Def_bit_ub_563_CM 1 100. 0. 1. DISPLAY_IDENTIFIER B_OZTOEOK ECU_ADDRESS 0xd000cf74 BIT_MASK 0x80 /end MEASUREMENT
/begin MEASUREMENT St_pgenllred "Statuswort" UBYTE _CNV_R_R_Def_dez_sl_551_CM 1 100. 0. 255. DISPLAY_IDENTIFIER ST_PGENLLRED ECU_ADDRESS 0xd000d8b0 FORMAT "%3.0" /end MEASUREMENT
/begin MEASUREMENT St_pgenllred.B_geli "Bedingung Generatorlastbegrenzung für Leerlaufstabilisierung" UBYTE _CNV_S_2_Def_bit_ub_563_CM 1 100. 0. 1. DISPLAY_IDENTIFIER B_GELI ECU_ADDRESS 0xd000d8b0 BIT_MASK 0x2 /end MEASUREMENT
/begin MEASUREMENT St_pgenllred.B_nsubgen "Bedingung Leerlaufsolldrehzahlanhebung bei erkannten Generatorlastschwankung" UBYTE _CNV_S_2_Def_bit_ub_563_CM 1 100. 0. 1. DISPLAY_IDENTIFIER B_NSUBGEN ECU_ADDRESS 0xd000d8b0 BIT_MASK 0x1 /end MEASUREMENT
/begin MEASUREMENT St_pgenllred.B_pgenllerk "Bedingung Generatorlimitierung wegen LL-Sägen erkannt" UBYTE _CNV_S_2_Def_bit_ub_563_CM 1 100. 0. 1. DISPLAY_IDENTIFIER B_PGENLLERK ECU_ADDRESS 0xd000d8b0 BIT_MASK 0x4 /end MEASUREMENT
/begin MEASUREMENT St_pgenllred_200ms "Statuswort" UBYTE _CNV_R_R_Def_dez_sl_551_CM 1 100. 0. 255. DISPLAY_IDENTIFIER ST_PGENLLRED_200MS ECU_ADDRESS 0xc0007a64 FORMAT "%3.0" /end MEASUREMENT
/begin MEASUREMENT St_pgenllred_200ms.B_dffaktiv "Bedingung Auswertung des Generatorlastsignals für Leerlaufregelung aktiv" UBYTE _CNV_S_2_Def_bit_ub_563_CM 1 100. 0. 1. DISPLAY_IDENTIFIER B_DFFAKTIV ECU_ADDRESS 0xc0007a64 BIT_MASK 0x2 /end MEASUREMENT
/begin MEASUREMENT St_pgenllred_200ms.B_nsubg_r "Resetbedingung für LL Anhebung GEN" UBYTE _CNV_S_2_Def_bit_ub_563_CM 1 100. 0. 1. DISPLAY_IDENTIFIER B_NSUBG_R ECU_ADDRESS 0xc0007a64 BIT_MASK 0x4 /end MEASUREMENT
/begin MEASUREMENT St_pgenllred_200ms.B_nsubgen1 "Temporäre Zwischengröße für LL Anhebung Generator" UBYTE _CNV_S_2_Def_bit_ub_563_CM 1 100. 0. 1. DISPLAY_IDENTIFIER B_NSUBGEN1 ECU_ADDRESS 0xc0007a64 BIT_MASK 0x8 /end MEASUREMENT
/begin MEASUREMENT St_pgenllred_200ms.B_pgenllfa "Bedingung für Rücksetzen erkanntes LL-Sägen durch Generator" UBYTE _CNV_S_2_Def_bit_ub_563_CM 1 100. 0. 1. DISPLAY_IDENTIFIER B_PGENLLFA ECU_ADDRESS 0xc0007a64 BIT_MASK 0x10 /end MEASUREMENT
/begin MEASUREMENT St_pgenllred_200ms.B_pgenredllve "Bedingung Fehler Fahrzeuggeschwindigkeit erkannt" UBYTE _CNV_S_2_Def_bit_ub_563_CM 1 100. 0. 1. DISPLAY_IDENTIFIER B_PGENREDLLVE ECU_ADDRESS 0xc0007a64 BIT_MASK 0x1 /end MEASUREMENT
/begin MEASUREMENT St_pgenred_1s "Statuswort" UBYTE _CNV_R_R_Def_dez_sl_551_CM 1 100. 0. 255. DISPLAY_IDENTIFIER ST_PGENRED_1S ECU_ADDRESS 0xc0007aa0 FORMAT "%3.0" /end MEASUREMENT
/begin MEASUREMENT St_pgenred_1s.B_genht "Bedingung Generator Hochtemperatur" UBYTE _CNV_S_2_Def_bit_ub_563_CM 1 100. 0. 1. DISPLAY_IDENTIFIER B_GENHT ECU_ADDRESS 0xc0007aa0 BIT_MASK 0x1 /end MEASUREMENT
/begin MEASUREMENT St_pgenred_1s.B_genhtkrit "Kein Langbezeichner vergeben" UBYTE _CNV_S_2_Def_bit_ub_563_CM 1 100. 0. 1. DISPLAY_IDENTIFIER B_GENHTKRIT ECU_ADDRESS 0xc0007aa0 BIT_MASK 0x2 /end MEASUREMENT
/begin MEASUREMENT St_pgenred_1s.B_genhtkritv "Bedingung kritische Temparatur vor Entprellung" UBYTE _CNV_S_2_Def_bit_ub_563_CM 1 100. 0. 1. DISPLAY_IDENTIFIER B_GENHTKRITV ECU_ADDRESS 0xc0007aa0 BIT_MASK 0x4 /end MEASUREMENT
/begin MEASUREMENT St_pgenred_1s.B_genhtmxgra "Maximale Gradient Chiptemparatur überstiegen" UBYTE _CNV_S_2_Def_bit_ub_563_CM 1 100. 0. 1. DISPLAY_IDENTIFIER B_GENHTMXGRA ECU_ADDRESS 0xc0007aa0 BIT_MASK 0x10 /end MEASUREMENT
/begin MEASUREMENT St_pgenred_1s.B_ierrgrenzh "Grenzstrom aus Hochtemperatur Generator aktiv" UBYTE _CNV_S_2_Def_bit_ub_563_CM 1 100. 0. 1. DISPLAY_IDENTIFIER B_IERRGRENZH ECU_ADDRESS 0xc0007aa0 BIT_MASK 0x20 /end MEASUREMENT
/begin MEASUREMENT St_pgenred_1s.B_tdiodekrit "Diodentemparatur im kritischen Bereich" UBYTE _CNV_S_2_Def_bit_ub_563_CM 1 100. 0. 1. DISPLAY_IDENTIFIER B_TDIODEKRIT ECU_ADDRESS 0xc0007aa0 BIT_MASK 0x8 /end MEASUREMENT
/begin MEASUREMENT St_ramp "" UBYTE _CNV_R_R_Def_dez_sl_551_CM 1 100. 0. 255. DISPLAY_IDENTIFIER ST_RAMP ECU_ADDRESS 0xd000e3f9 FORMAT "%3.0" /end MEASUREMENT
/begin MEASUREMENT St_ramp.B_arampend "" UBYTE _CNV_S_2_Def_bit_ub_563_CM 1 100. 0. 1. DISPLAY_IDENTIFIER B_ARAMPEND ECU_ADDRESS 0xd000e3f9 BIT_MASK 0x4 /end MEASUREMENT
/begin MEASUREMENT St_ramp.B_arampend_1 "" UBYTE _CNV_S_2_Def_bit_ub_563_CM 1 100. 0. 1. DISPLAY_IDENTIFIER B_ARAMPEND_1 ECU_ADDRESS 0xd000e3f9 BIT_MASK 0x8 /end MEASUREMENT
/begin MEASUREMENT St_ramp.B_erampend "" UBYTE _CNV_S_2_Def_bit_ub_563_CM 1 100. 0. 1. DISPLAY_IDENTIFIER B_ERAMPEND ECU_ADDRESS 0xd000e3f9 BIT_MASK 0x1 /end MEASUREMENT
/begin MEASUREMENT St_ramp.B_erampend_1 "" UBYTE _CNV_S_2_Def_bit_ub_563_CM 1 100. 0. 1. DISPLAY_IDENTIFIER B_ERAMPEND_1 ECU_ADDRESS 0xd000e3f9 BIT_MASK 0x2 /end MEASUREMENT
/begin MEASUREMENT St_restg "Statuswort RESTGAS" UBYTE _CNV_R_R_Def_dez_sl_551_CM 1 100. 0. 255. DISPLAY_IDENTIFIER ST_RESTG ECU_ADDRESS 0xd000e3ee FORMAT "%3.0" /end MEASUREMENT
/begin MEASUREMENT St_restg.B_ff_nvsaad "Statuswort RESTGAS" UBYTE _CNV_S_2_Def_bit_ub_563_CM 1 100. 0. 1. DISPLAY_IDENTIFIER B_FF_NVSAAD ECU_ADDRESS 0xd000e3ee BIT_MASK 0x8 /end MEASUREMENT
/begin MEASUREMENT St_restg.B_ff_nvsead "Statuswort RESTGAS" UBYTE _CNV_S_2_Def_bit_ub_563_CM 1 100. 0. 1. DISPLAY_IDENTIFIER B_FF_NVSEAD ECU_ADDRESS 0xd000e3ee BIT_MASK 0x4 /end MEASUREMENT
/begin MEASUREMENT St_restg.B_nvsaad "Adaptionssperre Auslassvanos" UBYTE _CNV_S_2_Def_bit_ub_563_CM 1 100. 0. 1. DISPLAY_IDENTIFIER B_NVSAAD ECU_ADDRESS 0xd000e3ee BIT_MASK 0x1 /end MEASUREMENT
/begin MEASUREMENT St_restg.B_nvsead "Adaptionssperre Einlassvanos" UBYTE _CNV_S_2_Def_bit_ub_563_CM 1 100. 0. 1. DISPLAY_IDENTIFIER B_NVSEAD ECU_ADDRESS 0xd000e3ee BIT_MASK 0x2 /end MEASUREMENT
/begin MEASUREMENT St_rstg "Statuswort RESTGAS" UBYTE _CNV_R_R_Def_dez_sl_551_CM 1 100. 0. 255. DISPLAY_IDENTIFIER ST_RSTG ECU_ADDRESS 0xd000e3f8 FORMAT "%3.0" /end MEASUREMENT
/begin MEASUREMENT St_rstg.B_aspan "Bedingung zus. Auslassspreizung bei Schubabschalten" UBYTE _CNV_S_2_Def_bit_ub_563_CM 1 100. 0. 1. DISPLAY_IDENTIFIER B_ASPAN ECU_ADDRESS 0xd000e3f8 BIT_MASK 0x4 /end MEASUREMENT
/begin MEASUREMENT St_rstg.B_espan "Bedingung zus. Einlassspreizung bei Schubabschalten" UBYTE _CNV_S_2_Def_bit_ub_563_CM 1 100. 0. 1. DISPLAY_IDENTIFIER B_ESPAN ECU_ADDRESS 0xd000e3f8 BIT_MASK 0x8 /end MEASUREMENT
/begin MEASUREMENT St_rstg.B_vsast "Bedingung Auslassvanos Start" UBYTE _CNV_S_2_Def_bit_ub_563_CM 1 100. 0. 1. DISPLAY_IDENTIFIER B_VSAST ECU_ADDRESS 0xd000e3f8 BIT_MASK 0x10 /end MEASUREMENT
/begin MEASUREMENT St_rstg.B_vsest "Bedingung Einlassvanos Start" UBYTE _CNV_S_2_Def_bit_ub_563_CM 1 100. 0. 1. DISPLAY_IDENTIFIER B_VSEST ECU_ADDRESS 0xd000e3f8 BIT_MASK 0x20 /end MEASUREMENT
/begin MEASUREMENT St_rstg.B_vzare "Bedingung Auslassvanos verzoegern" UBYTE _CNV_S_2_Def_bit_ub_563_CM 1 100. 0. 1. DISPLAY_IDENTIFIER B_VZARE ECU_ADDRESS 0xd000e3f8 BIT_MASK 0x40 /end MEASUREMENT
/begin MEASUREMENT St_rstg.B_vzere "Bedingung Einlassvanos verzoegern" UBYTE _CNV_S_2_Def_bit_ub_563_CM 1 100. 0. 1. DISPLAY_IDENTIFIER B_VZERE ECU_ADDRESS 0xd000e3f8 BIT_MASK 0x80 /end MEASUREMENT
/begin MEASUREMENT St_rstg.B_wnwmnba "minimaler Adaptionsgrenzwert erreicht (Auslass), Sollwertbegrenzung aktiv" UBYTE _CNV_S_2_Def_bit_ub_563_CM 1 100. 0. 1. DISPLAY_IDENTIFIER B_WNWMNBA ECU_ADDRESS 0xd000e3f8 BIT_MASK 0x2 /end MEASUREMENT
/begin MEASUREMENT St_rstg.B_wnwmnbe "minimaler Adaptionsgrenzwert erreicht (Einlass), Sollwertbegrenzung aktiv" UBYTE _CNV_S_2_Def_bit_ub_563_CM 1 100. 0. 1. DISPLAY_IDENTIFIER B_WNWMNBE ECU_ADDRESS 0xd000e3f8 BIT_MASK 0x1 /end MEASUREMENT
/begin MEASUREMENT St_rstg1 "Statuswort RESTGAS" UBYTE _CNV_R_R_Def_dez_sl_551_CM 1 100. 0. 255. DISPLAY_IDENTIFIER ST_RSTG1 ECU_ADDRESS 0xd000e43e FORMAT "%3.0" /end MEASUREMENT
/begin MEASUREMENT St_rstg1.B_nrf_kl15vorab "Statuswort RESTGAS" UBYTE _CNV_S_2_Def_bit_ub_563_CM 1 100. 0. 1. DISPLAY_IDENTIFIER B_NRF_KL15VORAB ECU_ADDRESS 0xd000e43e BIT_MASK 0x4 /end MEASUREMENT
/begin MEASUREMENT St_rstg1.Rsthyst1 "Hysterest Einlassseite" UBYTE _CNV_S_2_Def_bit_ub_563_CM 1 100. 0. 1. DISPLAY_IDENTIFIER RSTHYST1 ECU_ADDRESS 0xd000e43e BIT_MASK 0x1 /end MEASUREMENT
/begin MEASUREMENT St_rstg1.Rsthyst2 "Hysterest Einlassseite" UBYTE _CNV_S_2_Def_bit_ub_563_CM 1 100. 0. 1. DISPLAY_IDENTIFIER RSTHYST2 ECU_ADDRESS 0xd000e43e BIT_MASK 0x2 /end MEASUREMENT
/begin MEASUREMENT T_chipfilsdt "Differenzenquotient schnellgefilterte Chiptemparatur" SWORD _CNV_R_R_Def_t_sw_q_578_CM 1 100. -3276.8 3276.7 DISPLAY_IDENTIFIER T_CHIPFILSDT ECU_ADDRESS 0xc0007aa2 FORMAT "%6.1" /end MEASUREMENT
/begin MEASUREMENT T_diode "Diodentemparatur" SWORD _CNV_R_R_Def_t_sw_q_578_CM 1 100. -3276.8 3276.7 DISPLAY_IDENTIFIER T_DIODE ECU_ADDRESS 0xc0007aa4 FORMAT "%6.1" /end MEASUREMENT
/begin MEASUREMENT T_diodedelta "Deltatemparatur Diode" SWORD _CNV_R_R_Def_t_sw_q_578_CM 1 100. -3276.8 3276.7 DISPLAY_IDENTIFIER T_DIODEDELTA ECU_ADDRESS 0xc0007aa6 FORMAT "%6.1" /end MEASUREMENT
/begin MEASUREMENT Tans_gen "Ansauglufttemparatur Generator" SWORD _CNV_R_R_Def_t_sw_q_578_CM 1 100. -3276.8 3276.7 DISPLAY_IDENTIFIER TANS_GEN ECU_ADDRESS 0xc0007aa8 FORMAT "%6.1" /end MEASUREMENT
/begin MEASUREMENT Tchip_diff1 "Zwischengröße Generator-Chiptemperatur" SWORD _CNV_R_R_Def_t_sw_q_578_CM 1 100. -3276.8 3276.7 DISPLAY_IDENTIFIER TCHIP_DIFF1 ECU_ADDRESS 0xc000094c FORMAT "%6.1" /end MEASUREMENT
/begin MEASUREMENT Tchip_diff2 "Zwischengröße Generator-Chiptemperatur" SWORD _CNV_R_R_Def_t_sw_q_578_CM 1 100. -3276.8 3276.7 DISPLAY_IDENTIFIER TCHIP_DIFF2 ECU_ADDRESS 0xc000094e FORMAT "%6.1" /end MEASUREMENT
/begin MEASUREMENT Tchip_fil_l "Wirkliche Chiptemperatur vom Generatorregler als Mittelwert gefiltert" SWORD _CNV_R_R_Def_t_sw_q_578_CM 1 100. -3276.8 3276.7 DISPLAY_IDENTIFIER TCHIP_FIL_L ECU_ADDRESS 0xd000d8f4 FORMAT "%6.1" /end MEASUREMENT
/begin MEASUREMENT Tchip_fil_s "Wirkliche Chiptemperatur vom Generatorregler als Mittelwert gefiltert" SWORD _CNV_R_R_Def_t_sw_q_578_CM 1 100. -3276.8 3276.7 DISPLAY_IDENTIFIER TCHIP_FIL_S ECU_ADDRESS 0xd000d8f6 FORMAT "%6.1" /end MEASUREMENT
/begin MEASUREMENT Tchip_ist "Wirkliche Chiptemperatur vom Generatorregler" SWORD _CNV_R_R_Def_t_sw_q_578_CM 1 100. -3276.8 3276.7 DISPLAY_IDENTIFIER TCHIP_IST ECU_ADDRESS 0xc0007aaa FORMAT "%6.1" /end MEASUREMENT
/begin MEASUREMENT Tchip_mwa "Array zur Mittelwerbildung Tchip_ist" SWORD _CNV_R_R_Def_t_sw_q_578_CM 1 100. -3276.8 3276.7 DISPLAY_IDENTIFIER TCHIP_MWA ECU_ADDRESS 0xc0007aac FORMAT "%6.1" ARRAY_SIZE 16 MATRIX_DIM 16 1 1 /end MEASUREMENT
/begin MEASUREMENT Tchip_sum "Summenwert Tchip zur Mittelwertbildung" SWORD _CNV_R_R_Def_t_sw_q_578_CM 1 100. -3276.8 3276.7 DISPLAY_IDENTIFIER TCHIP_SUM ECU_ADDRESS 0xc0007acc FORMAT "%6.1" /end MEASUREMENT
/begin MEASUREMENT Tdffgen "Zeitzähler für Erkennung Generatorlastschwankung für Leerlaufanhebung" UWORD _CNV_R_R_Def_td_uw__718_CM 1 100. 0. 13107. DISPLAY_IDENTIFIER TDFFGEN ECU_ADDRESS 0xc0007a68 FORMAT "%6.1" /end MEASUREMENT
/begin MEASUREMENT Tgen "Generatortemperatur" SWORD _CNV_R_R_Def_t_sw_q_578_CM 1 100. -3276.8 3276.7 DISPLAY_IDENTIFIER TGEN ECU_ADDRESS 0xd000d856 FORMAT "%6.1" /end MEASUREMENT
/begin MEASUREMENT Toel "Ausgabewert Motoröltemperatur für LoCAN" SWORD _CNV_R_R_Def_t_sw_q_578_CM 1 100. -3276.8 3276.7 DISPLAY_IDENTIFIER TOEL ECU_ADDRESS 0xc0000714 FORMAT "%6.1" /end MEASUREMENT
/begin MEASUREMENT U_gentest "" UWORD _CNV_R_R_Def_u_ub_q_631_CM 1 100. 0. 6553.5 DISPLAY_IDENTIFIER U_GENTEST ECU_ADDRESS 0xc0000bb8 FORMAT "%8.3" /end MEASUREMENT
/begin MEASUREMENT U_vordiode "Diodenvorwärtsspannung" UWORD _CNV_R_R_Def_u_sw_q_580_CM 1 100. 0. 319.9951 DISPLAY_IDENTIFIER U_VORDIODE ECU_ADDRESS 0xc0007ad0 FORMAT "%8.3" /end MEASUREMENT
/begin MEASUREMENT Ub_old_st "letzter Wert Batteriespannung für Starterkennung" UWORD _CNV_R_R_Def_u_sb_q_583_CM 1 100. 0. 6173.397 DISPLAY_IDENTIFIER UB_OLD_ST ECU_ADDRESS 0xd000d89a FORMAT "%6.1" /end MEASUREMENT
/begin MEASUREMENT Ugen_calc "Berechnete Generatorspannung" UWORD _CNV_R_R_Def_u_ub_q_631_CM 1 100. 0. 6553.5 DISPLAY_IDENTIFIER UGEN_CALC ECU_ADDRESS 0xd000d85a FORMAT "%8.3" /end MEASUREMENT
/begin MEASUREMENT V_pgenllkor "Fahrzeuggeschwindigkeit korrigiert" UWORD _CNV_R_R_Def_v_uw_q_727_CM 1 100. 0. 6553.5 DISPLAY_IDENTIFIER V_PGENLLKOR ECU_ADDRESS 0xd000d8b4 FORMAT "%7.2" /end MEASUREMENT
/begin MEASUREMENT Vsa_admn "min. Adaptionswert Auslassvanos" UWORD _CNV_R_R_Def_spr_sw_561_CM 1 100. 0. 180. DISPLAY_IDENTIFIER VSA_ADMN ECU_ADDRESS 0xd000e444 FORMAT "%7.2" /end MEASUREMENT
/begin MEASUREMENT Vsa_sprn "Normspreizung Auslass" UWORD _CNV_R_R_Def_spr_sw_561_CM 1 100. 0. 6553.5 DISPLAY_IDENTIFIER VSA_SPRN ECU_ADDRESS 0xd000e3f4 FORMAT "%7.2" /end MEASUREMENT
/begin MEASUREMENT Vsa_vzt "Verzoegerungszeit Auslassvanos" UBYTE _CNV_R_R_Def_td_uw__673_CM 1 100. 0. 2.55 DISPLAY_IDENTIFIER VSA_VZT ECU_ADDRESS 0xd000e43f FORMAT "%5.2" /end MEASUREMENT
/begin MEASUREMENT Vsa_vzz "Erfolgte Anzahl an Nachtriggerungen (Einlassseite)" UBYTE _CNV_R_R_Def_dez_sl_551_CM 1 100. 0. 255. DISPLAY_IDENTIFIER VSA_VZZ ECU_ADDRESS 0xd000e440 FORMAT "%3.0" /end MEASUREMENT
/begin MEASUREMENT Vse_admn "min. Adaptionswert Einlassvanos" UWORD _CNV_R_R_Def_spr_sw_561_CM 1 100. 0. 180. DISPLAY_IDENTIFIER VSE_ADMN ECU_ADDRESS 0xd000e442 FORMAT "%7.2" /end MEASUREMENT
/begin MEASUREMENT Vse_sprn "Normspreizung Einlass" UWORD _CNV_R_R_Def_spr_sw_561_CM 1 100. 0. 6553.5 DISPLAY_IDENTIFIER VSE_SPRN ECU_ADDRESS 0xd000e3f6 FORMAT "%7.2" /end MEASUREMENT
/begin MEASUREMENT Vse_vzt "Verzoegerungszeit Einlassvanos" UBYTE _CNV_R_R_Def_td_uw__673_CM 1 100. 0. 2.55 DISPLAY_IDENTIFIER VSE_VZT ECU_ADDRESS 0xd000e446 FORMAT "%5.2" /end MEASUREMENT
/begin MEASUREMENT Vse_vzz "Erfolgte Anzahl an Nachtriggerungen (Einlassseite)" UBYTE _CNV_R_R_Def_dez_sl_551_CM 1 100. 0. 255. DISPLAY_IDENTIFIER VSE_VZZ ECU_ADDRESS 0xd000e447 FORMAT "%3.0" /end MEASUREMENT
/begin MEASUREMENT Wnwsamn "minimale Auslass Sollspreizung" UWORD _CNV_R_R_Def_spr_sw_561_CM 1 100. 0. 180. DISPLAY_IDENTIFIER WNWSAMN ECU_ADDRESS 0xd000e45a FORMAT "%7.2" /end MEASUREMENT
/begin MEASUREMENT Wnwsemn "minimale Einlass Sollspreizung" UWORD _CNV_R_R_Def_spr_sw_561_CM 1 100. 0. 180. DISPLAY_IDENTIFIER WNWSEMN ECU_ADDRESS 0xd000e458 FORMAT "%7.2" /end MEASUREMENT
/begin MEASUREMENT Z_gen_1min "" UBYTE _CNV_R_R_Def_dez_sl_551_CM 1 100. 0. 255. DISPLAY_IDENTIFIER Z_GEN_1MIN ECU_ADDRESS 0xc000093f FORMAT "%3.0" /end MEASUREMENT
/begin MEASUREMENT Z_tchip "Zaehler für Mittelwerbildung Tchip_ist" UBYTE _CNV_R_R_Def_dez_sl_551_CM 1 100. 0. 255. DISPLAY_IDENTIFIER Z_TCHIP ECU_ADDRESS 0xc0007ad2 FORMAT "%3.0" /end MEASUREMENT
/begin CHARACTERISTIC KF_ALLK "Kennfeld Leerlauf Auslassspreizung gedrosselt kalt" MAP 0xa0830118 _REC_MAP_52_u1_s2_s2 99.96000000000001 _CNV_R_R_Def_spr_ub_558_CM 0. 204. FORMAT "%5.2"
 /begin AXIS_DESCR STD_AXIS Nkw _CNV_R_R_Def_n_sw_q_595_CM 12 -32768. 32767. FORMAT "%5.0" /end AXIS_DESCR
 /begin AXIS_DESCR STD_AXIS Rk_soll_s _CNV_R_R_Def_rk_sw__600_CM 12 -1600. 1599.9511 /end AXIS_DESCR
/end CHARACTERISTIC
/begin CHARACTERISTIC KF_ALLW "Kennfeld Leerlauf Auslassspreizung gedrosselt warm" MAP 0xa0830054 _REC_MAP_52_u1_s2_s2 99.96000000000001 _CNV_R_R_Def_spr_ub_558_CM 0. 204. FORMAT "%5.2"
 /begin AXIS_DESCR STD_AXIS Nkw _CNV_R_R_Def_n_sw_q_595_CM 12 -32768. 32767. FORMAT "%5.0" /end AXIS_DESCR
 /begin AXIS_DESCR STD_AXIS Rk_soll_s _CNV_R_R_Def_rk_sw__600_CM 12 -1600. 1599.9511 /end AXIS_DESCR
/end CHARACTERISTIC
/begin CHARACTERISTIC KF_ASUESP "Kennfeld optimale Auslassspreizung Ueberspuelen" MAP 0xa0830438 _REC_MAP_52_u1_s2_s2 99.96000000000001 _CNV_R_R_Def_spr_ub_558_CM 0. 204. FORMAT "%5.2"
 /begin AXIS_DESCR STD_AXIS Nkw _CNV_R_R_Def_n_sw_q_595_CM 8 -32768. 32767. FORMAT "%5.0" /end AXIS_DESCR
 /begin AXIS_DESCR STD_AXIS Rfv_vns _CNV_R_R_Def_rf_sw__598_CM 8 -327.68 327.67 FORMAT "%7.4" /end AXIS_DESCR
/end CHARACTERISTIC
/begin CHARACTERISTIC KF_DASTDLL "" MAP 0xa0830754 _REC_MAP_52_u1_u2_s2 99.96000000000001 _CNV_R_R_Def_spr_ub_558_CM 0. 204. FORMAT "%5.2" /begin AXIS_DESCR STD_AXIS Minhub _CNV_R_R_Def_hub_uw_589_CM 6 0. 65.535 /end AXIS_DESCR
 /begin AXIS_DESCR STD_AXIS Dpssolfilt _CNV_R_R_Def_p_sw_q_576_CM 6 -1280. 1279.9609 FORMAT "%5.2" /end AXIS_DESCR
/end CHARACTERISTIC
/begin CHARACTERISTIC KF_DASTDT "" MAP 0xa0830714 _REC_MAP_52_u1_u2_s2 99.96000000000001 _CNV_R_R_Def_spr_ub_558_CM 0. 204. FORMAT "%5.2" /begin AXIS_DESCR STD_AXIS Minhub _CNV_R_R_Def_hub_uw_589_CM 6 0. 65.535 /end AXIS_DESCR
 /begin AXIS_DESCR STD_AXIS Dpssolfilt _CNV_R_R_Def_p_sw_q_576_CM 6 -1280. 1279.9609 FORMAT "%5.2" /end AXIS_DESCR
/end CHARACTERISTIC
/begin CHARACTERISTIC KF_DESTDLL "" MAP 0xa08306d4 _REC_MAP_52_u1_u2_s2 99.96000000000001 _CNV_R_R_Def_spr_ub_558_CM 0. 204. FORMAT "%5.2" /begin AXIS_DESCR STD_AXIS Minhub _CNV_R_R_Def_hub_uw_589_CM 6 0. 65.535 /end AXIS_DESCR
 /begin AXIS_DESCR STD_AXIS Dpssolfilt _CNV_R_R_Def_p_sw_q_576_CM 6 -1280. 1279.9609 FORMAT "%5.2" /end AXIS_DESCR
/end CHARACTERISTIC
/begin CHARACTERISTIC KF_DESTDT "" MAP 0xa0830694 _REC_MAP_52_u1_u2_s2 99.96000000000001 _CNV_R_R_Def_spr_ub_558_CM 0. 204. FORMAT "%5.2" /begin AXIS_DESCR STD_AXIS Minhub _CNV_R_R_Def_hub_uw_589_CM 6 0. 65.535 /end AXIS_DESCR
 /begin AXIS_DESCR STD_AXIS Dpssolfilt _CNV_R_R_Def_p_sw_q_576_CM 6 -1280. 1279.9609 FORMAT "%5.2" /end AXIS_DESCR
/end CHARACTERISTIC
/begin CHARACTERISTIC KF_ELLK "Kennfeld Leerlauf Einlassspreizung gedrosselt kalt" MAP 0xa082fd98 _REC_MAP_52_u1_s2_s2 99.96000000000001 _CNV_R_R_Def_spr_ub_558_CM 0. 204. FORMAT "%5.2"
 /begin AXIS_DESCR STD_AXIS Nkw _CNV_R_R_Def_n_sw_q_595_CM 12 -32768. 32767. FORMAT "%5.0" /end AXIS_DESCR
 /begin AXIS_DESCR STD_AXIS Rk_soll_s _CNV_R_R_Def_rk_sw__600_CM 12 -1600. 1599.9511 /end AXIS_DESCR
/end CHARACTERISTIC
/begin CHARACTERISTIC KF_ELLW "Kennfeld Leerlauf Einlassspreizung gedrosselt warm" MAP 0xa082fcd4 _REC_MAP_52_u1_s2_s2 99.96000000000001 _CNV_R_R_Def_spr_ub_558_CM 0. 204. FORMAT "%5.2"
 /begin AXIS_DESCR STD_AXIS Nkw _CNV_R_R_Def_n_sw_q_595_CM 12 -32768. 32767. FORMAT "%5.0" /end AXIS_DESCR
 /begin AXIS_DESCR STD_AXIS Rk_soll_s _CNV_R_R_Def_rk_sw__600_CM 12 -1600. 1599.9511 /end AXIS_DESCR
/end CHARACTERISTIC
/begin CHARACTERISTIC KF_ESUESP "Kennfeld optimale Einlassspreizung Ueberspuelen" MAP 0xa08303d4 _REC_MAP_52_u1_s2_s2 99.96000000000001 _CNV_R_R_Def_spr_ub_558_CM 0. 204. FORMAT "%5.2"
 /begin AXIS_DESCR STD_AXIS Nkw _CNV_R_R_Def_n_sw_q_595_CM 8 -32768. 32767. FORMAT "%5.0" /end AXIS_DESCR
 /begin AXIS_DESCR STD_AXIS Rfv_vns _CNV_R_R_Def_rf_sw__598_CM 8 -327.68 327.67 FORMAT "%7.4" /end AXIS_DESCR
/end CHARACTERISTIC
/begin CHARACTERISTIC KF_ETAMDKH_DEM "Eta_mdkh bei Sub-BA KH_DOE_EM" MAP 0xa082f2cc _REC_MAP_52_UBYTE_s2_s2_s2 99.99844999999999 _CNV_R_R_Def_eta_sw_599_CM -200. 199.9938
 /begin AXIS_DESCR STD_AXIS Nkw _CNV_R_R_Def_n_sw_q_595_CM 12 -32768. 32767. FORMAT "%5.0" /end AXIS_DESCR
 /begin AXIS_DESCR STD_AXIS Rf _CNV_R_R_Def_rf_sw__598_CM 10 -327.68 327.67 FORMAT "%7.4" /end AXIS_DESCR
/end CHARACTERISTIC
/begin CHARACTERISTIC KF_ETAMDKH_DLR "Eta_mdkh bei Sub-BA KH_DOE_LR" MAP 0xa082f1ac _REC_MAP_52_UBYTE_s2_s2_s2 99.99844999999999 _CNV_R_R_Def_eta_sw_599_CM -200. 199.9938
 /begin AXIS_DESCR STD_AXIS Nkw _CNV_R_R_Def_n_sw_q_595_CM 12 -32768. 32767. FORMAT "%5.0" /end AXIS_DESCR
 /begin AXIS_DESCR STD_AXIS Rf _CNV_R_R_Def_rf_sw__598_CM 10 -327.68 327.67 FORMAT "%7.4" /end AXIS_DESCR
/end CHARACTERISTIC
/begin CHARACTERISTIC KF_ETAMDKH_EM "Eta_mdkh bei Sub-BA KH_EM" MAP 0xa082f50c _REC_MAP_52_UBYTE_s2_s2_s2 99.99844999999999 _CNV_R_R_Def_eta_sw_599_CM -200. 199.9938
 /begin AXIS_DESCR STD_AXIS Nkw _CNV_R_R_Def_n_sw_q_595_CM 12 -32768. 32767. FORMAT "%5.0" /end AXIS_DESCR
 /begin AXIS_DESCR STD_AXIS Rf _CNV_R_R_Def_rf_sw__598_CM 10 -327.68 327.67 FORMAT "%7.4" /end AXIS_DESCR
/end CHARACTERISTIC
/begin CHARACTERISTIC KF_ETAMDKH_LR "Eta_mdkh bei Sub-BA KH_LR" MAP 0xa082f3ec _REC_MAP_52_UBYTE_s2_s2_s2 99.99844999999999 _CNV_R_R_Def_eta_sw_599_CM -200. 199.9938
 /begin AXIS_DESCR STD_AXIS Nkw _CNV_R_R_Def_n_sw_q_595_CM 12 -32768. 32767. FORMAT "%5.0" /end AXIS_DESCR
 /begin AXIS_DESCR STD_AXIS Rf _CNV_R_R_Def_rf_sw__598_CM 10 -327.68 327.67 FORMAT "%7.4" /end AXIS_DESCR
/end CHARACTERISTIC
/begin CHARACTERISTIC KF_GENTYP_NEU "Auswahlkennfeld Generatortyp" MAP 0xa0824614 _REC_MAP_52_u1_u1_u1 6. _CNV_R_R_Def_dez_sl_551_CM 1. 7. FORMAT "%3.0"
 /begin AXIS_DESCR STD_AXIS Gen_manufak _CNV_R_R_Def_dez_sl_551_CM 6 0. 255. FORMAT "%3.0" /end AXIS_DESCR
 /begin AXIS_DESCR STD_AXIS Gen_typkenn _CNV_R_R_Def_dez_sl_551_CM 32 0. 255. FORMAT "%3.0" /end AXIS_DESCR
/end CHARACTERISTIC
/begin CHARACTERISTIC KF_IERRGREHT "Generatorstrombegrenzung bei Generatorhochtemparatur" MAP 0xa0825160 _REC_MAP_52_u1_s2_s2 31.875 _CNV_R_R_Def_i_uw_q_630_CM 0. 31.875
 /begin AXIS_DESCR STD_AXIS N_gen _CNV_R_R_Def_n_sw_q_595_CM 3 -32768. 32767. FORMAT "%5.0" /end AXIS_DESCR
 /begin AXIS_DESCR STD_AXIS Gen_awnumm _CNV_R_R_Def_dez_sl_551_CM 6 -32768. 32767. FORMAT "%5.0" /end AXIS_DESCR
/end CHARACTERISTIC
/begin CHARACTERISTIC KF_IU1T1_1 "Kennfeld Generatorstrommodell" MAP 0xa0823eb4 _REC_MAP_52_UBYTE_s2_s2_s2 102.398435 _CNV_R_R_Def_i_sw_q_645_CM -1024. 1023.9687
 /begin AXIS_DESCR STD_AXIS NO_INPUT_QUANTITY _CNV_R_R_Def_i_uw_q_630_CM 10 -4096. 4095.875 /end AXIS_DESCR
 /begin AXIS_DESCR STD_AXIS N_gen _CNV_R_R_Def_n_sw_q_595_CM 10 -32768. 32767. FORMAT "%5.0" /end AXIS_DESCR
/end CHARACTERISTIC
/begin CHARACTERISTIC KF_IU1T1_2 "Kennfeld Generatorstrommodell" MAP 0xa08226e0 _REC_MAP_52_UBYTE_s2_s2_s2 102.398435 _CNV_R_R_Def_i_sw_q_645_CM -1024. 1023.9687
 /begin AXIS_DESCR STD_AXIS NO_INPUT_QUANTITY _CNV_R_R_Def_i_uw_q_630_CM 10 -4096. 4095.875 /end AXIS_DESCR
 /begin AXIS_DESCR STD_AXIS N_gen _CNV_R_R_Def_n_sw_q_595_CM 10 -32768. 32767. FORMAT "%5.0" /end AXIS_DESCR
/end CHARACTERISTIC
/begin CHARACTERISTIC KF_IU1T1_3 "Kennfeld Generatorstrommodell" MAP 0xa0822c98 _REC_MAP_52_UBYTE_s2_s2_s2 102.398435 _CNV_R_R_Def_i_sw_q_645_CM -1024. 1023.9687
 /begin AXIS_DESCR STD_AXIS NO_INPUT_QUANTITY _CNV_R_R_Def_i_uw_q_630_CM 10 -4096. 4095.875 /end AXIS_DESCR
 /begin AXIS_DESCR STD_AXIS N_gen _CNV_R_R_Def_n_sw_q_595_CM 10 -32768. 32767. FORMAT "%5.0" /end AXIS_DESCR
/end CHARACTERISTIC
/begin CHARACTERISTIC KF_IU1T1_4 "Kennfeld Generatorstrommodell" MAP 0xa0822f74 _REC_MAP_52_UBYTE_s2_s2_s2 102.398435 _CNV_R_R_Def_i_sw_q_645_CM -1024. 1023.9687
 /begin AXIS_DESCR STD_AXIS NO_INPUT_QUANTITY _CNV_R_R_Def_i_uw_q_630_CM 10 -4096. 4095.875 /end AXIS_DESCR
 /begin AXIS_DESCR STD_AXIS N_gen _CNV_R_R_Def_n_sw_q_595_CM 10 -32768. 32767. FORMAT "%5.0" /end AXIS_DESCR
/end CHARACTERISTIC
/begin CHARACTERISTIC KF_IU1T1_5 "Kennfeld Generatorstrommodell" MAP 0xa0822e80 _REC_MAP_52_UBYTE_s2_s2_s2 102.398435 _CNV_R_R_Def_i_sw_q_645_CM -1024. 1023.9687
 /begin AXIS_DESCR STD_AXIS NO_INPUT_QUANTITY _CNV_R_R_Def_i_uw_q_630_CM 10 -4096. 4095.875 /end AXIS_DESCR
 /begin AXIS_DESCR STD_AXIS N_gen _CNV_R_R_Def_n_sw_q_595_CM 10 -32768. 32767. FORMAT "%5.0" /end AXIS_DESCR
/end CHARACTERISTIC
/begin CHARACTERISTIC KF_IU1T1_6 "Kennfeld Generatorstrommodell" MAP 0xa082352c _REC_MAP_52_UBYTE_s2_s2_s2 102.398435 _CNV_R_R_Def_i_sw_q_645_CM -1024. 1023.9687
 /begin AXIS_DESCR STD_AXIS NO_INPUT_QUANTITY _CNV_R_R_Def_i_uw_q_630_CM 10 -4096. 4095.875 /end AXIS_DESCR
 /begin AXIS_DESCR STD_AXIS N_gen _CNV_R_R_Def_n_sw_q_595_CM 10 -32768. 32767. FORMAT "%5.0" /end AXIS_DESCR
/end CHARACTERISTIC
/begin CHARACTERISTIC KF_IU1T2_1 "Kennfeld Generatorstrommodell" MAP 0xa082409c _REC_MAP_52_UBYTE_s2_s2_s2 102.398435 _CNV_R_R_Def_i_sw_q_645_CM -1024. 1023.9687
 /begin AXIS_DESCR STD_AXIS NO_INPUT_QUANTITY _CNV_R_R_Def_i_uw_q_630_CM 10 -4096. 4095.875 /end AXIS_DESCR
 /begin AXIS_DESCR STD_AXIS N_gen _CNV_R_R_Def_n_sw_q_595_CM 10 -32768. 32767. FORMAT "%5.0" /end AXIS_DESCR
/end CHARACTERISTIC
/begin CHARACTERISTIC KF_IU1T2_2 "Kennfeld Generatorstrommodell" MAP 0xa08229bc _REC_MAP_52_UBYTE_s2_s2_s2 102.398435 _CNV_R_R_Def_i_sw_q_645_CM -1024. 1023.9687
 /begin AXIS_DESCR STD_AXIS NO_INPUT_QUANTITY _CNV_R_R_Def_i_uw_q_630_CM 10 -4096. 4095.875 /end AXIS_DESCR
 /begin AXIS_DESCR STD_AXIS N_gen _CNV_R_R_Def_n_sw_q_595_CM 10 -32768. 32767. FORMAT "%5.0" /end AXIS_DESCR
/end CHARACTERISTIC
/begin CHARACTERISTIC KF_IU1T2_3 "Kennfeld Generatorstrommodell" MAP 0xa0823250 _REC_MAP_52_UBYTE_s2_s2_s2 102.398435 _CNV_R_R_Def_i_sw_q_645_CM -1024. 1023.9687
 /begin AXIS_DESCR STD_AXIS NO_INPUT_QUANTITY _CNV_R_R_Def_i_uw_q_630_CM 10 -4096. 4095.875 /end AXIS_DESCR
 /begin AXIS_DESCR STD_AXIS N_gen _CNV_R_R_Def_n_sw_q_595_CM 10 -32768. 32767. FORMAT "%5.0" /end AXIS_DESCR
/end CHARACTERISTIC
/begin CHARACTERISTIC KF_IU1T2_4 "Kennfeld Generatorstrommodell" MAP 0xa0823620 _REC_MAP_52_UBYTE_s2_s2_s2 102.398435 _CNV_R_R_Def_i_sw_q_645_CM -1024. 1023.9687
 /begin AXIS_DESCR STD_AXIS NO_INPUT_QUANTITY _CNV_R_R_Def_i_uw_q_630_CM 10 -4096. 4095.875 /end AXIS_DESCR
 /begin AXIS_DESCR STD_AXIS N_gen _CNV_R_R_Def_n_sw_q_595_CM 10 -32768. 32767. FORMAT "%5.0" /end AXIS_DESCR
/end CHARACTERISTIC
/begin CHARACTERISTIC KF_IU1T2_5 "Kennfeld Generatorstrommodell" MAP 0xa08225ec _REC_MAP_52_UBYTE_s2_s2_s2 102.398435 _CNV_R_R_Def_i_sw_q_645_CM -1024. 1023.9687
 /begin AXIS_DESCR STD_AXIS NO_INPUT_QUANTITY _CNV_R_R_Def_i_uw_q_630_CM 10 -4096. 4095.875 /end AXIS_DESCR
 /begin AXIS_DESCR STD_AXIS N_gen _CNV_R_R_Def_n_sw_q_595_CM 10 -32768. 32767. FORMAT "%5.0" /end AXIS_DESCR
/end CHARACTERISTIC
/begin CHARACTERISTIC KF_IU1T2_6 "Kennfeld Generatorstrommodell" MAP 0xa0823714 _REC_MAP_52_UBYTE_s2_s2_s2 102.398435 _CNV_R_R_Def_i_sw_q_645_CM -1024. 1023.9687
 /begin AXIS_DESCR STD_AXIS NO_INPUT_QUANTITY _CNV_R_R_Def_i_uw_q_630_CM 10 -4096. 4095.875 /end AXIS_DESCR
 /begin AXIS_DESCR STD_AXIS N_gen _CNV_R_R_Def_n_sw_q_595_CM 10 -32768. 32767. FORMAT "%5.0" /end AXIS_DESCR
/end CHARACTERISTIC
/begin CHARACTERISTIC KF_IU2T1_1 "Kennfeld Generatorstrommodell" MAP 0xa0823344 _REC_MAP_52_UBYTE_s2_s2_s2 102.398435 _CNV_R_R_Def_i_sw_q_645_CM -1024. 1023.9687
 /begin AXIS_DESCR STD_AXIS NO_INPUT_QUANTITY _CNV_R_R_Def_i_uw_q_630_CM 10 -4096. 4095.875 /end AXIS_DESCR
 /begin AXIS_DESCR STD_AXIS N_gen _CNV_R_R_Def_n_sw_q_595_CM 10 -32768. 32767. FORMAT "%5.0" /end AXIS_DESCR
/end CHARACTERISTIC
/begin CHARACTERISTIC KF_IU2T1_2 "Kennfeld Generatorstrommodell" MAP 0xa0822ab0 _REC_MAP_52_UBYTE_s2_s2_s2 102.398435 _CNV_R_R_Def_i_sw_q_645_CM -1024. 1023.9687
 /begin AXIS_DESCR STD_AXIS NO_INPUT_QUANTITY _CNV_R_R_Def_i_uw_q_630_CM 10 -4096. 4095.875 /end AXIS_DESCR
 /begin AXIS_DESCR STD_AXIS N_gen _CNV_R_R_Def_n_sw_q_595_CM 10 -32768. 32767. FORMAT "%5.0" /end AXIS_DESCR
/end CHARACTERISTIC
/begin CHARACTERISTIC KF_IU2T1_3 "Kennfeld Generatorstrommodell" MAP 0xa08224f8 _REC_MAP_52_UBYTE_s2_s2_s2 102.398435 _CNV_R_R_Def_i_sw_q_645_CM -1024. 1023.9687
 /begin AXIS_DESCR STD_AXIS NO_INPUT_QUANTITY _CNV_R_R_Def_i_uw_q_630_CM 10 -4096. 4095.875 /end AXIS_DESCR
 /begin AXIS_DESCR STD_AXIS N_gen _CNV_R_R_Def_n_sw_q_595_CM 10 -32768. 32767. FORMAT "%5.0" /end AXIS_DESCR
/end CHARACTERISTIC
/begin CHARACTERISTIC KF_IU2T1_4 "Kennfeld Generatorstrommodell" MAP 0xa0823068 _REC_MAP_52_UBYTE_s2_s2_s2 102.398435 _CNV_R_R_Def_i_sw_q_645_CM -1024. 1023.9687
 /begin AXIS_DESCR STD_AXIS NO_INPUT_QUANTITY _CNV_R_R_Def_i_uw_q_630_CM 10 -4096. 4095.875 /end AXIS_DESCR
 /begin AXIS_DESCR STD_AXIS N_gen _CNV_R_R_Def_n_sw_q_595_CM 10 -32768. 32767. FORMAT "%5.0" /end AXIS_DESCR
/end CHARACTERISTIC
/begin CHARACTERISTIC KF_IU2T1_5 "Kennfeld Generatorstrommodell" MAP 0xa08239f0 _REC_MAP_52_UBYTE_s2_s2_s2 102.398435 _CNV_R_R_Def_i_sw_q_645_CM -1024. 1023.9687
 /begin AXIS_DESCR STD_AXIS NO_INPUT_QUANTITY _CNV_R_R_Def_i_uw_q_630_CM 10 -4096. 4095.875 /end AXIS_DESCR
 /begin AXIS_DESCR STD_AXIS N_gen _CNV_R_R_Def_n_sw_q_595_CM 10 -32768. 32767. FORMAT "%5.0" /end AXIS_DESCR
/end CHARACTERISTIC
/begin CHARACTERISTIC KF_IU2T1_6 "Kennfeld Generatorstrommodell" MAP 0xa0824378 _REC_MAP_52_UBYTE_s2_s2_s2 102.398435 _CNV_R_R_Def_i_sw_q_645_CM -1024. 1023.9687
 /begin AXIS_DESCR STD_AXIS NO_INPUT_QUANTITY _CNV_R_R_Def_i_uw_q_630_CM 10 -4096. 4095.875 /end AXIS_DESCR
 /begin AXIS_DESCR STD_AXIS N_gen _CNV_R_R_Def_n_sw_q_595_CM 10 -32768. 32767. FORMAT "%5.0" /end AXIS_DESCR
/end CHARACTERISTIC
/begin CHARACTERISTIC KF_KALLW "Kennfeld Leerlauf Auslassspreizung gedrosselt kalt zum Katheizen" MAP 0xa0830b14 _REC_MAP_52_u1_s2_s2 99.96000000000001 _CNV_R_R_Def_spr_ub_558_CM 0. 204. FORMAT "%5.2"
 /begin AXIS_DESCR STD_AXIS Nkw _CNV_R_R_Def_n_sw_q_595_CM 12 -32768. 32767. FORMAT "%5.0" /end AXIS_DESCR
 /begin AXIS_DESCR STD_AXIS Rfv_vns _CNV_R_R_Def_rf_sw__598_CM 12 -327.68 327.67 FORMAT "%7.4" /end AXIS_DESCR
/end CHARACTERISTIC
/begin CHARACTERISTIC KF_KALLW_2 "Kennfeld Leerlauf Auslassspreizung gedrosselt kalt zum Katheizen" MAP 0xa0831214 _REC_MAP_52_u1_s2_s2 99.96000000000001 _CNV_R_R_Def_spr_ub_558_CM 0. 204. FORMAT "%5.2"
 /begin AXIS_DESCR STD_AXIS Nkw _CNV_R_R_Def_n_sw_q_595_CM 12 -32768. 32767. FORMAT "%5.0" /end AXIS_DESCR
 /begin AXIS_DESCR STD_AXIS Rfv_vns _CNV_R_R_Def_rf_sw__598_CM 12 -327.68 327.67 FORMAT "%7.4" /end AXIS_DESCR
/end CHARACTERISTIC
/begin CHARACTERISTIC KF_KASKH "" MAP 0xa0830c9c _REC_MAP_52_u1_s2_s2 99.96000000000001 _CNV_R_R_Def_spr_ub_558_CM 0. 204. FORMAT "%5.2"
 /begin AXIS_DESCR STD_AXIS Nkw _CNV_R_R_Def_n_sw_q_595_CM 16 -32768. 32767. FORMAT "%5.0" /end AXIS_DESCR
 /begin AXIS_DESCR STD_AXIS Rfv_vns _CNV_R_R_Def_rf_sw__598_CM 12 -327.68 327.67 FORMAT "%7.4" /end AXIS_DESCR
/end CHARACTERISTIC
/begin CHARACTERISTIC KF_KASKH_2 "" MAP 0xa083139c _REC_MAP_52_u1_s2_s2 99.96000000000001 _CNV_R_R_Def_spr_ub_558_CM 0. 204. FORMAT "%5.2"
 /begin AXIS_DESCR STD_AXIS Nkw _CNV_R_R_Def_n_sw_q_595_CM 16 -32768. 32767. FORMAT "%5.0" /end AXIS_DESCR
 /begin AXIS_DESCR STD_AXIS Rfv_vns _CNV_R_R_Def_rf_sw__598_CM 12 -327.68 327.67 FORMAT "%7.4" /end AXIS_DESCR
/end CHARACTERISTIC
/begin CHARACTERISTIC KF_KASLL "" MAP 0xa082f908 _REC_MAP_52_u1_s2_s2 99.96000000000001 _CNV_R_R_Def_spr_ub_558_CM 0. 204. FORMAT "%5.2"
 /begin AXIS_DESCR STD_AXIS Nkw _CNV_R_R_Def_n_sw_q_595_CM 12 -32768. 32767. FORMAT "%5.0" /end AXIS_DESCR
 /begin AXIS_DESCR STD_AXIS Rfv_vns _CNV_R_R_Def_rf_sw__598_CM 12 -327.68 327.67 FORMAT "%7.4" /end AXIS_DESCR
/end CHARACTERISTIC
/begin CHARACTERISTIC KF_KASLL_HS "" MAP 0xa08319e4 _REC_MAP_52_u1_s2_s2 99.96000000000001 _CNV_R_R_Def_spr_ub_558_CM 0. 204. FORMAT "%5.2"
 /begin AXIS_DESCR STD_AXIS Nkw _CNV_R_R_Def_n_sw_q_595_CM 12 -32768. 32767. FORMAT "%5.0" /end AXIS_DESCR
 /begin AXIS_DESCR STD_AXIS Rk_soll_hs _CNV_R_R_Def_rk_sw__600_CM 5 -1600. 1599.9511 /end AXIS_DESCR
/end CHARACTERISTIC
/begin CHARACTERISTIC KF_KASOPT "Kennfeld optimale Auslassspreizung kalt teilgedrosselt" MAP 0xa082fe5c _REC_MAP_52_u1_s2_s2 99.96000000000001 _CNV_R_R_Def_spr_ub_558_CM 0. 204. FORMAT "%5.2"
 /begin AXIS_DESCR STD_AXIS Nkw _CNV_R_R_Def_n_sw_q_595_CM 16 -32768. 32767. FORMAT "%5.0" /end AXIS_DESCR
 /begin AXIS_DESCR STD_AXIS Rk_soll_s _CNV_R_R_Def_rk_sw__600_CM 12 -1600. 1599.9511 /end AXIS_DESCR
/end CHARACTERISTIC
/begin CHARACTERISTIC KF_KASOPT_HS "Kennfeld optimale Auslassspreizung kalt Homogen_Schicht" MAP 0xa083178c _REC_MAP_52_u1_s2_s2 99.96000000000001 _CNV_R_R_Def_spr_ub_558_CM 0. 204. FORMAT "%5.2"
 /begin AXIS_DESCR STD_AXIS Nkw _CNV_R_R_Def_n_sw_q_595_CM 16 -32768. 32767. FORMAT "%5.0" /end AXIS_DESCR
 /begin AXIS_DESCR STD_AXIS Rk_soll_hs _CNV_R_R_Def_rk_sw__600_CM 12 -1600. 1599.9511 /end AXIS_DESCR
/end CHARACTERISTIC
/begin CHARACTERISTIC KF_KASOPU "Kennfeld optimale Auslassspreizung kalt ungedrosselt" MAP 0xa0830598 _REC_MAP_52_u1_s2_s2 99.96000000000001 _CNV_R_R_Def_spr_ub_558_CM 0. 204. FORMAT "%5.2"
 /begin AXIS_DESCR STD_AXIS Nkw _CNV_R_R_Def_n_sw_q_595_CM 16 -32768. 32767. FORMAT "%5.0" /end AXIS_DESCR
 /begin AXIS_DESCR STD_AXIS Rfv_vns _CNV_R_R_Def_rf_sw__598_CM 12 -327.68 327.67 FORMAT "%7.4" /end AXIS_DESCR
/end CHARACTERISTIC
/begin CHARACTERISTIC KF_KELLW "Kennfeld Leerlauf Einlassspreizung gedrosselt kalt zum Katheizen" MAP 0xa0830794 _REC_MAP_52_u1_s2_s2 99.96000000000001 _CNV_R_R_Def_spr_ub_558_CM 0. 204. FORMAT "%5.2"
 /begin AXIS_DESCR STD_AXIS Nkw _CNV_R_R_Def_n_sw_q_595_CM 12 -32768. 32767. FORMAT "%5.0" /end AXIS_DESCR
 /begin AXIS_DESCR STD_AXIS Rfv_vns _CNV_R_R_Def_rf_sw__598_CM 12 -327.68 327.67 FORMAT "%7.4" /end AXIS_DESCR
/end CHARACTERISTIC
/begin CHARACTERISTIC KF_KELLW_2 "Kennfeld Leerlauf Einlassspreizung gedrosselt kalt zum Katheizen" MAP 0xa0830e94 _REC_MAP_52_u1_s2_s2 99.96000000000001 _CNV_R_R_Def_spr_ub_558_CM 0. 204. FORMAT "%5.2"
 /begin AXIS_DESCR STD_AXIS Nkw _CNV_R_R_Def_n_sw_q_595_CM 12 -32768. 32767. FORMAT "%5.0" /end AXIS_DESCR
 /begin AXIS_DESCR STD_AXIS Rfv_vns _CNV_R_R_Def_rf_sw__598_CM 12 -327.68 327.67 FORMAT "%7.4" /end AXIS_DESCR
/end CHARACTERISTIC
/begin CHARACTERISTIC KF_KESKH "" MAP 0xa083091c _REC_MAP_52_u1_s2_s2 99.96000000000001 _CNV_R_R_Def_spr_ub_558_CM 0. 204. FORMAT "%5.2"
 /begin AXIS_DESCR STD_AXIS Nkw _CNV_R_R_Def_n_sw_q_595_CM 16 -32768. 32767. FORMAT "%5.0" /end AXIS_DESCR
 /begin AXIS_DESCR STD_AXIS Rfv_vns _CNV_R_R_Def_rf_sw__598_CM 12 -327.68 327.67 FORMAT "%7.4" /end AXIS_DESCR
/end CHARACTERISTIC
/begin CHARACTERISTIC KF_KESKH_2 "" MAP 0xa083101c _REC_MAP_52_u1_s2_s2 99.96000000000001 _CNV_R_R_Def_spr_ub_558_CM 0. 204. FORMAT "%5.2"
 /begin AXIS_DESCR STD_AXIS Nkw _CNV_R_R_Def_n_sw_q_595_CM 16 -32768. 32767. FORMAT "%5.0" /end AXIS_DESCR
 /begin AXIS_DESCR STD_AXIS Rfv_vns _CNV_R_R_Def_rf_sw__598_CM 12 -327.68 327.67 FORMAT "%7.4" /end AXIS_DESCR
/end CHARACTERISTIC
/begin CHARACTERISTIC KF_KESLL "" MAP 0xa082f844 _REC_MAP_52_u1_s2_s2 99.96000000000001 _CNV_R_R_Def_spr_ub_558_CM 0. 204. FORMAT "%5.2"
 /begin AXIS_DESCR STD_AXIS Nkw _CNV_R_R_Def_n_sw_q_595_CM 12 -32768. 32767. FORMAT "%5.0" /end AXIS_DESCR
 /begin AXIS_DESCR STD_AXIS Rfv_vns _CNV_R_R_Def_rf_sw__598_CM 12 -327.68 327.67 FORMAT "%7.4" /end AXIS_DESCR
/end CHARACTERISTIC
/begin CHARACTERISTIC KF_KESLL_HS "" MAP 0xa0831984 _REC_MAP_52_u1_s2_s2 99.96000000000001 _CNV_R_R_Def_spr_ub_558_CM 0. 204. FORMAT "%5.2"
 /begin AXIS_DESCR STD_AXIS Nkw _CNV_R_R_Def_n_sw_q_595_CM 12 -32768. 32767. FORMAT "%5.0" /end AXIS_DESCR
 /begin AXIS_DESCR STD_AXIS Rk_soll_hs _CNV_R_R_Def_rk_sw__600_CM 5 -1600. 1599.9511 /end AXIS_DESCR
/end CHARACTERISTIC
/begin CHARACTERISTIC KF_KESOPT "Kennfeld optimale Einlassspreizung kalt teilgedrosselt" MAP 0xa082fadc _REC_MAP_52_u1_s2_s2 99.96000000000001 _CNV_R_R_Def_spr_ub_558_CM 0. 204. FORMAT "%5.2"
 /begin AXIS_DESCR STD_AXIS Nkw _CNV_R_R_Def_n_sw_q_595_CM 16 -32768. 32767. FORMAT "%5.0" /end AXIS_DESCR
 /begin AXIS_DESCR STD_AXIS Rk_soll_s _CNV_R_R_Def_rk_sw__600_CM 12 -1600. 1599.9511 /end AXIS_DESCR
/end CHARACTERISTIC
/begin CHARACTERISTIC KF_KESOPT_HS "Kennfeld optimale Einlassspreizung kalt Homogen_Schicht" MAP 0xa0831594 _REC_MAP_52_u1_s2_s2 99.96000000000001 _CNV_R_R_Def_spr_ub_558_CM 0. 204. FORMAT "%5.2"
 /begin AXIS_DESCR STD_AXIS Nkw _CNV_R_R_Def_n_sw_q_595_CM 16 -32768. 32767. FORMAT "%5.0" /end AXIS_DESCR
 /begin AXIS_DESCR STD_AXIS Rk_soll_hs _CNV_R_R_Def_rk_sw__600_CM 12 -1600. 1599.9511 /end AXIS_DESCR
/end CHARACTERISTIC
/begin CHARACTERISTIC KF_KESOPU "Kennfeld optimale Einlassspreizung kalt ungedrosselt" MAP 0xa083049c _REC_MAP_52_u1_s2_s2 99.96000000000001 _CNV_R_R_Def_spr_ub_558_CM 0. 204. FORMAT "%5.2"
 /begin AXIS_DESCR STD_AXIS Nkw _CNV_R_R_Def_n_sw_q_595_CM 16 -32768. 32767. FORMAT "%5.0" /end AXIS_DESCR
 /begin AXIS_DESCR STD_AXIS Rfv_vns _CNV_R_R_Def_rf_sw__598_CM 12 -327.68 327.67 FORMAT "%7.4" /end AXIS_DESCR
/end CHARACTERISTIC
/begin CHARACTERISTIC KF_MDGENFIL "Kennfeld Filterkonstante Generatormoment" MAP 0xa08245b0 _REC_MAP_52_UBYTE_u2_u2_s2 0.9999847412109381 _CNV_R_R_Def_f_uw_b_571_CM 0. 0.9999847412109381 FORMAT "%14.5" /begin AXIS_DESCR STD_AXIS Dffgen_f _CNV_R_R_Def_f_uw_b_555_CM 6 0. 99.9984 /end AXIS_DESCR
 /begin AXIS_DESCR STD_AXIS NO_INPUT_QUANTITY _CNV_R_R_Def_dt_sw__587_CM 6 -4096. 4095.875 FORMAT "%5.2" /end AXIS_DESCR
/end CHARACTERISTIC
/begin CHARACTERISTIC KF_MU1T1_1 "Kennfeld Generatormomentenmodell" MAP 0xa082315c _REC_MAP_52_UBYTE_s2_s2_s2 131.07 _CNV_R_R_Def_m_sw_q_554_CM -3276.8 3276.7 FORMAT "%5.2"
 /begin AXIS_DESCR STD_AXIS Ierr _CNV_R_R_Def_i_uw_q_630_CM 10 -4096. 4095.875 /end AXIS_DESCR
 /begin AXIS_DESCR STD_AXIS N_gen _CNV_R_R_Def_n_sw_q_595_CM 10 -32768. 32767. FORMAT "%5.0" /end AXIS_DESCR
/end CHARACTERISTIC
/begin CHARACTERISTIC KF_MU1T1_2 "Kennfeld Generatormomentenmodell" MAP 0xa0823ccc _REC_MAP_52_UBYTE_s2_s2_s2 131.07 _CNV_R_R_Def_m_sw_q_554_CM -3276.8 3276.7 FORMAT "%5.2"
 /begin AXIS_DESCR STD_AXIS Ierr _CNV_R_R_Def_i_uw_q_630_CM 10 -4096. 4095.875 /end AXIS_DESCR
 /begin AXIS_DESCR STD_AXIS N_gen _CNV_R_R_Def_n_sw_q_595_CM 10 -32768. 32767. FORMAT "%5.0" /end AXIS_DESCR
/end CHARACTERISTIC
/begin CHARACTERISTIC KF_MU1T1_3 "Kennfeld Generatormomentenmodell" MAP 0xa0824284 _REC_MAP_52_UBYTE_s2_s2_s2 131.07 _CNV_R_R_Def_m_sw_q_554_CM -3276.8 3276.7 FORMAT "%5.2"
 /begin AXIS_DESCR STD_AXIS Ierr _CNV_R_R_Def_i_uw_q_630_CM 10 -4096. 4095.875 /end AXIS_DESCR
 /begin AXIS_DESCR STD_AXIS N_gen _CNV_R_R_Def_n_sw_q_595_CM 10 -32768. 32767. FORMAT "%5.0" /end AXIS_DESCR
/end CHARACTERISTIC
/begin CHARACTERISTIC KF_MU1T1_4 "Kennfeld Generatormomentenmodell" MAP 0xa0823ae4 _REC_MAP_52_UBYTE_s2_s2_s2 131.07 _CNV_R_R_Def_m_sw_q_554_CM -3276.8 3276.7 FORMAT "%5.2"
 /begin AXIS_DESCR STD_AXIS Ierr _CNV_R_R_Def_i_uw_q_630_CM 10 -4096. 4095.875 /end AXIS_DESCR
 /begin AXIS_DESCR STD_AXIS N_gen _CNV_R_R_Def_n_sw_q_595_CM 10 -32768. 32767. FORMAT "%5.0" /end AXIS_DESCR
/end CHARACTERISTIC
/begin CHARACTERISTIC KF_MU1T1_5 "Kennfeld Generatormomentenmodell" MAP 0xa0823fa8 _REC_MAP_52_UBYTE_s2_s2_s2 131.07 _CNV_R_R_Def_m_sw_q_554_CM -3276.8 3276.7 FORMAT "%5.2"
 /begin AXIS_DESCR STD_AXIS Ierr _CNV_R_R_Def_i_uw_q_630_CM 10 -4096. 4095.875 /end AXIS_DESCR
 /begin AXIS_DESCR STD_AXIS N_gen _CNV_R_R_Def_n_sw_q_595_CM 10 -32768. 32767. FORMAT "%5.0" /end AXIS_DESCR
/end CHARACTERISTIC
/begin CHARACTERISTIC KF_MU1T1_6 "Kennfeld Generatormomentenmodell" MAP 0xa0822404 _REC_MAP_52_UBYTE_s2_s2_s2 131.07 _CNV_R_R_Def_m_sw_q_554_CM -3276.8 3276.7 FORMAT "%5.2"
 /begin AXIS_DESCR STD_AXIS Ierr _CNV_R_R_Def_i_uw_q_630_CM 10 -4096. 4095.875 /end AXIS_DESCR
 /begin AXIS_DESCR STD_AXIS N_gen _CNV_R_R_Def_n_sw_q_595_CM 10 -32768. 32767. FORMAT "%5.0" /end AXIS_DESCR
/end CHARACTERISTIC
/begin CHARACTERISTIC KF_MU1T2_1 "Kennfeld Generatormomentenmodell" MAP 0xa0822d8c _REC_MAP_52_UBYTE_s2_s2_s2 131.07 _CNV_R_R_Def_m_sw_q_554_CM -3276.8 3276.7 FORMAT "%5.2"
 /begin AXIS_DESCR STD_AXIS Ierr _CNV_R_R_Def_i_uw_q_630_CM 10 -4096. 4095.875 /end AXIS_DESCR
 /begin AXIS_DESCR STD_AXIS N_gen _CNV_R_R_Def_n_sw_q_595_CM 10 -32768. 32767. FORMAT "%5.0" /end AXIS_DESCR
/end CHARACTERISTIC
/begin CHARACTERISTIC KF_MU1T2_2 "Kennfeld Generatormomentenmodell" MAP 0xa0824190 _REC_MAP_52_UBYTE_s2_s2_s2 131.07 _CNV_R_R_Def_m_sw_q_554_CM -3276.8 3276.7 FORMAT "%5.2"
 /begin AXIS_DESCR STD_AXIS Ierr _CNV_R_R_Def_i_uw_q_630_CM 10 -4096. 4095.875 /end AXIS_DESCR
 /begin AXIS_DESCR STD_AXIS N_gen _CNV_R_R_Def_n_sw_q_595_CM 10 -32768. 32767. FORMAT "%5.0" /end AXIS_DESCR
/end CHARACTERISTIC
/begin CHARACTERISTIC KF_MU1T2_3 "Kennfeld Generatormomentenmodell" MAP 0xa0822310 _REC_MAP_52_UBYTE_s2_s2_s2 131.07 _CNV_R_R_Def_m_sw_q_554_CM -3276.8 3276.7 FORMAT "%5.2"
 /begin AXIS_DESCR STD_AXIS Ierr _CNV_R_R_Def_i_uw_q_630_CM 10 -4096. 4095.875 /end AXIS_DESCR
 /begin AXIS_DESCR STD_AXIS N_gen _CNV_R_R_Def_n_sw_q_595_CM 10 -32768. 32767. FORMAT "%5.0" /end AXIS_DESCR
/end CHARACTERISTIC
/begin CHARACTERISTIC KF_MU1T2_4 "Kennfeld Generatormomentenmodell" MAP 0xa0822ba4 _REC_MAP_52_UBYTE_s2_s2_s2 131.07 _CNV_R_R_Def_m_sw_q_554_CM -3276.8 3276.7 FORMAT "%5.2"
 /begin AXIS_DESCR STD_AXIS Ierr _CNV_R_R_Def_i_uw_q_630_CM 10 -4096. 4095.875 /end AXIS_DESCR
 /begin AXIS_DESCR STD_AXIS N_gen _CNV_R_R_Def_n_sw_q_595_CM 10 -32768. 32767. FORMAT "%5.0" /end AXIS_DESCR
/end CHARACTERISTIC
/begin CHARACTERISTIC KF_MU1T2_5 "Kennfeld Generatormomentenmodell" MAP 0xa08238fc _REC_MAP_52_UBYTE_s2_s2_s2 131.07 _CNV_R_R_Def_m_sw_q_554_CM -3276.8 3276.7 FORMAT "%5.2"
 /begin AXIS_DESCR STD_AXIS Ierr _CNV_R_R_Def_i_uw_q_630_CM 10 -4096. 4095.875 /end AXIS_DESCR
 /begin AXIS_DESCR STD_AXIS N_gen _CNV_R_R_Def_n_sw_q_595_CM 10 -32768. 32767. FORMAT "%5.0" /end AXIS_DESCR
/end CHARACTERISTIC
/begin CHARACTERISTIC KF_MU1T2_6 "Kennfeld Generatormomentenmodell" MAP 0xa08228c8 _REC_MAP_52_UBYTE_s2_s2_s2 131.07 _CNV_R_R_Def_m_sw_q_554_CM -3276.8 3276.7 FORMAT "%5.2"
 /begin AXIS_DESCR STD_AXIS Ierr _CNV_R_R_Def_i_uw_q_630_CM 10 -4096. 4095.875 /end AXIS_DESCR
 /begin AXIS_DESCR STD_AXIS N_gen _CNV_R_R_Def_n_sw_q_595_CM 10 -32768. 32767. FORMAT "%5.0" /end AXIS_DESCR
/end CHARACTERISTIC
/begin CHARACTERISTIC KF_MU2T1_1 "Kennfeld Generatormomentenmodell" MAP 0xa0823bd8 _REC_MAP_52_UBYTE_s2_s2_s2 131.07 _CNV_R_R_Def_m_sw_q_554_CM -3276.8 3276.7 FORMAT "%5.2"
 /begin AXIS_DESCR STD_AXIS Ierr _CNV_R_R_Def_i_uw_q_630_CM 10 -4096. 4095.875 /end AXIS_DESCR
 /begin AXIS_DESCR STD_AXIS N_gen _CNV_R_R_Def_n_sw_q_595_CM 10 -32768. 32767. FORMAT "%5.0" /end AXIS_DESCR
/end CHARACTERISTIC
/begin CHARACTERISTIC KF_MU2T1_2 "Kennfeld Generatormomentenmodell" MAP 0xa08227d4 _REC_MAP_52_UBYTE_s2_s2_s2 131.07 _CNV_R_R_Def_m_sw_q_554_CM -3276.8 3276.7 FORMAT "%5.2"
 /begin AXIS_DESCR STD_AXIS Ierr _CNV_R_R_Def_i_uw_q_630_CM 10 -4096. 4095.875 /end AXIS_DESCR
 /begin AXIS_DESCR STD_AXIS N_gen _CNV_R_R_Def_n_sw_q_595_CM 10 -32768. 32767. FORMAT "%5.0" /end AXIS_DESCR
/end CHARACTERISTIC
/begin CHARACTERISTIC KF_MU2T1_3 "Kennfeld Generatormomentenmodell" MAP 0xa082446c _REC_MAP_52_UBYTE_s2_s2_s2 131.07 _CNV_R_R_Def_m_sw_q_554_CM -3276.8 3276.7 FORMAT "%5.2"
 /begin AXIS_DESCR STD_AXIS Ierr _CNV_R_R_Def_i_uw_q_630_CM 10 -4096. 4095.875 /end AXIS_DESCR
 /begin AXIS_DESCR STD_AXIS N_gen _CNV_R_R_Def_n_sw_q_595_CM 10 -32768. 32767. FORMAT "%5.0" /end AXIS_DESCR
/end CHARACTERISTIC
/begin CHARACTERISTIC KF_MU2T1_4 "Kennfeld Generatormomentenmodell" MAP 0xa0823808 _REC_MAP_52_UBYTE_s2_s2_s2 131.07 _CNV_R_R_Def_m_sw_q_554_CM -3276.8 3276.7 FORMAT "%5.2"
 /begin AXIS_DESCR STD_AXIS Ierr _CNV_R_R_Def_i_uw_q_630_CM 10 -4096. 4095.875 /end AXIS_DESCR
 /begin AXIS_DESCR STD_AXIS N_gen _CNV_R_R_Def_n_sw_q_595_CM 10 -32768. 32767. FORMAT "%5.0" /end AXIS_DESCR
/end CHARACTERISTIC
/begin CHARACTERISTIC KF_MU2T1_5 "Kennfeld Generatormomentenmodell" MAP 0xa0823dc0 _REC_MAP_52_UBYTE_s2_s2_s2 131.07 _CNV_R_R_Def_m_sw_q_554_CM -3276.8 3276.7 FORMAT "%5.2"
 /begin AXIS_DESCR STD_AXIS Ierr _CNV_R_R_Def_i_uw_q_630_CM 10 -4096. 4095.875 /end AXIS_DESCR
 /begin AXIS_DESCR STD_AXIS N_gen _CNV_R_R_Def_n_sw_q_595_CM 10 -32768. 32767. FORMAT "%5.0" /end AXIS_DESCR
/end CHARACTERISTIC
/begin CHARACTERISTIC KF_MU2T1_6 "Kennfeld Generatormomentenmodell" MAP 0xa0823438 _REC_MAP_52_UBYTE_s2_s2_s2 131.07 _CNV_R_R_Def_m_sw_q_554_CM -3276.8 3276.7 FORMAT "%5.2"
 /begin AXIS_DESCR STD_AXIS Ierr _CNV_R_R_Def_i_uw_q_630_CM 10 -4096. 4095.875 /end AXIS_DESCR
 /begin AXIS_DESCR STD_AXIS N_gen _CNV_R_R_Def_n_sw_q_595_CM 10 -32768. 32767. FORMAT "%5.0" /end AXIS_DESCR
/end CHARACTERISTIC
/begin CHARACTERISTIC KF_TANSGENKO "Kennfeld zur Bestimmung Ansauglufttemparatur Generator" MAP 0xa0825188 _REC_MAP_52_UBYTE_s2_s2_s2 131.07 _CNV_R_R_Def_t_sw_q_578_CM -3276.8 3276.7 FORMAT "%4.1"
 /begin AXIS_DESCR STD_AXIS Tchip_fil_l _CNV_R_R_Def_t_sw_q_578_CM 4 -3276.8 3276.7 FORMAT "%4.1" /end AXIS_DESCR
 /begin AXIS_DESCR STD_AXIS N_gen _CNV_R_R_Def_n_sw_q_595_CM 4 -32768. 32767. FORMAT "%5.0" /end AXIS_DESCR
/end CHARACTERISTIC
/begin CHARACTERISTIC KF_UFDIODE "Kennfeld für Diodenvorwärtsspannung" MAP 0xa082513c _REC_MAP_52_UBYTE_u2_s2_u1 99.198481 _CNV_R_R_Def_u_sw_q_580_CM 0. 319.9951
 /begin AXIS_DESCR STD_AXIS Tans_gen _CNV_R_R_Def_t_sw_q_578_CM 2 -3276.8 3276.7 FORMAT "%4.1" /end AXIS_DESCR
 /begin AXIS_DESCR STD_AXIS Gen_awnumm _CNV_R_R_Def_dez_sl_551_CM 6 0. 255. FORMAT "%3.0" /end AXIS_DESCR
/end CHARACTERISTIC
/begin CHARACTERISTIC KF_WALLW "Kennfeld Leerlauf Auslassspreizung warm gedrosselt zum Katheizen" MAP 0xa0830bd8 _REC_MAP_52_u1_s2_s2 99.96000000000001 _CNV_R_R_Def_spr_ub_558_CM 0. 204. FORMAT "%5.2"
 /begin AXIS_DESCR STD_AXIS Nkw _CNV_R_R_Def_n_sw_q_595_CM 12 -32768. 32767. FORMAT "%5.0" /end AXIS_DESCR
 /begin AXIS_DESCR STD_AXIS Rfv_vns _CNV_R_R_Def_rf_sw__598_CM 12 -327.68 327.67 FORMAT "%7.4" /end AXIS_DESCR
/end CHARACTERISTIC
/begin CHARACTERISTIC KF_WALLW_2 "Kennfeld Leerlauf Auslassspreizung warm gedrosselt zum Katheizen" MAP 0xa08312d8 _REC_MAP_52_u1_s2_s2 99.96000000000001 _CNV_R_R_Def_spr_ub_558_CM 0. 204. FORMAT "%5.2"
 /begin AXIS_DESCR STD_AXIS Nkw _CNV_R_R_Def_n_sw_q_595_CM 12 -32768. 32767. FORMAT "%5.0" /end AXIS_DESCR
 /begin AXIS_DESCR STD_AXIS Rfv_vns _CNV_R_R_Def_rf_sw__598_CM 12 -327.68 327.67 FORMAT "%7.4" /end AXIS_DESCR
/end CHARACTERISTIC
/begin CHARACTERISTIC KF_WASKH "" MAP 0xa0830d98 _REC_MAP_52_u1_s2_s2 99.96000000000001 _CNV_R_R_Def_spr_ub_558_CM 0. 204. FORMAT "%5.2"
 /begin AXIS_DESCR STD_AXIS Nkw _CNV_R_R_Def_n_sw_q_595_CM 16 -32768. 32767. FORMAT "%5.0" /end AXIS_DESCR
 /begin AXIS_DESCR STD_AXIS Rfv_vns _CNV_R_R_Def_rf_sw__598_CM 12 -327.68 327.67 FORMAT "%7.4" /end AXIS_DESCR
/end CHARACTERISTIC
/begin CHARACTERISTIC KF_WASKH_2 "" MAP 0xa0831498 _REC_MAP_52_u1_s2_s2 99.96000000000001 _CNV_R_R_Def_spr_ub_558_CM 0. 204. FORMAT "%5.2"
 /begin AXIS_DESCR STD_AXIS Nkw _CNV_R_R_Def_n_sw_q_595_CM 16 -32768. 32767. FORMAT "%5.0" /end AXIS_DESCR
 /begin AXIS_DESCR STD_AXIS Rfv_vns _CNV_R_R_Def_rf_sw__598_CM 12 -327.68 327.67 FORMAT "%7.4" /end AXIS_DESCR
/end CHARACTERISTIC
/begin CHARACTERISTIC KF_WASLL "Kennfeld Auslassspreizung Leerlauf" MAP 0xa082f6bc _REC_MAP_52_u1_s2_s2 99.96000000000001 _CNV_R_R_Def_spr_ub_558_CM 0. 204. FORMAT "%5.2"
 /begin AXIS_DESCR STD_AXIS Nkw _CNV_R_R_Def_n_sw_q_595_CM 12 -32768. 32767. FORMAT "%5.0" /end AXIS_DESCR
 /begin AXIS_DESCR STD_AXIS Rfv_vns _CNV_R_R_Def_rf_sw__598_CM 12 -327.68 327.67 FORMAT "%7.4" /end AXIS_DESCR
/end CHARACTERISTIC
/begin CHARACTERISTIC KF_WASLL_HS "Kennfeld Auslassspreizung Leerlauf" MAP 0xa0831aa4 _REC_MAP_52_u1_s2_s2 99.96000000000001 _CNV_R_R_Def_spr_ub_558_CM 0. 204. FORMAT "%5.2"
 /begin AXIS_DESCR STD_AXIS Nkw _CNV_R_R_Def_n_sw_q_595_CM 12 -32768. 32767. FORMAT "%5.0" /end AXIS_DESCR
 /begin AXIS_DESCR STD_AXIS Rk_soll_hs _CNV_R_R_Def_rk_sw__600_CM 5 -1600. 1599.9511 /end AXIS_DESCR
/end CHARACTERISTIC
/begin CHARACTERISTIC KF_WASOPT "Kennfeld optimale Auslassspreizung warm teilgedrosselt" MAP 0xa082ff58 _REC_MAP_52_u1_s2_s2 99.96000000000001 _CNV_R_R_Def_spr_ub_558_CM 0. 204. FORMAT "%5.2"
 /begin AXIS_DESCR STD_AXIS Nkw _CNV_R_R_Def_n_sw_q_595_CM 16 -32768. 32767. FORMAT "%5.0" /end AXIS_DESCR
 /begin AXIS_DESCR STD_AXIS Rk_soll_s _CNV_R_R_Def_rk_sw__600_CM 12 -1600. 1599.9511 /end AXIS_DESCR
/end CHARACTERISTIC
/begin CHARACTERISTIC KF_WASOPT_HS "Kennfeld optimale Auslassspreizung warm Homogen_Schicht" MAP 0xa0831888 _REC_MAP_52_u1_s2_s2 99.96000000000001 _CNV_R_R_Def_spr_ub_558_CM 0. 204. FORMAT "%5.2"
 /begin AXIS_DESCR STD_AXIS Nkw _CNV_R_R_Def_n_sw_q_595_CM 16 -32768. 32767. FORMAT "%5.0" /end AXIS_DESCR
 /begin AXIS_DESCR STD_AXIS Rk_soll_hs _CNV_R_R_Def_rk_sw__600_CM 12 -1600. 1599.9511 /end AXIS_DESCR
/end CHARACTERISTIC
/begin CHARACTERISTIC KF_WASOPU "Kennfeld optimale Auslassspreizung warm ungedrosselt" MAP 0xa08302d8 _REC_MAP_52_u1_s2_s2 99.96000000000001 _CNV_R_R_Def_spr_ub_558_CM 0. 204. FORMAT "%5.2"
 /begin AXIS_DESCR STD_AXIS Nkw _CNV_R_R_Def_n_sw_q_595_CM 16 -32768. 32767. FORMAT "%5.0" /end AXIS_DESCR
 /begin AXIS_DESCR STD_AXIS Rfv_vns _CNV_R_R_Def_rf_sw__598_CM 12 -327.68 327.67 FORMAT "%7.4" /end AXIS_DESCR
/end CHARACTERISTIC
/begin CHARACTERISTIC KF_WASVL "Kennfeld Auslassspreizung Volllast abh. von Drehzahl und Klopfstaerke" MAP 0xa082f62c _REC_MAP_52_u1_s2_u2 99.96000000000001 _CNV_R_R_Def_spr_ub_558_CM 0. 204. FORMAT "%5.2"
 /begin AXIS_DESCR STD_AXIS Nkw _CNV_R_R_Def_n_sw_q_595_CM 16 -32768. 32767. FORMAT "%5.0" /end AXIS_DESCR
 /begin AXIS_DESCR STD_AXIS Wkrm _CNV_R_R_Def_zw_ub__738_CM 2 -49151.25 0. FORMAT "%5.2" /end AXIS_DESCR
/end CHARACTERISTIC
/begin CHARACTERISTIC KF_WASVLT "Kennfeld Auslassspreizung Volllast gedrosselt abh. von Drehzahl und Klopfstaerke" MAP 0xa082f674 _REC_MAP_52_u1_s2_u2 99.96000000000001 _CNV_R_R_Def_spr_ub_558_CM 0. 204. FORMAT "%5.2"
 /begin AXIS_DESCR STD_AXIS Nkw _CNV_R_R_Def_n_sw_q_595_CM 16 -32768. 32767. FORMAT "%5.0" /end AXIS_DESCR
 /begin AXIS_DESCR STD_AXIS Wkrm _CNV_R_R_Def_zw_ub__738_CM 2 -49151.25 0. FORMAT "%5.2" /end AXIS_DESCR
/end CHARACTERISTIC
/begin CHARACTERISTIC KF_WELLW "Kennfeld Leerlauf Einlassspreizung warm gedrosselt zum Katheizen" MAP 0xa0830858 _REC_MAP_52_u1_s2_s2 99.96000000000001 _CNV_R_R_Def_spr_ub_558_CM 0. 204. FORMAT "%5.2"
 /begin AXIS_DESCR STD_AXIS Nkw _CNV_R_R_Def_n_sw_q_595_CM 12 -32768. 32767. FORMAT "%5.0" /end AXIS_DESCR
 /begin AXIS_DESCR STD_AXIS Rfv_vns _CNV_R_R_Def_rf_sw__598_CM 12 -327.68 327.67 FORMAT "%7.4" /end AXIS_DESCR
/end CHARACTERISTIC
/begin CHARACTERISTIC KF_WELLW_2 "Kennfeld Leerlauf Einlassspreizung warm gedrosselt zum Katheizen" MAP 0xa0830f58 _REC_MAP_52_u1_s2_s2 99.96000000000001 _CNV_R_R_Def_spr_ub_558_CM 0. 204. FORMAT "%5.2"
 /begin AXIS_DESCR STD_AXIS Nkw _CNV_R_R_Def_n_sw_q_595_CM 12 -32768. 32767. FORMAT "%5.0" /end AXIS_DESCR
 /begin AXIS_DESCR STD_AXIS Rfv_vns _CNV_R_R_Def_rf_sw__598_CM 12 -327.68 327.67 FORMAT "%7.4" /end AXIS_DESCR
/end CHARACTERISTIC
/begin CHARACTERISTIC KF_WESKH "" MAP 0xa0830a18 _REC_MAP_52_u1_s2_s2 99.96000000000001 _CNV_R_R_Def_spr_ub_558_CM 0. 204. FORMAT "%5.2"
 /begin AXIS_DESCR STD_AXIS Nkw _CNV_R_R_Def_n_sw_q_595_CM 16 -32768. 32767. FORMAT "%5.0" /end AXIS_DESCR
 /begin AXIS_DESCR STD_AXIS Rfv_vns _CNV_R_R_Def_rf_sw__598_CM 12 -327.68 327.67 FORMAT "%7.4" /end AXIS_DESCR
/end CHARACTERISTIC
/begin CHARACTERISTIC KF_WESKH_2 "" MAP 0xa0831118 _REC_MAP_52_u1_s2_s2 99.96000000000001 _CNV_R_R_Def_spr_ub_558_CM 0. 204. FORMAT "%5.2"
 /begin AXIS_DESCR STD_AXIS Nkw _CNV_R_R_Def_n_sw_q_595_CM 16 -32768. 32767. FORMAT "%5.0" /end AXIS_DESCR
 /begin AXIS_DESCR STD_AXIS Rfv_vns _CNV_R_R_Def_rf_sw__598_CM 12 -327.68 327.67 FORMAT "%7.4" /end AXIS_DESCR
/end CHARACTERISTIC
/begin CHARACTERISTIC KF_WESLL "Kennfeld Einlasssprezung Leerlauf" MAP 0xa082f780 _REC_MAP_52_u1_s2_s2 99.96000000000001 _CNV_R_R_Def_spr_ub_558_CM 0. 204. FORMAT "%5.2"
 /begin AXIS_DESCR STD_AXIS Nkw _CNV_R_R_Def_n_sw_q_595_CM 12 -32768. 32767. FORMAT "%5.0" /end AXIS_DESCR
 /begin AXIS_DESCR STD_AXIS Rfv_vns _CNV_R_R_Def_rf_sw__598_CM 12 -327.68 327.67 FORMAT "%7.4" /end AXIS_DESCR
/end CHARACTERISTIC
/begin CHARACTERISTIC KF_WESLL_HS "Kennfeld Einlasssprezung Leerlauf" MAP 0xa0831a44 _REC_MAP_52_u1_s2_s2 99.96000000000001 _CNV_R_R_Def_spr_ub_558_CM 0. 204. FORMAT "%5.2"
 /begin AXIS_DESCR STD_AXIS Nkw _CNV_R_R_Def_n_sw_q_595_CM 12 -32768. 32767. FORMAT "%5.0" /end AXIS_DESCR
 /begin AXIS_DESCR STD_AXIS Rk_soll_hs _CNV_R_R_Def_rk_sw__600_CM 5 -1600. 1599.9511 /end AXIS_DESCR
/end CHARACTERISTIC
/begin CHARACTERISTIC KF_WESOPT "Kennfeld optimale Einlassspreizung warm teilgedrosselt" MAP 0xa082fbd8 _REC_MAP_52_u1_s2_s2 99.96000000000001 _CNV_R_R_Def_spr_ub_558_CM 0. 204. FORMAT "%5.2"
 /begin AXIS_DESCR STD_AXIS Nkw _CNV_R_R_Def_n_sw_q_595_CM 16 -32768. 32767. FORMAT "%5.0" /end AXIS_DESCR
 /begin AXIS_DESCR STD_AXIS Rk_soll_s _CNV_R_R_Def_rk_sw__600_CM 12 -1600. 1599.9511 /end AXIS_DESCR
/end CHARACTERISTIC
/begin CHARACTERISTIC KF_WESOPT_HS "Kennfeld optimale Einlassspreizung warm Homogen_Schicht" MAP 0xa0831690 _REC_MAP_52_u1_s2_s2 99.96000000000001 _CNV_R_R_Def_spr_ub_558_CM 0. 204. FORMAT "%5.2"
 /begin AXIS_DESCR STD_AXIS Nkw _CNV_R_R_Def_n_sw_q_595_CM 16 -32768. 32767. FORMAT "%5.0" /end AXIS_DESCR
 /begin AXIS_DESCR STD_AXIS Rk_soll_hs _CNV_R_R_Def_rk_sw__600_CM 12 -1600. 1599.9511 /end AXIS_DESCR
/end CHARACTERISTIC
/begin CHARACTERISTIC KF_WESOPU "Kennfeld optimale Einlassspreizung warm ungedrosselt" MAP 0xa08301dc _REC_MAP_52_u1_s2_s2 99.96000000000001 _CNV_R_R_Def_spr_ub_558_CM 0. 204. FORMAT "%5.2"
 /begin AXIS_DESCR STD_AXIS Nkw _CNV_R_R_Def_n_sw_q_595_CM 16 -32768. 32767. FORMAT "%5.0" /end AXIS_DESCR
 /begin AXIS_DESCR STD_AXIS Rfv_vns _CNV_R_R_Def_rf_sw__598_CM 12 -327.68 327.67 FORMAT "%7.4" /end AXIS_DESCR
/end CHARACTERISTIC
/begin CHARACTERISTIC KF_WESVL "Kennfeld Einlassspreizung Volllast abh. von Drehzahl und Klopfstaerke" MAP 0xa082f9cc _REC_MAP_52_u1_s2_u2 99.96000000000001 _CNV_R_R_Def_spr_ub_558_CM 0. 204. FORMAT "%5.2"
 /begin AXIS_DESCR STD_AXIS Nkw _CNV_R_R_Def_n_sw_q_595_CM 16 -32768. 32767. FORMAT "%5.0" /end AXIS_DESCR
 /begin AXIS_DESCR STD_AXIS Wkrm _CNV_R_R_Def_zw_ub__738_CM 2 -49151.25 0. FORMAT "%5.2" /end AXIS_DESCR
/end CHARACTERISTIC
/begin CHARACTERISTIC KF_WESVLT "Kennfeld Einlassspreizung Volllast gedrosselt abh. von Drehzahl und Klopfstaerke" MAP 0xa082fa14 _REC_MAP_52_u1_s2_u2 99.96000000000001 _CNV_R_R_Def_spr_ub_558_CM 0. 204. FORMAT "%5.2"
 /begin AXIS_DESCR STD_AXIS Nkw _CNV_R_R_Def_n_sw_q_595_CM 16 -32768. 32767. FORMAT "%5.0" /end AXIS_DESCR
 /begin AXIS_DESCR STD_AXIS Wkrm _CNV_R_R_Def_zw_ub__738_CM 2 -49151.25 0. FORMAT "%5.2" /end AXIS_DESCR
/end CHARACTERISTIC
/begin CHARACTERISTIC KF_WNWKHK "" MAP 0xa082fa5c _REC_MAP_52_u1_s2_u2 0.996 _CNV_R_R_Def_f_ub_b_553_CM 0. 0.996
 /begin AXIS_DESCR STD_AXIS Tmot _CNV_R_R_Def_t_sw_q_579_CM 6 -327.68 327.67 FORMAT "%5.2" /end AXIS_DESCR
 /begin AXIS_DESCR STD_AXIS Tn_start_10 _CNV_R_R_Def_td_uw__673_CM 6 0. 655.35 FORMAT "%5.2" /end AXIS_DESCR
/end CHARACTERISTIC
/begin CHARACTERISTIC KF_WNWKHK_2 "" MAP 0xa082fa9c _REC_MAP_52_u1_s2_u2 0.996 _CNV_R_R_Def_f_ub_b_553_CM 0. 0.996
 /begin AXIS_DESCR STD_AXIS Tmot _CNV_R_R_Def_t_sw_q_579_CM 6 -327.68 327.67 FORMAT "%5.2" /end AXIS_DESCR
 /begin AXIS_DESCR STD_AXIS Tn_start_10 _CNV_R_R_Def_td_uw__673_CM 6 0. 655.35 FORMAT "%5.2" /end AXIS_DESCR
/end CHARACTERISTIC
/begin CHARACTERISTIC KL_ASPAN "Kennlinie Auslassspreizung Schubabschalten" CURVE 0xa082ef18 _REC_CUR_TKL_UW_VV__u1_s2 0. _CNV_R_R_Def_spr_ub_558_CM -26214.4 26213.6 FORMAT "%5.2"
 /begin AXIS_DESCR STD_AXIS Nkw _CNV_R_R_Def_n_sw_q_595_CM 5 -32768. 32767. FORMAT "%5.0" /end AXIS_DESCR
/end CHARACTERISTIC
/begin CHARACTERISTIC KL_ASPVZ "Kennlinie Einschaltverzoegerung Auslass abh. von Tmot" CURVE 0xa082efa4 _REC_CUR_TKL_UW_VV__u1_s2 99.45 _CNV_R_R_Def_td_uw__673_CM 0. 255. FORMAT "%5.2"
 /begin AXIS_DESCR STD_AXIS Tmot _CNV_R_R_Def_t_sw_q_579_CM 5 -327.68 327.67 FORMAT "%5.2" /end AXIS_DESCR
/end CHARACTERISTIC
/begin CHARACTERISTIC KL_ESPAN "Kennlinie Einlassspreizung Schubabschalten" CURVE 0xa082ef2c _REC_CUR_TKL_UW_VV__u1_s2 99.96000000000001 _CNV_R_R_Def_spr_ub_558_CM 0. 204. FORMAT "%5.2"
 /begin AXIS_DESCR STD_AXIS Nkw _CNV_R_R_Def_n_sw_q_595_CM 5 -32768. 32767. FORMAT "%5.0" /end AXIS_DESCR
/end CHARACTERISTIC
/begin CHARACTERISTIC KL_ESPVZ "Kennlinie Einschaltverzoegerung Einlass abh. von Tmot" CURVE 0xa082efb8 _REC_CUR_TKL_UW_VV__u1_s2 99.45 _CNV_R_R_Def_td_uw__673_CM 0. 255. FORMAT "%5.2"
 /begin AXIS_DESCR STD_AXIS Tmot _CNV_R_R_Def_t_sw_q_579_CM 5 -327.68 327.67 FORMAT "%5.2" /end AXIS_DESCR
/end CHARACTERISTIC
/begin CHARACTERISTIC KL_FASHSW "Kennlinie Faktor Auslass Homogen_Schicht warm" CURVE 0xa082f170 _REC_CUR_TKL_UW_VV__u1_s2 0.996 _CNV_R_R_Def_f_ub_b_553_CM 0. 0.996
 /begin AXIS_DESCR STD_AXIS Tmot _CNV_R_R_Def_t_sw_q_579_CM 6 -327.68 327.67 FORMAT "%5.2" /end AXIS_DESCR
/end CHARACTERISTIC
/begin CHARACTERISTIC KL_FASTW "Kennlinie Faktor Auslass teilgedrosselt warm" CURVE 0xa082ef54 _REC_CUR_TKL_UW_VV__u1_s2 0.996 _CNV_R_R_Def_f_ub_b_553_CM 0. 0.996
 /begin AXIS_DESCR STD_AXIS Tmot _CNV_R_R_Def_t_sw_q_579_CM 6 -327.68 327.67 FORMAT "%5.2" /end AXIS_DESCR
/end CHARACTERISTIC
/begin CHARACTERISTIC KL_FASW "Kennlinie Faktor Auslass ungedrosselt warm" CURVE 0xa082ef68 _REC_CUR_TKL_UW_VV__u1_s2 0.996 _CNV_R_R_Def_f_ub_b_553_CM 0. 0.996
 /begin AXIS_DESCR STD_AXIS Tmot _CNV_R_R_Def_t_sw_q_579_CM 6 -327.68 327.67 FORMAT "%5.2" /end AXIS_DESCR
/end CHARACTERISTIC
/begin CHARACTERISTIC KL_FEASWLL "" CURVE 0xa082ef40 _REC_CUR_TKL_UW_VV__u1_s2 0.996 _CNV_R_R_Def_f_ub_b_553_CM 0. 0.996
 /begin AXIS_DESCR STD_AXIS Tmot _CNV_R_R_Def_t_sw_q_579_CM 6 -327.68 327.67 FORMAT "%5.2" /end AXIS_DESCR
/end CHARACTERISTIC
/begin CHARACTERISTIC KL_FEASWLL_HS "" CURVE 0xa082f184 _REC_CUR_TKL_UW_VV__u1_s2 0.996 _CNV_R_R_Def_f_ub_b_553_CM 0. 0.996
 /begin AXIS_DESCR STD_AXIS Tmot _CNV_R_R_Def_t_sw_q_579_CM 6 -327.68 327.67 FORMAT "%5.2" /end AXIS_DESCR
/end CHARACTERISTIC
/begin CHARACTERISTIC KL_FEASWLL_S "" CURVE 0xa082f198 _REC_CUR_TKL_UW_VV__u1_s2 0.996 _CNV_R_R_Def_f_ub_b_553_CM 0. 0.996
 /begin AXIS_DESCR STD_AXIS Tmot _CNV_R_R_Def_t_sw_q_579_CM 6 -327.68 327.67 FORMAT "%5.2" /end AXIS_DESCR
/end CHARACTERISTIC
/begin CHARACTERISTIC KL_FESHSW "Kennlinie Faktor Einlass Homogen_Schicht warm" CURVE 0xa082f15c _REC_CUR_TKL_UW_VV__u1_s2 0.996 _CNV_R_R_Def_f_ub_b_553_CM 0. 0.996
 /begin AXIS_DESCR STD_AXIS Tmot _CNV_R_R_Def_t_sw_q_579_CM 6 -327.68 327.67 FORMAT "%5.2" /end AXIS_DESCR
/end CHARACTERISTIC
/begin CHARACTERISTIC KL_FESTW "Kennlinie Faktor Einlass teilgedrosselt warm" CURVE 0xa082ef7c _REC_CUR_TKL_UW_VV__u1_s2 0.996 _CNV_R_R_Def_f_ub_b_553_CM 0. 0.996
 /begin AXIS_DESCR STD_AXIS Tmot _CNV_R_R_Def_t_sw_q_579_CM 6 -327.68 327.67 FORMAT "%5.2" /end AXIS_DESCR
/end CHARACTERISTIC
/begin CHARACTERISTIC KL_FESW "Kennlinie Faktor Einlass ungedrosselt warm" CURVE 0xa082ef90 _REC_CUR_TKL_UW_VV__u1_s2 0.996 _CNV_R_R_Def_f_ub_b_553_CM 0. 0.996
 /begin AXIS_DESCR STD_AXIS Tmot _CNV_R_R_Def_t_sw_q_579_CM 6 -327.68 327.67 FORMAT "%5.2" /end AXIS_DESCR
/end CHARACTERISTIC
/begin CHARACTERISTIC KL_GELIKMIE "Faktor für Generatorlastbegrenzung für Leerlaufstabilisierung" CURVE 0xa0824e84 _REC_CUR_TKL_UW_VV__u1_u1 1.9921 _CNV_R_R_Def_f_ub_b_613_CM 0. 1.9921 /begin AXIS_DESCR STD_AXIS Ierr _CNV_R_R_Def_i_uw_q_630_CM 6 0. 31.875 /end AXIS_DESCR /end CHARACTERISTIC
/begin CHARACTERISTIC KL_GENLDST "Auslastungsgrad Generator" CURVE 0xa0824760 _REC_CUR_TKL_UW_VV__u1_s2 99.60930000000001 _CNV_R_R_Def_f_ub_b_586_CM 0. 99.60930000000001 FORMAT "%5.2"
 /begin AXIS_DESCR STD_AXIS Tgen _CNV_R_R_Def_t_sw_q_578_CM 6 -3276.8 3276.7 FORMAT "%4.1" /end AXIS_DESCR
/end CHARACTERISTIC
/begin CHARACTERISTIC KL_GENUEBSETZ "Kennlinie für Generatoruebersetzung" CURVE 0xa082459c _REC_CUR_TKL_UW_VV__u1_u1 3.9686 _CNV_R_R_Def_f_ub_b_632_CM 1.57e-002 3.9843 FORMAT "%5.2"
 /begin AXIS_DESCR STD_AXIS Gen_awnumm _CNV_R_R_Def_dez_sl_551_CM 8 0. 255. FORMAT "%3.0" /end AXIS_DESCR
/end CHARACTERISTIC
/begin CHARACTERISTIC KL_MAT_ASPRL_KH "Eingansauswahl BA Umschaltung KH-Auslass-LL" CURVE 0xa082f094 _REC_CUR_TKL_UW_VV__u1_u2 3. _CNV_R_R_Def_dez_sl_551_CM 0. 3. FORMAT "%3.0"
 /begin AXIS_DESCR STD_AXIS Baw_ist _CNV_R_R_Def_dez_sl_551_CM 32 0. 65535. FORMAT "%5.0" /end AXIS_DESCR
/end CHARACTERISTIC
/begin CHARACTERISTIC KL_MAT_ASPRTL_KH "Eingansauswahl BA Umschaltung KH-Auslass-TL" CURVE 0xa082f0f8 _REC_CUR_TKL_UW_VV__u1_u2 3. _CNV_R_R_Def_dez_sl_551_CM 0. 3. FORMAT "%3.0"
 /begin AXIS_DESCR STD_AXIS Baw_ist _CNV_R_R_Def_dez_sl_551_CM 32 0. 65535. FORMAT "%5.0" /end AXIS_DESCR
/end CHARACTERISTIC
/begin CHARACTERISTIC KL_MAT_ESPRL_KH "Eingansauswahl BA Umschaltung KH-Einlass-LL" CURVE 0xa082efcc _REC_CUR_TKL_UW_VV__u1_u2 3. _CNV_R_R_Def_dez_sl_551_CM 0. 3. FORMAT "%3.0"
 /begin AXIS_DESCR STD_AXIS Baw_ist _CNV_R_R_Def_dez_sl_551_CM 32 0. 65535. FORMAT "%5.0" /end AXIS_DESCR
/end CHARACTERISTIC
/begin CHARACTERISTIC KL_MAT_ESPRTL_KH "Eingansauswahl BA Umschaltung KH-Einlass-TL" CURVE 0xa082f030 _REC_CUR_TKL_UW_VV__u1_u2 3. _CNV_R_R_Def_dez_sl_551_CM 0. 3. FORMAT "%3.0"
 /begin AXIS_DESCR STD_AXIS Baw_ist _CNV_R_R_Def_dez_sl_551_CM 32 0. 65535. FORMAT "%5.0" /end AXIS_DESCR
/end CHARACTERISTIC
/begin CHARACTERISTIC KL_NELUEFTGE "E-Lüfteranforderung Generator" CURVE 0xa08250e8 _REC_CUR_TKL_UW_VV__u1_u1 99.60930000000001 _CNV_R_R_Def_f_ub_b_586_CM 0. 99.60930000000001 FORMAT "%5.2"
 /begin AXIS_DESCR STD_AXIS Gen_awnumm _CNV_R_R_Def_dez_sl_551_CM 6 0. 255. FORMAT "%3.0" /end AXIS_DESCR
/end CHARACTERISTIC
/begin CHARACTERISTIC KL_OZPERMKL "Skalierungskennlinie Permittivität" CURVE 0xa081a8fc _REC_CUR_TKL_UW_VV__u2_u2 5.9999 _CNV_R_R_Def_perm_u_674_CM 0. 5.9999 FORMAT "%14.5"
 /begin AXIS_DESCR STD_AXIS Oz_permt _CNV_R_R_Def_dez_sl_551_CM 2 0. 65535. FORMAT "%5.0" /end AXIS_DESCR
/end CHARACTERISTIC
/begin CHARACTERISTIC KL_OZTEMPKL "Für die Öltemperatur-Berechnung QLT" CURVE 0xa081a92c _REC_CUR_TKL_UW_VV__s2_u2 131.07 _CNV_R_R_Def_t_sw_q_578_CM -3276.8 3276.7 FORMAT "%4.1"
 /begin AXIS_DESCR STD_AXIS Oz_tempt _CNV_R_R_Def_dez_sl_551_CM 6 0. 65535. FORMAT "%5.0" /end AXIS_DESCR
/end CHARACTERISTIC
/begin CHARACTERISTIC KL_RTHJADIOD "Temperaturkoeffizient der Diode" CURVE 0xa082510c _REC_CUR_TKL_UW_VV__u2_u1 99.9984 _CNV_R_R_Def_f_uw_b_555_CM 0. 99.9984
 /begin AXIS_DESCR STD_AXIS Gen_awnumm _CNV_R_R_Def_dez_sl_551_CM 6 0. 255. FORMAT "%3.0" /end AXIS_DESCR
/end CHARACTERISTIC
/begin CHARACTERISTIC KL_TCHIPOFFS "Offset zur gemessenen Chiptemperatur Herstellerspezifisch" CURVE 0xa0825120 _REC_CUR_TKL_UW_VV__s2_u1 131.07 _CNV_R_R_Def_t_sw_q_578_CM -3276.8 3276.7 FORMAT "%4.1"
 /begin AXIS_DESCR STD_AXIS Gen_manufak _CNV_R_R_Def_dez_sl_551_CM 8 0. 255. FORMAT "%3.0" /end AXIS_DESCR
/end CHARACTERISTIC
/begin CHARACTERISTIC KL_TKTOENIV "Umsetzung Tk -> Oelnivau" CURVE 0xa081a948 _REC_CUR_TKL_UW_VV__u2_u2 75. _CNV_R_R_Def_td_ub__574_CM 0. 75. FORMAT "%4.1"
 /begin AXIS_DESCR STD_AXIS Td_og_tk _CNV_R_R_Def_td_ub__574_CM 8 0. 6553.5 FORMAT "%4.1" /end AXIS_DESCR
/end CHARACTERISTIC
/begin CHARACTERISTIC KL_TMAXDIODE "Zulässige Diodenmaximaltemperatur" CURVE 0xa08250f8 _REC_CUR_TKL_UW_VV__s2_u1 131.07 _CNV_R_R_Def_t_sw_q_578_CM -3276.8 3276.7 FORMAT "%4.1"
 /begin AXIS_DESCR STD_AXIS Gen_awnumm _CNV_R_R_Def_dez_sl_551_CM 6 0. 255. FORMAT "%3.0" /end AXIS_DESCR
/end CHARACTERISTIC
/begin CHARACTERISTIC KL_TVTOEL "Für die Öltemperatur-Berechnung Töns" CURVE 0xa081a908 _REC_CUR_TKL_UW_VV__s2_u2 131.07 _CNV_R_R_Def_t_sw_q_578_CM -3276.8 3276.7 FORMAT "%4.1"
 /begin AXIS_DESCR STD_AXIS NO_INPUT_QUANTITY _CNV_R_R_Def_td_ub__574_CM 8 0. 6553.5 FORMAT "%4.1" /end AXIS_DESCR
/end CHARACTERISTIC
/begin CHARACTERISTIC KL_T_CHIP1 "Applikationskonstanten für Temperaturen Generatormodell" CURVE 0xa0824588 _REC_CUR_TKL_UW_VV__s2_u1 131.07 _CNV_R_R_Def_t_sw_q_578_CM -3276.8 3276.7 FORMAT "%4.1"
 /begin AXIS_DESCR STD_AXIS Gen_awnumm _CNV_R_R_Def_dez_sl_551_CM 6 0. 255. FORMAT "%3.0" /end AXIS_DESCR
/end CHARACTERISTIC
/begin CHARACTERISTIC KL_T_CHIP2 "Applikationskonstanten für Temperaturen Generatormodell" CURVE 0xa0824574 _REC_CUR_TKL_UW_VV__s2_u1 131.07 _CNV_R_R_Def_t_sw_q_578_CM -3276.8 3276.7 FORMAT "%4.1"
 /begin AXIS_DESCR STD_AXIS Gen_awnumm _CNV_R_R_Def_dez_sl_551_CM 6 0. 255. FORMAT "%3.0" /end AXIS_DESCR
/end CHARACTERISTIC
/begin CHARACTERISTIC K_APPUPLLDST "Applikationswert St_ldstgen für Nachlauf" VALUE 0xa0824756 _REC_VAL_20_u1 99.45 _CNV_R_R_Def_dez_sl_551_CM 0. 255. FORMAT "%3.0" /end CHARACTERISTIC
/begin CHARACTERISTIC K_APP_LLAH "Kennwert zum Umschalten auf Applikationskonstante" VALUE 0xa082477a _REC_VAL_20_u1 99.45 _CNV_R_R_Def_dez_sl_551_CM 0. 255. FORMAT "%3.0" /end CHARACTERISTIC
/begin CHARACTERISTIC K_ASPRNOTL "Notlaufspreizung Auslassvanos" VALUE 0xa082eed8 _REC_VAL_20_u1 99.96000000000001 _CNV_R_R_Def_spr_ub_558_CM 0. 204. FORMAT "%5.2" /end CHARACTERISTIC
/begin CHARACTERISTIC K_CW_OZ_2 "Codeword OZ - 2" VALUE 0xa081a8ec _REC_VAL_20_u2 0. _CNV_R_R_Def_dez_sl_551_CM 0. 65535. FORMAT "%5.0" /end CHARACTERISTIC
/begin CHARACTERISTIC K_DELTADFFMX "Gradientenschwelle des Generator-Lastsignals für Leerlauf-Solldrehzahlanhebung" VALUE 0xa0824e76 _REC_VAL_20_s1 99.45 _CNV_R_R_Def_f_sb_b_584_CM -64. 63.5 FORMAT "%5.2" /end CHARACTERISTIC
/begin CHARACTERISTIC K_DFFGENFIL "Filterkonstante Dffgen" VALUE 0xa082456e _REC_VAL_20_u1 0.996 _CNV_R_R_Def_f_ub_b_553_CM 0. 0.996 /end CHARACTERISTIC
/begin CHARACTERISTIC K_DFFLIM "Schwelle für Generatorlast zum Rücksetzen der Leerlauf-Solldrehzahlanhebung" VALUE 0xa0824e77 _REC_VAL_20_u1 99.60930000000001 _CNV_R_R_Def_f_ub_b_586_CM 0. 99.60930000000001 FORMAT "%5.2" /end CHARACTERISTIC
/begin CHARACTERISTIC K_DFFLLANH "Schwelle für Generatorlast zum Aktivieren der Leerlauf-Solldrehzahlanhebung" VALUE 0xa0824e78 _REC_VAL_20_u1 99.60930000000001 _CNV_R_R_Def_f_ub_b_586_CM 0. 99.60930000000001 FORMAT "%5.2" /end CHARACTERISTIC
/begin CHARACTERISTIC K_DFFSCHZMX "Zählerschwelle für Aktivieren der Leerlauf-Solldrehzahlanhebung bei Generatorlastschw." VALUE 0xa0824e79 _REC_VAL_20_u1 99.45 _CNV_R_R_Def_dez_sl_551_CM 0. 255. FORMAT "%3.0" /end CHARACTERISTIC
/begin CHARACTERISTIC K_DFMODE "DF-Mode-Schalter themermisch/elektrisch" VALUE 0xa0824757 _REC_VAL_20_u1 99.45 _CNV_R_R_Def_dez_sl_551_CM 0. 255. FORMAT "%3.0" /end CHARACTERISTIC
/begin CHARACTERISTIC K_DFSCHWGENTEST "" VALUE 0xa0824ed4 _REC_VAL_20_u1 99.60930000000001 _CNV_R_R_Def_f_ub_b_586_CM 0. 99.60930000000001 FORMAT "%5.2" /end CHARACTERISTIC
/begin CHARACTERISTIC K_DFS_MAX "DF-Auslastung Maximalschwelle" VALUE 0xa0824758 _REC_VAL_20_u1 99.60930000000001 _CNV_R_R_Def_f_ub_b_586_CM 0. 99.60930000000001 FORMAT "%5.2" /end CHARACTERISTIC
/begin CHARACTERISTIC K_DFS_MIN "DF-Auslastung Minimalschwelle" VALUE 0xa0824759 _REC_VAL_20_u1 99.60930000000001 _CNV_R_R_Def_f_ub_b_586_CM 0. 99.60930000000001 FORMAT "%5.2" /end CHARACTERISTIC
/begin CHARACTERISTIC K_DFS_MITT "DF-Auslastung Mittelschwelle" VALUE 0xa082475a _REC_VAL_20_u1 99.60930000000001 _CNV_R_R_Def_f_ub_b_586_CM 0. 99.60930000000001 FORMAT "%5.2" /end CHARACTERISTIC
/begin CHARACTERISTIC K_DF_DEAKAPP "Df-Schwelle für IG 0A Zwangssetzung" VALUE 0xa082456f _REC_VAL_20_u1 99.60930000000001 _CNV_R_R_Def_f_ub_b_586_CM 0. 99.60930000000001 FORMAT "%5.2" /end CHARACTERISTIC
/begin CHARACTERISTIC K_DTMSPR "Motortemperaturhysterese fuer Spreizungsfreigabe" VALUE 0xa082ef00 _REC_VAL_20_s2 98.30250000000001 _CNV_R_R_Def_t_sw_q_579_CM -327.68 327.67 FORMAT "%5.2" /end CHARACTERISTIC
/begin CHARACTERISTIC K_DTOG_UBMIN "Min Spannung für die Diagnose Toens" VALUE 0xa081a8da _REC_VAL_20_u2 123.46794 _CNV_R_R_Def_u_sb_q_583_CM 0. 6173.397 FORMAT "%4.1" /end CHARACTERISTIC
/begin CHARACTERISTIC K_EN_MDGEN "Berechnung Generatormoment (in)aktiv" VALUE 0xa0824570 _REC_VAL_20_u1 99.45 _CNV_R_R_Def_dez_sl_551_CM 0. 255. FORMAT "%3.0" /end CHARACTERISTIC
/begin CHARACTERISTIC K_ESPRNOTL "Notlaufspreizung Einlassvanos" VALUE 0xa082eed9 _REC_VAL_20_u1 99.96000000000001 _CNV_R_R_Def_spr_ub_558_CM 0. 204. FORMAT "%5.2" /end CHARACTERISTIC
/begin CHARACTERISTIC K_ETA_MDKH "Minimales Wirkungsgrad bei Katheizen" VALUE 0xa082eefe _REC_VAL_20_s2 99.99844999999999 _CNV_R_R_Def_eta_sw_599_CM -200. 199.9938 /end CHARACTERISTIC
/begin CHARACTERISTIC K_FILIGEN "" VALUE 0xa0824ed5 _REC_VAL_20_u1 0.9920000000000001 _CNV_R_R_Def_f_ub_b_553_CM 4.e-003 0.996 /end CHARACTERISTIC
/begin CHARACTERISTIC K_FWNWKH_MAX "" VALUE 0xa082eef0 _REC_VAL_20_u2 0.9999 _CNV_R_R_Def_f_uw_b_571_CM 0. 0.9999 FORMAT "%14.5" /end CHARACTERISTIC
/begin CHARACTERISTIC K_FWNWKH_MIN "" VALUE 0xa082eeee _REC_VAL_20_u2 0.9999 _CNV_R_R_Def_f_uw_b_571_CM 0. 0.9999 FORMAT "%14.5" /end CHARACTERISTIC
/begin CHARACTERISTIC K_GELIIEAPP "Applikationswert Generatorlastbegrenzung für Leerlaufsolldrehzahlberechnung" VALUE 0xa0824e7a _REC_VAL_20_u1 31.875 _CNV_R_R_Def_i_uw_q_630_CM 0. 31.875 /end CHARACTERISTIC
/begin CHARACTERISTIC K_GELIIEZK "Zeitkonstante für Filterung Generatorlastsignal (Leerlaufsolldrehzahlberechnung)" VALUE 0xa0824e7b _REC_VAL_20_u1 0.996 _CNV_R_R_Def_f_ub_b_553_CM 0. 0.996 /end CHARACTERISTIC
/begin CHARACTERISTIC K_GELISETAPP "Aoolikationswert Generatorlastbegrenzung für Leerlaufstabilisierung" VALUE 0xa0824e7c _REC_VAL_20_u1 1. _CNV_R_R_Def_dez_sl_551_CM 0. 1. FORMAT "%3.0" /end CHARACTERISTIC
/begin CHARACTERISTIC K_GELIVMAX "Maximale Fahrzeuggeschwindigkeit für Generatorlastbegrenzung" VALUE 0xa0824e64 _REC_VAL_20_u2 131.07 _CNV_R_R_Def_v_uw_q_727_CM 0. 6553.5 FORMAT "%5.2" /end CHARACTERISTIC
/begin CHARACTERISTIC K_GENITEST_TOL "" VALUE 0xa0824ed6 _REC_VAL_20_u1 99.60930000000001 _CNV_R_R_Def_f_ub_b_586_CM 0. 99.60930000000001 FORMAT "%5.2" /end CHARACTERISTIC
/begin CHARACTERISTIC K_GENLDDFMAX "Schwell Anzeige maximaler Auslastungsgrad Generator" VALUE 0xa082475b _REC_VAL_20_u1 99.60930000000001 _CNV_R_R_Def_f_ub_b_586_CM 0. 99.60930000000001 FORMAT "%5.2" /end CHARACTERISTIC
/begin CHARACTERISTIC K_GENLLAHAPP "Applikationskonstente zum Setzen B_idlespec" VALUE 0xa082477b _REC_VAL_20_u1 99.45 _CNV_R_R_Def_dez_sl_551_CM 0. 255. FORMAT "%3.0" /end CHARACTERISTIC
/begin CHARACTERISTIC K_GENMDNMOF "Offset des Generatormoments" VALUE 0xa082230c _REC_VAL_20_s2 131.07 _CNV_R_R_Def_m_sw_q_554_CM -3276.8 3276.7 FORMAT "%5.2" /end CHARACTERISTIC
/begin CHARACTERISTIC K_GENMSKKL61 "" VALUE 0xa08222e0 _REC_VAL_20_u2 0. _CNV_R_R_Def_dez_sl_551_CM 0. 65535. FORMAT "%5.0" /end CHARACTERISTIC
/begin CHARACTERISTIC K_GENMXGRADH "Maximal zulässiger Gradient Chiptemperatur" VALUE 0xa08250cc _REC_VAL_20_s2 131.07 _CNV_R_R_Def_t_sw_q_578_CM -3276.8 3276.7 FORMAT "%4.1" /end CHARACTERISTIC
/begin CHARACTERISTIC K_GENPDTIME "Predrivetime für Ladekontrollampe KL61" VALUE 0xa08222e2 _REC_VAL_20_u2 131.07 _CNV_R_R_Def_td_ub__574_CM 0. 6553.5 FORMAT "%4.1" /end CHARACTERISTIC
/begin CHARACTERISTIC K_GENREGVPLAUS "" VALUE 0xa08222f6 _REC_VAL_20_u1 99.45 _CNV_R_R_Def_dez_sl_551_CM 0. 255. FORMAT "%3.0" /end CHARACTERISTIC
/begin CHARACTERISTIC K_GENSTATX "" VALUE 0xa08222f7 _REC_VAL_20_u1 29. _CNV_R_R_Def_dez_sl_551_CM 1. 30. FORMAT "%3.0" /end CHARACTERISTIC
/begin CHARACTERISTIC K_GENSTATY "" VALUE 0xa08222f8 _REC_VAL_20_u1 29. _CNV_R_R_Def_dez_sl_551_CM 1. 30. FORMAT "%3.0" /end CHARACTERISTIC
/begin CHARACTERISTIC K_GENSTATZ "" VALUE 0xa08222f9 _REC_VAL_20_u1 29. _CNV_R_R_Def_dez_sl_551_CM 1. 30. FORMAT "%3.0" /end CHARACTERISTIC
/begin CHARACTERISTIC K_GENUTEST_TOL "" VALUE 0xa0824ed7 _REC_VAL_20_u1 99.60930000000001 _CNV_R_R_Def_f_ub_b_586_CM 0. 99.60930000000001 FORMAT "%5.2" /end CHARACTERISTIC
/begin CHARACTERISTIC K_GEN_DNMIN "Motordrehzahlschwelle  für Auswertung der Generatorfehler" VALUE 0xa08222dc _REC_VAL_20_s2 0. _CNV_R_R_Def_n_sw_q_595_CM -32768. 32767. FORMAT "%5.0" /end CHARACTERISTIC
/begin CHARACTERISTIC K_GEN_IGOF "Offsetwert Generatorstrom" VALUE 0xa0824564 _REC_VAL_20_u2 99.06 _CNV_R_R_Def_f_uw_b_679_CM 0. 254. FORMAT "%5.2" /end CHARACTERISTIC
/begin CHARACTERISTIC K_HTGENDFGRO "Schwelle Generaorauslastung zur E-Lüfteranforderung" VALUE 0xa08250de _REC_VAL_20_u1 99.45 _CNV_R_R_Def_dez_sl_551_CM 0. 255. FORMAT "%3.0" /end CHARACTERISTIC
/begin CHARACTERISTIC K_IERRFIL "Filterkonstante für Filterung Erregerstrom" VALUE 0xa082475c _REC_VAL_20_u1 0.9920000000000001 _CNV_R_R_Def_f_ub_b_553_CM 4.e-003 0.996 /end CHARACTERISTIC
/begin CHARACTERISTIC K_IGNOTWERT "Generatorstrom bei unpl.Generator oder Kommunikationsverlust" VALUE 0xa0824571 _REC_VAL_20_u1 99.45 _CNV_R_R_Def_ql_ub__573_CM 0. 255. /end CHARACTERISTIC
/begin CHARACTERISTIC K_IMDGENNRRW "Schwellwert zum Rechenrasterwechsel Momentenberechung" VALUE 0xa082455e _REC_VAL_20_s2 0. _CNV_R_R_Def_n_sw_q_595_CM -32768. 32767. FORMAT "%5.0" /end CHARACTERISTIC
/begin CHARACTERISTIC K_I_VERTEIL "Stromverteilung" VALUE 0xa08250df _REC_VAL_20_u1 3.9686 _CNV_R_R_Def_f_ub_b_632_CM 1.57e-002 3.9843 FORMAT "%5.2" /end CHARACTERISTIC
/begin CHARACTERISTIC K_KHRAMP_AUS "" VALUE 0xa082eeea _REC_VAL_20_u2 0.9999 _CNV_R_R_Def_f_uw_b_571_CM 0. 0.9999 FORMAT "%14.5" /end CHARACTERISTIC
/begin CHARACTERISTIC K_KHRAMP_EIN "" VALUE 0xa082eeec _REC_VAL_20_u2 0.9999 _CNV_R_R_Def_f_uw_b_571_CM 0. 0.9999 FORMAT "%14.5" /end CHARACTERISTIC
/begin CHARACTERISTIC K_KH_EIN "" VALUE 0xa082ee9c _REC_VAL_20_u1 0.996 _CNV_R_R_Def_f_ub_b_553_CM 0. 0.996 /end CHARACTERISTIC
/begin CHARACTERISTIC K_LLWDNMAX "Obere Schwelle Drehzahlabweichung im Leerlauf für Erkennung Generatorlastschwankung" VALUE 0xa0824e54 _REC_VAL_20_s2 0. _CNV_R_R_Def_n_sw_q_595_CM -32768. 32767. FORMAT "%5.0" /end CHARACTERISTIC
/begin CHARACTERISTIC K_LLWDNMIN "Untere Schwelle Drehzahlabweichung im Leerlauf für Erkennung Generatorlastschwankung" VALUE 0xa0824e56 _REC_VAL_20_s2 0. _CNV_R_R_Def_n_sw_q_595_CM -32768. 32767. FORMAT "%5.0" /end CHARACTERISTIC
/begin CHARACTERISTIC K_MANAWNUMM "Manuelle Vorgabe Generatortyp" VALUE 0xa0824572 _REC_VAL_20_u1 5. _CNV_R_R_Def_dez_sl_551_CM 1. 6. FORMAT "%3.0" /end CHARACTERISTIC
/begin CHARACTERISTIC K_MATEN_KATHZ "Betriebsart Enablematrix Kathheizen" VAL_BLK 0xa082eed0 _REC_VAL_2_u1 99.45 _CNV_R_R_Def_dez_sl_551_CM 0. 255. FORMAT "%3.0" NUMBER 8 /end CHARACTERISTIC
/begin CHARACTERISTIC K_MAT_ASPR "Zuordnung Eingang Ba-Umschaltung zu Betriebsart" VAL_BLK 0xa082eec0 _REC_VAL_2_u1 99.45 _CNV_R_R_Def_dez_sl_551_CM 0. 255. FORMAT "%3.0" NUMBER 8 /end CHARACTERISTIC
/begin CHARACTERISTIC K_MAT_ASPRL "Zuordnung Eingang Ba-Umschaltung zu Betriebsart" VAL_BLK 0xa082eeb8 _REC_VAL_2_u1 99.45 _CNV_R_R_Def_dez_sl_551_CM 0. 255. FORMAT "%3.0" NUMBER 8 /end CHARACTERISTIC
/begin CHARACTERISTIC K_MAT_ASPRVL "Zuordnung Eingang Ba-Umschaltung zu Betriebsart" VAL_BLK 0xa082eec8 _REC_VAL_2_u1 99.45 _CNV_R_R_Def_dez_sl_551_CM 0. 255. FORMAT "%3.0" NUMBER 8 /end CHARACTERISTIC
/begin CHARACTERISTIC K_MAT_ESPR "Zuordnung Eingang Ba-Umschaltung zu Betriebsart" VAL_BLK 0xa082eea8 _REC_VAL_2_u1 99.45 _CNV_R_R_Def_dez_sl_551_CM 0. 255. FORMAT "%3.0" NUMBER 8 /end CHARACTERISTIC
/begin CHARACTERISTIC K_MAT_ESPRL "Zuordnung Eingang Ba-Umschaltung zu Betriebsart" VAL_BLK 0xa082eea0 _REC_VAL_2_u1 99.45 _CNV_R_R_Def_dez_sl_551_CM 0. 255. FORMAT "%3.0" NUMBER 8 /end CHARACTERISTIC
/begin CHARACTERISTIC K_MAT_ESPRVL "Zuordnung Eingang Ba-Umschaltung zu Betriebsart" VAL_BLK 0xa082eeb0 _REC_VAL_2_u1 99.45 _CNV_R_R_Def_dez_sl_551_CM 0. 255. FORMAT "%3.0" NUMBER 8 /end CHARACTERISTIC
/begin CHARACTERISTIC K_MSKGENDFP "Bitmaske Generator Fehler-> DFP" VALUE 0xa08222fa _REC_VAL_20_u1 99.45 _CNV_R_R_Def_dez_sl_551_CM 0. 255. FORMAT "%3.0" /end CHARACTERISTIC
/begin CHARACTERISTIC K_MSKGENDIAG "" VALUE 0xa08222e4 _REC_VAL_20_u2 0. _CNV_R_R_Def_dez_sl_551_CM 0. 65535. FORMAT "%5.0" /end CHARACTERISTIC
/begin CHARACTERISTIC K_MSKGENKL61 "Bitmaske fuer Generatorfehler -> Ladekontrolle" VALUE 0xa08222fb _REC_VAL_20_u1 99.45 _CNV_R_R_Def_dez_sl_551_CM 0. 255. FORMAT "%3.0" /end CHARACTERISTIC
/begin CHARACTERISTIC K_MSKGENSTAT "" VALUE 0xa08222e6 _REC_VAL_20_u2 0. _CNV_R_R_Def_dez_sl_551_CM 0. 65535. FORMAT "%5.0" /end CHARACTERISTIC
/begin CHARACTERISTIC K_NGENHTMN1 "Untere Drehzahlschwelle für kritischen Bereich Didentemparatur" VALUE 0xa08250ce _REC_VAL_20_s2 0. _CNV_R_R_Def_n_sw_q_595_CM 0. 32767. FORMAT "%5.0" /end CHARACTERISTIC
/begin CHARACTERISTIC K_NGENHTMX1 "Obere Drehzahlschwelle für kritischen Bereich Didentemparatur" VALUE 0xa08250d0 _REC_VAL_20_s2 0. _CNV_R_R_Def_n_sw_q_595_CM 0. 32767. FORMAT "%5.0" /end CHARACTERISTIC
/begin CHARACTERISTIC K_NMAXVNS_ANS "" VALUE 0xa082eef2 _REC_VAL_20_s2 0. _CNV_R_R_Def_n_sw_q_595_CM -32768. 32767. FORMAT "%5.0" /end CHARACTERISTIC
/begin CHARACTERISTIC K_NMOTLLANH "Motordrehzahlschwelle für Rücksetzen der Leerlaufanhebung Generatorlast" VALUE 0xa0824e58 _REC_VAL_20_s2 0. _CNV_R_R_Def_n_sw_q_595_CM -32768. 32767. FORMAT "%5.0" /end CHARACTERISTIC
/begin CHARACTERISTIC K_NSCHW_CALC "Drehzahlschwelle für Generator-Grenzmoment-Berechnung" VALUE 0xa0824560 _REC_VAL_20_s2 0. _CNV_R_R_Def_n_sw_q_595_CM 0. 32767. FORMAT "%5.0" /end CHARACTERISTIC
/begin CHARACTERISTIC K_NSCHW_MD "Drehzahlschwelle fuer Aktivierung Generatormomentberechnung außerhalb BSD-Koordinator" VALUE 0xa0824562 _REC_VAL_20_s2 0. _CNV_R_R_Def_n_sw_q_595_CM -32768. 32767. FORMAT "%5.0" /end CHARACTERISTIC
/begin CHARACTERISTIC K_NSTATLLANH "Schwelle Leerlaufsolldrehzahl zum Aktivieren der Leerlaufanhebung Generatorlast" VALUE 0xa0824e5a _REC_VAL_20_s2 0. _CNV_R_R_Def_n_sw_q_595_CM -32768. 32767. FORMAT "%5.0" /end CHARACTERISTIC
/begin CHARACTERISTIC K_NSTSTAT1 "Kein Langbezeichner vergeben" VALUE 0xa0824ebc _REC_VAL_20_s2 0. _CNV_R_R_Def_n_sw_q_595_CM -32768. 32767. FORMAT "%5.0" /end CHARACTERISTIC
/begin CHARACTERISTIC K_NSTSTAT2 "Kein Langbezeichner vergeben" VALUE 0xa0824ebe _REC_VAL_20_s2 0. _CNV_R_R_Def_n_sw_q_595_CM -32768. 32767. FORMAT "%5.0" /end CHARACTERISTIC
/begin CHARACTERISTIC K_NSTSTAT3 "Kein Langbezeichner vergeben" VALUE 0xa0824ec0 _REC_VAL_20_s2 0. _CNV_R_R_Def_n_sw_q_595_CM -32768. 32767. FORMAT "%5.0" /end CHARACTERISTIC
/begin CHARACTERISTIC K_NSUBO "N_soll bei Batterieladebilanz zu niedrig" VALUE 0xa0824776 _REC_VAL_20_s2 0. _CNV_R_R_Def_n_sw_q_595_CM 0. 32767. FORMAT "%5.0" /end CHARACTERISTIC
/begin CHARACTERISTIC K_NSUBTRA "Kein Langbezeichner vergeben" VALUE 0xa0824778 _REC_VAL_20_s2 0. _CNV_R_R_Def_n_sw_q_595_CM -32768. 32767. FORMAT "%5.0" /end CHARACTERISTIC
/begin CHARACTERISTIC K_NSUBU "N_soll bei Ladebilanz iO" VALUE 0xa0824774 _REC_VAL_20_s2 0. _CNV_R_R_Def_n_sw_q_595_CM 0. 32767. FORMAT "%5.0" /end CHARACTERISTIC
/begin CHARACTERISTIC K_OFASPRAP "Offset Applikation Auslass" VALUE 0xa082ef02 _REC_VAL_20_s2 100.8 _CNV_R_R_Def_spr_ub_558_CM -180. 180. FORMAT "%5.2" /end CHARACTERISTIC
/begin CHARACTERISTIC K_OFESPRAP "Offset Applikation Einlass" VALUE 0xa082ef04 _REC_VAL_20_s2 100.8 _CNV_R_R_Def_spr_ub_558_CM -180. 180. FORMAT "%5.2" /end CHARACTERISTIC
/begin CHARACTERISTIC K_OZDELTOE "Verzögerung für das Schreiben in Fehlerspeicher Töns-Fehler" VALUE 0xa081a8dc _REC_VAL_20_u2 0. _CNV_R_R_Def_dez_sl_551_CM 0. 65535. FORMAT "%5.0" /end CHARACTERISTIC
/begin CHARACTERISTIC K_OZDIAGNMOT "Mindestdrehzahl zur QLT-Diagnose" VALUE 0xa081a8d4 _REC_VAL_20_s2 0. _CNV_R_R_Def_n_sw_q_595_CM -32768. 32767. FORMAT "%5.0" /end CHARACTERISTIC
/begin CHARACTERISTIC K_OZDIAGNMOT2 "Max Drehzahl zur QLT-Diagnose" VALUE 0xa081a8d6 _REC_VAL_20_s2 0. _CNV_R_R_Def_n_sw_q_595_CM -32768. 32767. FORMAT "%5.0" /end CHARACTERISTIC
/begin CHARACTERISTIC K_OZDIAGSPG "Spannung, unterhalb der die Diagnose ausgeblendet wird" VALUE 0xa081a8de _REC_VAL_20_u2 123.46794 _CNV_R_R_Def_u_sb_q_583_CM 0. 6173.397 FORMAT "%4.1" /end CHARACTERISTIC
/begin CHARACTERISTIC K_OZERRD "Entprellzeit Sensor- und Kommunikationsfehler" VALUE 0xa081a8e0 _REC_VAL_20_u2 0. _CNV_R_R_Def_dez_sl_551_CM 0. 65535. FORMAT "%5.0" /end CHARACTERISTIC
/begin CHARACTERISTIC K_OZHEAL "Entprellzeit Fehler-Healing" VALUE 0xa081a8e2 _REC_VAL_20_u2 0. _CNV_R_R_Def_dez_sl_551_CM 0. 65535. FORMAT "%5.0" /end CHARACTERISTIC
/begin CHARACTERISTIC K_OZNIVKL "Konvertierungsfaktor für den Niveau-Wert QLT" VALUE 0xa081a8f8 _REC_VAL_20_u1 74.70699999999999 _CNV_R_R_Def_niv_ub_667_CM 0. 74.70699999999999 FORMAT "%5.2" /end CHARACTERISTIC
/begin CHARACTERISTIC K_OZPERMRMIN "Grenze für Niveauberechnung aus Permittivität" VALUE 0xa081a8f0 _REC_VAL_20_u2 0. _CNV_R_R_Def_dez_sl_551_CM 0. 65535. FORMAT "%5.0" /end CHARACTERISTIC
/begin CHARACTERISTIC K_OZPLTEMP "Max Temperatursprung QLT (Plausibilisierung wegen ASIC-Pins Bruch)" VALUE 0xa081a8e8 _REC_VAL_20_u1 99.45 _CNV_R_R_Def_dez_sl_551_CM 0. 255. FORMAT "%3.0" /end CHARACTERISTIC
/begin CHARACTERISTIC K_OZPLZTEMP "Max unplausibel Sprünge (Plausibilisierung wegen ASIC-Pins Bruch)" VALUE 0xa081a8e9 _REC_VAL_20_u1 99.45 _CNV_R_R_Def_dez_sl_551_CM 0. 255. FORMAT "%3.0" /end CHARACTERISTIC
/begin CHARACTERISTIC K_OZPRREFMAX "Maximum für Referenzpermittivität" VALUE 0xa081a8f2 _REC_VAL_20_u2 102.4 _CNV_R_R_Def_dez_sl_551_CM 0. 1024. FORMAT "%5.0" /end CHARACTERISTIC
/begin CHARACTERISTIC K_OZPRREFMIN "Minimum für Referenzpermittivität" VALUE 0xa081a8f4 _REC_VAL_20_u2 102.4 _CNV_R_R_Def_dez_sl_551_CM 0. 1024. FORMAT "%5.0" /end CHARACTERISTIC
/begin CHARACTERISTIC K_OZSTZYK "Max Permittivitätsfahler für die Niveau-Freigabe " VALUE 0xa081a8f9 _REC_VAL_20_u1 99.45 _CNV_R_R_Def_dez_sl_551_CM 0. 255. FORMAT "%3.0" /end CHARACTERISTIC
/begin CHARACTERISTIC K_OZTEMPQERR "Temperaturschwelle für den Permittivitätsfehler" VALUE 0xa081a8d8 _REC_VAL_20_s2 131.07 _CNV_R_R_Def_t_sw_q_578_CM -3276.8 3276.7 FORMAT "%4.1" /end CHARACTERISTIC
/begin CHARACTERISTIC K_OZZTEMP "Max Zeit mit dem selben Temperaturwert (Plausibilisierung wegen ASIC-Pins Bruch)" VALUE 0xa081a8e4 _REC_VAL_20_u2 0. _CNV_R_R_Def_dez_sl_551_CM 0. 65535. FORMAT "%5.0" /end CHARACTERISTIC
/begin CHARACTERISTIC K_PLAUSAUS "Zeitdauer Ausschaltentprellung Plausibilisierung Fehler" VALUE 0xa08222e8 _REC_VAL_20_u2 131.07 _CNV_R_R_Def_td_ub__574_CM 0. 6553.5 FORMAT "%4.1" /end CHARACTERISTIC
/begin CHARACTERISTIC K_PLAUSEIN "Zeitdauer Einschaltentprellung Plausibilisierung Fehler" VALUE 0xa08222ea _REC_VAL_20_u2 131.07 _CNV_R_R_Def_td_ub__574_CM 0. 6553.5 FORMAT "%4.1" /end CHARACTERISTIC
/begin CHARACTERISTIC K_PR_IERRLLRED "Prio Erregerstrombegrenzung durch LL Sägen" VALUE 0xa0824e7d _REC_VAL_20_u1 99.45 _CNV_R_R_Def_dez_sl_551_CM 0. 255. FORMAT "%3.0" /end CHARACTERISTIC
/begin CHARACTERISTIC K_PR_IERRTRED "Prio Erregerstromanforderung wegen Hochtemperatur" VALUE 0xa08250e0 _REC_VAL_20_u1 99.45 _CNV_R_R_Def_dez_sl_551_CM 0. 255. FORMAT "%3.0" /end CHARACTERISTIC
/begin CHARACTERISTIC K_PT1SPR "Filterkonstante Spreizung" VALUE 0xa082eedc _REC_VAL_20_u1 0.996 _CNV_R_R_Def_f_ub_b_553_CM 0. 0.996 /end CHARACTERISTIC
/begin CHARACTERISTIC K_PWGLLANH "Fahrpedalwinkel-Schwelle für Rücksetzen der Leerlaufanhebung Generatorlast" VALUE 0xa0824e5c _REC_VAL_20_s2 95.99852999999999 _CNV_R_R_Def_wdk_sw_683_CM -800. 799.9755 FORMAT "%5.2" /end CHARACTERISTIC
/begin CHARACTERISTIC K_RAMPENA "" VALUE 0xa082eef6 _REC_VAL_20_u2 131.07 _CNV_R_R_Def_spr_sw_561_CM 0. 6553.5 FORMAT "%5.2" /end CHARACTERISTIC
/begin CHARACTERISTIC K_RFMAXVNS_ANS "" VALUE 0xa082eef4 _REC_VAL_20_s2 98.30250000000001 _CNV_R_R_Def_rf_sw__598_CM -327.68 327.67 FORMAT "%7.4" /end CHARACTERISTIC
/begin CHARACTERISTIC K_R_LADLTG "Applikationskonstante für Widerstand Ladeleitung" VALUE 0xa0824566 _REC_VAL_20_u2 102.39843 _CNV_R_R_Def_r_uw_b_769_CM 0. 1023.9843 FORMAT "%5.0" /end CHARACTERISTIC
/begin CHARACTERISTIC K_SCHNKWLLRED "Drehzahlgrenze für Aktivierung Sägeerkennung PGENLLRED" VALUE 0xa0824e5e _REC_VAL_20_s2 0. _CNV_R_R_Def_n_sw_q_595_CM -32768. 32767. FORMAT "%5.0" /end CHARACTERISTIC
/begin CHARACTERISTIC K_SCHPWGLLRED "Grenze Pedalwertgeber für Verzögerung B_ll in PGENLLRED" VALUE 0xa0824e60 _REC_VAL_20_s2 95.99852999999999 _CNV_R_R_Def_wdk_sw_683_CM -800. 799.9755 FORMAT "%5.2" /end CHARACTERISTIC
/begin CHARACTERISTIC K_SNMBSDKL61 "" VALUE 0xa08222de _REC_VAL_20_s2 0. _CNV_R_R_Def_n_sw_q_595_CM -32768. 32767. FORMAT "%5.0" /end CHARACTERISTIC
/begin CHARACTERISTIC K_SPRLLFL_AUS "" VALUE 0xa082eee3 _REC_VAL_20_u1 99.45 _CNV_R_R_Def_dez_sl_551_CM 0. 255. FORMAT "%3.0" /end CHARACTERISTIC
/begin CHARACTERISTIC K_SPRLLFL_EIN "" VALUE 0xa082eee4 _REC_VAL_20_u1 99.45 _CNV_R_R_Def_dez_sl_551_CM 0. 255. FORMAT "%3.0" /end CHARACTERISTIC
/begin CHARACTERISTIC K_SPRRAMP_EIN "Minimale Rampensteigung nach Startende" VALUE 0xa082ef14 _REC_VAL_20_s2 131.07 _CNV_R_R_Def_spr_sw_561_CM -3276.8 3276.7 FORMAT "%5.2" /end CHARACTERISTIC
/begin CHARACTERISTIC K_SPRRAMP_NEG "" VALUE 0xa082eefa _REC_VAL_20_s2 131.07 _CNV_R_R_Def_spr_sw_561_CM -3276.8 3276.7 FORMAT "%5.2" /end CHARACTERISTIC
/begin CHARACTERISTIC K_SPRRAMP_POS "" VALUE 0xa082eef8 _REC_VAL_20_s2 131.07 _CNV_R_R_Def_spr_sw_561_CM -3276.8 3276.7 FORMAT "%5.2" /end CHARACTERISTIC
/begin CHARACTERISTIC K_SPRZGAN_OFF "Anschlagspreizung Offset" VAL_BLK 0xa082eee6 _REC_VAL_2_u1 99.96000000000001 _CNV_R_R_Def_spr_ub_558_CM 0. 204. FORMAT "%5.2" NUMBER 4 /end CHARACTERISTIC
/begin CHARACTERISTIC K_TCHIPFIL "Filterkonstante schneller Tchip Filter" VALUE 0xa08250d8 _REC_VAL_20_u2 0.9999847412109381 _CNV_R_R_Def_f_uw_b_571_CM 0. 0.9999847412109381 FORMAT "%14.5" /end CHARACTERISTIC
/begin CHARACTERISTIC K_TDBLLLLRED "Applizierbare Verzögerung B_ll in PGENLLRED" VALUE 0xa0824e66 _REC_VAL_20_u2 98.30250000000001 _CNV_R_R_Def_td_uw__673_CM 0. 655.35 FORMAT "%5.2" /end CHARACTERISTIC
/begin CHARACTERISTIC K_TDFDTMAX "Zeitschwelle zum Erkennen Drehzahlabweichung durch Generatorlastschwankung" VALUE 0xa0824e68 _REC_VAL_20_u2 131.07 _CNV_R_R_Def_td_uw__718_CM 0. 13107. FORMAT "%4.1" /end CHARACTERISTIC
/begin CHARACTERISTIC K_TDFFABLF "Zeitschwelle (Tdffgen) zum Rücksetzen der Leerlaufanhebung" VALUE 0xa0824e6a _REC_VAL_20_u2 131.07 _CNV_R_R_Def_td_uw__718_CM 0. 13107. FORMAT "%4.1" /end CHARACTERISTIC
/begin CHARACTERISTIC K_TDFFMAX "Maximale Periodendauer Generatorlastschwankungen  für Leerlaufstabilisierung" VALUE 0xa0824e6c _REC_VAL_20_u2 131.07 _CNV_R_R_Def_td_uw__718_CM 0. 13107. FORMAT "%4.1" /end CHARACTERISTIC
/begin CHARACTERISTIC K_TDFFMIN "Minimale Periodendauer Generatorlastschwankungen für Leerlaufstabilisierung" VALUE 0xa0824e6e _REC_VAL_20_u2 131.07 _CNV_R_R_Def_td_uw__718_CM 0. 13107. FORMAT "%4.1" /end CHARACTERISTIC
/begin CHARACTERISTIC K_TDFIERR "Filterzeit des Erregerstromes" VALUE 0xa0824568 _REC_VAL_20_u2 98.30250000000001 _CNV_R_R_Def_td_uw__673_CM 0. 655.35 FORMAT "%5.2" /end CHARACTERISTIC
/begin CHARACTERISTIC K_TDGENERR "" VALUE 0xa08222ec _REC_VAL_20_u2 131.07 _CNV_R_R_Def_td_ub__574_CM 0. 6553.5 FORMAT "%4.1" /end CHARACTERISTIC
/begin CHARACTERISTIC K_TDGENFBSD "" VALUE 0xa08222ee _REC_VAL_20_u2 131.07 _CNV_R_R_Def_td_ub__574_CM 0. 6553.5 FORMAT "%4.1" /end CHARACTERISTIC
/begin CHARACTERISTIC K_TDNGENKRIT "Verzögerung Generator im kritischen Drehzahlbereich" VALUE 0xa08250e1 _REC_VAL_20_u1 99.45 _CNV_R_R_Def_td_ub__611_CM 0. 255. FORMAT "%5.2" /end CHARACTERISTIC
/begin CHARACTERISTIC K_TDNHOLD "Haltezeit für Bedingung Drehzahlabweichung durch Generatorlastschwankung" VALUE 0xa0824e7e _REC_VAL_20_u1 51. _CNV_R_R_Def_td_uw__718_CM 0. 51. FORMAT "%4.1" /end CHARACTERISTIC
/begin CHARACTERISTIC K_TDSTATE1 "" VALUE 0xa0824ec4 _REC_VAL_20_u2 131.07 _CNV_R_R_Def_td_ub__574_CM 0. 6553.5 FORMAT "%4.1" /end CHARACTERISTIC
/begin CHARACTERISTIC K_TDSTATE2 "" VALUE 0xa0824ec6 _REC_VAL_20_u2 131.07 _CNV_R_R_Def_td_ub__574_CM 0. 6553.5 FORMAT "%4.1" /end CHARACTERISTIC
/begin CHARACTERISTIC K_TDSTATE3 "" VALUE 0xa0824ec8 _REC_VAL_20_u2 131.07 _CNV_R_R_Def_td_ub__574_CM 0. 6553.5 FORMAT "%4.1" /end CHARACTERISTIC
/begin CHARACTERISTIC K_TDSTATE4 "" VALUE 0xa0824eca _REC_VAL_20_u2 131.07 _CNV_R_R_Def_td_ub__574_CM 0. 6553.5 FORMAT "%4.1" /end CHARACTERISTIC
/begin CHARACTERISTIC K_TDTCHIPKRI "Verzögerung Generatorhochtemperatur" VALUE 0xa08250e2 _REC_VAL_20_u1 99.45 _CNV_R_R_Def_td_ub__611_CM 0. 255. FORMAT "%5.2" /end CHARACTERISTIC
/begin CHARACTERISTIC K_TDTCHIPMX "Verzögerung erhöhte Chiptemperatur" VALUE 0xa08250e3 _REC_VAL_20_u1 99.45 _CNV_R_R_Def_dez_sl_551_CM 0. 255. FORMAT "%3.0" /end CHARACTERISTIC
/begin CHARACTERISTIC K_TDUBFZMN "Verzögerung Bordnetzschwelle" VALUE 0xa08250e4 _REC_VAL_20_u1 99.45 _CNV_R_R_Def_td_ub__611_CM 0. 255. FORMAT "%5.2" /end CHARACTERISTIC
/begin CHARACTERISTIC K_TD_UGENDIAG "Entprellzeit Unterspannungsdiagnose Generator" VALUE 0xa08222f0 _REC_VAL_20_u2 131.07 _CNV_R_R_Def_td_ub__574_CM 0. 6553.5 FORMAT "%4.1" /end CHARACTERISTIC
/begin CHARACTERISTIC K_TFIGENHT "Filterkonstante verteilter Generatorstrom" VALUE 0xa08250e5 _REC_VAL_20_u1 0.9920000000000001 _CNV_R_R_Def_f_ub_b_553_CM 4.e-003 0.996 /end CHARACTERISTIC
/begin CHARACTERISTIC K_TFTDIODE "Filterkonstante Deltatemparatur Diode" VALUE 0xa08250da _REC_VAL_20_u2 0.9999694824218756 _CNV_R_R_Def_f_uw_b_571_CM 1.52587890625e-005 0.9999847412109381 FORMAT "%14.5" /end CHARACTERISTIC
/begin CHARACTERISTIC K_TGENMXGRAD "Schwellwert für Erkennung mayimaler Gradient" VALUE 0xa08250d2 _REC_VAL_20_s2 131.07 _CNV_R_R_Def_t_sw_q_578_CM -3276.8 3276.7 FORMAT "%4.1" /end CHARACTERISTIC
/begin CHARACTERISTIC K_TGENMXTHD "Schwellwert für überhöhte Temparatur Generator" VALUE 0xa08250d4 _REC_VAL_20_s2 131.07 _CNV_R_R_Def_t_sw_q_578_CM -3276.8 3276.7 FORMAT "%4.1" /end CHARACTERISTIC
/begin CHARACTERISTIC K_TGENRSHT "Reset bei unterschrittener Chiptemperatur" VALUE 0xa08250d6 _REC_VAL_20_s2 131.07 _CNV_R_R_Def_t_sw_q_578_CM -3276.8 3276.7 FORMAT "%4.1" /end CHARACTERISTIC
/begin CHARACTERISTIC K_TLCHTEP "Entprellung Hochtemperatur Generator" VALUE 0xa08250e6 _REC_VAL_20_u1 99.45 _CNV_R_R_Def_td_ub__611_CM 0. 255. FORMAT "%5.2" /end CHARACTERISTIC
/begin CHARACTERISTIC K_TMASPR "Motortemperaturschwelle fuer Auslassspreizungsfreigabe" VALUE 0xa082ef06 _REC_VAL_20_s2 98.30250000000001 _CNV_R_R_Def_t_sw_q_579_CM -327.68 327.67 FORMAT "%5.2" /end CHARACTERISTIC
/begin CHARACTERISTIC K_TMESPR "Motortemperaturschwelle fuer Einlassspreizungsfreigabe" VALUE 0xa082ef08 _REC_VAL_20_s2 98.30250000000001 _CNV_R_R_Def_t_sw_q_579_CM -327.68 327.67 FORMAT "%5.2" /end CHARACTERISTIC
/begin CHARACTERISTIC K_TMOTLLANH "Motortemperatur-Schwelle zum Aktivieren der Leerlaufanhebung Generatorlast" VALUE 0xa0824e62 _REC_VAL_20_s2 98.30250000000001 _CNV_R_R_Def_t_sw_q_579_CM -327.68 327.67 FORMAT "%5.2" /end CHARACTERISTIC
/begin CHARACTERISTIC K_TMVS_ANLERN "Tmot Schwelle fuer zus. Anschlagadaption bei SA" VALUE 0xa082ef0e _REC_VAL_20_s2 98.30250000000001 _CNV_R_R_Def_t_sw_q_579_CM -327.68 327.67 FORMAT "%5.2" /end CHARACTERISTIC
/begin CHARACTERISTIC K_TNNSTART "Zeittriggerschwelle nach Motorstart" VALUE 0xa0824754 _REC_VAL_20_u2 98.30250000000001 _CNV_R_R_Def_td_uw__673_CM 0. 655.35 FORMAT "%5.2" /end CHARACTERISTIC
/begin CHARACTERISTIC K_TNSTLLANH "Zeitschwelle nach Startende zum Aktivieren der Leerlaufanhebung Generatorlast" VALUE 0xa0824e70 _REC_VAL_20_u2 98.30250000000001 _CNV_R_R_Def_td_uw__673_CM 0. 655.35 FORMAT "%5.2" /end CHARACTERISTIC
/begin CHARACTERISTIC K_TOGMAXUNPL "Max Versuche für unplausibel Fehler Toens" VALUE 0xa081a8ea _REC_VAL_20_u1 99.45 _CNV_R_R_Def_dez_sl_551_CM 0. 255. FORMAT "%3.0" /end CHARACTERISTIC
/begin CHARACTERISTIC K_TOGVERZOEG "Für das Überspringen der ersten Messungen Töns" VALUE 0xa081a8fa _REC_VAL_20_u1 99.45 _CNV_R_R_Def_dez_sl_551_CM 0. 255. FORMAT "%3.0" /end CHARACTERISTIC
/begin CHARACTERISTIC K_TOG_CNTMAX "Max Versuche für Signal-Fehler Toens" VALUE 0xa081a8e6 _REC_VAL_20_u2 98.30250000000001 _CNV_R_R_Def_td_uw__673_CM 0. 655.35 FORMAT "%5.2" /end CHARACTERISTIC
/begin CHARACTERISTIC K_TRTYP "Faktor für die Berechnung Öl-Temperatur Töns" VALUE 0xa081a8f6 _REC_VAL_20_u2 98.30250000000001 _CNV_R_R_Def_td_uw__673_CM 0. 655.35 FORMAT "%5.2" /end CHARACTERISTIC
/begin CHARACTERISTIC K_TVRAMP "Startwert fuer TurnOnDelay Timer fuer Dvsx_ramp" VALUE 0xa082ef0a _REC_VAL_20_u2 98.30250000000001 _CNV_R_R_Def_td_uw__673_CM 0. 655.35 FORMAT "%5.2" /end CHARACTERISTIC
/begin CHARACTERISTIC K_TVSPSA "Startwert fuer TurnOnDelay Timer fuer zus. Anschlagadaption bei SA" VALUE 0xa082ef0c _REC_VAL_20_u2 98.30250000000001 _CNV_R_R_Def_td_uw__673_CM 0. 655.35 FORMAT "%5.2" /end CHARACTERISTIC
/begin CHARACTERISTIC K_UBOFF "Spannungsoffset für ugen_calc" VALUE 0xa082456a _REC_VAL_20_u2 131.07 _CNV_R_R_Def_u_ub_q_631_CM 0. 6553.5 /end CHARACTERISTIC
/begin CHARACTERISTIC K_UB_GRENZST "Grenzwert Gradient d. Bordnetzspannung im Start" VALUE 0xa0824750 _REC_VAL_20_u2 123.46794 _CNV_R_R_Def_u_sb_q_583_CM 0. 6173.397 FORMAT "%4.1" /end CHARACTERISTIC
/begin CHARACTERISTIC K_UGENDIAG "Diagoseschwelle Generatorunterspannung" VALUE 0xa08222f2 _REC_VAL_20_u2 123.46794 _CNV_R_R_Def_u_sb_q_583_CM 0. 6173.397 FORMAT "%4.1" /end CHARACTERISTIC
/begin CHARACTERISTIC K_UGENHTMN "Schwellwert Bordnetzspannung Reset Generatorstrombefrenzung durch Hochtemperatur" VALUE 0xa08250dc _REC_VAL_20_u2 123.46794 _CNV_R_R_Def_u_sb_q_583_CM 0. 6173.397 FORMAT "%4.1" /end CHARACTERISTIC
/begin CHARACTERISTIC K_UGENTEST1 "" VALUE 0xa0824ecc _REC_VAL_20_u2 131.07 _CNV_R_R_Def_u_ub_q_631_CM 0. 6553.5 /end CHARACTERISTIC
/begin CHARACTERISTIC K_UGENTEST2 "" VALUE 0xa0824ece _REC_VAL_20_u2 131.07 _CNV_R_R_Def_u_ub_q_631_CM 0. 6553.5 /end CHARACTERISTIC
/begin CHARACTERISTIC K_UGENTEST3 "" VALUE 0xa0824ed0 _REC_VAL_20_u2 131.07 _CNV_R_R_Def_u_ub_q_631_CM 0. 6553.5 /end CHARACTERISTIC
/begin CHARACTERISTIC K_UGENTEST4 "" VALUE 0xa0824ed2 _REC_VAL_20_u2 131.07 _CNV_R_R_Def_u_ub_q_631_CM 0. 6553.5 /end CHARACTERISTIC
/begin CHARACTERISTIC K_UGOFFSET "Offset zur Schwelle Generatorunterspannungs Diagnose" VALUE 0xa08222f4 _REC_VAL_20_u2 123.46794 _CNV_R_R_Def_u_sb_q_583_CM 0. 6173.397 FORMAT "%4.1" /end CHARACTERISTIC
/begin CHARACTERISTIC K_VFZGGENFIL "Filterkonstante Filterung V" VALUE 0xa0824e72 _REC_VAL_20_u2 0.9999694824218756 _CNV_R_R_Def_f_uw_b_571_CM 1.52587890625e-005 0.9999847412109381 FORMAT "%14.5" /end CHARACTERISTIC
/begin CHARACTERISTIC K_VFZGGENKOR "Korrekturfaktor für V" VALUE 0xa0824e7f _REC_VAL_20_u1 7.9687 _CNV_R_R_Def_f_ub_b_694_CM 0. 7.9687 FORMAT "%5.2" /end CHARACTERISTIC
/begin CHARACTERISTIC K_VFZGLLANH "Fahrgeschwindigkeits-Schwelle ¨ fur R¨ ucksetzen der Leerlaufanhebung Generatorlast" VALUE 0xa0824e74 _REC_VAL_20_u2 0. _CNV_R_R_Def_v_uw_q_726_CM 0. 65535. FORMAT "%5.0" /end CHARACTERISTIC
/begin CHARACTERISTIC K_VNS_VZD "Verstellschwelle VANOS" VALUE 0xa082eedf _REC_VAL_20_u1 25.5 _CNV_R_R_Def_spr_sw_561_CM 0. 25.5 FORMAT "%5.2" /end CHARACTERISTIC
/begin CHARACTERISTIC K_VNS_VZZMX "Max. Anzahl an Nachtriggerungen" VALUE 0xa082eee0 _REC_VAL_20_u1 99.45 _CNV_R_R_Def_dez_sl_551_CM 0. 255. FORMAT "%3.0" /end CHARACTERISTIC
/begin CHARACTERISTIC K_VNS_WTZ "Wartezeit" VALUE 0xa082eee1 _REC_VAL_20_u1 2.55 _CNV_R_R_Def_td_uw__673_CM 0. 2.55 FORMAT "%5.2" /end CHARACTERISTIC
/begin CHARACTERISTIC K_VSEMN_NOTL "Einlassspreizung bei VVT-Notlauf" VALUE 0xa082eefc _REC_VAL_20_u2 100.8 _CNV_R_R_Def_spr_sw_561_CM 0. 180. FORMAT "%5.2" /end CHARACTERISTIC
/begin CHARACTERISTIC K_WNWAIMN "Minimalwert der individuellen NW-Spaetanschlagsadaption" VALUE 0xa082ef10 _REC_VAL_20_u2 100.8 _CNV_R_R_Def_spr_sw_561_CM 0. 180. FORMAT "%5.2" /end CHARACTERISTIC
/begin CHARACTERISTIC K_WNWKHRA_MIN "" VALUE 0xa082eee2 _REC_VAL_20_u1 0.996 _CNV_R_R_Def_f_ub_b_553_CM 0. 0.996 /end CHARACTERISTIC
/begin CHARACTERISTIC K_WNWMN "Minimaler Nockenwellensollwinkel" VALUE 0xa082ef12 _REC_VAL_20_u2 100.8 _CNV_R_R_Def_spr_sw_561_CM 0. 180. FORMAT "%5.2" /end CHARACTERISTIC
/begin CHARACTERISTIC K_ZMGENIG "Filterzeit der Generatorstromes" VALUE 0xa082456c _REC_VAL_20_u2 131.07 _CNV_R_R_Def_td_ub__574_CM 0. 6553.5 FORMAT "%4.1" /end CHARACTERISTIC
/begin CHARACTERISTIC S_ASPSATRU "Applikationsschalter fuer dauerhafte zus. Auslassspreizung" VALUE 0xa082eede _REC_VAL_20_u1 1. _CNV_R_R_Def_dez_sl_551_CM 0. 1. FORMAT "%3.0" /end CHARACTERISTIC
/begin CHARACTERISTIC S_BTVS_GDEIN "Testeransteuerung bei Gedrosselt erlauben" VALUE 0xa082ee9e _REC_VAL_20_u1 1. _CNV_R_R_Def_dez_sl_551_CM 0. 1. FORMAT "%3.0" /end CHARACTERISTIC
/begin CHARACTERISTIC S_DGENSTAT "" VALUE 0xa08222fc _REC_VAL_20_u1 1. _CNV_R_R_Def_dez_sl_551_CM 0. 1. FORMAT "%3.0" /end CHARACTERISTIC
/begin CHARACTERISTIC S_DGENSTATENA "" VALUE 0xa08222fd _REC_VAL_20_u1 1. _CNV_R_R_Def_dez_sl_551_CM 0. 1. FORMAT "%3.0" /end CHARACTERISTIC
/begin CHARACTERISTIC S_ENABLLLLRED "Aktivierung Einrechnung B_ll in PGENLLRED" VALUE 0xa0824e80 _REC_VAL_20_u1 1. _CNV_R_R_Def_dez_sl_551_CM 0. 1. FORMAT "%3.0" /end CHARACTERISTIC
/begin CHARACTERISTIC S_ENUGDIAG "Freigabe Unterspannungsdiagnose Generator" VALUE 0xa08222fe _REC_VAL_20_u1 1. _CNV_R_R_Def_dez_sl_551_CM 0. 1. FORMAT "%3.0" /end CHARACTERISTIC
/begin CHARACTERISTIC S_ESPSATRU "Applikationsschalter fuer dauerhafte zus. Einlassspreizung" VALUE 0xa082eedd _REC_VAL_20_u1 1. _CNV_R_R_Def_dez_sl_551_CM 0. 1. FORMAT "%3.0" /end CHARACTERISTIC
/begin CHARACTERISTIC S_GELIBIEAPP "Applikation Generatorlastbegrenzung für Leerlaufstabilisierung" VALUE 0xa0824e81 _REC_VAL_20_u1 1. _CNV_R_R_Def_dez_sl_551_CM 0. 1. FORMAT "%3.0" /end CHARACTERISTIC
/begin CHARACTERISTIC S_GENDIAGNEU "" VALUE 0xa08222ff _REC_VAL_20_u1 1. _CNV_R_R_Def_dez_sl_551_CM 0. 1. FORMAT "%3.0" /end CHARACTERISTIC
/begin CHARACTERISTIC S_GENPLAUS "" VALUE 0xa0822300 _REC_VAL_20_u1 1. _CNV_R_R_Def_dez_sl_551_CM 0. 1. FORMAT "%3.0" /end CHARACTERISTIC
/begin CHARACTERISTIC S_GENTESTANF "" VALUE 0xa0824ed8 _REC_VAL_20_u1 1. _CNV_R_R_Def_dez_sl_551_CM 0. 1. FORMAT "%3.0" /end CHARACTERISTIC
/begin CHARACTERISTIC S_HTDETEC "Schalter zur Aktivierung Überwachung Diodentemparatur" VALUE 0xa08250e7 _REC_VAL_20_u1 1. _CNV_R_R_Def_dez_sl_551_CM 0. 1. FORMAT "%3.0" /end CHARACTERISTIC
/begin CHARACTERISTIC S_KATHEIN_EXT "" VALUE 0xa082ee9d _REC_VAL_20_u1 1. _CNV_R_R_Def_dez_sl_551_CM 0. 1. FORMAT "%3.0" /end CHARACTERISTIC
/begin CHARACTERISTIC S_MDAPPAS "Schalter Applikation Auslass" VALUE 0xa082eeda _REC_VAL_20_u1 1. _CNV_R_R_Def_dez_sl_551_CM 0. 1. FORMAT "%3.0" /end CHARACTERISTIC
/begin CHARACTERISTIC S_MDAPPES "Schalter Applikation Einlass" VALUE 0xa082eedb _REC_VAL_20_u1 1. _CNV_R_R_Def_dez_sl_551_CM 0. 1. FORMAT "%3.0" /end CHARACTERISTIC
/begin CHARACTERISTIC S_OZBSDKOORD "BSD Koordinator aktiv" VALUE 0xa081a8eb _REC_VAL_20_u1 99.45 _CNV_R_R_Def_dez_sl_551_CM 0. 255. FORMAT "%3.0" /end CHARACTERISTIC
/begin CHARACTERISTIC S_PGENLL_AKT "Aktivierung Leistungsreduzierung Generator durch Generatorlastschwankung" VALUE 0xa0824e82 _REC_VAL_20_u1 1. _CNV_R_R_Def_dez_sl_551_CM 0. 1. FORMAT "%3.0" /end CHARACTERISTIC
/begin CHARACTERISTIC S_PMSTRTMOD "Startnkw aufgrund B_sta || Spgseinbruch" VALUE 0xa0824752 _REC_VAL_20_u1 99.45 _CNV_R_R_Def_dez_sl_551_CM 0. 255. FORMAT "%3.0" /end CHARACTERISTIC
/begin CHARACTERISTIC S_RDGENTYP "Schalter Freigabe Manuelle Vorgabe Generatortyp" VALUE 0xa0824573 _REC_VAL_20_u1 99.45 _CNV_R_R_Def_dez_sl_551_CM 0. 255. FORMAT "%3.0" /end CHARACTERISTIC
/begin CHARACTERISTIC S_SICHER_ON "Spreizungen VVT sicher aktiv" VALUE 0xa082ee9f _REC_VAL_20_u1 1. _CNV_R_R_Def_dez_sl_551_CM 0. 1. FORMAT "%3.0" /end CHARACTERISTIC
/begin CHARACTERISTIC S_STRTNKWMOD "Schalter N oder Nkw_zahn" VALUE 0xa0824753 _REC_VAL_20_u1 99.45 _CNV_R_R_Def_dez_sl_551_CM 0. 255. FORMAT "%3.0" /end CHARACTERISTIC
/begin COMPU_METHOD _CNV_R_R_Def_dez_sl_551_CM "Def_dez_sl_q1" RAT_FUNC "%6.3" "-" COEFFS 0. 1. 0. 0. 0. 1. /end COMPU_METHOD
/begin COMPU_METHOD _CNV_R_R_Def_f_ub_b_553_CM "Def_f_ub_b1" RAT_FUNC "%6.3" "-" COEFFS 0. 256. 0. 0. 0. 1. /end COMPU_METHOD
/begin COMPU_METHOD _CNV_R_R_Def_m_sw_q_554_CM "Def_m_sw_q0p1" RAT_FUNC "%6.3" "Nm" COEFFS 0. 10. 0. 0. 0. 1. /end COMPU_METHOD
/begin COMPU_METHOD _CNV_R_R_Def_f_uw_b_555_CM "Def_f_uw_b100" RAT_FUNC "%6.3" "%" COEFFS 0. 65536. 0. 0. 0. 100. /end COMPU_METHOD
/begin COMPU_METHOD _CNV_R_R_Def_spr_ub_558_CM "Def_spr_ub_q0p8" RAT_FUNC "%6.3" "° KW" COEFFS 0. 1. 0. 0. 0. 0.8 /end COMPU_METHOD
/begin COMPU_METHOD _CNV_R_R_Def_spr_sw_561_CM "Def_spr_sw_q0p1" RAT_FUNC "%6.3" "° KW" COEFFS 0. 10. 0. 0. 0. 1. /end COMPU_METHOD
/begin COMPU_METHOD _CNV_S_2_Def_bit_ub_563_CM "Def_bit_ub_0" TAB_VERB "%6.3" "-" COMPU_TAB_REF _CNV_S_2_Def_bit_ub_563 /end COMPU_METHOD
/begin COMPU_VTAB _CNV_S_2_Def_bit_ub_563 "Def_bit_ub_0" TAB_VERB 2 0 "FALSE" 1 "TRUE" /end COMPU_VTAB
/begin COMPU_METHOD _CNV_R_R_Def_f_uw_b_571_CM "Def_f_uw_b1" RAT_FUNC "%6.3" "-" COEFFS 0. 65536. 0. 0. 0. 1. /end COMPU_METHOD
/begin COMPU_METHOD _CNV_R_R_Def_ql_ub__573_CM "Def_ql_ub_q1" RAT_FUNC "%6.3" "" COEFFS 0. 1. 0. 0. 0. 1. /end COMPU_METHOD
/begin COMPU_METHOD _CNV_R_R_Def_td_ub__574_CM "Def_td_ub_q0p1" RAT_FUNC "%6.3" "s" COEFFS 0. 10. 0. 0. 0. 1. /end COMPU_METHOD
/begin COMPU_METHOD _CNV_R_R_Def_p_sw_q_576_CM "Def_p_sw_q0p039" RAT_FUNC "%6.3" "hPa" COEFFS 0. 256. 0. 0. 0. 10. /end COMPU_METHOD
/begin COMPU_METHOD _CNV_R_R_Def_t_sw_q_578_CM "Def_t_sw_q0p1" RAT_FUNC "%6.3" "°C" COEFFS 0. 10. 0. 0. 0. 1. /end COMPU_METHOD
/begin COMPU_METHOD _CNV_R_R_Def_t_sw_q_579_CM "Def_t_sw_q0p01" RAT_FUNC "%6.3" "°C" COEFFS 0. 100. 0. 0. 0. 1. /end COMPU_METHOD
/begin COMPU_METHOD _CNV_R_R_Def_u_sw_q_580_CM "Def_u_sw_q0p00488" RAT_FUNC "%6.3" "V" COEFFS 0. 1024. 0. 0. 0. 5. /end COMPU_METHOD
/begin COMPU_METHOD _CNV_R_R_Def_u_sb_q_583_CM "Def_u_sb_q0p0942" RAT_FUNC "%6.3" "V" COEFFS 0. 1. 0. 0. 0. 9.420000000000001e-002 /end COMPU_METHOD
/begin COMPU_METHOD _CNV_R_R_Def_f_sb_b_584_CM "Def_f_sb_b64" RAT_FUNC "%6.3" "-" COEFFS 0. 128. 0. 0. 0. 64. /end COMPU_METHOD
/begin COMPU_METHOD _CNV_R_R_Def_f_ub_b_586_CM "Def_f_ub_b100" RAT_FUNC "%6.3" "%" COEFFS 0. 256. 0. 0. 0. 100. /end COMPU_METHOD
/begin COMPU_METHOD _CNV_R_R_Def_dt_sw__587_CM "Def_dt_sw_b4096" RAT_FUNC "%6.3" "m/s" COEFFS 0. 32768. 0. 0. 0. 4096. /end COMPU_METHOD
/begin COMPU_METHOD _CNV_R_R_Def_f_uw_b_588_CM "Def_f_uw_b32" RAT_FUNC "%6.3" "-" COEFFS 0. 65536. 0. 0. 0. 32. /end COMPU_METHOD
/begin COMPU_METHOD _CNV_R_R_Def_hub_uw_589_CM "Def_hub_uw_q0p001" RAT_FUNC "%6.3" "mm" COEFFS 0. 1000. 0. 0. 0. 1. /end COMPU_METHOD
/begin COMPU_METHOD _CNV_R_R_Def_n_sw_q_595_CM "Def_n_sw_q1p0" RAT_FUNC "%6.3" "Upm" COEFFS 0. 1. 0. 0. 0. 1. /end COMPU_METHOD
/begin COMPU_METHOD _CNV_R_R_Def_rf_sw__598_CM "Def_rf_sw_q0p01" RAT_FUNC "%6.3" "%" COEFFS 0. 100. 0. 0. 0. 1. /end COMPU_METHOD
/begin COMPU_METHOD _CNV_R_R_Def_eta_sw_599_CM "Def_eta_sw_b200" RAT_FUNC "%6.3" "%" COEFFS 0. 32768. 0. 0. 0. 200. /end COMPU_METHOD
/begin COMPU_METHOD _CNV_R_R_Def_rk_sw__600_CM "Def_rk_sw_b1600" RAT_FUNC "%6.3" "%" COEFFS 0. 2048. 0. 0. 0. 100. /end COMPU_METHOD
/begin COMPU_METHOD _CNV_R_R_Def_td_ub__611_CM "Def_td_ub_q1" RAT_FUNC "%6.3" "s" COEFFS 0. 1. 0. 0. 0. 1. /end COMPU_METHOD
/begin COMPU_METHOD _CNV_R_R_Def_f_ub_b_613_CM "Def_f_ub_b2" RAT_FUNC "%6.3" "-" COEFFS 0. 256. 0. 0. 0. 2. /end COMPU_METHOD
/begin COMPU_METHOD _CNV_R_R_Def_f_uw_b_621_CM "Def_f_uw_b256" RAT_FUNC "%6.3" "-" COEFFS 0. 65536. 0. 0. 0. 256. /end COMPU_METHOD
/begin COMPU_METHOD _CNV_R_R_Def_i_uw_q_630_CM "Def_i_uw_q0p125" RAT_FUNC "%6.3" "A" COEFFS 0. 8. 0. 0. 0. 1. /end COMPU_METHOD
/begin COMPU_METHOD _CNV_R_R_Def_u_ub_q_631_CM "Def_u_ub_q0p1" RAT_FUNC "%6.3" "V" COEFFS 0. 10. 0. 0. 0. 1. /end COMPU_METHOD
/begin COMPU_METHOD _CNV_R_R_Def_f_ub_b_632_CM "Def_f_ub_b4" RAT_FUNC "%6.3" "-" COEFFS 0. 256. 0. 0. 0. 4. /end COMPU_METHOD
/begin COMPU_METHOD _CNV_R_R_Def_i_uw_q_638_CM "Def_i_uw_q0p03125" RAT_FUNC "%6.3" "A" COEFFS 0. 65536. 0. 0. 0. 2048. /end COMPU_METHOD
/begin COMPU_METHOD _CNV_R_R_Def_i_sw_q_645_CM "Def_i_sw_q0p03125" RAT_FUNC "%6.3" "A" COEFFS 0. 32. 0. 0. 0. 1. /end COMPU_METHOD
/begin COMPU_METHOD _CNV_R_R_Def_niv_ub_667_CM "Def_niv_ub_b75" RAT_FUNC "%6.3" "" COEFFS 0. 256. 0. 0. 0. 75. /end COMPU_METHOD
/begin COMPU_METHOD _CNV_R_R_Def_td_uw__673_CM "Def_td_uw_q0p01" RAT_FUNC "%6.3" "s" COEFFS 0. 100. 0. 0. 0. 1. /end COMPU_METHOD
/begin COMPU_METHOD _CNV_R_R_Def_perm_u_674_CM "Def_perm_uw_b6" RAT_FUNC "%6.3" "-" COEFFS 0. 65536. 0. 0. 0. 6. /end COMPU_METHOD
/begin COMPU_METHOD _CNV_R_R_Def_f_uw_b_679_CM "Def_f_uw_b2048" RAT_FUNC "%6.3" "-" COEFFS 0. 65536. 0. 0. 0. 2048. /end COMPU_METHOD
/begin COMPU_METHOD _CNV_R_R_Def_wdk_sw_683_CM "Def_wdk_sw_q0p0244" RAT_FUNC "%6.3" "%" COEFFS 0. 4096. 0. 0. 0. 100. /end COMPU_METHOD
/begin COMPU_METHOD _CNV_R_R_Def_f_ub_b_694_CM "Def_f_ub_b8" RAT_FUNC "%6.3" "-" COEFFS 0. 256. 0. 0. 0. 8. /end COMPU_METHOD
/begin COMPU_METHOD _CNV_R_R_Def_td_uw__718_CM "Def_td_uw_q0p2" RAT_FUNC "%6.3" "s" COEFFS 0. 5. 0. 0. 0. 1. /end COMPU_METHOD
/begin COMPU_METHOD _CNV_R_R_Def_v_uw_q_726_CM "Def_v_uw_q1p0" RAT_FUNC "%6.3" "km/h" COEFFS 0. 1. 0. 0. 0. 1. /end COMPU_METHOD
/begin COMPU_METHOD _CNV_R_R_Def_v_uw_q_727_CM "Def_v_uw_q0p1" RAT_FUNC "%6.3" "km/h" COEFFS 0. 10. 0. 0. 0. 1. /end COMPU_METHOD
/begin COMPU_METHOD _CNV_R_R_Def_zw_ub__738_CM "Def_zw_ub_q0p75" RAT_FUNC "%6.3" "°" COEFFS 0. -1. 0. 0. 0. 0.75 /end COMPU_METHOD
/begin COMPU_METHOD _CNV_R_R_Def_r_uw_b_769_CM "Def_r_uw_b1024" RAT_FUNC "%6.3" "mOhm" COEFFS 0. 64. 0. 0. 0. 1. /end COMPU_METHOD
/begin RECORD_LAYOUT _REC_VAL_20_u1 FNC_VALUES 1 UBYTE COLUMN_DIR DIRECT /end RECORD_LAYOUT
/begin RECORD_LAYOUT _REC_VAL_20_u2 FNC_VALUES 1 UWORD COLUMN_DIR DIRECT /end RECORD_LAYOUT
/begin RECORD_LAYOUT _REC_VAL_20_s2 FNC_VALUES 1 SWORD COLUMN_DIR DIRECT /end RECORD_LAYOUT
/begin RECORD_LAYOUT _REC_VAL_20_s1 FNC_VALUES 1 SBYTE COLUMN_DIR DIRECT /end RECORD_LAYOUT
/begin RECORD_LAYOUT _REC_MAP_52_u1_s2_s2 NO_AXIS_PTS_X 1 UBYTE NO_AXIS_PTS_Y 2 UBYTE AXIS_PTS_X 3 SWORD INDEX_INCR DIRECT AXIS_PTS_Y 4 SWORD INDEX_INCR DIRECT FNC_VALUES 5 UBYTE COLUMN_DIR DIRECT /end RECORD_LAYOUT
/begin RECORD_LAYOUT _REC_MAP_52_UBYTE_s2_s2_s2 NO_AXIS_PTS_X 1 UBYTE NO_AXIS_PTS_Y 2 UBYTE AXIS_PTS_X 3 SWORD INDEX_INCR DIRECT AXIS_PTS_Y 4 SWORD INDEX_INCR DIRECT FNC_VALUES 5 SWORD COLUMN_DIR DIRECT /end RECORD_LAYOUT
/begin RECORD_LAYOUT _REC_MAP_52_UBYTE_u2_u2_s2 NO_AXIS_PTS_X 1 UBYTE NO_AXIS_PTS_Y 2 UBYTE AXIS_PTS_X 3 UWORD INDEX_INCR DIRECT AXIS_PTS_Y 4 SWORD INDEX_INCR DIRECT FNC_VALUES 5 UWORD COLUMN_DIR DIRECT /end RECORD_LAYOUT
/begin RECORD_LAYOUT _REC_MAP_52_u1_u2_s2 NO_AXIS_PTS_X 1 UBYTE NO_AXIS_PTS_Y 2 UBYTE AXIS_PTS_X 3 UWORD INDEX_INCR DIRECT AXIS_PTS_Y 4 SWORD INDEX_INCR DIRECT FNC_VALUES 5 UBYTE COLUMN_DIR DIRECT /end RECORD_LAYOUT
/begin RECORD_LAYOUT _REC_MAP_52_u1_u1_u1 NO_AXIS_PTS_X 1 UBYTE NO_AXIS_PTS_Y 2 UBYTE AXIS_PTS_X 3 UBYTE INDEX_INCR DIRECT AXIS_PTS_Y 4 UBYTE INDEX_INCR DIRECT FNC_VALUES 5 UBYTE COLUMN_DIR DIRECT /end RECORD_LAYOUT
/begin RECORD_LAYOUT _REC_MAP_52_u1_s2_u2 NO_AXIS_PTS_X 1 UBYTE NO_AXIS_PTS_Y 2 UBYTE AXIS_PTS_X 3 SWORD INDEX_INCR DIRECT AXIS_PTS_Y 4 UWORD INDEX_INCR DIRECT FNC_VALUES 5 UBYTE COLUMN_DIR DIRECT /end RECORD_LAYOUT
/begin RECORD_LAYOUT _REC_MAP_52_UBYTE_u2_s2_u1 NO_AXIS_PTS_X 1 UBYTE NO_AXIS_PTS_Y 2 UBYTE AXIS_PTS_X 3 SWORD INDEX_INCR DIRECT AXIS_PTS_Y 4 UBYTE INDEX_INCR DIRECT FNC_VALUES 5 UWORD COLUMN_DIR DIRECT /end RECORD_LAYOUT
/begin RECORD_LAYOUT _REC_CUR_TKL_UW_VV__u2_u2 NO_AXIS_PTS_X 1 UBYTE RESERVED 2 BYTE AXIS_PTS_X 3 UWORD INDEX_INCR DIRECT FNC_VALUES 4 UWORD COLUMN_DIR DIRECT /end RECORD_LAYOUT
/begin RECORD_LAYOUT _REC_CUR_TKL_UW_VV__u1_s2 NO_AXIS_PTS_X 1 UBYTE RESERVED 2 BYTE AXIS_PTS_X 3 SWORD INDEX_INCR DIRECT FNC_VALUES 4 UBYTE COLUMN_DIR DIRECT /end RECORD_LAYOUT
/begin RECORD_LAYOUT _REC_CUR_TKL_UW_VV__u1_u2 NO_AXIS_PTS_X 1 UBYTE RESERVED 2 BYTE AXIS_PTS_X 3 UWORD INDEX_INCR DIRECT FNC_VALUES 4 UBYTE COLUMN_DIR DIRECT /end RECORD_LAYOUT
/begin RECORD_LAYOUT _REC_CUR_TKL_UW_VV__s2_u2 NO_AXIS_PTS_X 1 UBYTE RESERVED 2 BYTE AXIS_PTS_X 3 UWORD INDEX_INCR DIRECT FNC_VALUES 4 SWORD COLUMN_DIR DIRECT /end RECORD_LAYOUT
/begin RECORD_LAYOUT _REC_CUR_TKL_UW_VV__u1_u1 NO_AXIS_PTS_X 1 UBYTE RESERVED 2 BYTE AXIS_PTS_X 3 UBYTE INDEX_INCR DIRECT FNC_VALUES 4 UBYTE COLUMN_DIR DIRECT /end RECORD_LAYOUT
/begin RECORD_LAYOUT _REC_CUR_TKL_UW_VV__s2_u1 NO_AXIS_PTS_X 1 UBYTE RESERVED 2 BYTE AXIS_PTS_X 3 UBYTE INDEX_INCR DIRECT FNC_VALUES 4 SWORD COLUMN_DIR DIRECT /end RECORD_LAYOUT
/begin RECORD_LAYOUT _REC_CUR_TKL_UW_VV__u2_u1 NO_AXIS_PTS_X 1 UBYTE RESERVED 2 BYTE AXIS_PTS_X 3 UBYTE INDEX_INCR DIRECT FNC_VALUES 4 UWORD COLUMN_DIR DIRECT /end RECORD_LAYOUT
/begin RECORD_LAYOUT _REC_VAL_2_u1 FNC_VALUES 1 UBYTE COLUMN_DIR DIRECT /end RECORD_LAYOUT
/begin FUNCTION RESTGAS ""
 /begin DEF_CHARACTERISTIC KF_ALLK KF_ALLW KF_ASUESP KF_DASTDLL KF_DASTDT KF_DESTDLL KF_DESTDT KF_ELLK KF_ELLW KF_ESUESP KF_ETAMDKH_DEM KF_ETAMDKH_DLR KF_ETAMDKH_EM KF_ETAMDKH_LR KF_KALLW KF_KALLW_2 KF_KASKH KF_KASKH_2 KF_KASLL KF_KASLL_HS KF_KASOPT KF_KASOPT_HS KF_KASOPU KF_KELLW KF_KELLW_2 KF_KESKH KF_KESKH_2 KF_KESLL KF_KESLL_HS KF_KESOPT KF_KESOPT_HS KF_KESOPU KF_WALLW KF_WALLW_2 KF_WASKH KF_WASKH_2 KF_WASLL KF_WASLL_HS KF_WASOPT KF_WASOPT_HS KF_WASOPU KF_WASVL KF_WASVLT KF_WELLW KF_WELLW_2 KF_WESKH KF_WESKH_2 KF_WESLL KF_WESLL_HS KF_WESOPT KF_WESOPT_HS KF_WESOPU KF_WESVL KF_WESVLT KF_WNWKHK KF_WNWKHK_2 KL_ASPAN KL_ASPVZ KL_ESPAN KL_ESPVZ KL_FASHSW KL_FASTW KL_FASW KL_FEASWLL KL_FEASWLL_HS KL_FEASWLL_S KL_FESHSW KL_FESTW KL_FESW KL_MAT_ASPRL_KH KL_MAT_ASPRTL_KH KL_MAT_ESPRL_KH KL_MAT_ESPRTL_KH K_ASPRNOTL K_DTMSPR K_ESPRNOTL K_ETA_MDKH K_FWNWKH_MAX K_FWNWKH_MIN K_KHRAMP_AUS K_KHRAMP_EIN K_KH_EIN K_MATEN_KATHZ K_MAT_ASPR K_MAT_ASPRL K_MAT_ASPRVL K_MAT_ESPR K_MAT_ESPRL K_MAT_ESPRVL K_NMAXVNS_ANS K_OFASPRAP K_OFESPRAP K_PT1SPR K_RAMPENA K_RFMAXVNS_ANS K_SPRLLFL_AUS K_SPRLLFL_EIN K_SPRRAMP_EIN K_SPRRAMP_NEG K_SPRRAMP_POS K_SPRZGAN_OFF K_TMASPR K_TMESPR K_TMVS_ANLERN K_TVRAMP K_TVSPSA K_VNS_VZD K_VNS_VZZMX K_VNS_WTZ K_VSEMN_NOTL K_WNWAIMN K_WNWKHRA_MIN K_WNWMN S_ASPSATRU S_BTVS_GDEIN S_ESPSATRU S_KATHEIN_EXT S_MDAPPAS S_MDAPPES S_SICHER_ON /end DEF_CHARACTERISTIC
 /begin REF_CHARACTERISTIC K_SPRZG_AN /end REF_CHARACTERISTIC
 /begin OUT_MEASUREMENT All_kh All_kh_2 All_kh_3 Allk Allk_2 Allw Allw_2 As Ask Aspr Aspr_last Aspr_norm Aspr_ramp Aspr_vl1 Aspr_vl2 Aspr_vs Asprhs Asprimx Asprl Asprlast Asprlhs Asprll Asprll_kh Asprlu Asprt Asprtl_kh Aspru Astk Astw Asuesp Asw Aswll Atl_kh Atl_kh_2 Atl_kh_3 Atlk_kh Atlk_kh_2 Atlw_kh Atlw_kh_2 Dvsa_ramp Dvse_ramp Ell_kh Ell_kh_2 Ell_kh_3 Ellk Ellk_2 Ellw Ellw_2 Es Esk Espr Espr_last Espr_norm Espr_ramp Espr_vl1 Espr_vl2 Espr_vs Esprhs Esprimx Esprl Esprlast Esprlhs Esprll Esprll_kh Esprlu Esprt Esprtl_kh Espru Estk Estw Esuesp Esw Eswll Eta_mdkh Etl_kh Etl_kh_2 Etl_kh_3 Etlk_kh Etlk_kh_2 Etlw_kh Etlw_kh_2 F_easwll F_easwll_hs F_easwll_s F_wnwkh_aus Fashsw_aus Fastw_aus Fasw_aus Feshsw_aus Festw_aus Fesw_aus St_ramp St_ramp.B_arampend St_ramp.B_arampend_1 St_ramp.B_erampend St_ramp.B_erampend_1 St_restg St_restg.B_ff_nvsaad St_restg.B_ff_nvsead St_restg.B_nvsaad St_restg.B_nvsead St_rstg St_rstg.B_aspan St_rstg.B_espan St_rstg.B_vsast St_rstg.B_vsest St_rstg.B_vzare St_rstg.B_vzere St_rstg.B_wnwmnba St_rstg.B_wnwmnbe St_rstg1 St_rstg1.B_nrf_kl15vorab St_rstg1.Rsthyst1 St_rstg1.Rsthyst2 Vsa_admn Vsa_sprn Vsa_vzt Vsa_vzz Vse_admn Vse_sprn Vse_vzt Vse_vzz Wnwsamn Wnwsemn /end OUT_MEASUREMENT
 /begin IN_MEASUREMENT Ba_ist Ba_soll Ba_subist Baw_ist Baw_soll Dpssolfilt F_atldyn F_sicher_rf F_wnwkh F_wnwkhk F_wnwkhk_2 Minhub Nkw Rf Rf_soll Rfv_vns Rk_soll_hs Rk_soll_s St_bgkuppl1 St_bgkuppl1.B_ll St_blshub St_blshub.B_fhubvnsi_ini St_blshub.B_hubst St_blshub.B_llk St_blshub.B_nwe St_blshub.B_vns_spron St_blshub.B_vsean_loc St_blshub.B_vvtclose St_btvns St_btvns.B_btvsa St_btvns.B_btvsa2 St_btvns.B_btvse St_btvns.B_btvse2 St_dps St_dps.B_dpsadp St_dps.B_gd St_dps.B_gdst St_dps.B_gdvhub St_dvvt1 St_dvvt1.B_vvtnotl St_kl15 St_kl15.B_kl15_ep St_kl15.B_kl15_vorab St_mdbanl3 St_mdbanl3.B_evdiag_b1 St_mdbanl3.B_evdiag_b2 St_mdbanl3.B_evvt_vsa St_mdbanl3.B_evvt_vse St_mdbanl3.B_fi_agr St_mdbanl3.B_fi_agrfs St_mdbanl3.B_fi_agrsens St_mdbanl3.B_mdmax_notl St_motzustd St_motzustd.B_ll_roh St_motzustd.B_vl St_sawe St_sawe.B_sa St_sawe.B_sae St_sawe.B_safast St_start St_start.B_jumpstart St_start.B_sta St_start.B_start St_start.B_startende St_start.B_wst St_vsa St_vsa.B_npos1dyn St_vsa.B_vsaadnok St_vsa.B_vsaadok St_vsa.B_vsaadp St_vsa.B_vsadyn St_vsa.B_vsaflan St_vsa.B_vsanwerr St_vsa.B_vsaspran St_vse St_vse.B_npos0dyn St_vse.B_vseadnok St_vse.B_vseadok St_vse.B_vseadp St_vse.B_vsedyn St_vse.B_vseflan St_vse.B_vsenwerr St_vse.B_vsespran Tmot Vsa2_adp Vsa2_spri Vsa_adp Vsa_btsoll Vsa_spri Vsa_sprs Vsa_sprs_kh Vse2_adp Vse2_spri Vse_adp Vse_btsoll Vse_spri Vse_sprs Vse_sprs_kh Wkrm /end IN_MEASUREMENT
/end FUNCTION
/begin FUNCTION gen_30_64_ ""
 /begin SUB_FUNCTION DGEN GENIUTEST GEN_FASTA IMDGEN LDSTGEN LLRANH PGENLLRED PGENTRED /end SUB_FUNCTION
/end FUNCTION
/begin FUNCTION DGEN ""
 /begin DEF_CHARACTERISTIC K_GENMSKKL61 K_GENPDTIME K_GENREGVPLAUS K_GENSTATX K_GENSTATY K_GENSTATZ K_GEN_DNMIN K_MSKGENDFP K_MSKGENDIAG K_MSKGENKL61 K_MSKGENSTAT K_PLAUSAUS K_PLAUSEIN K_SNMBSDKL61 K_TDGENERR K_TDGENFBSD K_TD_UGENDIAG K_UGENDIAG K_UGOFFSET S_DGENSTAT S_DGENSTATENA S_ENUGDIAG S_GENDIAGNEU S_GENPLAUS /end DEF_CHARACTERISTIC
 /begin REF_CHARACTERISTIC S_BSDKOORD /end REF_CHARACTERISTIC
 /begin OUT_MEASUREMENT Gen_arraycnt_nv Gen_arraycntx Gen_arraycnty Gen_arraycntz Gen_arrayerr_nv Gen_arraygrenzerrnz Gen_arraygrenzerrxy Gen_arraygrenzn_sum Gen_arraygrenznerrn Gen_arraygrenznz_sum Gen_arraygrenzxy_sum Gen_arrayierrg_nv Gen_arrayub_nv Gen_arrayuberrn Gen_arrayuberrnz Gen_arrayuberrxy Gen_arrayubn_sum Gen_arrayubnz_sum Gen_arrayubxy_sum Gen_arrayugen_nv Gen_arrayugenerrn Gen_arrayugenerrnz Gen_arrayugenerrxy Gen_arrayugenn_sum Gen_arrayugennz_sum Gen_arrayugenxy_sum Gen_count Gen_count_1min Gen_fbsak Gen_ierrgrenz Gen_ierrgrenz_1min Gen_stat2_div Gen_statroh Gen_ub Gen_ub_1min Gen_ugen Gen_ugen_1min Gensatzsum_akt Gensatzsum_eintrag St_dgen0 St_dgen0.B_1stbsder St_dgen0.B_genfprl St_dgen0.B_gfbsupak St_dgen0.B_gfelak St_dgen0.B_gfhtak St_dgen0.B_gfmeak St_dgen0.B_gfnobsak St_dgen0.B_kl61 St_dgen1 St_dgen1.B_genudiag St_dgen_neu St_dgen_neu.B_dgenub2_err St_dgen_neu.B_en_gendiag St_dgen_neu.B_genfel_fs St_dgen_neu.B_genfht_fs St_dgen_neu.B_genfme_fs St_dgen_neu.B_genhtb_fs St_dgen_neu.B_genregupl St_dgen_neu.B_gensatz St_dgen_neu2 St_dgen_neu2.B_genhtb St_dgen_neu2.B_genudiag_fs St_dgen_neu2.B_stat_calc St_dgen_neu2.B_tdgenerr St_dgen_neu2.B_tdgenerr_1min St_dgen_neu2.B_tdgenfbsd St_dgen_neu3 St_dgen_neu3.B_genfsulev St_dgen_neu3.B_genfsulev_fs St_dgen_neu3.B_genplaus St_dgen_neu3.B_gfhtbak St_dgen_neu3.B_gfsulevak St_dgen_neu3.B_gfudiagak St_dgen_neu3.B_gfwregak St_dgen_nv St_dgen_nv.B_gensatz1_bel St_dgen_nv.B_gensatz2_bel St_dgenerrst_md1 St_dgenerrst_md2 St_dgengrenz1 St_dgengrenz1_md1 St_dgengrenz1_md2 St_dgengrenz2 St_dgengrenz2_md1 St_dgengrenz2_md2 St_dgengrenzerr St_dgengrenzerr_md1 St_dgengrenzerr_md2 St_dgengrenznz St_dgengrenznz_md1 St_dgengrenznz_md2 St_dgenub1 St_dgenub1_md1 St_dgenub1_md2 St_dgenub2 St_dgenub2_md1 St_dgenub2_md2 St_dgenuberr St_dgenuberr_md1 St_dgenuberr_md2 St_dgenubnz St_dgenubnz_md1 St_dgenubnz_md2 St_dgenugen1 St_dgenugen1_md1 St_dgenugen1_md2 St_dgenugen2 St_dgenugen2_md1 St_dgenugen2_md2 St_dgenugenerr St_dgenugenerr_md1 St_dgenugenerr_md2 St_dgenugennz St_dgenugennz_md1 St_dgenugennz_md2 St_gen St_genbsd St_gengen Z_gen_1min /end OUT_MEASUREMENT
 /begin IN_MEASUREMENT Ierrgrenz Nkw St_dgen0.B_1stbsder St_dgen0.B_genfprl St_dgen0.B_gfbsupak St_dgen0.B_gfelak St_dgen0.B_gfhtak St_dgen0.B_gfmeak St_dgen0.B_gfnobsak St_dgen0.B_kl61 St_imdgen_nv0 St_imdgen_nv0.B_genfkupl St_mkwchn St_mkwchn.B_kwdreht St_pgenred_1s St_pgenred_1s.B_genht St_pgenred_1s.B_genhtkrit St_pgenred_1s.B_genhtkritv St_pgenred_1s.B_genhtmxgra St_pgenred_1s.B_ierrgrenzh St_pgenred_1s.B_tdiodekrit St_pmukomp St_pmukomp.B_genoffdiag St_pmukomp.B_rl_berok St_pmukomp.B_udgenentpr St_pwf St_pwf.B_pwf St_start St_start.B_jumpstart St_start.B_sta St_start.B_start St_start.B_startende St_start.B_wst U_gen Ub /end IN_MEASUREMENT
/end FUNCTION
/begin FUNCTION GENIUTEST ""
 /begin DEF_CHARACTERISTIC K_DFSCHWGENTEST K_FILIGEN K_GENITEST_TOL K_GENUTEST_TOL K_TDSTATE1 K_TDSTATE2 K_TDSTATE3 K_TDSTATE4 K_UGENTEST1 K_UGENTEST2 K_UGENTEST3 K_UGENTEST4 S_GENTESTANF /end DEF_CHARACTERISTIC
 /begin OUT_MEASUREMENT Genitest_tol Geniutest_ab Geniutest_err Genutest_tol I_genm I_gentest St_gentest U_gentest /end OUT_MEASUREMENT
 /begin IN_MEASUREMENT I_gen St_dgen1 St_dgen1.B_genudiag St_dgen_neu St_dgen_neu.B_dgenub2_err St_dgen_neu.B_en_gendiag St_dgen_neu.B_genfel_fs St_dgen_neu.B_genfht_fs St_dgen_neu.B_genfme_fs St_dgen_neu.B_genhtb_fs St_dgen_neu.B_genregupl St_dgen_neu.B_gensatz St_dgen_neu2 St_dgen_neu2.B_genhtb St_dgen_neu2.B_genudiag_fs St_dgen_neu2.B_stat_calc St_dgen_neu2.B_tdgenerr St_dgen_neu2.B_tdgenerr_1min St_dgen_neu2.B_tdgenfbsd St_generator St_generator.B_crashgen St_generator.B_genactiv St_generator.B_genfbsd St_generator.B_genfel St_generator.B_genfht St_generator.B_genfme St_imdgen_nv0 St_imdgen_nv0.B_genfkupl St_start St_start.B_jumpstart St_start.B_sta St_start.B_start St_start.B_startende St_start.B_wst U_gen Ub /end IN_MEASUREMENT
/end FUNCTION
/begin FUNCTION GEN_FASTA "" /begin DEF_CHARACTERISTIC K_NSTSTAT1 K_NSTSTAT2 K_NSTSTAT3 /end DEF_CHARACTERISTIC
 /begin OUT_MEASUREMENT Bszsi Bsztemp Dfdp Dfds Dfmonitor Dfsumme Dfwanzahl Igenk St_imdgen_nv1 St_imdgen_nv1.B_bszsichok /end OUT_MEASUREMENT
 /begin IN_MEASUREMENT Dffgen I_gen Nkw St_dgen0 St_dgen0.B_1stbsder St_dgen0.B_genfprl St_dgen0.B_gfbsupak St_dgen0.B_gfelak St_dgen0.B_gfhtak St_dgen0.B_gfmeak St_dgen0.B_gfnobsak St_dgen0.B_kl61 St_mkwchn St_mkwchn.B_kwdreht St_pwf St_pwf.B_pwf St_start St_start.B_jumpstart St_start.B_sta St_start.B_start St_start.B_startende St_start.B_wst /end IN_MEASUREMENT
/end FUNCTION
/begin FUNCTION IMDGEN ""
 /begin DEF_CHARACTERISTIC KF_GENTYP_NEU KF_IU1T1_1 KF_IU1T1_2 KF_IU1T1_3 KF_IU1T1_4 KF_IU1T1_5 KF_IU1T1_6 KF_IU1T2_1 KF_IU1T2_2 KF_IU1T2_3 KF_IU1T2_4 KF_IU1T2_5 KF_IU1T2_6 KF_IU2T1_1 KF_IU2T1_2 KF_IU2T1_3 KF_IU2T1_4 KF_IU2T1_5 KF_IU2T1_6 KF_MDGENFIL KF_MU1T1_1 KF_MU1T1_2 KF_MU1T1_3 KF_MU1T1_4 KF_MU1T1_5 KF_MU1T1_6 KF_MU1T2_1 KF_MU1T2_2 KF_MU1T2_3 KF_MU1T2_4 KF_MU1T2_5 KF_MU1T2_6 KF_MU2T1_1 KF_MU2T1_2 KF_MU2T1_3 KF_MU2T1_4 KF_MU2T1_5 KF_MU2T1_6 KL_GENUEBSETZ KL_T_CHIP1 KL_T_CHIP2 K_DFFGENFIL K_DF_DEAKAPP K_EN_MDGEN K_GENMDNMOF K_GEN_IGOF K_IGNOTWERT K_IMDGENNRRW K_MANAWNUMM K_NSCHW_CALC K_NSCHW_MD K_R_LADLTG K_TDFIERR K_UBOFF K_ZMGENIG S_RDGENTYP /end DEF_CHARACTERISTIC
 /begin OUT_MEASUREMENT Dffgen_dt Dffgen_f Gen_awnumm Gen_uebsetz I_gen I_gen_g I_gen_nafil I_gen_vorfil I_genmax I_gentmp I_gentp Kf_iu1 Kf_iu2 Kf_iu3 Md_gen_roh Md_genfil Md_gennm Md_gennm_end Md_gennmtp Md_genrel Md_genvf N_gen N_gen_tmp St_imdgen0 St_imdgen0.B_gene St_imdgen0.B_generken St_imdgen0.B_im0 St_imdgen0.B_mod_calc St_imdgen_nv0 St_imdgen_nv0.B_genfkupl Tchip_diff1 Tchip_diff2 Tgen Ugen_calc /end OUT_MEASUREMENT
 /begin IN_MEASUREMENT Dffgen Dfgrob I_craweng Nkw St_dgen0 St_dgen0.B_1stbsder St_dgen0.B_genfprl St_dgen0.B_gfbsupak St_dgen0.B_gfelak St_dgen0.B_gfhtak St_dgen0.B_gfmeak St_dgen0.B_gfnobsak St_dgen0.B_kl61 St_start St_start.B_jumpstart St_start.B_sta St_start.B_start St_start.B_startende St_start.B_wst St_ugenkor0 St_ugenkor0.B_genoff St_ugenkor0.B_verb_off Tchip_fil_l U_gen Ub /end IN_MEASUREMENT
/end FUNCTION
/begin FUNCTION LDSTGEN ""
 /begin DEF_CHARACTERISTIC KL_GENLDST K_APPUPLLDST K_DFMODE K_DFS_MAX K_DFS_MIN K_DFS_MITT K_GENLDDFMAX K_IERRFIL K_TNNSTART K_UB_GRENZST S_PMSTRTMOD S_STRTNKWMOD /end DEF_CHARACTERISTIC
 /begin OUT_MEASUREMENT Dffgen Dfpropval Ierr_fil N_nstart St_bldstg St_bldstg.B_ubeb_start St_ldstgen Ub_old_st /end OUT_MEASUREMENT
 /begin IN_MEASUREMENT Dfgrob Dfsiggen Ierr Ierrgrenz Nkw Nkw_zahn St_dgen0 St_dgen0.B_1stbsder St_dgen0.B_genfprl St_dgen0.B_gfbsupak St_dgen0.B_gfelak St_dgen0.B_gfhtak St_dgen0.B_gfmeak St_dgen0.B_gfnobsak St_dgen0.B_kl61 St_genallg St_genallg.B_abliactiv St_genallg.B_bsdprot1 St_genallg.B_bsdprot2 St_genallg.B_iliactiv St_genallg.B_rd_gentyp St_mkwchn St_mkwchn.B_kwdreht St_pmbattmng1 St_pmbattmng1.B_batt_bad St_pmbattmng1.B_batt_good St_pmbattmng1.B_lbatteinih St_pmbattmng1.B_lbatteiniv St_pmbattmng1.B_lbattenh St_pmbattmng1.B_lbattenv St_pmbattmng1.B_lbattinit St_pmbattmng1.B_noctrgen St_start St_start.B_jumpstart St_start.B_sta St_start.B_start St_start.B_startende St_start.B_wst St_ugenkor0 St_ugenkor0.B_genoff St_ugenkor0.B_verb_off Tgen Ub /end IN_MEASUREMENT
/end FUNCTION
/begin FUNCTION LLRANH "" /begin DEF_CHARACTERISTIC K_APP_LLAH K_GENLLAHAPP K_NSUBO K_NSUBTRA K_NSUBU /end DEF_CHARACTERISTIC
 /begin OUT_MEASUREMENT Nslb St_llranh0 St_llranh0.B_idl_tp St_llranh0.B_idlgspec St_llranh0.B_nsub St_llranh0.B_nsub_tmp /end OUT_MEASUREMENT
 /begin IN_MEASUREMENT Bordnetz Fahrzeug N_idlgspec N_idlibs N_idlms Nsllm St_bgkuppl1 St_bgkuppl1.B_ll St_egs St_egs.B_egs_khl1 St_egs.B_egs_khl2 St_egs.B_fs St_igrin St_igrin.B_fe St_igrin.B_fetrawedeak St_igrin.B_tra St_igrin.B_we St_llranh0.B_idl_tp St_llranh0.B_idlgspec St_llranh0.B_nsub St_llranh0.B_nsub_tmp St_pmbattmng0 St_pmbattmng0.B_batt_entl St_pmbattmng0.B_bt_timer St_pmbattmng0.B_btmaxfrei St_pmbattmng0.B_btpau St_pmbattmng0.B_dly_tbi St_pmbattmng0.B_ibsok St_pmbattmng0.B_inibumg St_pmi_nv St_pmi_nv.B_fapmmess St_pmi_nv.B_ulcp St_pmspgw St_pmspgw.B_bnqh St_pmspgw.B_eps_ak St_pmspgw.B_ldaeps_ak St_pmspgw.B_pmspgwbns St_pmspgw.B_ubw_aktiv St_pmspgw.B_ubw_ullow St_pmspgw.B_ubw_ulowak St_pmspgw.B_ubw_uslow V /end IN_MEASUREMENT
/end FUNCTION
/begin FUNCTION PGENLLRED ""
 /begin DEF_CHARACTERISTIC KL_GELIKMIE K_DELTADFFMX K_DFFLIM K_DFFLLANH K_DFFSCHZMX K_GELIIEAPP K_GELIIEZK K_GELISETAPP K_GELIVMAX K_LLWDNMAX K_LLWDNMIN K_NMOTLLANH K_NSTATLLANH K_PR_IERRLLRED K_PWGLLANH K_SCHNKWLLRED K_SCHPWGLLRED K_TDBLLLLRED K_TDFDTMAX K_TDFFABLF K_TDFFMAX K_TDFFMIN K_TDNHOLD K_TMOTLLANH K_TNSTLLANH K_VFZGGENFIL K_VFZGGENKOR K_VFZGLLANH S_ENABLLLLRED S_GELIBIEAPP S_PGENLL_AKT /end DEF_CHARACTERISTIC
 /begin OUT_MEASUREMENT Deltadff Dffgenschz Dnkw Ierrgrenz_ll Pr_ierrllred St_pgenllred St_pgenllred.B_geli St_pgenllred.B_nsubgen St_pgenllred.B_pgenllerk St_pgenllred_200ms St_pgenllred_200ms.B_dffaktiv St_pgenllred_200ms.B_nsubg_r St_pgenllred_200ms.B_nsubgen1 St_pgenllred_200ms.B_pgenllfa St_pgenllred_200ms.B_pgenredllve Tdffgen V_pgenllkor /end OUT_MEASUREMENT
 /begin IN_MEASUREMENT Dffgen Ierr Nkw Nstat Pr_sollmn Pr_spgw Pwg_ist St_bgkuppl1 St_bgkuppl1.B_ll St_bns St_bns.B_bns St_mkwchn St_mkwchn.B_kwdreht St_ubw St_ubw.B_ubw_ulow Tmot Tn_start_10 V V_can /end IN_MEASUREMENT
/end FUNCTION
/begin FUNCTION PGENTRED ""
 /begin DEF_CHARACTERISTIC KF_IERRGREHT KF_TANSGENKO KF_UFDIODE KL_NELUEFTGE KL_RTHJADIOD KL_TCHIPOFFS KL_TMAXDIODE K_GENMXGRADH K_HTGENDFGRO K_I_VERTEIL K_NGENHTMN1 K_NGENHTMX1 K_PR_IERRTRED K_TCHIPFIL K_TDNGENKRIT K_TDTCHIPKRI K_TDTCHIPMX K_TDUBFZMN K_TFIGENHT K_TFTDIODE K_TGENMXGRAD K_TGENMXTHD K_TGENRSHT K_TLCHTEP K_UGENHTMN S_HTDETEC /end DEF_CHARACTERISTIC
 /begin OUT_MEASUREMENT Ierrgrenz_ht Nelueft_gen P_totdiode Pr_ierrtred St_pgenred_1s St_pgenred_1s.B_genht St_pgenred_1s.B_genhtkrit St_pgenred_1s.B_genhtkritv St_pgenred_1s.B_genhtmxgra St_pgenred_1s.B_ierrgrenzh St_pgenred_1s.B_tdiodekrit T_chipfilsdt T_diode T_diodedelta Tans_gen Tchip_fil_l Tchip_fil_s Tchip_ist Tchip_mwa Tchip_sum U_vordiode Z_tchip /end OUT_MEASUREMENT
 /begin IN_MEASUREMENT Dfgrob Gen_awnumm Gen_manufak I_gen N_gen St_generator St_generator.B_crashgen St_generator.B_genactiv St_generator.B_genfbsd St_generator.B_genfel St_generator.B_genfht St_generator.B_genfme Tchip Ub /end IN_MEASUREMENT
/end FUNCTION
/begin FUNCTION oz_30_49_ "" /begin SUB_FUNCTION DQLT OZBG OZGG OZNIVDL OZTEMP /end SUB_FUNCTION /end FUNCTION
/begin FUNCTION DQLT ""
 /begin DEF_CHARACTERISTIC K_DTOG_UBMIN K_OZDELTOE K_OZDIAGNMOT K_OZDIAGNMOT2 K_OZDIAGSPG K_OZERRD K_OZHEAL K_OZPLTEMP K_OZPLZTEMP K_OZTEMPQERR K_OZZTEMP K_TOGMAXUNPL K_TOG_CNTMAX S_OZBSDKOORD /end DEF_CHARACTERISTIC
 /begin REF_CHARACTERISTIC K_CW_OZ /end REF_CHARACTERISTIC
 /begin OUT_MEASUREMENT Oz_diagtoens Oz_permerrz Oz_tempplz Oz_temprold St_dqlt0 St_dqlt0.B_ozdiagnmotok St_dqlt0.B_ozerrbsd St_dqlt0.B_ozkttoens St_dqlt0.B_ozlerr St_dqlt0.B_ozqerr St_dqlt0.B_ozterr St_dqlt0.B_td_ogerr St_dqlt0.B_td_ogupl St_dqlt1 St_dqlt1.B_ozerr St_dqlt1.B_ozfbsd2 St_dqlt1.B_oztemppl St_oz_o St_oz_o.B_mol_sf St_oz_o.B_oztemic /end OUT_MEASUREMENT
 /begin IN_MEASUREMENT Nkw St_cbsozout_nv0 St_cbsozout_nv0.B_ozkl15 St_cbsozout_nv0.B_ozpeilerr Toel_oz Ub /end IN_MEASUREMENT
/end FUNCTION
/begin FUNCTION OZBG "" /begin DEF_CHARACTERISTIC K_CW_OZ_2 /end DEF_CHARACTERISTIC /begin REF_CHARACTERISTIC K_CW_OZ /end REF_CHARACTERISTIC
 /begin OUT_MEASUREMENT Oz_tempakt St_ozbg0 St_ozbg0.B_mol_vb St_ozbg0.B_mol_vl St_ozbg0.B_oeltemp Toel /end OUT_MEASUREMENT
 /begin IN_MEASUREMENT Oz_lp Oz_tempf St_kl15 St_kl15.B_kl15_ep St_kl15.B_kl15_vorab St_ozbg0.B_mol_vb St_ozbg0.B_mol_vl St_ozbg0.B_oeltemp St_ozgg0 St_ozgg0.B_ozniv St_ozgg0.B_oznivqlt St_ozgg0.B_oznivtoe St_ozgg0.B_ozperm St_ozgg0.B_oztemp St_ozgg0.B_oztempqlt St_ozgg0.B_oztemptoe St_ozgg0.B_oztoeok St_oznivdl0 St_oznivdl0.B_ozkrzkor St_oznivdl0.B_ozkrzlkor St_oznivdl0.B_ozlangmw St_oznivdl0.B_ozluft St_oznivdl0.B_oznivb St_oznivdl0.B_ozor St_oznivdl0.B_ozpoelnl St_oznivdl0.B_ozvormw Tmot Tn_start_10 Toel_oz /end IN_MEASUREMENT
/end FUNCTION
/begin FUNCTION OZGG ""
 /begin DEF_CHARACTERISTIC KL_OZPERMKL KL_OZTEMPKL KL_TKTOENIV KL_TVTOEL K_OZNIVKL K_OZPERMRMIN K_OZPRREFMAX K_OZPRREFMIN K_OZSTZYK K_TOGVERZOEG K_TRTYP /end DEF_CHARACTERISTIC
 /begin OUT_MEASUREMENT Oz_anztoe Oz_niv Oz_nivqlt Oz_nivrers Oz_nivt Oz_nivtoe Oz_perm Oz_permakt Oz_permt Oz_perref Oz_temp Oz_tempqlt Oz_tempt Oz_temptoe St_ozgg0 St_ozgg0.B_ozniv St_ozgg0.B_oznivqlt St_ozgg0.B_oznivtoe St_ozgg0.B_ozperm St_ozgg0.B_oztemp St_ozgg0.B_oztempqlt St_ozgg0.B_oztemptoe St_ozgg0.B_oztoeok /end OUT_MEASUREMENT
 /begin IN_MEASUREMENT Oz_nivr Oz_permerrz Oz_permr Oz_tempr St_dqlt0 St_dqlt0.B_ozdiagnmotok St_dqlt0.B_ozerrbsd St_dqlt0.B_ozkttoens St_dqlt0.B_ozlerr St_dqlt0.B_ozqerr St_dqlt0.B_ozterr St_dqlt0.B_td_ogerr St_dqlt0.B_td_ogupl St_dqlt1 St_dqlt1.B_ozerr St_dqlt1.B_ozfbsd2 St_dqlt1.B_oztemppl St_oz St_oz.B_anhang St_oz.B_ozfbsd St_oz_i St_oz_i.B_td_og St_oz_i.B_td_ogok St_oz_i.B_toel St_oz_o St_oz_o.B_mol_sf St_oz_o.B_oztemic Td_og_cnt Td_og_tk Td_og_tr Td_og_tv /end IN_MEASUREMENT
/end FUNCTION
/end MODULE
/end PROJECT
