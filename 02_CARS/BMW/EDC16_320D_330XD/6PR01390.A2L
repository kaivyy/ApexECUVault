ASAP2_VERSION 1 3
/begin PROJECT P390 "BMW DDE6.2 6-Zylinder VR0.1 15.03.2004 CAN11/12H"
/begin HEADER "" VERSION "VR0.1_6Z_CAN11/12H" PROJECT_NO P390 /end HEADER
/begin MODULE DIM ""
/begin MOD_COMMON "" BYTE_ORDER MSB_FIRST ALIGNMENT_BYTE 1 ALIGNMENT_WORD 2 ALIGNMENT_LONG 4 ALIGNMENT_FLOAT32_IEEE 4 /end MOD_COMMON
/begin CHARACTERISTIC DSCHED_numSelFID_C "FID auswählbar zur Anzeige der defekten und nicht defekten DFPs welche den ausgewählten FID verriegeln" VALUE 0xC96FC Kw_Wu16 61733.0000000 FidName 0.00 61733.0000000 FORMAT "%13.7" /end CHARACTERISTIC
/begin CHARACTERISTIC DSMDur_DfctDur1Mode_C "Betriebsart des globalen Fehlerdauerzählers 1" VALUE 0xCE0EE Kw_Wu8 2.000 OneToOne 0.00 2.000 FORMAT "%5.3" EXTENDED_LIMITS 0.00 255.0 /end CHARACTERISTIC
/begin CHARACTERISTIC DSMDur_DfctDur2Mode_C "Betriebsart des globalen Fehlerdauerzählers 2" VALUE 0xCE0EF Kw_Wu8 2.000 OneToOne 0.00 2.000 FORMAT "%5.3" EXTENDED_LIMITS 0.00 255.0 /end CHARACTERISTIC
/begin CHARACTERISTIC DSMDur_stDfctDur1Enable_C "Aktivierungsbedingungen für den globalen Defektdauerzähler 1" VALUE 0xCE0F0 Kw_Wu8 255.0 OneToOne 0.00 255.0 FORMAT "%5.1" /end CHARACTERISTIC
/begin CHARACTERISTIC DSMDur_stDfctDur2Enable_C "Aktivierungsbedingungen für den globalen Defektdauerzähler 2" VALUE 0xCE0F1 Kw_Wu8 255.0 OneToOne 0.00 255.0 FORMAT "%5.1" /end CHARACTERISTIC
/begin CHARACTERISTIC DSMDur_stDfctDur1Reset_C "Rücksetzbedingungen für den globalen Defektdauerzähler 1" VALUE 0xCE0F2 Kw_Wu8 255.0 OneToOne 0.00 255.0 FORMAT "%5.1" /end CHARACTERISTIC
/begin CHARACTERISTIC DSMDur_stDfctDur2Reset_C "Rücksetzbedingungen für den globalen Defektdauerzähler 2" VALUE 0xCE0F3 Kw_Wu8 255.0 OneToOne 0.00 255.0 FORMAT "%5.1" /end CHARACTERISTIC
/begin CHARACTERISTIC DSM_cnvMilKmFCM_Offset_C "Offset für Umrechnung Meilen/Kilometer beim Fehlerspeicher lesen" VALUE 0xC96FE Kw_Ws16 65535.00 LengthKm -32768.00 32767.00 FORMAT "%8.2" /end CHARACTERISTIC
/begin CHARACTERISTIC DSM_cnvMilKmFCM_Slope_C "Slope für Umrechnung Meilen/Kilometer beim Fehlerspeicher lesen" VALUE 0xC9700 Kw_Ws16 65.53500 SlopeRes1000 -32.76800 32.76700 FORMAT "%8.5" /end CHARACTERISTIC
/begin CHARACTERISTIC DSM_Class1Mil_C "Art der MIL Ansteuerung" VALUE 0xC9702 Kw_Wu8 2.00000000000 Mil 0.00 2.00000000000 FORMAT "%13.11" /end CHARACTERISTIC
/begin CHARACTERISTIC DSM_Class1TFlc_C "Trigger Art für Fehlereintrags Bestätigungsentprellung (->Lampe an)" VALUE 0xC9703 Kw_Wu8 3.00000000000 ClassTrigger 0.00 3.00000000000 FORMAT "%13.11" /end CHARACTERISTIC
/begin CHARACTERISTIC DSM_Class1Flc_C "Anzahl Triggerereignisse für Fehlereintrags Bestätigungsentprellung (->Lampe an)" VALUE 0xC9704 Kw_Wu8 255.0 OneToOne 0.00 255.0 FORMAT "%5.1" /end CHARACTERISTIC
/begin CHARACTERISTIC DSM_Class1THlc_C "Trigger Art für Fehlerheilung (->Lampe aus)" VALUE 0xC9705 Kw_Wu8 3.00000000000 ClassTrigger 0.00 3.00000000000 FORMAT "%13.11" /end CHARACTERISTIC
/begin CHARACTERISTIC DSM_Class1Hlc_C "Anzahl Triggerereignisse für Fehlerheilung (->Lampe aus)" VALUE 0xC9706 Kw_Wu8 255.0 OneToOne 0.00 255.0 FORMAT "%5.1" /end CHARACTERISTIC
/begin CHARACTERISTIC DSM_Class1Scatt_C "Fehler ist lesbar für OBD Scan tool tester (SCATT) wenn Wert = 1" VALUE 0xC9707 Kw_Wu8 1.00000000000 Scatt 0.00 1.00000000000 FORMAT "%13.11" /end CHARACTERISTIC
/begin CHARACTERISTIC DSM_Class1TDlcPen_C "Trigger Art für Löschentprellung von nicht bestätigten Fehlern (pending)" VALUE 0xC9708 Kw_Wu8 3.00000000000 ClassTriggerTDlc 0.00 3.00000000000 FORMAT "%13.11" /end CHARACTERISTIC
/begin CHARACTERISTIC DSM_Class1DlcPen_C "Anzahl Triggerereignisse für die Löschung von nicht bestätigten Fehlern (pending)" VALUE 0xC9709 Kw_Wu8 255.0 OneToOne 0.00 255.0 FORMAT "%5.1" /end CHARACTERISTIC
/begin CHARACTERISTIC DSM_Class1TDlc_C "Trigger Art für Löschentprellung" VALUE 0xC970A Kw_Wu8 3.00000000000 ClassTriggerTDlc 0.00 3.00000000000 FORMAT "%13.11" /end CHARACTERISTIC
/begin CHARACTERISTIC DSM_Class1DlcKd_C "Anzahl Triggerereignisse für die Löschung von Fehlereinträgen mit Status Kundendienst" VALUE 0xC970B Kw_Wu8 255.0 OneToOne 0.00 255.0 FORMAT "%5.1" /end CHARACTERISTIC
/begin CHARACTERISTIC DSM_Class1Dlc_C "Anzahl Triggerereignisse für die Löschung von Fehlereinträgen" VALUE 0xC970C Kw_Wu8 255.0 OneToOne 0.00 255.0 FORMAT "%5.1" /end CHARACTERISTIC
/begin CHARACTERISTIC DSM_Class1Prio_C "Priorität des Fehlereintrages für Verdrängung und freeze frame Zuordnung" VALUE 0xC970D Kw_Wu8 255.0 OneToOne 0.00 255.0 FORMAT "%5.1" /end CHARACTERISTIC
/begin CHARACTERISTIC DSM_Class1SysLamp_C "Art der Systemlampenansteuerung" VALUE 0xC970E Kw_Wu8 2.00000000000 SysLamp 0.00 2.00000000000 FORMAT "%13.11" /end CHARACTERISTIC
/begin CHARACTERISTIC DSM_Class1ResErf_C "Verhalten Fehlerflags bei Reset und abgebrochenem Nachlauf" VALUE 0xC970F Kw_Wu8 3.00000000000 ResErf 0.00 3.00000000000 FORMAT "%13.11" /end CHARACTERISTIC
/begin CHARACTERISTIC DSM_Class1Readiness_C "Zuordnung Entprellklasse zu Readiness Flags" VALUE 0xC9710 Kw_Wu8 64.0000000000 Readiness 0.00 64.0000000000 FORMAT "%13.10" /end CHARACTERISTIC
/begin CHARACTERISTIC DSM_Class2Mil_C "Art der MIL Ansteuerung" VALUE 0xC9711 Kw_Wu8 2.00000000000 Mil 0.00 2.00000000000 FORMAT "%13.11" /end CHARACTERISTIC
/begin CHARACTERISTIC DSM_Class2TFlc_C "Trigger Art für Fehlereintrags Bestätigungsentprellung (->Lampe an)" VALUE 0xC9712 Kw_Wu8 3.00000000000 ClassTrigger 0.00 3.00000000000 FORMAT "%13.11" /end CHARACTERISTIC
/begin CHARACTERISTIC DSM_Class2Flc_C "Anzahl Triggerereignisse für Fehlereintrags Bestätigungsentprellung (->Lampe an)" VALUE 0xC9713 Kw_Wu8 255.0 OneToOne 0.00 255.0 FORMAT "%5.1" /end CHARACTERISTIC
/begin CHARACTERISTIC DSM_Class2THlc_C "Trigger Art für Fehlerheilung (->Lampe aus)" VALUE 0xC9714 Kw_Wu8 3.00000000000 ClassTrigger 0.00 3.00000000000 FORMAT "%13.11" /end CHARACTERISTIC
/begin CHARACTERISTIC DSM_Class2Hlc_C "Anzahl Triggerereignisse für Fehlerheilung (->Lampe aus)" VALUE 0xC9715 Kw_Wu8 255.0 OneToOne 0.00 255.0 FORMAT "%5.1" /end CHARACTERISTIC
/begin CHARACTERISTIC DSM_Class2Scatt_C "Fehler ist lesbar für OBD Scan tool tester (SCATT) wenn Wert = 1" VALUE 0xC9716 Kw_Wu8 1.00000000000 Scatt 0.00 1.00000000000 FORMAT "%13.11" /end CHARACTERISTIC
/begin CHARACTERISTIC DSM_Class2TDlcPen_C "Trigger Art für Löschentprellung von nicht bestätigten Fehlern (pending)" VALUE 0xC9717 Kw_Wu8 3.00000000000 ClassTriggerTDlc 0.00 3.00000000000 FORMAT "%13.11" /end CHARACTERISTIC
/begin CHARACTERISTIC DSM_Class2DlcPen_C "Anzahl Triggerereignisse für die Löschung von nicht bestätigten Fehlern (pending)" VALUE 0xC9718 Kw_Wu8 255.0 OneToOne 0.00 255.0 FORMAT "%5.1" /end CHARACTERISTIC
/begin CHARACTERISTIC DSM_Class2TDlc_C "Trigger Art für Löschentprellung" VALUE 0xC9719 Kw_Wu8 3.00000000000 ClassTriggerTDlc 0.00 3.00000000000 FORMAT "%13.11" /end CHARACTERISTIC
/begin CHARACTERISTIC DSM_Class2DlcKd_C "Anzahl Triggerereignisse für die Löschung von Fehlereinträgen mit Status Kundendienst" VALUE 0xC971A Kw_Wu8 255.0 OneToOne 0.00 255.0 FORMAT "%5.1" /end CHARACTERISTIC
/begin CHARACTERISTIC DSM_Class2Dlc_C "Anzahl Triggerereignisse für die Löschung von Fehlereinträgen" VALUE 0xC971B Kw_Wu8 255.0 OneToOne 0.00 255.0 FORMAT "%5.1" /end CHARACTERISTIC
/begin CHARACTERISTIC DSM_Class2Prio_C "Priorität des Fehlereintrages für Verdrängung und freeze frame Zuordnung" VALUE 0xC971C Kw_Wu8 255.0 OneToOne 0.00 255.0 FORMAT "%5.1" /end CHARACTERISTIC
/begin CHARACTERISTIC DSM_Class2SysLamp_C "Art der Systemlampenansteuerung" VALUE 0xC971D Kw_Wu8 2.00000000000 SysLamp 0.00 2.00000000000 FORMAT "%13.11" /end CHARACTERISTIC
/begin CHARACTERISTIC DSM_Class2ResErf_C "Verhalten Fehlerflags bei Reset und abgebrochenem Nachlauf" VALUE 0xC971E Kw_Wu8 3.00000000000 ResErf 0.00 3.00000000000 FORMAT "%13.11" /end CHARACTERISTIC
/begin CHARACTERISTIC DSM_Class2Readiness_C "Zuordnung Entprellklasse zu Readiness Flags" VALUE 0xC971F Kw_Wu8 64.0000000000 Readiness 0.00 64.0000000000 FORMAT "%13.10" /end CHARACTERISTIC
/begin CHARACTERISTIC DSM_Class3Mil_C "Art der MIL Ansteuerung" VALUE 0xC9720 Kw_Wu8 2.00000000000 Mil 0.00 2.00000000000 FORMAT "%13.11" /end CHARACTERISTIC
/begin CHARACTERISTIC DSM_Class3TFlc_C "Trigger Art für Fehlereintrags Bestätigungsentprellung (->Lampe an)" VALUE 0xC9721 Kw_Wu8 3.00000000000 ClassTrigger 0.00 3.00000000000 FORMAT "%13.11" /end CHARACTERISTIC
/begin CHARACTERISTIC DSM_Class3Flc_C "Anzahl Triggerereignisse für Fehlereintrags Bestätigungsentprellung (->Lampe an)" VALUE 0xC9722 Kw_Wu8 255.0 OneToOne 0.00 255.0 FORMAT "%5.1" /end CHARACTERISTIC
/begin CHARACTERISTIC DSM_Class3THlc_C "Trigger Art für Fehlerheilung (->Lampe aus)" VALUE 0xC9723 Kw_Wu8 3.00000000000 ClassTrigger 0.00 3.00000000000 FORMAT "%13.11" /end CHARACTERISTIC
/begin CHARACTERISTIC DSM_Class3Hlc_C "Anzahl Triggerereignisse für Fehlerheilung (->Lampe aus)" VALUE 0xC9724 Kw_Wu8 255.0 OneToOne 0.00 255.0 FORMAT "%5.1" /end CHARACTERISTIC
/begin CHARACTERISTIC DSM_Class3Scatt_C "Fehler ist lesbar für OBD Scan tool tester (SCATT) wenn Wert = 1" VALUE 0xC9725 Kw_Wu8 1.00000000000 Scatt 0.00 1.00000000000 FORMAT "%13.11" /end CHARACTERISTIC
/begin CHARACTERISTIC DSM_Class3TDlcPen_C "Trigger Art für Löschentprellung von nicht bestätigten Fehlern (pending)" VALUE 0xC9726 Kw_Wu8 3.00000000000 ClassTriggerTDlc 0.00 3.00000000000 FORMAT "%13.11" /end CHARACTERISTIC
/begin CHARACTERISTIC DSM_Class3DlcPen_C "Anzahl Triggerereignisse für die Löschung von nicht bestätigten Fehlern (pending)" VALUE 0xC9727 Kw_Wu8 255.0 OneToOne 0.00 255.0 FORMAT "%5.1" /end CHARACTERISTIC
/begin CHARACTERISTIC DSM_Class3TDlc_C "Trigger Art für Löschentprellung" VALUE 0xC9728 Kw_Wu8 3.00000000000 ClassTriggerTDlc 0.00 3.00000000000 FORMAT "%13.11" /end CHARACTERISTIC
/begin CHARACTERISTIC DSM_Class3DlcKd_C "Anzahl Triggerereignisse für die Löschung von Fehlereinträgen mit Status Kundendienst" VALUE 0xC9729 Kw_Wu8 255.0 OneToOne 0.00 255.0 FORMAT "%5.1" /end CHARACTERISTIC
/begin CHARACTERISTIC DSM_Class3Dlc_C "Anzahl Triggerereignisse für die Löschung von Fehlereinträgen" VALUE 0xC972A Kw_Wu8 255.0 OneToOne 0.00 255.0 FORMAT "%5.1" /end CHARACTERISTIC
/begin CHARACTERISTIC DSM_Class3Prio_C "Priorität des Fehlereintrages für Verdrängung und freeze frame Zuordnung" VALUE 0xC972B Kw_Wu8 255.0 OneToOne 0.00 255.0 FORMAT "%5.1" /end CHARACTERISTIC
/begin CHARACTERISTIC DSM_Class3SysLamp_C "Art der Systemlampenansteuerung" VALUE 0xC972C Kw_Wu8 2.00000000000 SysLamp 0.00 2.00000000000 FORMAT "%13.11" /end CHARACTERISTIC
/begin CHARACTERISTIC DSM_Class3ResErf_C "Verhalten Fehlerflags bei Reset und abgebrochenem Nachlauf" VALUE 0xC972D Kw_Wu8 3.00000000000 ResErf 0.00 3.00000000000 FORMAT "%13.11" /end CHARACTERISTIC
/begin CHARACTERISTIC DSM_Class3Readiness_C "Zuordnung Entprellklasse zu Readiness Flags" VALUE 0xC972E Kw_Wu8 64.0000000000 Readiness 0.00 64.0000000000 FORMAT "%13.10" /end CHARACTERISTIC
/begin CHARACTERISTIC DSM_Class4Mil_C "Art der MIL Ansteuerung" VALUE 0xC972F Kw_Wu8 2.00000000000 Mil 0.00 2.00000000000 FORMAT "%13.11" /end CHARACTERISTIC
/begin CHARACTERISTIC DSM_Class4TFlc_C "Trigger Art für Fehlereintrags Bestätigungsentprellung (->Lampe an)" VALUE 0xC9730 Kw_Wu8 3.00000000000 ClassTrigger 0.00 3.00000000000 FORMAT "%13.11" /end CHARACTERISTIC
/begin CHARACTERISTIC DSM_Class4Flc_C "Anzahl Triggerereignisse für Fehlereintrags Bestätigungsentprellung (->Lampe an)" VALUE 0xC9731 Kw_Wu8 255.0 OneToOne 0.00 255.0 FORMAT "%5.1" /end CHARACTERISTIC
/begin CHARACTERISTIC DSM_Class4THlc_C "Trigger Art für Fehlerheilung (->Lampe aus)" VALUE 0xC9732 Kw_Wu8 3.00000000000 ClassTrigger 0.00 3.00000000000 FORMAT "%13.11" /end CHARACTERISTIC
/begin CHARACTERISTIC DSM_Class4Hlc_C "Anzahl Triggerereignisse für Fehlerheilung (->Lampe aus)" VALUE 0xC9733 Kw_Wu8 255.0 OneToOne 0.00 255.0 FORMAT "%5.1" /end CHARACTERISTIC
/begin CHARACTERISTIC DSM_Class4Scatt_C "Fehler ist lesbar für OBD Scan tool tester (SCATT) wenn Wert = 1" VALUE 0xC9734 Kw_Wu8 1.00000000000 Scatt 0.00 1.00000000000 FORMAT "%13.11" /end CHARACTERISTIC
/begin CHARACTERISTIC DSM_Class4TDlcPen_C "Trigger Art für Löschentprellung von nicht bestätigten Fehlern (pending)" VALUE 0xC9735 Kw_Wu8 3.00000000000 ClassTriggerTDlc 0.00 3.00000000000 FORMAT "%13.11" /end CHARACTERISTIC
/begin CHARACTERISTIC DSM_Class4DlcPen_C "Anzahl Triggerereignisse für die Löschung von nicht bestätigten Fehlern (pending)" VALUE 0xC9736 Kw_Wu8 255.0 OneToOne 0.00 255.0 FORMAT "%5.1" /end CHARACTERISTIC
/begin CHARACTERISTIC DSM_Class4TDlc_C "Trigger Art für Löschentprellung" VALUE 0xC9737 Kw_Wu8 3.00000000000 ClassTriggerTDlc 0.00 3.00000000000 FORMAT "%13.11" /end CHARACTERISTIC
/begin CHARACTERISTIC DSM_Class4DlcKd_C "Anzahl Triggerereignisse für die Löschung von Fehlereinträgen mit Status Kundendienst" VALUE 0xC9738 Kw_Wu8 255.0 OneToOne 0.00 255.0 FORMAT "%5.1" /end CHARACTERISTIC
/begin CHARACTERISTIC DSM_Class4Dlc_C "Anzahl Triggerereignisse für die Löschung von Fehlereinträgen" VALUE 0xC9739 Kw_Wu8 255.0 OneToOne 0.00 255.0 FORMAT "%5.1" /end CHARACTERISTIC
/begin CHARACTERISTIC DSM_Class4Prio_C "Priorität des Fehlereintrages für Verdrängung und freeze frame Zuordnung" VALUE 0xC973A Kw_Wu8 255.0 OneToOne 0.00 255.0 FORMAT "%5.1" /end CHARACTERISTIC
/begin CHARACTERISTIC DSM_Class4SysLamp_C "Art der Systemlampenansteuerung" VALUE 0xC973B Kw_Wu8 2.00000000000 SysLamp 0.00 2.00000000000 FORMAT "%13.11" /end CHARACTERISTIC
/begin CHARACTERISTIC DSM_Class4ResErf_C "Verhalten Fehlerflags bei Reset und abgebrochenem Nachlauf" VALUE 0xC973C Kw_Wu8 3.00000000000 ResErf 0.00 3.00000000000 FORMAT "%13.11" /end CHARACTERISTIC
/begin CHARACTERISTIC DSM_Class4Readiness_C "Zuordnung Entprellklasse zu Readiness Flags" VALUE 0xC973D Kw_Wu8 64.0000000000 Readiness 0.00 64.0000000000 FORMAT "%13.10" /end CHARACTERISTIC
/begin CHARACTERISTIC DSM_Class5Mil_C "Art der MIL Ansteuerung" VALUE 0xC973E Kw_Wu8 2.00000000000 Mil 0.00 2.00000000000 FORMAT "%13.11" /end CHARACTERISTIC
/begin CHARACTERISTIC DSM_Class5TFlc_C "Trigger Art für Fehlereintrags Bestätigungsentprellung (->Lampe an)" VALUE 0xC973F Kw_Wu8 3.00000000000 ClassTrigger 0.00 3.00000000000 FORMAT "%13.11" /end CHARACTERISTIC
/begin CHARACTERISTIC DSM_Class5Flc_C "Anzahl Triggerereignisse für Fehlereintrags Bestätigungsentprellung (->Lampe an)" VALUE 0xC9740 Kw_Wu8 255.0 OneToOne 0.00 255.0 FORMAT "%5.1" /end CHARACTERISTIC
/begin CHARACTERISTIC DSM_Class5THlc_C "Trigger Art für Fehlerheilung (->Lampe aus)" VALUE 0xC9741 Kw_Wu8 3.00000000000 ClassTrigger 0.00 3.00000000000 FORMAT "%13.11" /end CHARACTERISTIC
/begin CHARACTERISTIC DSM_Class5Hlc_C "Anzahl Triggerereignisse für Fehlerheilung (->Lampe aus)" VALUE 0xC9742 Kw_Wu8 255.0 OneToOne 0.00 255.0 FORMAT "%5.1" /end CHARACTERISTIC
/begin CHARACTERISTIC DSM_Class5Scatt_C "Fehler ist lesbar für OBD Scan tool tester (SCATT) wenn Wert = 1" VALUE 0xC9743 Kw_Wu8 1.00000000000 Scatt 0.00 1.00000000000 FORMAT "%13.11" /end CHARACTERISTIC
/begin CHARACTERISTIC DSM_Class5TDlcPen_C "Trigger Art für Löschentprellung von nicht bestätigten Fehlern (pending)" VALUE 0xC9744 Kw_Wu8 3.00000000000 ClassTriggerTDlc 0.00 3.00000000000 FORMAT "%13.11" /end CHARACTERISTIC
/begin CHARACTERISTIC DSM_Class5DlcPen_C "Anzahl Triggerereignisse für die Löschung von nicht bestätigten Fehlern (pending)" VALUE 0xC9745 Kw_Wu8 255.0 OneToOne 0.00 255.0 FORMAT "%5.1" /end CHARACTERISTIC
/begin CHARACTERISTIC DSM_Class5TDlc_C "Trigger Art für Löschentprellung" VALUE 0xC9746 Kw_Wu8 3.00000000000 ClassTriggerTDlc 0.00 3.00000000000 FORMAT "%13.11" /end CHARACTERISTIC
/begin CHARACTERISTIC DSM_Class5DlcKd_C "Anzahl Triggerereignisse für die Löschung von Fehlereinträgen mit Status Kundendienst" VALUE 0xC9747 Kw_Wu8 255.0 OneToOne 0.00 255.0 FORMAT "%5.1" /end CHARACTERISTIC
/begin CHARACTERISTIC DSM_Class5Dlc_C "Anzahl Triggerereignisse für die Löschung von Fehlereinträgen" VALUE 0xC9748 Kw_Wu8 255.0 OneToOne 0.00 255.0 FORMAT "%5.1" /end CHARACTERISTIC
/begin CHARACTERISTIC DSM_Class5Prio_C "Priorität des Fehlereintrages für Verdrängung und freeze frame Zuordnung" VALUE 0xC9749 Kw_Wu8 255.0 OneToOne 0.00 255.0 FORMAT "%5.1" /end CHARACTERISTIC
/begin CHARACTERISTIC DSM_Class5SysLamp_C "Art der Systemlampenansteuerung" VALUE 0xC974A Kw_Wu8 2.00000000000 SysLamp 0.00 2.00000000000 FORMAT "%13.11" /end CHARACTERISTIC
/begin CHARACTERISTIC DSM_Class5ResErf_C "Verhalten Fehlerflags bei Reset und abgebrochenem Nachlauf" VALUE 0xC974B Kw_Wu8 3.00000000000 ResErf 0.00 3.00000000000 FORMAT "%13.11" /end CHARACTERISTIC
/begin CHARACTERISTIC DSM_Class5Readiness_C "Zuordnung Entprellklasse zu Readiness Flags" VALUE 0xC974C Kw_Wu8 64.0000000000 Readiness 0.00 64.0000000000 FORMAT "%13.10" /end CHARACTERISTIC
/begin CHARACTERISTIC DSM_Class6Mil_C "Art der MIL Ansteuerung" VALUE 0xC974D Kw_Wu8 2.00000000000 Mil 0.00 2.00000000000 FORMAT "%13.11" /end CHARACTERISTIC
/begin CHARACTERISTIC DSM_Class6TFlc_C "Trigger Art für Fehlereintrags Bestätigungsentprellung (->Lampe an)" VALUE 0xC974E Kw_Wu8 3.00000000000 ClassTrigger 0.00 3.00000000000 FORMAT "%13.11" /end CHARACTERISTIC
/begin CHARACTERISTIC DSM_Class6Flc_C "Anzahl Triggerereignisse für Fehlereintrags Bestätigungsentprellung (->Lampe an)" VALUE 0xC974F Kw_Wu8 255.0 OneToOne 0.00 255.0 FORMAT "%5.1" /end CHARACTERISTIC
/begin CHARACTERISTIC DSM_Class6THlc_C "Trigger Art für Fehlerheilung (->Lampe aus)" VALUE 0xC9750 Kw_Wu8 3.00000000000 ClassTrigger 0.00 3.00000000000 FORMAT "%13.11" /end CHARACTERISTIC
/begin CHARACTERISTIC DSM_Class6Hlc_C "Anzahl Triggerereignisse für Fehlerheilung (->Lampe aus)" VALUE 0xC9751 Kw_Wu8 255.0 OneToOne 0.00 255.0 FORMAT "%5.1" /end CHARACTERISTIC
/begin CHARACTERISTIC DSM_Class6Scatt_C "Fehler ist lesbar für OBD Scan tool tester (SCATT) wenn Wert = 1" VALUE 0xC9752 Kw_Wu8 1.00000000000 Scatt 0.00 1.00000000000 FORMAT "%13.11" /end CHARACTERISTIC
/begin CHARACTERISTIC DSM_Class6TDlcPen_C "Trigger Art für Löschentprellung von nicht bestätigten Fehlern (pending)" VALUE 0xC9753 Kw_Wu8 3.00000000000 ClassTriggerTDlc 0.00 3.00000000000 FORMAT "%13.11" /end CHARACTERISTIC
/begin CHARACTERISTIC DSM_Class6DlcPen_C "Anzahl Triggerereignisse für die Löschung von nicht bestätigten Fehlern (pending)" VALUE 0xC9754 Kw_Wu8 255.0 OneToOne 0.00 255.0 FORMAT "%5.1" /end CHARACTERISTIC
/begin CHARACTERISTIC DSM_Class6TDlc_C "Trigger Art für Löschentprellung" VALUE 0xC9755 Kw_Wu8 3.00000000000 ClassTriggerTDlc 0.00 3.00000000000 FORMAT "%13.11" /end CHARACTERISTIC
/begin CHARACTERISTIC DSM_Class6DlcKd_C "Anzahl Triggerereignisse für die Löschung von Fehlereinträgen mit Status Kundendienst" VALUE 0xC9756 Kw_Wu8 255.0 OneToOne 0.00 255.0 FORMAT "%5.1" /end CHARACTERISTIC
/begin CHARACTERISTIC DSM_Class6Dlc_C "Anzahl Triggerereignisse für die Löschung von Fehlereinträgen" VALUE 0xC9757 Kw_Wu8 255.0 OneToOne 0.00 255.0 FORMAT "%5.1" /end CHARACTERISTIC
/begin CHARACTERISTIC DSM_Class6Prio_C "Priorität des Fehlereintrages für Verdrängung und freeze frame Zuordnung" VALUE 0xC9758 Kw_Wu8 255.0 OneToOne 0.00 255.0 FORMAT "%5.1" /end CHARACTERISTIC
/begin CHARACTERISTIC DSM_Class6SysLamp_C "Art der Systemlampenansteuerung" VALUE 0xC9759 Kw_Wu8 2.00000000000 SysLamp 0.00 2.00000000000 FORMAT "%13.11" /end CHARACTERISTIC
/begin CHARACTERISTIC DSM_Class6ResErf_C "Verhalten Fehlerflags bei Reset und abgebrochenem Nachlauf" VALUE 0xC975A Kw_Wu8 3.00000000000 ResErf 0.00 3.00000000000 FORMAT "%13.11" /end CHARACTERISTIC
/begin CHARACTERISTIC DSM_Class6Readiness_C "Zuordnung Entprellklasse zu Readiness Flags" VALUE 0xC975B Kw_Wu8 64.0000000000 Readiness 0.00 64.0000000000 FORMAT "%13.10" /end CHARACTERISTIC
/begin CHARACTERISTIC DSM_Class7Mil_C "Art der MIL Ansteuerung" VALUE 0xC975C Kw_Wu8 2.00000000000 Mil 0.00 2.00000000000 FORMAT "%13.11" /end CHARACTERISTIC
/begin CHARACTERISTIC DSM_Class7TFlc_C "Trigger Art für Fehlereintrags Bestätigungsentprellung (->Lampe an)" VALUE 0xC975D Kw_Wu8 3.00000000000 ClassTrigger 0.00 3.00000000000 FORMAT "%13.11" /end CHARACTERISTIC
/begin CHARACTERISTIC DSM_Class7Flc_C "Anzahl Triggerereignisse für Fehlereintrags Bestätigungsentprellung (->Lampe an)" VALUE 0xC975E Kw_Wu8 255.0 OneToOne 0.00 255.0 FORMAT "%5.1" /end CHARACTERISTIC
/begin CHARACTERISTIC DSM_Class7THlc_C "Trigger Art für Fehlerheilung (->Lampe aus)" VALUE 0xC975F Kw_Wu8 3.00000000000 ClassTrigger 0.00 3.00000000000 FORMAT "%13.11" /end CHARACTERISTIC
/begin CHARACTERISTIC DSM_Class7Hlc_C "Anzahl Triggerereignisse für Fehlerheilung (->Lampe aus)" VALUE 0xC9760 Kw_Wu8 255.0 OneToOne 0.00 255.0 FORMAT "%5.1" /end CHARACTERISTIC
/begin CHARACTERISTIC DSM_Class7Scatt_C "Fehler ist lesbar für OBD Scan tool tester (SCATT) wenn Wert = 1" VALUE 0xC9761 Kw_Wu8 1.00000000000 Scatt 0.00 1.00000000000 FORMAT "%13.11" /end CHARACTERISTIC
/begin CHARACTERISTIC DSM_Class7TDlcPen_C "Trigger Art für Löschentprellung von nicht bestätigten Fehlern (pending)" VALUE 0xC9762 Kw_Wu8 3.00000000000 ClassTriggerTDlc 0.00 3.00000000000 FORMAT "%13.11" /end CHARACTERISTIC
/begin CHARACTERISTIC DSM_Class7DlcPen_C "Anzahl Triggerereignisse für die Löschung von nicht bestätigten Fehlern (pending)" VALUE 0xC9763 Kw_Wu8 255.0 OneToOne 0.00 255.0 FORMAT "%5.1" /end CHARACTERISTIC
/begin CHARACTERISTIC DSM_Class7TDlc_C "Trigger Art für Löschentprellung" VALUE 0xC9764 Kw_Wu8 3.00000000000 ClassTriggerTDlc 0.00 3.00000000000 FORMAT "%13.11" /end CHARACTERISTIC
/begin CHARACTERISTIC DSM_Class7DlcKd_C "Anzahl Triggerereignisse für die Löschung von Fehlereinträgen mit Status Kundendienst" VALUE 0xC9765 Kw_Wu8 255.0 OneToOne 0.00 255.0 FORMAT "%5.1" /end CHARACTERISTIC
/begin CHARACTERISTIC DSM_Class7Dlc_C "Anzahl Triggerereignisse für die Löschung von Fehlereinträgen" VALUE 0xC9766 Kw_Wu8 255.0 OneToOne 0.00 255.0 FORMAT "%5.1" /end CHARACTERISTIC
/begin CHARACTERISTIC DSM_Class7Prio_C "Priorität des Fehlereintrages für Verdrängung und freeze frame Zuordnung" VALUE 0xC9767 Kw_Wu8 255.0 OneToOne 0.00 255.0 FORMAT "%5.1" /end CHARACTERISTIC
/begin CHARACTERISTIC DSM_Class7SysLamp_C "Art der Systemlampenansteuerung" VALUE 0xC9768 Kw_Wu8 2.00000000000 SysLamp 0.00 2.00000000000 FORMAT "%13.11" /end CHARACTERISTIC
/begin CHARACTERISTIC DSM_Class7ResErf_C "Verhalten Fehlerflags bei Reset und abgebrochenem Nachlauf" VALUE 0xC9769 Kw_Wu8 3.00000000000 ResErf 0.00 3.00000000000 FORMAT "%13.11" /end CHARACTERISTIC
/begin CHARACTERISTIC DSM_Class7Readiness_C "Zuordnung Entprellklasse zu Readiness Flags" VALUE 0xC976A Kw_Wu8 64.0000000000 Readiness 0.00 64.0000000000 FORMAT "%13.10" /end CHARACTERISTIC
/begin CHARACTERISTIC DSM_Class8Mil_C "Art der MIL Ansteuerung" VALUE 0xC976B Kw_Wu8 2.00000000000 Mil 0.00 2.00000000000 FORMAT "%13.11" /end CHARACTERISTIC
/begin CHARACTERISTIC DSM_Class8TFlc_C "Trigger Art für Fehlereintrags Bestätigungsentprellung (->Lampe an)" VALUE 0xC976C Kw_Wu8 3.00000000000 ClassTrigger 0.00 3.00000000000 FORMAT "%13.11" /end CHARACTERISTIC
/begin CHARACTERISTIC DSM_Class8Flc_C "Anzahl Triggerereignisse für Fehlereintrags Bestätigungsentprellung (->Lampe an)" VALUE 0xC976D Kw_Wu8 255.0 OneToOne 0.00 255.0 FORMAT "%5.1" /end CHARACTERISTIC
/begin CHARACTERISTIC DSM_Class8THlc_C "Trigger Art für Fehlerheilung (->Lampe aus)" VALUE 0xC976E Kw_Wu8 3.00000000000 ClassTrigger 0.00 3.00000000000 FORMAT "%13.11" /end CHARACTERISTIC
/begin CHARACTERISTIC DSM_Class8Hlc_C "Anzahl Triggerereignisse für Fehlerheilung (->Lampe aus)" VALUE 0xC976F Kw_Wu8 255.0 OneToOne 0.00 255.0 FORMAT "%5.1" /end CHARACTERISTIC
/begin CHARACTERISTIC DSM_Class8Scatt_C "Fehler ist lesbar für OBD Scan tool tester (SCATT) wenn Wert = 1" VALUE 0xC9770 Kw_Wu8 1.00000000000 Scatt 0.00 1.00000000000 FORMAT "%13.11" /end CHARACTERISTIC
/begin CHARACTERISTIC DSM_Class8TDlcPen_C "Trigger Art für Löschentprellung von nicht bestätigten Fehlern (pending)" VALUE 0xC9771 Kw_Wu8 3.00000000000 ClassTriggerTDlc 0.00 3.00000000000 FORMAT "%13.11" /end CHARACTERISTIC
/begin CHARACTERISTIC DSM_Class8DlcPen_C "Anzahl Triggerereignisse für die Löschung von nicht bestätigten Fehlern (pending)" VALUE 0xC9772 Kw_Wu8 255.0 OneToOne 0.00 255.0 FORMAT "%5.1" /end CHARACTERISTIC
/begin CHARACTERISTIC DSM_Class8TDlc_C "Trigger Art für Löschentprellung" VALUE 0xC9773 Kw_Wu8 3.00000000000 ClassTriggerTDlc 0.00 3.00000000000 FORMAT "%13.11" /end CHARACTERISTIC
/begin CHARACTERISTIC DSM_Class8DlcKd_C "Anzahl Triggerereignisse für die Löschung von Fehlereinträgen mit Status Kundendienst" VALUE 0xC9774 Kw_Wu8 255.0 OneToOne 0.00 255.0 FORMAT "%5.1" /end CHARACTERISTIC
/begin CHARACTERISTIC DSM_Class8Dlc_C "Anzahl Triggerereignisse für die Löschung von Fehlereinträgen" VALUE 0xC9775 Kw_Wu8 255.0 OneToOne 0.00 255.0 FORMAT "%5.1" /end CHARACTERISTIC
/begin CHARACTERISTIC DSM_Class8Prio_C "Priorität des Fehlereintrages für Verdrängung und freeze frame Zuordnung" VALUE 0xC9776 Kw_Wu8 255.0 OneToOne 0.00 255.0 FORMAT "%5.1" /end CHARACTERISTIC
/begin CHARACTERISTIC DSM_Class8SysLamp_C "Art der Systemlampenansteuerung" VALUE 0xC9777 Kw_Wu8 2.00000000000 SysLamp 0.00 2.00000000000 FORMAT "%13.11" /end CHARACTERISTIC
/begin CHARACTERISTIC DSM_Class8ResErf_C "Verhalten Fehlerflags bei Reset und abgebrochenem Nachlauf" VALUE 0xC9778 Kw_Wu8 3.00000000000 ResErf 0.00 3.00000000000 FORMAT "%13.11" /end CHARACTERISTIC
/begin CHARACTERISTIC DSM_Class8Readiness_C "Zuordnung Entprellklasse zu Readiness Flags" VALUE 0xC9779 Kw_Wu8 64.0000000000 Readiness 0.00 64.0000000000 FORMAT "%13.10" /end CHARACTERISTIC
/begin CHARACTERISTIC DSM_Class9Mil_C "Art der MIL Ansteuerung" VALUE 0xC977A Kw_Wu8 2.00000000000 Mil 0.00 2.00000000000 FORMAT "%13.11" /end CHARACTERISTIC
/begin CHARACTERISTIC DSM_Class9TFlc_C "Trigger Art für Fehlereintrags Bestätigungsentprellung (->Lampe an)" VALUE 0xC977B Kw_Wu8 3.00000000000 ClassTrigger 0.00 3.00000000000 FORMAT "%13.11" /end CHARACTERISTIC
/begin CHARACTERISTIC DSM_Class9Flc_C "Anzahl Triggerereignisse für Fehlereintrags Bestätigungsentprellung (->Lampe an)" VALUE 0xC977C Kw_Wu8 255.0 OneToOne 0.00 255.0 FORMAT "%5.1" /end CHARACTERISTIC
/begin CHARACTERISTIC DSM_Class9THlc_C "Trigger Art für Fehlerheilung (->Lampe aus)" VALUE 0xC977D Kw_Wu8 3.00000000000 ClassTrigger 0.00 3.00000000000 FORMAT "%13.11" /end CHARACTERISTIC
/begin CHARACTERISTIC DSM_Class9Hlc_C "Anzahl Triggerereignisse für Fehlerheilung (->Lampe aus)" VALUE 0xC977E Kw_Wu8 255.0 OneToOne 0.00 255.0 FORMAT "%5.1" /end CHARACTERISTIC
/begin CHARACTERISTIC DSM_Class9Scatt_C "Fehler ist lesbar für OBD Scan tool tester (SCATT) wenn Wert = 1" VALUE 0xC977F Kw_Wu8 1.00000000000 Scatt 0.00 1.00000000000 FORMAT "%13.11" /end CHARACTERISTIC
/begin CHARACTERISTIC DSM_Class9TDlcPen_C "Trigger Art für Löschentprellung von nicht bestätigten Fehlern (pending)" VALUE 0xC9780 Kw_Wu8 3.00000000000 ClassTriggerTDlc 0.00 3.00000000000 FORMAT "%13.11" /end CHARACTERISTIC
/begin CHARACTERISTIC DSM_Class9DlcPen_C "Anzahl Triggerereignisse für die Löschung von nicht bestätigten Fehlern (pending)" VALUE 0xC9781 Kw_Wu8 255.0 OneToOne 0.00 255.0 FORMAT "%5.1" /end CHARACTERISTIC
/begin CHARACTERISTIC DSM_Class9TDlc_C "Trigger Art für Löschentprellung" VALUE 0xC9782 Kw_Wu8 3.00000000000 ClassTriggerTDlc 0.00 3.00000000000 FORMAT "%13.11" /end CHARACTERISTIC
/begin CHARACTERISTIC DSM_Class9DlcKd_C "Anzahl Triggerereignisse für die Löschung von Fehlereinträgen mit Status Kundendienst" VALUE 0xC9783 Kw_Wu8 255.0 OneToOne 0.00 255.0 FORMAT "%5.1" /end CHARACTERISTIC
/begin CHARACTERISTIC DSM_Class9Dlc_C "Anzahl Triggerereignisse für die Löschung von Fehlereinträgen" VALUE 0xC9784 Kw_Wu8 255.0 OneToOne 0.00 255.0 FORMAT "%5.1" /end CHARACTERISTIC
/begin CHARACTERISTIC DSM_Class9Prio_C "Priorität des Fehlereintrages für Verdrängung und freeze frame Zuordnung" VALUE 0xC9785 Kw_Wu8 255.0 OneToOne 0.00 255.0 FORMAT "%5.1" /end CHARACTERISTIC
/begin CHARACTERISTIC DSM_Class9SysLamp_C "Art der Systemlampenansteuerung" VALUE 0xC9786 Kw_Wu8 2.00000000000 SysLamp 0.00 2.00000000000 FORMAT "%13.11" /end CHARACTERISTIC
/begin CHARACTERISTIC DSM_Class9ResErf_C "Verhalten Fehlerflags bei Reset und abgebrochenem Nachlauf" VALUE 0xC9787 Kw_Wu8 3.00000000000 ResErf 0.00 3.00000000000 FORMAT "%13.11" /end CHARACTERISTIC
/begin CHARACTERISTIC DSM_Class9Readiness_C "Zuordnung Entprellklasse zu Readiness Flags" VALUE 0xC9788 Kw_Wu8 64.0000000000 Readiness 0.00 64.0000000000 FORMAT "%13.10" /end CHARACTERISTIC
/begin CHARACTERISTIC DSM_Class10Mil_C "Art der MIL Ansteuerung" VALUE 0xC9789 Kw_Wu8 2.00000000000 Mil 0.00 2.00000000000 FORMAT "%13.11" /end CHARACTERISTIC
/begin CHARACTERISTIC DSM_Class10TFlc_C "Trigger Art für Fehlereintrags Bestätigungsentprellung (->Lampe an)" VALUE 0xC978A Kw_Wu8 3.00000000000 ClassTrigger 0.00 3.00000000000 FORMAT "%13.11" /end CHARACTERISTIC
/begin CHARACTERISTIC DSM_Class10Flc_C "Anzahl Triggerereignisse für Fehlereintrags Bestätigungsentprellung (->Lampe an)" VALUE 0xC978B Kw_Wu8 255.0 OneToOne 0.00 255.0 FORMAT "%5.1" /end CHARACTERISTIC
/begin CHARACTERISTIC DSM_Class10THlc_C "Trigger Art für Fehlerheilung (->Lampe aus)" VALUE 0xC978C Kw_Wu8 3.00000000000 ClassTrigger 0.00 3.00000000000 FORMAT "%13.11" /end CHARACTERISTIC
/begin CHARACTERISTIC DSM_Class10Hlc_C "Anzahl Triggerereignisse für Fehlerheilung (->Lampe aus)" VALUE 0xC978D Kw_Wu8 255.0 OneToOne 0.00 255.0 FORMAT "%5.1" /end CHARACTERISTIC
/begin CHARACTERISTIC DSM_Class10Scatt_C "Fehler ist lesbar für OBD Scan tool tester (SCATT) wenn Wert = 1" VALUE 0xC978E Kw_Wu8 1.00000000000 Scatt 0.00 1.00000000000 FORMAT "%13.11" /end CHARACTERISTIC
/begin CHARACTERISTIC DSM_Class10TDlcPen_C "Trigger Art für Löschentprellung von nicht bestätigten Fehlern (pending)" VALUE 0xC978F Kw_Wu8 3.00000000000 ClassTriggerTDlc 0.00 3.00000000000 FORMAT "%13.11" /end CHARACTERISTIC
/begin CHARACTERISTIC DSM_Class10DlcPen_C "Anzahl Triggerereignisse für die Löschung von nicht bestätigten Fehlern (pending)" VALUE 0xC9790 Kw_Wu8 255.0 OneToOne 0.00 255.0 FORMAT "%5.1" /end CHARACTERISTIC
/begin CHARACTERISTIC DSM_Class10TDlc_C "Trigger Art für Löschentprellung" VALUE 0xC9791 Kw_Wu8 3.00000000000 ClassTriggerTDlc 0.00 3.00000000000 FORMAT "%13.11" /end CHARACTERISTIC
/begin CHARACTERISTIC DSM_Class10DlcKd_C "Anzahl Triggerereignisse für die Löschung von Fehlereinträgen mit Status Kundendienst" VALUE 0xC9792 Kw_Wu8 255.0 OneToOne 0.00 255.0 FORMAT "%5.1" /end CHARACTERISTIC
/begin CHARACTERISTIC DSM_Class10Dlc_C "Anzahl Triggerereignisse für die Löschung von Fehlereinträgen" VALUE 0xC9793 Kw_Wu8 255.0 OneToOne 0.00 255.0 FORMAT "%5.1" /end CHARACTERISTIC
/begin CHARACTERISTIC DSM_Class10Prio_C "Priorität des Fehlereintrages für Verdrängung und freeze frame Zuordnung" VALUE 0xC9794 Kw_Wu8 255.0 OneToOne 0.00 255.0 FORMAT "%5.1" /end CHARACTERISTIC
/begin CHARACTERISTIC DSM_Class10SysLamp_C "Art der Systemlampenansteuerung" VALUE 0xC9795 Kw_Wu8 2.00000000000 SysLamp 0.00 2.00000000000 FORMAT "%13.11" /end CHARACTERISTIC
/begin CHARACTERISTIC DSM_Class10ResErf_C "Verhalten Fehlerflags bei Reset und abgebrochenem Nachlauf" VALUE 0xC9796 Kw_Wu8 3.00000000000 ResErf 0.00 3.00000000000 FORMAT "%13.11" /end CHARACTERISTIC
/begin CHARACTERISTIC DSM_Class10Readiness_C "Zuordnung Entprellklasse zu Readiness Flags" VALUE 0xC9797 Kw_Wu8 64.0000000000 Readiness 0.00 64.0000000000 FORMAT "%13.10" /end CHARACTERISTIC
/begin CHARACTERISTIC DSM_Class11Mil_C "Art der MIL Ansteuerung" VALUE 0xC9798 Kw_Wu8 2.00000000000 Mil 0.00 2.00000000000 FORMAT "%13.11" /end CHARACTERISTIC
/begin CHARACTERISTIC DSM_Class11TFlc_C "Trigger Art für Fehlereintrags Bestätigungsentprellung (->Lampe an)" VALUE 0xC9799 Kw_Wu8 3.00000000000 ClassTrigger 0.00 3.00000000000 FORMAT "%13.11" /end CHARACTERISTIC
/begin CHARACTERISTIC DSM_Class11Flc_C "Anzahl Triggerereignisse für Fehlereintrags Bestätigungsentprellung (->Lampe an)" VALUE 0xC979A Kw_Wu8 255.0 OneToOne 0.00 255.0 FORMAT "%5.1" /end CHARACTERISTIC
/begin CHARACTERISTIC DSM_Class11THlc_C "Trigger Art für Fehlerheilung (->Lampe aus)" VALUE 0xC979B Kw_Wu8 3.00000000000 ClassTrigger 0.00 3.00000000000 FORMAT "%13.11" /end CHARACTERISTIC
/begin CHARACTERISTIC DSM_Class11Hlc_C "Anzahl Triggerereignisse für Fehlerheilung (->Lampe aus)" VALUE 0xC979C Kw_Wu8 255.0 OneToOne 0.00 255.0 FORMAT "%5.1" /end CHARACTERISTIC
/begin CHARACTERISTIC DSM_Class11Scatt_C "Fehler ist lesbar für OBD Scan tool tester (SCATT) wenn Wert = 1" VALUE 0xC979D Kw_Wu8 1.00000000000 Scatt 0.00 1.00000000000 FORMAT "%13.11" /end CHARACTERISTIC
/begin CHARACTERISTIC DSM_Class11TDlcPen_C "Trigger Art für Löschentprellung von nicht bestätigten Fehlern (pending)" VALUE 0xC979E Kw_Wu8 3.00000000000 ClassTriggerTDlc 0.00 3.00000000000 FORMAT "%13.11" /end CHARACTERISTIC
/begin CHARACTERISTIC DSM_Class11DlcPen_C "Anzahl Triggerereignisse für die Löschung von nicht bestätigten Fehlern (pending)" VALUE 0xC979F Kw_Wu8 255.0 OneToOne 0.00 255.0 FORMAT "%5.1" /end CHARACTERISTIC
/begin CHARACTERISTIC DSM_Class11TDlc_C "Trigger Art für Löschentprellung" VALUE 0xC97A0 Kw_Wu8 3.00000000000 ClassTriggerTDlc 0.00 3.00000000000 FORMAT "%13.11" /end CHARACTERISTIC
/begin CHARACTERISTIC DSM_Class11DlcKd_C "Anzahl Triggerereignisse für die Löschung von Fehlereinträgen mit Status Kundendienst" VALUE 0xC97A1 Kw_Wu8 255.0 OneToOne 0.00 255.0 FORMAT "%5.1" /end CHARACTERISTIC
/begin CHARACTERISTIC DSM_Class11Dlc_C "Anzahl Triggerereignisse für die Löschung von Fehlereinträgen" VALUE 0xC97A2 Kw_Wu8 255.0 OneToOne 0.00 255.0 FORMAT "%5.1" /end CHARACTERISTIC
/begin CHARACTERISTIC DSM_Class11Prio_C "Priorität des Fehlereintrages für Verdrängung und freeze frame Zuordnung" VALUE 0xC97A3 Kw_Wu8 255.0 OneToOne 0.00 255.0 FORMAT "%5.1" /end CHARACTERISTIC
/begin CHARACTERISTIC DSM_Class11SysLamp_C "Art der Systemlampenansteuerung" VALUE 0xC97A4 Kw_Wu8 2.00000000000 SysLamp 0.00 2.00000000000 FORMAT "%13.11" /end CHARACTERISTIC
/begin CHARACTERISTIC DSM_Class11ResErf_C "Verhalten Fehlerflags bei Reset und abgebrochenem Nachlauf" VALUE 0xC97A5 Kw_Wu8 3.00000000000 ResErf 0.00 3.00000000000 FORMAT "%13.11" /end CHARACTERISTIC
/begin CHARACTERISTIC DSM_Class11Readiness_C "Zuordnung Entprellklasse zu Readiness Flags" VALUE 0xC97A6 Kw_Wu8 64.0000000000 Readiness 0.00 64.0000000000 FORMAT "%13.10" /end CHARACTERISTIC
/begin CHARACTERISTIC DSM_Class12Mil_C "Art der MIL Ansteuerung" VALUE 0xC97A7 Kw_Wu8 2.00000000000 Mil 0.00 2.00000000000 FORMAT "%13.11" /end CHARACTERISTIC
/begin CHARACTERISTIC DSM_Class12TFlc_C "Trigger Art für Fehlereintrags Bestätigungsentprellung (->Lampe an)" VALUE 0xC97A8 Kw_Wu8 3.00000000000 ClassTrigger 0.00 3.00000000000 FORMAT "%13.11" /end CHARACTERISTIC
/begin CHARACTERISTIC DSM_Class12Flc_C "Anzahl Triggerereignisse für Fehlereintrags Bestätigungsentprellung (->Lampe an)" VALUE 0xC97A9 Kw_Wu8 255.0 OneToOne 0.00 255.0 FORMAT "%5.1" /end CHARACTERISTIC
/begin CHARACTERISTIC DSM_Class12THlc_C "Trigger Art für Fehlerheilung (->Lampe aus)" VALUE 0xC97AA Kw_Wu8 3.00000000000 ClassTrigger 0.00 3.00000000000 FORMAT "%13.11" /end CHARACTERISTIC
/begin CHARACTERISTIC DSM_Class12Hlc_C "Anzahl Triggerereignisse für Fehlerheilung (->Lampe aus)" VALUE 0xC97AB Kw_Wu8 255.0 OneToOne 0.00 255.0 FORMAT "%5.1" /end CHARACTERISTIC
/begin CHARACTERISTIC DSM_Class12Scatt_C "Fehler ist lesbar für OBD Scan tool tester (SCATT) wenn Wert = 1" VALUE 0xC97AC Kw_Wu8 1.00000000000 Scatt 0.00 1.00000000000 FORMAT "%13.11" /end CHARACTERISTIC
/begin CHARACTERISTIC DSM_Class12TDlcPen_C "Trigger Art für Löschentprellung von nicht bestätigten Fehlern (pending)" VALUE 0xC97AD Kw_Wu8 3.00000000000 ClassTriggerTDlc 0.00 3.00000000000 FORMAT "%13.11" /end CHARACTERISTIC
/begin CHARACTERISTIC DSM_Class12DlcPen_C "Anzahl Triggerereignisse für die Löschung von nicht bestätigten Fehlern (pending)" VALUE 0xC97AE Kw_Wu8 255.0 OneToOne 0.00 255.0 FORMAT "%5.1" /end CHARACTERISTIC
/begin CHARACTERISTIC DSM_Class12TDlc_C "Trigger Art für Löschentprellung" VALUE 0xC97AF Kw_Wu8 3.00000000000 ClassTriggerTDlc 0.00 3.00000000000 FORMAT "%13.11" /end CHARACTERISTIC
/begin CHARACTERISTIC DSM_Class12DlcKd_C "Anzahl Triggerereignisse für die Löschung von Fehlereinträgen mit Status Kundendienst" VALUE 0xC97B0 Kw_Wu8 255.0 OneToOne 0.00 255.0 FORMAT "%5.1" /end CHARACTERISTIC
/begin CHARACTERISTIC DSM_Class12Dlc_C "Anzahl Triggerereignisse für die Löschung von Fehlereinträgen" VALUE 0xC97B1 Kw_Wu8 255.0 OneToOne 0.00 255.0 FORMAT "%5.1" /end CHARACTERISTIC
/begin CHARACTERISTIC DSM_Class12Prio_C "Priorität des Fehlereintrages für Verdrängung und freeze frame Zuordnung" VALUE 0xC97B2 Kw_Wu8 255.0 OneToOne 0.00 255.0 FORMAT "%5.1" /end CHARACTERISTIC
/begin CHARACTERISTIC DSM_Class12SysLamp_C "Art der Systemlampenansteuerung" VALUE 0xC97B3 Kw_Wu8 2.00000000000 SysLamp 0.00 2.00000000000 FORMAT "%13.11" /end CHARACTERISTIC
/begin CHARACTERISTIC DSM_Class12ResErf_C "Verhalten Fehlerflags bei Reset und abgebrochenem Nachlauf" VALUE 0xC97B4 Kw_Wu8 3.00000000000 ResErf 0.00 3.00000000000 FORMAT "%13.11" /end CHARACTERISTIC
/begin CHARACTERISTIC DSM_Class12Readiness_C "Zuordnung Entprellklasse zu Readiness Flags" VALUE 0xC97B5 Kw_Wu8 64.0000000000 Readiness 0.00 64.0000000000 FORMAT "%13.10" /end CHARACTERISTIC
/begin CHARACTERISTIC DSM_Class13Mil_C "Art der MIL Ansteuerung" VALUE 0xC97B6 Kw_Wu8 2.00000000000 Mil 0.00 2.00000000000 FORMAT "%13.11" /end CHARACTERISTIC
/begin CHARACTERISTIC DSM_Class13TFlc_C "Trigger Art für Fehlereintrags Bestätigungsentprellung (->Lampe an)" VALUE 0xC97B7 Kw_Wu8 3.00000000000 ClassTrigger 0.00 3.00000000000 FORMAT "%13.11" /end CHARACTERISTIC
/begin CHARACTERISTIC DSM_Class13Flc_C "Anzahl Triggerereignisse für Fehlereintrags Bestätigungsentprellung (->Lampe an)" VALUE 0xC97B8 Kw_Wu8 255.0 OneToOne 0.00 255.0 FORMAT "%5.1" /end CHARACTERISTIC
/begin CHARACTERISTIC DSM_Class13THlc_C "Trigger Art für Fehlerheilung (->Lampe aus)" VALUE 0xC97B9 Kw_Wu8 3.00000000000 ClassTrigger 0.00 3.00000000000 FORMAT "%13.11" /end CHARACTERISTIC
/begin CHARACTERISTIC DSM_Class13Hlc_C "Anzahl Triggerereignisse für Fehlerheilung (->Lampe aus)" VALUE 0xC97BA Kw_Wu8 255.0 OneToOne 0.00 255.0 FORMAT "%5.1" /end CHARACTERISTIC
/begin CHARACTERISTIC DSM_Class13Scatt_C "Fehler ist lesbar für OBD Scan tool tester (SCATT) wenn Wert = 1" VALUE 0xC97BB Kw_Wu8 1.00000000000 Scatt 0.00 1.00000000000 FORMAT "%13.11" /end CHARACTERISTIC
/begin CHARACTERISTIC DSM_Class13TDlcPen_C "Trigger Art für Löschentprellung von nicht bestätigten Fehlern (pending)" VALUE 0xC97BC Kw_Wu8 3.00000000000 ClassTriggerTDlc 0.00 3.00000000000 FORMAT "%13.11" /end CHARACTERISTIC
/begin CHARACTERISTIC DSM_Class13DlcPen_C "Anzahl Triggerereignisse für die Löschung von nicht bestätigten Fehlern (pending)" VALUE 0xC97BD Kw_Wu8 255.0 OneToOne 0.00 255.0 FORMAT "%5.1" /end CHARACTERISTIC
/begin CHARACTERISTIC DSM_Class13TDlc_C "Trigger Art für Löschentprellung" VALUE 0xC97BE Kw_Wu8 3.00000000000 ClassTriggerTDlc 0.00 3.00000000000 FORMAT "%13.11" /end CHARACTERISTIC
/begin CHARACTERISTIC DSM_Class13DlcKd_C "Anzahl Triggerereignisse für die Löschung von Fehlereinträgen mit Status Kundendienst" VALUE 0xC97BF Kw_Wu8 255.0 OneToOne 0.00 255.0 FORMAT "%5.1" /end CHARACTERISTIC
/begin CHARACTERISTIC DSM_Class13Dlc_C "Anzahl Triggerereignisse für die Löschung von Fehlereinträgen" VALUE 0xC97C0 Kw_Wu8 255.0 OneToOne 0.00 255.0 FORMAT "%5.1" /end CHARACTERISTIC
/begin CHARACTERISTIC DSM_Class13Prio_C "Priorität des Fehlereintrages für Verdrängung und freeze frame Zuordnung" VALUE 0xC97C1 Kw_Wu8 255.0 OneToOne 0.00 255.0 FORMAT "%5.1" /end CHARACTERISTIC
/begin CHARACTERISTIC DSM_Class13SysLamp_C "Art der Systemlampenansteuerung" VALUE 0xC97C2 Kw_Wu8 2.00000000000 SysLamp 0.00 2.00000000000 FORMAT "%13.11" /end CHARACTERISTIC
/begin CHARACTERISTIC DSM_Class13ResErf_C "Verhalten Fehlerflags bei Reset und abgebrochenem Nachlauf" VALUE 0xC97C3 Kw_Wu8 3.00000000000 ResErf 0.00 3.00000000000 FORMAT "%13.11" /end CHARACTERISTIC
/begin CHARACTERISTIC DSM_Class13Readiness_C "Zuordnung Entprellklasse zu Readiness Flags" VALUE 0xC97C4 Kw_Wu8 64.0000000000 Readiness 0.00 64.0000000000 FORMAT "%13.10" /end CHARACTERISTIC
/begin CHARACTERISTIC DSM_Class14Mil_C "Art der MIL Ansteuerung" VALUE 0xC97C5 Kw_Wu8 2.00000000000 Mil 0.00 2.00000000000 FORMAT "%13.11" /end CHARACTERISTIC
/begin CHARACTERISTIC DSM_Class14TFlc_C "Trigger Art für Fehlereintrags Bestätigungsentprellung (->Lampe an)" VALUE 0xC97C6 Kw_Wu8 3.00000000000 ClassTrigger 0.00 3.00000000000 FORMAT "%13.11" /end CHARACTERISTIC
/begin CHARACTERISTIC DSM_Class14Flc_C "Anzahl Triggerereignisse für Fehlereintrags Bestätigungsentprellung (->Lampe an)" VALUE 0xC97C7 Kw_Wu8 255.0 OneToOne 0.00 255.0 FORMAT "%5.1" /end CHARACTERISTIC
/begin CHARACTERISTIC DSM_Class14THlc_C "Trigger Art für Fehlerheilung (->Lampe aus)" VALUE 0xC97C8 Kw_Wu8 3.00000000000 ClassTrigger 0.00 3.00000000000 FORMAT "%13.11" /end CHARACTERISTIC
/begin CHARACTERISTIC DSM_Class14Hlc_C "Anzahl Triggerereignisse für Fehlerheilung (->Lampe aus)" VALUE 0xC97C9 Kw_Wu8 255.0 OneToOne 0.00 255.0 FORMAT "%5.1" /end CHARACTERISTIC
/begin CHARACTERISTIC DSM_Class14Scatt_C "Fehler ist lesbar für OBD Scan tool tester (SCATT) wenn Wert = 1" VALUE 0xC97CA Kw_Wu8 1.00000000000 Scatt 0.00 1.00000000000 FORMAT "%13.11" /end CHARACTERISTIC
/begin CHARACTERISTIC DSM_Class14TDlcPen_C "Trigger Art für Löschentprellung von nicht bestätigten Fehlern (pending)" VALUE 0xC97CB Kw_Wu8 3.00000000000 ClassTriggerTDlc 0.00 3.00000000000 FORMAT "%13.11" /end CHARACTERISTIC
/begin CHARACTERISTIC DSM_Class14DlcPen_C "Anzahl Triggerereignisse für die Löschung von nicht bestätigten Fehlern (pending)" VALUE 0xC97CC Kw_Wu8 255.0 OneToOne 0.00 255.0 FORMAT "%5.1" /end CHARACTERISTIC
/begin CHARACTERISTIC DSM_Class14TDlc_C "Trigger Art für Löschentprellung" VALUE 0xC97CD Kw_Wu8 3.00000000000 ClassTriggerTDlc 0.00 3.00000000000 FORMAT "%13.11" /end CHARACTERISTIC
/begin CHARACTERISTIC DSM_Class14DlcKd_C "Anzahl Triggerereignisse für die Löschung von Fehlereinträgen mit Status Kundendienst" VALUE 0xC97CE Kw_Wu8 255.0 OneToOne 0.00 255.0 FORMAT "%5.1" /end CHARACTERISTIC
/begin CHARACTERISTIC DSM_Class14Dlc_C "Anzahl Triggerereignisse für die Löschung von Fehlereinträgen" VALUE 0xC97CF Kw_Wu8 255.0 OneToOne 0.00 255.0 FORMAT "%5.1" /end CHARACTERISTIC
/begin CHARACTERISTIC DSM_Class14Prio_C "Priorität des Fehlereintrages für Verdrängung und freeze frame Zuordnung" VALUE 0xC97D0 Kw_Wu8 255.0 OneToOne 0.00 255.0 FORMAT "%5.1" /end CHARACTERISTIC
/begin CHARACTERISTIC DSM_Class14SysLamp_C "Art der Systemlampenansteuerung" VALUE 0xC97D1 Kw_Wu8 2.00000000000 SysLamp 0.00 2.00000000000 FORMAT "%13.11" /end CHARACTERISTIC
/begin CHARACTERISTIC DSM_Class14ResErf_C "Verhalten Fehlerflags bei Reset und abgebrochenem Nachlauf" VALUE 0xC97D2 Kw_Wu8 3.00000000000 ResErf 0.00 3.00000000000 FORMAT "%13.11" /end CHARACTERISTIC
/begin CHARACTERISTIC DSM_Class14Readiness_C "Zuordnung Entprellklasse zu Readiness Flags" VALUE 0xC97D3 Kw_Wu8 64.0000000000 Readiness 0.00 64.0000000000 FORMAT "%13.10" /end CHARACTERISTIC
/begin CHARACTERISTIC DSM_Class15Mil_C "Art der MIL Ansteuerung" VALUE 0xC97D4 Kw_Wu8 2.00000000000 Mil 0.00 2.00000000000 FORMAT "%13.11" /end CHARACTERISTIC
/begin CHARACTERISTIC DSM_Class15TFlc_C "Trigger Art für Fehlereintrags Bestätigungsentprellung (->Lampe an)" VALUE 0xC97D5 Kw_Wu8 3.00000000000 ClassTrigger 0.00 3.00000000000 FORMAT "%13.11" /end CHARACTERISTIC
/begin CHARACTERISTIC DSM_Class15Flc_C "Anzahl Triggerereignisse für Fehlereintrags Bestätigungsentprellung (->Lampe an)" VALUE 0xC97D6 Kw_Wu8 255.0 OneToOne 0.00 255.0 FORMAT "%5.1" /end CHARACTERISTIC
/begin CHARACTERISTIC DSM_Class15THlc_C "Trigger Art für Fehlerheilung (->Lampe aus)" VALUE 0xC97D7 Kw_Wu8 3.00000000000 ClassTrigger 0.00 3.00000000000 FORMAT "%13.11" /end CHARACTERISTIC
/begin CHARACTERISTIC DSM_Class15Hlc_C "Anzahl Triggerereignisse für Fehlerheilung (->Lampe aus)" VALUE 0xC97D8 Kw_Wu8 255.0 OneToOne 0.00 255.0 FORMAT "%5.1" /end CHARACTERISTIC
/begin CHARACTERISTIC DSM_Class15Scatt_C "Fehler ist lesbar für OBD Scan tool tester (SCATT) wenn Wert = 1" VALUE 0xC97D9 Kw_Wu8 1.00000000000 Scatt 0.00 1.00000000000 FORMAT "%13.11" /end CHARACTERISTIC
/begin CHARACTERISTIC DSM_Class15TDlcPen_C "Trigger Art für Löschentprellung von nicht bestätigten Fehlern (pending)" VALUE 0xC97DA Kw_Wu8 3.00000000000 ClassTriggerTDlc 0.00 3.00000000000 FORMAT "%13.11" /end CHARACTERISTIC
/begin CHARACTERISTIC DSM_Class15DlcPen_C "Anzahl Triggerereignisse für die Löschung von nicht bestätigten Fehlern (pending)" VALUE 0xC97DB Kw_Wu8 255.0 OneToOne 0.00 255.0 FORMAT "%5.1" /end CHARACTERISTIC
/begin CHARACTERISTIC DSM_Class15TDlc_C "Trigger Art für Löschentprellung" VALUE 0xC97DC Kw_Wu8 3.00000000000 ClassTriggerTDlc 0.00 3.00000000000 FORMAT "%13.11" /end CHARACTERISTIC
/begin CHARACTERISTIC DSM_Class15DlcKd_C "Anzahl Triggerereignisse für die Löschung von Fehlereinträgen mit Status Kundendienst" VALUE 0xC97DD Kw_Wu8 255.0 OneToOne 0.00 255.0 FORMAT "%5.1" /end CHARACTERISTIC
/begin CHARACTERISTIC DSM_Class15Dlc_C "Anzahl Triggerereignisse für die Löschung von Fehlereinträgen" VALUE 0xC97DE Kw_Wu8 255.0 OneToOne 0.00 255.0 FORMAT "%5.1" /end CHARACTERISTIC
/begin CHARACTERISTIC DSM_Class15Prio_C "Priorität des Fehlereintrages für Verdrängung und freeze frame Zuordnung" VALUE 0xC97DF Kw_Wu8 255.0 OneToOne 0.00 255.0 FORMAT "%5.1" /end CHARACTERISTIC
/begin CHARACTERISTIC DSM_Class15SysLamp_C "Art der Systemlampenansteuerung" VALUE 0xC97E0 Kw_Wu8 2.00000000000 SysLamp 0.00 2.00000000000 FORMAT "%13.11" /end CHARACTERISTIC
/begin CHARACTERISTIC DSM_Class15ResErf_C "Verhalten Fehlerflags bei Reset und abgebrochenem Nachlauf" VALUE 0xC97E1 Kw_Wu8 3.00000000000 ResErf 0.00 3.00000000000 FORMAT "%13.11" /end CHARACTERISTIC
/begin CHARACTERISTIC DSM_Class15Readiness_C "Zuordnung Entprellklasse zu Readiness Flags" VALUE 0xC97E2 Kw_Wu8 64.0000000000 Readiness 0.00 64.0000000000 FORMAT "%13.10" /end CHARACTERISTIC
/begin CHARACTERISTIC DSM_Class16Mil_C "Art der MIL Ansteuerung" VALUE 0xC97E3 Kw_Wu8 2.00000000000 Mil 0.00 2.00000000000 FORMAT "%13.11" /end CHARACTERISTIC
/begin CHARACTERISTIC DSM_Class16TFlc_C "Trigger Art für Fehlereintrags Bestätigungsentprellung (->Lampe an)" VALUE 0xC97E4 Kw_Wu8 3.00000000000 ClassTrigger 0.00 3.00000000000 FORMAT "%13.11" /end CHARACTERISTIC
/begin CHARACTERISTIC DSM_Class16Flc_C "Anzahl Triggerereignisse für Fehlereintrags Bestätigungsentprellung (->Lampe an)" VALUE 0xC97E5 Kw_Wu8 255.0 OneToOne 0.00 255.0 FORMAT "%5.1" /end CHARACTERISTIC
/begin CHARACTERISTIC DSM_Class16THlc_C "Trigger Art für Fehlerheilung (->Lampe aus)" VALUE 0xC97E6 Kw_Wu8 3.00000000000 ClassTrigger 0.00 3.00000000000 FORMAT "%13.11" /end CHARACTERISTIC
/begin CHARACTERISTIC DSM_Class16Hlc_C "Anzahl Triggerereignisse für Fehlerheilung (->Lampe aus)" VALUE 0xC97E7 Kw_Wu8 255.0 OneToOne 0.00 255.0 FORMAT "%5.1" /end CHARACTERISTIC
/begin CHARACTERISTIC DSM_Class16Scatt_C "Fehler ist lesbar für OBD Scan tool tester (SCATT) wenn Wert = 1" VALUE 0xC97E8 Kw_Wu8 1.00000000000 Scatt 0.00 1.00000000000 FORMAT "%13.11" /end CHARACTERISTIC
/begin CHARACTERISTIC DSM_Class16TDlcPen_C "Trigger Art für Löschentprellung von nicht bestätigten Fehlern (pending)" VALUE 0xC97E9 Kw_Wu8 3.00000000000 ClassTriggerTDlc 0.00 3.00000000000 FORMAT "%13.11" /end CHARACTERISTIC
/begin CHARACTERISTIC DSM_Class16DlcPen_C "Anzahl Triggerereignisse für die Löschung von nicht bestätigten Fehlern (pending)" VALUE 0xC97EA Kw_Wu8 255.0 OneToOne 0.00 255.0 FORMAT "%5.1" /end CHARACTERISTIC
/begin CHARACTERISTIC DSM_Class16TDlc_C "Trigger Art für Löschentprellung" VALUE 0xC97EB Kw_Wu8 3.00000000000 ClassTriggerTDlc 0.00 3.00000000000 FORMAT "%13.11" /end CHARACTERISTIC
/begin CHARACTERISTIC DSM_Class16DlcKd_C "Anzahl Triggerereignisse für die Löschung von Fehlereinträgen mit Status Kundendienst" VALUE 0xC97EC Kw_Wu8 255.0 OneToOne 0.00 255.0 FORMAT "%5.1" /end CHARACTERISTIC
/begin CHARACTERISTIC DSM_Class16Dlc_C "Anzahl Triggerereignisse für die Löschung von Fehlereinträgen" VALUE 0xC97ED Kw_Wu8 255.0 OneToOne 0.00 255.0 FORMAT "%5.1" /end CHARACTERISTIC
/begin CHARACTERISTIC DSM_Class16Prio_C "Priorität des Fehlereintrages für Verdrängung und freeze frame Zuordnung" VALUE 0xC97EE Kw_Wu8 255.0 OneToOne 0.00 255.0 FORMAT "%5.1" /end CHARACTERISTIC
/begin CHARACTERISTIC DSM_Class16SysLamp_C "Art der Systemlampenansteuerung" VALUE 0xC97EF Kw_Wu8 2.00000000000 SysLamp 0.00 2.00000000000 FORMAT "%13.11" /end CHARACTERISTIC
/begin CHARACTERISTIC DSM_Class16ResErf_C "Verhalten Fehlerflags bei Reset und abgebrochenem Nachlauf" VALUE 0xC97F0 Kw_Wu8 3.00000000000 ResErf 0.00 3.00000000000 FORMAT "%13.11" /end CHARACTERISTIC
/begin CHARACTERISTIC DSM_Class16Readiness_C "Zuordnung Entprellklasse zu Readiness Flags" VALUE 0xC97F1 Kw_Wu8 64.0000000000 Readiness 0.00 64.0000000000 FORMAT "%13.10" /end CHARACTERISTIC
/begin CHARACTERISTIC DSM_Class17Mil_C "Art der MIL Ansteuerung" VALUE 0xC97F2 Kw_Wu8 2.00000000000 Mil 0.00 2.00000000000 FORMAT "%13.11" /end CHARACTERISTIC
/begin CHARACTERISTIC DSM_Class17TFlc_C "Trigger Art für Fehlereintrags Bestätigungsentprellung (->Lampe an)" VALUE 0xC97F3 Kw_Wu8 3.00000000000 ClassTrigger 0.00 3.00000000000 FORMAT "%13.11" /end CHARACTERISTIC
/begin CHARACTERISTIC DSM_Class17Flc_C "Anzahl Triggerereignisse für Fehlereintrags Bestätigungsentprellung (->Lampe an)" VALUE 0xC97F4 Kw_Wu8 255.0 OneToOne 0.00 255.0 FORMAT "%5.1" /end CHARACTERISTIC
/begin CHARACTERISTIC DSM_Class17THlc_C "Trigger Art für Fehlerheilung (->Lampe aus)" VALUE 0xC97F5 Kw_Wu8 3.00000000000 ClassTrigger 0.00 3.00000000000 FORMAT "%13.11" /end CHARACTERISTIC
/begin CHARACTERISTIC DSM_Class17Hlc_C "Anzahl Triggerereignisse für Fehlerheilung (->Lampe aus)" VALUE 0xC97F6 Kw_Wu8 255.0 OneToOne 0.00 255.0 FORMAT "%5.1" /end CHARACTERISTIC
/begin CHARACTERISTIC DSM_Class17Scatt_C "Fehler ist lesbar für OBD Scan tool tester (SCATT) wenn Wert = 1" VALUE 0xC97F7 Kw_Wu8 1.00000000000 Scatt 0.00 1.00000000000 FORMAT "%13.11" /end CHARACTERISTIC
/begin CHARACTERISTIC DSM_Class17TDlcPen_C "Trigger Art für Löschentprellung von nicht bestätigten Fehlern (pending)" VALUE 0xC97F8 Kw_Wu8 3.00000000000 ClassTriggerTDlc 0.00 3.00000000000 FORMAT "%13.11" /end CHARACTERISTIC
/begin CHARACTERISTIC DSM_Class17DlcPen_C "Anzahl Triggerereignisse für die Löschung von nicht bestätigten Fehlern (pending)" VALUE 0xC97F9 Kw_Wu8 255.0 OneToOne 0.00 255.0 FORMAT "%5.1" /end CHARACTERISTIC
/begin CHARACTERISTIC DSM_Class17TDlc_C "Trigger Art für Löschentprellung" VALUE 0xC97FA Kw_Wu8 3.00000000000 ClassTriggerTDlc 0.00 3.00000000000 FORMAT "%13.11" /end CHARACTERISTIC
/begin CHARACTERISTIC DSM_Class17DlcKd_C "Anzahl Triggerereignisse für die Löschung von Fehlereinträgen mit Status Kundendienst" VALUE 0xC97FB Kw_Wu8 255.0 OneToOne 0.00 255.0 FORMAT "%5.1" /end CHARACTERISTIC
/begin CHARACTERISTIC DSM_Class17Dlc_C "Anzahl Triggerereignisse für die Löschung von Fehlereinträgen" VALUE 0xC97FC Kw_Wu8 255.0 OneToOne 0.00 255.0 FORMAT "%5.1" /end CHARACTERISTIC
/begin CHARACTERISTIC DSM_Class17Prio_C "Priorität des Fehlereintrages für Verdrängung und freeze frame Zuordnung" VALUE 0xC97FD Kw_Wu8 255.0 OneToOne 0.00 255.0 FORMAT "%5.1" /end CHARACTERISTIC
/begin CHARACTERISTIC DSM_Class17SysLamp_C "Art der Systemlampenansteuerung" VALUE 0xC97FE Kw_Wu8 2.00000000000 SysLamp 0.00 2.00000000000 FORMAT "%13.11" /end CHARACTERISTIC
/begin CHARACTERISTIC DSM_Class17ResErf_C "Verhalten Fehlerflags bei Reset und abgebrochenem Nachlauf" VALUE 0xC97FF Kw_Wu8 3.00000000000 ResErf 0.00 3.00000000000 FORMAT "%13.11" /end CHARACTERISTIC
/begin CHARACTERISTIC DSM_Class17Readiness_C "Zuordnung Entprellklasse zu Readiness Flags" VALUE 0xC9800 Kw_Wu8 64.0000000000 Readiness 0.00 64.0000000000 FORMAT "%13.10" /end CHARACTERISTIC
/begin CHARACTERISTIC DSM_Class18Mil_C "Art der MIL Ansteuerung" VALUE 0xC9801 Kw_Wu8 2.00000000000 Mil 0.00 2.00000000000 FORMAT "%13.11" /end CHARACTERISTIC
/begin CHARACTERISTIC DSM_Class18TFlc_C "Trigger Art für Fehlereintrags Bestätigungsentprellung (->Lampe an)" VALUE 0xC9802 Kw_Wu8 3.00000000000 ClassTrigger 0.00 3.00000000000 FORMAT "%13.11" /end CHARACTERISTIC
/begin CHARACTERISTIC DSM_Class18Flc_C "Anzahl Triggerereignisse für Fehlereintrags Bestätigungsentprellung (->Lampe an)" VALUE 0xC9803 Kw_Wu8 255.0 OneToOne 0.00 255.0 FORMAT "%5.1" /end CHARACTERISTIC
/begin CHARACTERISTIC DSM_Class18THlc_C "Trigger Art für Fehlerheilung (->Lampe aus)" VALUE 0xC9804 Kw_Wu8 3.00000000000 ClassTrigger 0.00 3.00000000000 FORMAT "%13.11" /end CHARACTERISTIC
/begin CHARACTERISTIC DSM_Class18Hlc_C "Anzahl Triggerereignisse für Fehlerheilung (->Lampe aus)" VALUE 0xC9805 Kw_Wu8 255.0 OneToOne 0.00 255.0 FORMAT "%5.1" /end CHARACTERISTIC
/begin CHARACTERISTIC DSM_Class18Scatt_C "Fehler ist lesbar für OBD Scan tool tester (SCATT) wenn Wert = 1" VALUE 0xC9806 Kw_Wu8 1.00000000000 Scatt 0.00 1.00000000000 FORMAT "%13.11" /end CHARACTERISTIC
/begin CHARACTERISTIC DSM_Class18TDlcPen_C "Trigger Art für Löschentprellung von nicht bestätigten Fehlern (pending)" VALUE 0xC9807 Kw_Wu8 3.00000000000 ClassTriggerTDlc 0.00 3.00000000000 FORMAT "%13.11" /end CHARACTERISTIC
/begin CHARACTERISTIC DSM_Class18DlcPen_C "Anzahl Triggerereignisse für die Löschung von nicht bestätigten Fehlern (pending)" VALUE 0xC9808 Kw_Wu8 255.0 OneToOne 0.00 255.0 FORMAT "%5.1" /end CHARACTERISTIC
/begin CHARACTERISTIC DSM_Class18TDlc_C "Trigger Art für Löschentprellung" VALUE 0xC9809 Kw_Wu8 3.00000000000 ClassTriggerTDlc 0.00 3.00000000000 FORMAT "%13.11" /end CHARACTERISTIC
/begin CHARACTERISTIC DSM_Class18DlcKd_C "Anzahl Triggerereignisse für die Löschung von Fehlereinträgen mit Status Kundendienst" VALUE 0xC980A Kw_Wu8 255.0 OneToOne 0.00 255.0 FORMAT "%5.1" /end CHARACTERISTIC
/begin CHARACTERISTIC DSM_Class18Dlc_C "Anzahl Triggerereignisse für die Löschung von Fehlereinträgen" VALUE 0xC980B Kw_Wu8 255.0 OneToOne 0.00 255.0 FORMAT "%5.1" /end CHARACTERISTIC
/begin CHARACTERISTIC DSM_Class18Prio_C "Priorität des Fehlereintrages für Verdrängung und freeze frame Zuordnung" VALUE 0xC980C Kw_Wu8 255.0 OneToOne 0.00 255.0 FORMAT "%5.1" /end CHARACTERISTIC
/begin CHARACTERISTIC DSM_Class18SysLamp_C "Art der Systemlampenansteuerung" VALUE 0xC980D Kw_Wu8 2.00000000000 SysLamp 0.00 2.00000000000 FORMAT "%13.11" /end CHARACTERISTIC
/begin CHARACTERISTIC DSM_Class18ResErf_C "Verhalten Fehlerflags bei Reset und abgebrochenem Nachlauf" VALUE 0xC980E Kw_Wu8 3.00000000000 ResErf 0.00 3.00000000000 FORMAT "%13.11" /end CHARACTERISTIC
/begin CHARACTERISTIC DSM_Class18Readiness_C "Zuordnung Entprellklasse zu Readiness Flags" VALUE 0xC980F Kw_Wu8 64.0000000000 Readiness 0.00 64.0000000000 FORMAT "%13.10" /end CHARACTERISTIC
/begin CHARACTERISTIC DSM_Class19Mil_C "Art der MIL Ansteuerung" VALUE 0xC9810 Kw_Wu8 2.00000000000 Mil 0.00 2.00000000000 FORMAT "%13.11" /end CHARACTERISTIC
/begin CHARACTERISTIC DSM_Class19TFlc_C "Trigger Art für Fehlereintrags Bestätigungsentprellung (->Lampe an)" VALUE 0xC9811 Kw_Wu8 3.00000000000 ClassTrigger 0.00 3.00000000000 FORMAT "%13.11" /end CHARACTERISTIC
/begin CHARACTERISTIC DSM_Class19Flc_C "Anzahl Triggerereignisse für Fehlereintrags Bestätigungsentprellung (->Lampe an)" VALUE 0xC9812 Kw_Wu8 255.0 OneToOne 0.00 255.0 FORMAT "%5.1" /end CHARACTERISTIC
/begin CHARACTERISTIC DSM_Class19THlc_C "Trigger Art für Fehlerheilung (->Lampe aus)" VALUE 0xC9813 Kw_Wu8 3.00000000000 ClassTrigger 0.00 3.00000000000 FORMAT "%13.11" /end CHARACTERISTIC
/begin CHARACTERISTIC DSM_Class19Hlc_C "Anzahl Triggerereignisse für Fehlerheilung (->Lampe aus)" VALUE 0xC9814 Kw_Wu8 255.0 OneToOne 0.00 255.0 FORMAT "%5.1" /end CHARACTERISTIC
/begin CHARACTERISTIC DSM_Class19Scatt_C "Fehler ist lesbar für OBD Scan tool tester (SCATT) wenn Wert = 1" VALUE 0xC9815 Kw_Wu8 1.00000000000 Scatt 0.00 1.00000000000 FORMAT "%13.11" /end CHARACTERISTIC
/begin CHARACTERISTIC DSM_Class19TDlcPen_C "Trigger Art für Löschentprellung von nicht bestätigten Fehlern (pending)" VALUE 0xC9816 Kw_Wu8 3.00000000000 ClassTriggerTDlc 0.00 3.00000000000 FORMAT "%13.11" /end CHARACTERISTIC
/begin CHARACTERISTIC DSM_Class19DlcPen_C "Anzahl Triggerereignisse für die Löschung von nicht bestätigten Fehlern (pending)" VALUE 0xC9817 Kw_Wu8 255.0 OneToOne 0.00 255.0 FORMAT "%5.1" /end CHARACTERISTIC
/begin CHARACTERISTIC DSM_Class19TDlc_C "Trigger Art für Löschentprellung" VALUE 0xC9818 Kw_Wu8 3.00000000000 ClassTriggerTDlc 0.00 3.00000000000 FORMAT "%13.11" /end CHARACTERISTIC
/begin CHARACTERISTIC DSM_Class19DlcKd_C "Anzahl Triggerereignisse für die Löschung von Fehlereinträgen mit Status Kundendienst" VALUE 0xC9819 Kw_Wu8 255.0 OneToOne 0.00 255.0 FORMAT "%5.1" /end CHARACTERISTIC
/begin CHARACTERISTIC DSM_Class19Dlc_C "Anzahl Triggerereignisse für die Löschung von Fehlereinträgen" VALUE 0xC981A Kw_Wu8 255.0 OneToOne 0.00 255.0 FORMAT "%5.1" /end CHARACTERISTIC
/begin CHARACTERISTIC DSM_Class19Prio_C "Priorität des Fehlereintrages für Verdrängung und freeze frame Zuordnung" VALUE 0xC981B Kw_Wu8 255.0 OneToOne 0.00 255.0 FORMAT "%5.1" /end CHARACTERISTIC
/begin CHARACTERISTIC DSM_Class19SysLamp_C "Art der Systemlampenansteuerung" VALUE 0xC981C Kw_Wu8 2.00000000000 SysLamp 0.00 2.00000000000 FORMAT "%13.11" /end CHARACTERISTIC
/begin CHARACTERISTIC DSM_Class19ResErf_C "Verhalten Fehlerflags bei Reset und abgebrochenem Nachlauf" VALUE 0xC981D Kw_Wu8 3.00000000000 ResErf 0.00 3.00000000000 FORMAT "%13.11" /end CHARACTERISTIC
/begin CHARACTERISTIC DSM_Class19Readiness_C "Zuordnung Entprellklasse zu Readiness Flags" VALUE 0xC981E Kw_Wu8 64.0000000000 Readiness 0.00 64.0000000000 FORMAT "%13.10" /end CHARACTERISTIC
/begin CHARACTERISTIC DSM_Class20Mil_C "Art der MIL Ansteuerung" VALUE 0xC981F Kw_Wu8 2.00000000000 Mil 0.00 2.00000000000 FORMAT "%13.11" /end CHARACTERISTIC
/begin CHARACTERISTIC DSM_Class20TFlc_C "Trigger Art für Fehlereintrags Bestätigungsentprellung (->Lampe an)" VALUE 0xC9820 Kw_Wu8 3.00000000000 ClassTrigger 0.00 3.00000000000 FORMAT "%13.11" /end CHARACTERISTIC
/begin CHARACTERISTIC DSM_Class20Flc_C "Anzahl Triggerereignisse für Fehlereintrags Bestätigungsentprellung (->Lampe an)" VALUE 0xC9821 Kw_Wu8 255.0 OneToOne 0.00 255.0 FORMAT "%5.1" /end CHARACTERISTIC
/begin CHARACTERISTIC DSM_Class20THlc_C "Trigger Art für Fehlerheilung (->Lampe aus)" VALUE 0xC9822 Kw_Wu8 3.00000000000 ClassTrigger 0.00 3.00000000000 FORMAT "%13.11" /end CHARACTERISTIC
/begin CHARACTERISTIC DSM_Class20Hlc_C "Anzahl Triggerereignisse für Fehlerheilung (->Lampe aus)" VALUE 0xC9823 Kw_Wu8 255.0 OneToOne 0.00 255.0 FORMAT "%5.1" /end CHARACTERISTIC
/begin CHARACTERISTIC DSM_Class20Scatt_C "Fehler ist lesbar für OBD Scan tool tester (SCATT) wenn Wert = 1" VALUE 0xC9824 Kw_Wu8 1.00000000000 Scatt 0.00 1.00000000000 FORMAT "%13.11" /end CHARACTERISTIC
/begin CHARACTERISTIC DSM_Class20TDlcPen_C "Trigger Art für Löschentprellung von nicht bestätigten Fehlern (pending)" VALUE 0xC9825 Kw_Wu8 3.00000000000 ClassTriggerTDlc 0.00 3.00000000000 FORMAT "%13.11" /end CHARACTERISTIC
/begin CHARACTERISTIC DSM_Class20DlcPen_C "Anzahl Triggerereignisse für die Löschung von nicht bestätigten Fehlern (pending)" VALUE 0xC9826 Kw_Wu8 255.0 OneToOne 0.00 255.0 FORMAT "%5.1" /end CHARACTERISTIC
/begin CHARACTERISTIC DSM_Class20TDlc_C "Trigger Art für Löschentprellung" VALUE 0xC9827 Kw_Wu8 3.00000000000 ClassTriggerTDlc 0.00 3.00000000000 FORMAT "%13.11" /end CHARACTERISTIC
/begin CHARACTERISTIC DSM_Class20DlcKd_C "Anzahl Triggerereignisse für die Löschung von Fehlereinträgen mit Status Kundendienst" VALUE 0xC9828 Kw_Wu8 255.0 OneToOne 0.00 255.0 FORMAT "%5.1" /end CHARACTERISTIC
/begin CHARACTERISTIC DSM_Class20Dlc_C "Anzahl Triggerereignisse für die Löschung von Fehlereinträgen" VALUE 0xC9829 Kw_Wu8 255.0 OneToOne 0.00 255.0 FORMAT "%5.1" /end CHARACTERISTIC
/begin CHARACTERISTIC DSM_Class20Prio_C "Priorität des Fehlereintrages für Verdrängung und freeze frame Zuordnung" VALUE 0xC982A Kw_Wu8 255.0 OneToOne 0.00 255.0 FORMAT "%5.1" /end CHARACTERISTIC
/begin CHARACTERISTIC DSM_Class20SysLamp_C "Art der Systemlampenansteuerung" VALUE 0xC982B Kw_Wu8 2.00000000000 SysLamp 0.00 2.00000000000 FORMAT "%13.11" /end CHARACTERISTIC
/begin CHARACTERISTIC DSM_Class20ResErf_C "Verhalten Fehlerflags bei Reset und abgebrochenem Nachlauf" VALUE 0xC982C Kw_Wu8 3.00000000000 ResErf 0.00 3.00000000000 FORMAT "%13.11" /end CHARACTERISTIC
/begin CHARACTERISTIC DSM_Class20Readiness_C "Zuordnung Entprellklasse zu Readiness Flags" VALUE 0xC982D Kw_Wu8 64.0000000000 Readiness 0.00 64.0000000000 FORMAT "%13.10" /end CHARACTERISTIC
/begin CHARACTERISTIC DSM_FCMClear_C "Fehlerspeicher löschen über Label" VALUE 0xC982E Kw_Wu8 1.000 OneToOne 0.00 1.000 FORMAT "%5.3" EXTENDED_LIMITS 0.00 255.0 /end CHARACTERISTIC
/begin CHARACTERISTIC DSM_FrzFrEnvironment_C "Freeze frame, Auswahl der Umweltbedingungen" VAL_BLK 0xC9830 Kwb_Wu16 255.000000000 SigName 0.00 255.000000000 FORMAT "%13.9" NUMBER 11 /end CHARACTERISTIC
/begin CHARACTERISTIC DSM_stStepWidth_CA "Schrittweite der Ereignisentprellung der up/down counter" VAL_BLK 0xC9846 Kwb_Wu8 255.0 OneToOne 0.00 255.0 FORMAT "%5.1" NUMBER 4 /end CHARACTERISTIC
/begin CHARACTERISTIC DSM_SysLampMode_C "Aktivierungsbedingung der System Lampe (1= aktuelle Fehler, 0 = bestätigte Fehlerspeichereinträge)" VALUE 0xC984A Kw_Wu8 2.00000000000 SysLampMode 0.00 2.00000000000 FORMAT "%13.11" /end CHARACTERISTIC
/begin CHARACTERISTIC DSM_tiDCMin_C "Mindestzeit für driving cycle Erkennung (Maximalwert = Nachlauf)" VALUE 0xC984C Kw_Wu16 65535.00 TimeDsmDC 0.00 65535.00 FORMAT "%8.2" /end CHARACTERISTIC
/begin CHARACTERISTIC DSM_tiWucDelay_C "Zeitverzögerung für die Abtasung der Kühlwassertemperatur bei Start zur Warm Up Cycle Ermittlung" VALUE 0xC984E Kw_Wu16 655350.0 Time_ms 0.00 655350.0 FORMAT "%8.1" /end CHARACTERISTIC
/begin CHARACTERISTIC DSM_WucMinDiff_C "Minimale Differenztemperatur für warm up cycle" VALUE 0xC9850 Kw_Ws16 6553.500 TempDiff_Cels -3276.800 3276.700 FORMAT "%8.3" /end CHARACTERISTIC
/begin CHARACTERISTIC DSM_WucMinTemp_C "Minimaltemperatur für warm up cycle" VALUE 0xC9852 Kw_Ws16 950.000 Temp_Cels -50.140 899.860 FORMAT "%8.3" EXTENDED_LIMITS -3549.940 3003.560 /end CHARACTERISTIC
/begin MEASUREMENT DSC_stTstTrigger_mp "Zustand Testeranforderung an DSM Scheduler" UBYTE OneToOne 1 100 0.00 255.0 FORMAT "%5.1" ECU_ADDRESS 0x8FE604 /end MEASUREMENT
/begin MEASUREMENT DSMDur_ctDfctDur1 "Wert Fehlerdauerzähler" UWORD OneToOne 1 100 0.00 65535.00 FORMAT "%8.2" ECU_ADDRESS 0x7F8BF4 /end MEASUREMENT
/begin MEASUREMENT DSMDur_ctDfctDur2 "Wert Fehlerdauerzähler 2" UWORD OneToOne 1 100 0.00 65535.00 FORMAT "%8.2" ECU_ADDRESS 0x7F8BF6 /end MEASUREMENT
/begin MEASUREMENT DSMDur_stGlobalDefCnt_mp "Aktivierungs und Resetzustand der beiden globalen Fehlerdauerzähler" UBYTE OneToOne 1 100 0.00 255.0 FORMAT "%5.1" ECU_ADDRESS 0x6F808C /end MEASUREMENT
/begin FUNCTION dsched "" /begin DEF_CHARACTERISTIC DSCHED_numSelFID_C /end DEF_CHARACTERISTIC /end FUNCTION
/begin FUNCTION dsched_msg "" /end FUNCTION
/begin FUNCTION dsched_uic "" /begin OUT_MEASUREMENT DSC_stTstTrigger_mp /end OUT_MEASUREMENT /end FUNCTION
/begin FUNCTION dsm ""
 /begin DEF_CHARACTERISTIC DSM_cnvMilKmFCM_Offset_C DSM_cnvMilKmFCM_Slope_C DSM_Class1Mil_C DSM_Class1TFlc_C DSM_Class1Flc_C DSM_Class1THlc_C DSM_Class1Hlc_C DSM_Class1Scatt_C DSM_Class1TDlcPen_C DSM_Class1DlcPen_C DSM_Class1TDlc_C DSM_Class1DlcKd_C DSM_Class1Dlc_C DSM_Class1Prio_C DSM_Class1SysLamp_C DSM_Class1ResErf_C DSM_Class1Readiness_C DSM_Class2Mil_C DSM_Class2TFlc_C DSM_Class2Flc_C DSM_Class2THlc_C DSM_Class2Hlc_C DSM_Class2Scatt_C DSM_Class2TDlcPen_C DSM_Class2DlcPen_C DSM_Class2TDlc_C DSM_Class2DlcKd_C DSM_Class2Dlc_C DSM_Class2Prio_C DSM_Class2SysLamp_C DSM_Class2ResErf_C DSM_Class2Readiness_C DSM_Class3Mil_C DSM_Class3TFlc_C DSM_Class3Flc_C DSM_Class3THlc_C DSM_Class3Hlc_C DSM_Class3Scatt_C DSM_Class3TDlcPen_C DSM_Class3DlcPen_C DSM_Class3TDlc_C DSM_Class3DlcKd_C DSM_Class3Dlc_C DSM_Class3Prio_C DSM_Class3SysLamp_C DSM_Class3ResErf_C DSM_Class3Readiness_C DSM_Class4Mil_C DSM_Class4TFlc_C DSM_Class4Flc_C DSM_Class4THlc_C DSM_Class4Hlc_C DSM_Class4Scatt_C DSM_Class4TDlcPen_C DSM_Class4DlcPen_C DSM_Class4TDlc_C DSM_Class4DlcKd_C DSM_Class4Dlc_C DSM_Class4Prio_C DSM_Class4SysLamp_C DSM_Class4ResErf_C DSM_Class4Readiness_C DSM_Class5Mil_C DSM_Class5TFlc_C DSM_Class5Flc_C DSM_Class5THlc_C DSM_Class5Hlc_C DSM_Class5Scatt_C DSM_Class5TDlcPen_C DSM_Class5DlcPen_C DSM_Class5TDlc_C DSM_Class5DlcKd_C DSM_Class5Dlc_C DSM_Class5Prio_C DSM_Class5SysLamp_C DSM_Class5ResErf_C DSM_Class5Readiness_C DSM_Class6Mil_C DSM_Class6TFlc_C DSM_Class6Flc_C DSM_Class6THlc_C DSM_Class6Hlc_C DSM_Class6Scatt_C DSM_Class6TDlcPen_C DSM_Class6DlcPen_C DSM_Class6TDlc_C DSM_Class6DlcKd_C DSM_Class6Dlc_C DSM_Class6Prio_C DSM_Class6SysLamp_C DSM_Class6ResErf_C DSM_Class6Readiness_C DSM_Class7Mil_C DSM_Class7TFlc_C DSM_Class7Flc_C DSM_Class7THlc_C DSM_Class7Hlc_C DSM_Class7Scatt_C DSM_Class7TDlcPen_C DSM_Class7DlcPen_C DSM_Class7TDlc_C DSM_Class7DlcKd_C DSM_Class7Dlc_C DSM_Class7Prio_C DSM_Class7SysLamp_C DSM_Class7ResErf_C DSM_Class7Readiness_C DSM_Class8Mil_C DSM_Class8TFlc_C DSM_Class8Flc_C DSM_Class8THlc_C DSM_Class8Hlc_C DSM_Class8Scatt_C DSM_Class8TDlcPen_C DSM_Class8DlcPen_C DSM_Class8TDlc_C DSM_Class8DlcKd_C DSM_Class8Dlc_C DSM_Class8Prio_C DSM_Class8SysLamp_C DSM_Class8ResErf_C DSM_Class8Readiness_C DSM_Class9Mil_C DSM_Class9TFlc_C DSM_Class9Flc_C DSM_Class9THlc_C DSM_Class9Hlc_C DSM_Class9Scatt_C DSM_Class9TDlcPen_C DSM_Class9DlcPen_C DSM_Class9TDlc_C DSM_Class9DlcKd_C DSM_Class9Dlc_C DSM_Class9Prio_C DSM_Class9SysLamp_C DSM_Class9ResErf_C DSM_Class9Readiness_C DSM_Class10Mil_C DSM_Class10TFlc_C DSM_Class10Flc_C DSM_Class10THlc_C DSM_Class10Hlc_C DSM_Class10Scatt_C DSM_Class10TDlcPen_C DSM_Class10DlcPen_C DSM_Class10TDlc_C DSM_Class10DlcKd_C DSM_Class10Dlc_C DSM_Class10Prio_C DSM_Class10SysLamp_C DSM_Class10ResErf_C DSM_Class10Readiness_C DSM_Class11Mil_C DSM_Class11TFlc_C DSM_Class11Flc_C DSM_Class11THlc_C DSM_Class11Hlc_C DSM_Class11Scatt_C DSM_Class11TDlcPen_C DSM_Class11DlcPen_C DSM_Class11TDlc_C DSM_Class11DlcKd_C DSM_Class11Dlc_C DSM_Class11Prio_C DSM_Class11SysLamp_C DSM_Class11ResErf_C DSM_Class11Readiness_C DSM_Class12Mil_C DSM_Class12TFlc_C DSM_Class12Flc_C DSM_Class12THlc_C DSM_Class12Hlc_C DSM_Class12Scatt_C DSM_Class12TDlcPen_C DSM_Class12DlcPen_C DSM_Class12TDlc_C DSM_Class12DlcKd_C DSM_Class12Dlc_C DSM_Class12Prio_C DSM_Class12SysLamp_C DSM_Class12ResErf_C DSM_Class12Readiness_C DSM_Class13Mil_C DSM_Class13TFlc_C DSM_Class13Flc_C DSM_Class13THlc_C DSM_Class13Hlc_C DSM_Class13Scatt_C DSM_Class13TDlcPen_C DSM_Class13DlcPen_C DSM_Class13TDlc_C DSM_Class13DlcKd_C DSM_Class13Dlc_C DSM_Class13Prio_C DSM_Class13SysLamp_C DSM_Class13ResErf_C DSM_Class13Readiness_C DSM_Class14Mil_C DSM_Class14TFlc_C DSM_Class14Flc_C DSM_Class14THlc_C DSM_Class14Hlc_C DSM_Class14Scatt_C DSM_Class14TDlcPen_C DSM_Class14DlcPen_C DSM_Class14TDlc_C DSM_Class14DlcKd_C DSM_Class14Dlc_C DSM_Class14Prio_C DSM_Class14SysLamp_C DSM_Class14ResErf_C DSM_Class14Readiness_C DSM_Class15Mil_C DSM_Class15TFlc_C DSM_Class15Flc_C DSM_Class15THlc_C DSM_Class15Hlc_C DSM_Class15Scatt_C DSM_Class15TDlcPen_C DSM_Class15DlcPen_C DSM_Class15TDlc_C DSM_Class15DlcKd_C DSM_Class15Dlc_C DSM_Class15Prio_C DSM_Class15SysLamp_C DSM_Class15ResErf_C DSM_Class15Readiness_C DSM_Class16Mil_C DSM_Class16TFlc_C DSM_Class16Flc_C DSM_Class16THlc_C DSM_Class16Hlc_C DSM_Class16Scatt_C DSM_Class16TDlcPen_C DSM_Class16DlcPen_C DSM_Class16TDlc_C DSM_Class16DlcKd_C DSM_Class16Dlc_C DSM_Class16Prio_C DSM_Class16SysLamp_C DSM_Class16ResErf_C DSM_Class16Readiness_C DSM_Class17Mil_C DSM_Class17TFlc_C DSM_Class17Flc_C DSM_Class17THlc_C DSM_Class17Hlc_C DSM_Class17Scatt_C DSM_Class17TDlcPen_C DSM_Class17DlcPen_C DSM_Class17TDlc_C DSM_Class17DlcKd_C DSM_Class17Dlc_C DSM_Class17Prio_C DSM_Class17SysLamp_C DSM_Class17ResErf_C DSM_Class17Readiness_C DSM_Class18Mil_C DSM_Class18TFlc_C DSM_Class18Flc_C DSM_Class18THlc_C DSM_Class18Hlc_C DSM_Class18Scatt_C DSM_Class18TDlcPen_C DSM_Class18DlcPen_C DSM_Class18TDlc_C DSM_Class18DlcKd_C DSM_Class18Dlc_C DSM_Class18Prio_C DSM_Class18SysLamp_C DSM_Class18ResErf_C DSM_Class18Readiness_C DSM_Class19Mil_C DSM_Class19TFlc_C DSM_Class19Flc_C DSM_Class19THlc_C DSM_Class19Hlc_C DSM_Class19Scatt_C DSM_Class19TDlcPen_C DSM_Class19DlcPen_C DSM_Class19TDlc_C DSM_Class19DlcKd_C DSM_Class19Dlc_C DSM_Class19Prio_C DSM_Class19SysLamp_C DSM_Class19ResErf_C DSM_Class19Readiness_C DSM_Class20Mil_C DSM_Class20TFlc_C DSM_Class20Flc_C DSM_Class20THlc_C DSM_Class20Hlc_C DSM_Class20Scatt_C DSM_Class20TDlcPen_C DSM_Class20DlcPen_C DSM_Class20TDlc_C DSM_Class20DlcKd_C DSM_Class20Dlc_C DSM_Class20Prio_C DSM_Class20SysLamp_C DSM_Class20ResErf_C DSM_Class20Readiness_C DSM_FCMClear_C DSM_FrzFrEnvironment_C DSM_stStepWidth_CA DSM_SysLampMode_C DSM_tiDCMin_C DSM_tiWucDelay_C DSM_WucMinDiff_C DSM_WucMinTemp_C /end DEF_CHARACTERISTIC
/end FUNCTION
/begin FUNCTION dsmdur ""
 /begin DEF_CHARACTERISTIC DSMDur_DfctDur1Mode_C DSMDur_DfctDur2Mode_C DSMDur_stDfctDur1Enable_C DSMDur_stDfctDur2Enable_C DSMDur_stDfctDur1Reset_C DSMDur_stDfctDur2Reset_C /end DEF_CHARACTERISTIC
/end FUNCTION
/begin FUNCTION dsmdur_msg "" /begin OUT_MEASUREMENT DSMDur_ctDfctDur1 DSMDur_ctDfctDur2 /end OUT_MEASUREMENT /end FUNCTION
/begin FUNCTION dsmdur_uic "" /begin OUT_MEASUREMENT DSMDur_stGlobalDefCnt_mp /end OUT_MEASUREMENT /end FUNCTION
/begin COMPU_METHOD ClassTrigger "Verbale Umrechnung für DSM_Class%TFlc_C und DSM_Class%THlc_C" TAB_VERB "%6.3" "-" COMPU_TAB_REF ClassTrigger /end COMPU_METHOD
/begin COMPU_VTAB ClassTrigger "Verbale Umrechnung für DSM_Class%TFlc_C und DSM_Class%THlc_C" TAB_VERB 4 0 "no handling" 1 "time quantum" 2 "driving cycle" 3 "warm up cycle" /end COMPU_VTAB
/begin COMPU_METHOD ClassTriggerTDlc "Verbale Umrechnung für DSM_Class%TDlc_C und DSM_Class%TDlcPen_C" TAB_VERB "%6.3" "-" COMPU_TAB_REF ClassTriggerTDlc /end COMPU_METHOD
/begin COMPU_VTAB ClassTriggerTDlc "Verbale Umrechnung für DSM_Class%TDlc_C und DSM_Class%TDlcPen_C" TAB_VERB 4 0 "no handling" 1 "each afterrun_1" 2 "each afterrun_2" 3 "warm up cycle" /end COMPU_VTAB
/begin COMPU_METHOD FidName "Verbale Umrechnung für Fid-Namen" TAB_VERB "%6.3" "-" COMPU_TAB_REF FidName /end COMPU_METHOD
/begin COMPU_VTAB FidName "Verbale Umrechnung für Fid-Namen" TAB_VERB 1466 0 "Fid_unused" 4097 "Fid_ACCIRevErr_MAX" 4098 "Fid_ACCRevErr_MAX" 4099 "Fid_ACC_AliveErr_MAX" 4100 "Fid_ACC_CsErr_MAX" 4101 "Fid_ACC_TiOutErr_MAX" 4102 "Fid_ACCtl_MAX" 4103 "Fid_ACCtlDflt1_MAX" 4104 "Fid_ACCtlDflt2_MAX" 4105 "Fid_ACCtl_ACTrqErr_MAX" 4106 "Fid_ACCtl_CTSErr_MAX" 4107 "Fid_ACCtl_FanErr_MAX" 4108 "Fid_ACCtl_TGearbxErr_MAX" 4109 "Fid_ACCtl_VSSErr_MAX" 4110 "Fid_ACTrqC_MAX" 4111 "Fid_AFSCD_MAX" 4112 "Fid_AFSCD_AirPerTime_MAX" 4113 "Fid_AFSCD_PlOffsDrft_MAX" 4114 "Fid_AFSCD_PlSetyDrft_MAX" 4115 "Fid_AFSCD_SRCCorrAirm_MAX" 4116 "Fid_AFSCD_SRCDcyc_MAX" 4117 "Fid_AFSCD_SRCRawAirm_MAX" 4118 "Fid_AFSCD_SRCRefSig_MAX" 4119 "Fid_AFS_CanMon_MAX" 4120 "Fid_AFS_GenDisableCond_MAX" 4121 "Fid_AOHt_AltErr_MAX" 4122 "Fid_AOHt_ShutOffErr_MAX" 4123 "Fid_APP1_MAX" 4124 "Fid_APP2_MAX" 4125 "Fid_APPKickdown_MAX" 4126 "Fid_APSCD_MAX" 4127 "Fid_ARSOff_MAX" 4128 "Fid_ASDdc_MAX" 4129 "Fid_ASModSwtOffEng_MAX" 4130 "Fid_ASModSwtOffIndVol_MAX" 4131 "Fid_AccPed_MAX" 4132 "Fid_AccPedBrkPres_MAX" 4133 "Fid_AccPedVel_MAX" 4134 "Fid_AccPed_Brk_MAX" 4135 "Fid_AirCtl_MAX" 4136 "Fid_AirCtlNeg_MAX" 4137 "Fid_AirCtlNeg2_MAX" 4138 "Fid_AirCtlPFltEGRRed_MAX" 4139 "Fid_AirCtlPlateBreak_MAX" 4140 "Fid_AirCtlPlateBreakActv_MAX" 4141 "Fid_AirCtlPos_MAX" 4142 "Fid_AirCtlPos2_MAX" 4143 "Fid_AirCtl_Brk_MAX" 4144 "Fid_BPSCDMon_MAX" 4145 "Fid_CTSCDFlTemp_MAX" 4146 "Fid_CTSCD_Plaus_MAX" 4147 "Fid_ClgDynTst_MAX" 4148 "Fid_CmbChb_MAX" 4149 "Fid_CoDT_GripDeb_MAX" 4150 "Fid_CoEngIRevSys1_MAX" 4151 "Fid_CoEngIRevSys2_MAX" 4152 "Fid_CoEngIRevVeh_MAX" 4153 "Fid_CoEngPFltErr_MAX" 4154 "Fid_CoEngRevSys1_MAX" 4155 "Fid_CoEngRevSys2_MAX" 4156 "Fid_CoEngRevVeh_MAX" 4157 "Fid_CoEngShOffTst_MAX" 4158 "Fid_CoEngSoftShOffTV_MAX" 4159 "Fid_CoEng_ActrPrt_MAX" 4160 "Fid_CoEng_Nrml2Strt_MAX" 4161 "Fid_CoEng_PwrStgEnable_MAX" 4162 "Fid_CoEng_trqLimErr_MAX" 4163 "Fid_CoEng_trqLimErr1_MAX" 4164 "Fid_CoEng_trqLimErr2_MAX" 4165 "Fid_CoEng_trqLimErr3_MAX" 4166 "Fid_CoEng_trqLimErr4_MAX" 4167 "Fid_CoVM_StabDem_Err_MAX" 4168 "Fid_CoVehtrqLimErr_MAX" 4169 "Fid_CpBVlvOff_MAX" 4170 "Fid_CrCtlShutOffIr_MAX" 4171 "Fid_CrCtl_ASCTimeout_MAX" 4172 "Fid_CrCtl_CanDef_MAX" 4173 "Fid_CrCtl_KombiTimeout_MAX" 4174 "Fid_CrCtl_vCrCtl_MAX" 4175 "Fid_DCCIRevErr_MAX" 4176 "Fid_DCCRevErr_MAX" 4177 "Fid_DCC_AliveErr_MAX" 4178 "Fid_DCC_CsErr_MAX" 4179 "Fid_DCC_PlausErr_MAX" 4180 "Fid_DCC_TiOutErr_MAX" 4181 "Fid_DSM_Wuc_MAX" 4182 "Fid_EATSCDTSubs_MAX" 4183 "Fid_EBAFCD_MAX" 4184 "Fid_EBFCD_MAX" 4185 "Fid_ECU_MAX" 4186 "Fid_EGSysCoLSU0_MAX" 4187 "Fid_EGSysCoNSC_MAX" 4188 "Fid_EGSysCoOxi_MAX" 4189 "Fid_EGSysCoTrbn_MAX" 4190 "Fid_EGSysCoTube0_MAX" 4191 "Fid_EGSysCoTube1_MAX" 4192 "Fid_EGSysHtgDel_MAX" 4193 "Fid_EGSysNSC_MAX" 4194 "Fid_EGSysOxiCat_MAX" 4195 "Fid_EGSysPresEnv_MAX" 4196 "Fid_EGSysStrt_MAX" 4197 "Fid_EGSysTemp_MAX" 4198 "Fid_EGSysTrbn_MAX" 4199 "Fid_EGSysTube_MAX" 4200 "Fid_EGSys_AP_MAX" 4201 "Fid_EGTRgnLck_MAX" 4202 "Fid_EGTTempGvnrAirCtl_MAX" 4203 "Fid_EGTTempGvnrInr_MAX" 4204 "Fid_EGTTempGvnrOutr_MAX" 4205 "Fid_EMCCD_ShutOff_MAX" 4206 "Fid_ETClbCorActv_MAX" 4207 "Fid_EngCTSCD_MAX" 4208 "Fid_EngMCaSBackUp_MAX" 4209 "Fid_EngMCrSBackUp_MAX" 4210 "Fid_EngMTEng_MAX" 4211 "Fid_EngMTrqFrcPDiff_MAX" 4212 "Fid_EngMVVeh_MAX" 4213 "Fid_EngM_ChkStrtSpd_MAX" 4214 "Fid_EngPrt_nLimErr_MAX" 4215 "Fid_FBC_MAX" 4216 "Fid_FBCMonI_MAX" 4217 "Fid_FMASwtOff1_MAX" 4218 "Fid_FMASwtOff3_MAX" 4219 "Fid_FMTC_AirCorr_MAX" 4220 "Fid_FMTC_SOECorr_MAX" 4221 "Fid_FTSCDErr_MAX" 4222 "Fid_FWOscDet_MAX" 4223 "Fid_FanCtl_MAX" 4224 "Fid_FanGbxOil_MAX" 4225 "Fid_FlMngFullLdRglOff_MAX" 4226 "Fid_FlMngSmkDefect_MAX" 4227 "Fid_FlSysCTSSens_MAX" 4228 "Fid_FlSysDens_MAX" 4229 "Fid_FlSysFTSSens_MAX" 4230 "Fid_FrmMngAPP_MAX" 4231 "Fid_FrmMngARS_MAX" 4232 "Fid_FrmMngAddLevl_MAX" 4233 "Fid_FrmMngBrk_MAX" 4234 "Fid_FrmMngBrkDef_MAX" 4235 "Fid_FrmMngCoEng_MAX" 4236 "Fid_FrmMngCoEng_St2_MAX" 4237 "Fid_FrmMngConvDef_MAX" 4238 "Fid_FrmMngEngOvrSpd_MAX" 4239 "Fid_FrmMngEngRpmTemp_MAX" 4240 "Fid_FrmMngEngSpd_MAX" 4241 "Fid_FrmMngInjDU1_MAX" 4242 "Fid_FrmMngInjDU2_MAX" 4243 "Fid_FrmMngInjVlv_MAX" 4244 "Fid_FrmMngOBDCtl_MAX" 4245 "Fid_FrmMngPFltDef_MAX" 4246 "Fid_FrmMngParkConsumer_MAX" 4247 "Fid_FrmMngPla_DSC_MAX" 4248 "Fid_FrmMngPla_EGS_MAX" 4249 "Fid_FrmMngPowerTrainCAN_MAX" 4250 "Fid_FrmMngPwrMngLIGovSt_MAX" 4251 "Fid_FrmMngSIG_ARS_MAX" 4252 "Fid_FrmMngSIG_DSC_MAX" 4253 "Fid_FrmMngSig_EGS_MAX" 4254 "Fid_FrmMngTO_ARS_MAX" 4255 "Fid_FrmMngTO_DSC_MAX" 4256 "Fid_FrmMngTo_EGS_MAX" 4257 "Fid_FrmMngTrqGearbx_MAX" 4258 "Fid_FrmMngWaterVlv_MAX" 4259 "Fid_FrmMng_ST_TORQ_MAX" 4260 "Fid_FrmMng_stTrq_MAX" 4261 "Fid_FrmMngnSetpoint_MAX" 4262 "Fid_FrmMngpVal_MAX" 4263 "Fid_FrmMngtEng_MAX" 4264 "Fid_GearbxDrvAway_MAX" 4265 "Fid_GearbxDrvAwayInactiv_MAX" 4266 "Fid_GearbxPtCANErr_MAX" 4267 "Fid_GearbxTrqLimErr_MAX" 4268 "Fid_Gearbx_GearDet_MAX" 4269 "Fid_Gearbx_TrqIntv_Err_MAX" 4270 "Fid_GlwCtl1_MAX" 4271 "Fid_HDC_MAX" 4272 "Fid_IndSys1_MAX" 4273 "Fid_IndSys2_MAX" 4274 "Fid_InjCrvCoErr_MAX" 4275 "Fid_InjCtl_qLimErr_MAX" 4276 "Fid_InjVCDCls_MAX" 4277 "Fid_InjVlvActrTemp_MAX" 4278 "Fid_InjVlvInjLim_MAX" 4279 "Fid_InjVlvMon_MAX" 4280 "Fid_InjVlvNVC_MAX" 4281 "Fid_InjVlvSetUpVolt_MAX" 4282 "Fid_InjVlvWvCorOff_MAX" 4283 "Fid_LIGovSetpDrvAway_MAX" 4284 "Fid_LIGovSetpointDrvAwy_MAX" 4285 "Fid_LIGovUbr_MAX" 4286 "Fid_LSUCDMon0_MAX" 4287 "Fid_LSUCDO20_MAX" 4288 "Fid_LSUCDRi0_MAX" 4289 "Fid_LSUCDactiv0_MAX" 4290 "Fid_LSUCDlsu0_MAX" 4291 "Fid_LSUClbSched_MAX" 4292 "Fid_LSUCtl0_MAX" 4293 "Fid_LSUMonAllChecks_MAX" 4294 "Fid_LSUMonPlausChk_MAX" 4295 "Fid_Layer_FI_TANS_MAX" 4296 "Fid_Layer_FI_TUMG_MAX" 4297 "Fid_Layer_MANHYDR_MAX" 4298 "Fid_Layer_MANLUFT_MAX" 4299 "Fid_MSidCD_ECU_MAX" 4300 "Fid_MSidCD_Pin_MAX" 4301 "Fid_MeUnCDCalcI_MAX" 4302 "Fid_OTSCD_MAX" 4303 "Fid_PCR_MAX" 4304 "Fid_PCRBalGvnr_MAX" 4305 "Fid_PCRExtnLimActr_MAX" 4306 "Fid_PCRGvnrDvtNeg_MAX" 4307 "Fid_PCRGvnrDvtPos_MAX" 4308 "Fid_PCRLPGvnrDvtNeg_MAX" 4309 "Fid_PCRLPGvnrDvtPos_MAX" 4310 "Fid_PCRSurgeLIGov_MAX" 4311 "Fid_PCR_LP_MAX" 4312 "Fid_PCR_LPMS_MAX" 4313 "Fid_PCR_MS_MAX" 4314 "Fid_PCR_SurgeDet_MAX" 4315 "Fid_PCVCDCalcI_MAX" 4316 "Fid_PFltAshCor_MAX" 4317 "Fid_PFltAshCorRgn_MAX" 4318 "Fid_PFltBrk_MAX" 4319 "Fid_PFltChar_MAX" 4320 "Fid_PFltChngPar_MAX" 4321 "Fid_PFltClth_MAX" 4322 "Fid_PFltDiagRls1_MAX" 4323 "Fid_PFltDiagRls2_MAX" 4324 "Fid_PFltDynChk_MAX" 4325 "Fid_PFltEngPrtRgnMon_MAX" 4326 "Fid_PFltGearDet_MAX" 4327 "Fid_PFltHsLnChk_MAX" 4328 "Fid_PFltLckRgnErr_MAX" 4329 "Fid_PFltLckRgnFuel_MAX" 4330 "Fid_PFltNumPFltErr_MAX" 4331 "Fid_PFltNumPFltErrLck_MAX" 4332 "Fid_PFltPPreErr_MAX" 4333 "Fid_PFltPlausPres_MAX" 4334 "Fid_PFltPlausTemp_MAX" 4335 "Fid_PFltPresPlausProj_MAX" 4336 "Fid_PFltPresSensFrz_MAX" 4337 "Fid_PFltPresSensHsLn_MAX" 4338 "Fid_PFltSRCPres_MAX" 4339 "Fid_PFltSRCTemp_MAX" 4340 "Fid_PFltSimOn_MAX" 4341 "Fid_PFltSpdVeh_MAX" 4342 "Fid_PFltSuc_MAX" 4343 "Fid_PFltTempAir_MAX" 4344 "Fid_PFltTempClnt_MAX" 4345 "Fid_PFltTempOxiPre_MAX" 4346 "Fid_PFltTempPre_MAX" 4347 "Fid_PFltTempSensFrz_MAX" 4348 "Fid_PFltVltgBatt_MAX" 4349 "Fid_RailCDRPSErrChk_MAX" 4350 "Fid_RailCDSubstVal_MAX" 4351 "Fid_RailCD_PMonStrt_MAX" 4352 "Fid_RailCtlMode_MAX" 4353 "Fid_RailMeUn0Blk_MAX" 4354 "Fid_RailMeUn0Rls_MAX" 4355 "Fid_RailMeUn1Blk_MAX" 4356 "Fid_RailMeUn1Rls_MAX" 4357 "Fid_RailMeUn2Blk_MAX" 4358 "Fid_RailMeUn2Rls_MAX" 4359 "Fid_RailMeUn3Blk_MAX" 4360 "Fid_RailMeUn3Rls_MAX" 4361 "Fid_RailMeUn4Blk_MAX" 4362 "Fid_RailMeUn4Rls_MAX" 4363 "Fid_RailMeUnCtlMode_MAX" 4364 "Fid_RailPCV0Blk_MAX" 4365 "Fid_RailPCV0Rls_MAX" 4366 "Fid_RailPCV1Blk_MAX" 4367 "Fid_RailPCV1Rls_MAX" 4368 "Fid_RailPCV2Blk_MAX" 4369 "Fid_RailPCV2Rls_MAX" 4370 "Fid_RailPCV3Blk_MAX" 4371 "Fid_RailPCV3Rls_MAX" 4372 "Fid_RailPCV4Blk_MAX" 4373 "Fid_RailPCV4Rls_MAX" 4374 "Fid_RailPCV5Blk_MAX" 4375 "Fid_RailPCV5Rls_MAX" 4376 "Fid_RailPCVCtlMode_MAX" 4377 "Fid_RailSetPointLim_MAX" 4378 "Fid_RailSetPointRed_MAX" 4379 "Fid_ShuttrCTS_MAX" 4380 "Fid_ShuttrEGS_MAX" 4381 "Fid_SignalsTstNLim_MAX" 4382 "Fid_StSysImmo_MAX" 4383 "Fid_StSysStrtTipGbxDat_MAX" 4384 "Fid_T15CDCanError_MAX" 4385 "Fid_T50CDSig_MAX" 4386 "Fid_UsrDa_FDCOff_MAX" 4387 "Fid_VehDaDist_MAX" 4388 "Fid_ZFCClbActv_MAX" 4389 "Fid_ZFCCldCmbCham_MAX" 8193 "Fid_ACCIRevErr_MIN" 8194 "Fid_ACCRevErr_MIN" 8195 "Fid_ACC_AliveErr_MIN" 8196 "Fid_ACC_CsErr_MIN" 8197 "Fid_ACC_TiOutErr_MIN" 8198 "Fid_ACCtl_MIN" 8199 "Fid_ACCtlDflt1_MIN" 8200 "Fid_ACCtlDflt2_MIN" 8201 "Fid_ACCtl_ACTrqErr_MIN" 8202 "Fid_ACCtl_CTSErr_MIN" 8203 "Fid_ACCtl_FanErr_MIN" 8204 "Fid_ACCtl_TGearbxErr_MIN" 8205 "Fid_ACCtl_VSSErr_MIN" 8206 "Fid_ACTrqC_MIN" 8207 "Fid_AFSCD_MIN" 8208 "Fid_AFSCD_AirPerTime_MIN" 8209 "Fid_AFSCD_PlOffsDrft_MIN" 8210 "Fid_AFSCD_PlSetyDrft_MIN" 8211 "Fid_AFSCD_SRCCorrAirm_MIN" 8212 "Fid_AFSCD_SRCDcyc_MIN" 8213 "Fid_AFSCD_SRCRawAirm_MIN" 8214 "Fid_AFSCD_SRCRefSig_MIN" 8215 "Fid_AFS_CanMon_MIN" 8216 "Fid_AFS_GenDisableCond_MIN" 8217 "Fid_AOHt_AltErr_MIN" 8218 "Fid_AOHt_ShutOffErr_MIN" 8219 "Fid_APP1_MIN" 8220 "Fid_APP2_MIN" 8221 "Fid_APPKickdown_MIN" 8222 "Fid_APSCD_MIN" 8223 "Fid_ARSOff_MIN" 8224 "Fid_ASDdc_MIN" 8225 "Fid_ASModSwtOffEng_MIN" 8226 "Fid_ASModSwtOffIndVol_MIN" 8227 "Fid_AccPed_MIN" 8228 "Fid_AccPedBrkPres_MIN" 8229 "Fid_AccPedVel_MIN" 8230 "Fid_AccPed_Brk_MIN" 8231 "Fid_AirCtl_MIN" 8232 "Fid_AirCtlNeg_MIN" 8233 "Fid_AirCtlNeg2_MIN" 8234 "Fid_AirCtlPFltEGRRed_MIN" 8235 "Fid_AirCtlPlateBreak_MIN" 8236 "Fid_AirCtlPlateBreakActv_MIN" 8237 "Fid_AirCtlPos_MIN" 8238 "Fid_AirCtlPos2_MIN" 8239 "Fid_AirCtl_Brk_MIN" 8240 "Fid_BPSCDMon_MIN" 8241 "Fid_CTSCDFlTemp_MIN" 8242 "Fid_CTSCD_Plaus_MIN" 8243 "Fid_ClgDynTst_MIN" 8244 "Fid_CmbChb_MIN" 8245 "Fid_CoDT_GripDeb_MIN" 8246 "Fid_CoEngIRevSys1_MIN" 8247 "Fid_CoEngIRevSys2_MIN" 8248 "Fid_CoEngIRevVeh_MIN" 8249 "Fid_CoEngPFltErr_MIN" 8250 "Fid_CoEngRevSys1_MIN" 8251 "Fid_CoEngRevSys2_MIN" 8252 "Fid_CoEngRevVeh_MIN" 8253 "Fid_CoEngShOffTst_MIN" 8254 "Fid_CoEngSoftShOffTV_MIN" 8255 "Fid_CoEng_ActrPrt_MIN" 8256 "Fid_CoEng_Nrml2Strt_MIN" 8257 "Fid_CoEng_PwrStgEnable_MIN" 8258 "Fid_CoEng_trqLimErr_MIN" 8259 "Fid_CoEng_trqLimErr1_MIN" 8260 "Fid_CoEng_trqLimErr2_MIN" 8261 "Fid_CoEng_trqLimErr3_MIN" 8262 "Fid_CoEng_trqLimErr4_MIN" 8263 "Fid_CoVM_StabDem_Err_MIN" 8264 "Fid_CoVehtrqLimErr_MIN" 8265 "Fid_CpBVlvOff_MIN" 8266 "Fid_CrCtlShutOffIr_MIN" 8267 "Fid_CrCtl_ASCTimeout_MIN" 8268 "Fid_CrCtl_CanDef_MIN" 8269 "Fid_CrCtl_KombiTimeout_MIN" 8270 "Fid_CrCtl_vCrCtl_MIN" 8271 "Fid_DCCIRevErr_MIN" 8272 "Fid_DCCRevErr_MIN" 8273 "Fid_DCC_AliveErr_MIN" 8274 "Fid_DCC_CsErr_MIN" 8275 "Fid_DCC_PlausErr_MIN" 8276 "Fid_DCC_TiOutErr_MIN" 8277 "Fid_DSM_Wuc_MIN" 8278 "Fid_EATSCDTSubs_MIN" 8279 "Fid_EBAFCD_MIN" 8280 "Fid_EBFCD_MIN" 8281 "Fid_ECU_MIN" 8282 "Fid_EGSysCoLSU0_MIN" 8283 "Fid_EGSysCoNSC_MIN" 8284 "Fid_EGSysCoOxi_MIN" 8285 "Fid_EGSysCoTrbn_MIN" 8286 "Fid_EGSysCoTube0_MIN" 8287 "Fid_EGSysCoTube1_MIN" 8288 "Fid_EGSysHtgDel_MIN" 8289 "Fid_EGSysNSC_MIN" 8290 "Fid_EGSysOxiCat_MIN" 8291 "Fid_EGSysPresEnv_MIN" 8292 "Fid_EGSysStrt_MIN" 8293 "Fid_EGSysTemp_MIN" 8294 "Fid_EGSysTrbn_MIN" 8295 "Fid_EGSysTube_MIN" 8296 "Fid_EGSys_AP_MIN" 8297 "Fid_EGTRgnLck_MIN" 8298 "Fid_EGTTempGvnrAirCtl_MIN" 8299 "Fid_EGTTempGvnrInr_MIN" 8300 "Fid_EGTTempGvnrOutr_MIN" 8301 "Fid_EMCCD_ShutOff_MIN" 8302 "Fid_ETClbCorActv_MIN" 8303 "Fid_EngCTSCD_MIN" 8304 "Fid_EngMCaSBackUp_MIN" 8305 "Fid_EngMCrSBackUp_MIN" 8306 "Fid_EngMTEng_MIN" 8307 "Fid_EngMTrqFrcPDiff_MIN" 8308 "Fid_EngMVVeh_MIN" 8309 "Fid_EngM_ChkStrtSpd_MIN" 8310 "Fid_EngPrt_nLimErr_MIN" 8311 "Fid_FBC_MIN" 8312 "Fid_FBCMonI_MIN" 8313 "Fid_FMASwtOff1_MIN" 8314 "Fid_FMASwtOff3_MIN" 8315 "Fid_FMTC_AirCorr_MIN" 8316 "Fid_FMTC_SOECorr_MIN" 8317 "Fid_FTSCDErr_MIN" 8318 "Fid_FWOscDet_MIN" 8319 "Fid_FanCtl_MIN" 8320 "Fid_FanGbxOil_MIN" 8321 "Fid_FlMngFullLdRglOff_MIN" 8322 "Fid_FlMngSmkDefect_MIN" 8323 "Fid_FlSysCTSSens_MIN" 8324 "Fid_FlSysDens_MIN" 8325 "Fid_FlSysFTSSens_MIN" 8326 "Fid_FrmMngAPP_MIN" 8327 "Fid_FrmMngARS_MIN" 8328 "Fid_FrmMngAddLevl_MIN" 8329 "Fid_FrmMngBrk_MIN" 8330 "Fid_FrmMngBrkDef_MIN" 8331 "Fid_FrmMngCoEng_MIN" 8332 "Fid_FrmMngCoEng_St2_MIN" 8333 "Fid_FrmMngConvDef_MIN" 8334 "Fid_FrmMngEngOvrSpd_MIN" 8335 "Fid_FrmMngEngRpmTemp_MIN" 8336 "Fid_FrmMngEngSpd_MIN" 8337 "Fid_FrmMngInjDU1_MIN" 8338 "Fid_FrmMngInjDU2_MIN" 8339 "Fid_FrmMngInjVlv_MIN" 8340 "Fid_FrmMngOBDCtl_MIN" 8341 "Fid_FrmMngPFltDef_MIN" 8342 "Fid_FrmMngParkConsumer_MIN" 8343 "Fid_FrmMngPla_DSC_MIN" 8344 "Fid_FrmMngPla_EGS_MIN" 8345 "Fid_FrmMngPowerTrainCAN_MIN" 8346 "Fid_FrmMngPwrMngLIGovSt_MIN" 8347 "Fid_FrmMngSIG_ARS_MIN" 8348 "Fid_FrmMngSIG_DSC_MIN" 8349 "Fid_FrmMngSig_EGS_MIN" 8350 "Fid_FrmMngTO_ARS_MIN" 8351 "Fid_FrmMngTO_DSC_MIN" 8352 "Fid_FrmMngTo_EGS_MIN" 8353 "Fid_FrmMngTrqGearbx_MIN" 8354 "Fid_FrmMngWaterVlv_MIN" 8355 "Fid_FrmMng_ST_TORQ_MIN" 8356 "Fid_FrmMng_stTrq_MIN" 8357 "Fid_FrmMngnSetpoint_MIN" 8358 "Fid_FrmMngpVal_MIN" 8359 "Fid_FrmMngtEng_MIN" 8360 "Fid_GearbxDrvAway_MIN" 8361 "Fid_GearbxDrvAwayInactiv_MIN" 8362 "Fid_GearbxPtCANErr_MIN" 8363 "Fid_GearbxTrqLimErr_MIN" 8364 "Fid_Gearbx_GearDet_MIN" 8365 "Fid_Gearbx_TrqIntv_Err_MIN" 8366 "Fid_GlwCtl1_MIN" 8367 "Fid_HDC_MIN" 8368 "Fid_IndSys1_MIN" 8369 "Fid_IndSys2_MIN" 8370 "Fid_InjCrvCoErr_MIN" 8371 "Fid_InjCtl_qLimErr_MIN" 8372 "Fid_InjVCDCls_MIN" 8373 "Fid_InjVlvActrTemp_MIN" 8374 "Fid_InjVlvInjLim_MIN" 8375 "Fid_InjVlvMon_MIN" 8376 "Fid_InjVlvNVC_MIN" 8377 "Fid_InjVlvSetUpVolt_MIN" 8378 "Fid_InjVlvWvCorOff_MIN" 8379 "Fid_LIGovSetpDrvAway_MIN" 8380 "Fid_LIGovSetpointDrvAwy_MIN" 8381 "Fid_LIGovUbr_MIN" 8382 "Fid_LSUCDMon0_MIN" 8383 "Fid_LSUCDO20_MIN" 8384 "Fid_LSUCDRi0_MIN" 8385 "Fid_LSUCDactiv0_MIN" 8386 "Fid_LSUCDlsu0_MIN" 8387 "Fid_LSUClbSched_MIN" 8388 "Fid_LSUCtl0_MIN" 8389 "Fid_LSUMonAllChecks_MIN" 8390 "Fid_LSUMonPlausChk_MIN" 8391 "Fid_Layer_FI_TANS_MIN" 8392 "Fid_Layer_FI_TUMG_MIN" 8393 "Fid_Layer_MANHYDR_MIN" 8394 "Fid_Layer_MANLUFT_MIN" 8395 "Fid_MSidCD_ECU_MIN" 8396 "Fid_MSidCD_Pin_MIN" 8397 "Fid_MeUnCDCalcI_MIN" 8398 "Fid_OTSCD_MIN" 8399 "Fid_PCR_MIN" 8400 "Fid_PCRBalGvnr_MIN" 8401 "Fid_PCRExtnLimActr_MIN" 8402 "Fid_PCRGvnrDvtNeg_MIN" 8403 "Fid_PCRGvnrDvtPos_MIN" 8404 "Fid_PCRLPGvnrDvtNeg_MIN" 8405 "Fid_PCRLPGvnrDvtPos_MIN" 8406 "Fid_PCRSurgeLIGov_MIN" 8407 "Fid_PCR_LP_MIN" 8408 "Fid_PCR_LPMS_MIN" 8409 "Fid_PCR_MS_MIN" 8410 "Fid_PCR_SurgeDet_MIN" 8411 "Fid_PCVCDCalcI_MIN" 8412 "Fid_PFltAshCor_MIN" 8413 "Fid_PFltAshCorRgn_MIN" 8414 "Fid_PFltBrk_MIN" 8415 "Fid_PFltChar_MIN" 8416 "Fid_PFltChngPar_MIN" 8417 "Fid_PFltClth_MIN" 8418 "Fid_PFltDiagRls1_MIN" 8419 "Fid_PFltDiagRls2_MIN" 8420 "Fid_PFltDynChk_MIN" 8421 "Fid_PFltEngPrtRgnMon_MIN" 8422 "Fid_PFltGearDet_MIN" 8423 "Fid_PFltHsLnChk_MIN" 8424 "Fid_PFltLckRgnErr_MIN" 8425 "Fid_PFltLckRgnFuel_MIN" 8426 "Fid_PFltNumPFltErr_MIN" 8427 "Fid_PFltNumPFltErrLck_MIN" 8428 "Fid_PFltPPreErr_MIN" 8429 "Fid_PFltPlausPres_MIN" 8430 "Fid_PFltPlausTemp_MIN" 8431 "Fid_PFltPresPlausProj_MIN" 8432 "Fid_PFltPresSensFrz_MIN" 8433 "Fid_PFltPresSensHsLn_MIN" 8434 "Fid_PFltSRCPres_MIN" 8435 "Fid_PFltSRCTemp_MIN" 8436 "Fid_PFltSimOn_MIN" 8437 "Fid_PFltSpdVeh_MIN" 8438 "Fid_PFltSuc_MIN" 8439 "Fid_PFltTempAir_MIN" 8440 "Fid_PFltTempClnt_MIN" 8441 "Fid_PFltTempOxiPre_MIN" 8442 "Fid_PFltTempPre_MIN" 8443 "Fid_PFltTempSensFrz_MIN" 8444 "Fid_PFltVltgBatt_MIN" 8445 "Fid_RailCDRPSErrChk_MIN" 8446 "Fid_RailCDSubstVal_MIN" 8447 "Fid_RailCD_PMonStrt_MIN" 8448 "Fid_RailCtlMode_MIN" 8449 "Fid_RailMeUn0Blk_MIN" 8450 "Fid_RailMeUn0Rls_MIN" 8451 "Fid_RailMeUn1Blk_MIN" 8452 "Fid_RailMeUn1Rls_MIN" 8453 "Fid_RailMeUn2Blk_MIN" 8454 "Fid_RailMeUn2Rls_MIN" 8455 "Fid_RailMeUn3Blk_MIN" 8456 "Fid_RailMeUn3Rls_MIN" 8457 "Fid_RailMeUn4Blk_MIN" 8458 "Fid_RailMeUn4Rls_MIN" 8459 "Fid_RailMeUnCtlMode_MIN" 8460 "Fid_RailPCV0Blk_MIN" 8461 "Fid_RailPCV0Rls_MIN" 8462 "Fid_RailPCV1Blk_MIN" 8463 "Fid_RailPCV1Rls_MIN" 8464 "Fid_RailPCV2Blk_MIN" 8465 "Fid_RailPCV2Rls_MIN" 8466 "Fid_RailPCV3Blk_MIN" 8467 "Fid_RailPCV3Rls_MIN" 8468 "Fid_RailPCV4Blk_MIN" 8469 "Fid_RailPCV4Rls_MIN" 8470 "Fid_RailPCV5Blk_MIN" 8471 "Fid_RailPCV5Rls_MIN" 8472 "Fid_RailPCVCtlMode_MIN" 8473 "Fid_RailSetPointLim_MIN" 8474 "Fid_RailSetPointRed_MIN" 8475 "Fid_ShuttrCTS_MIN" 8476 "Fid_ShuttrEGS_MIN" 8477 "Fid_SignalsTstNLim_MIN" 8478 "Fid_StSysImmo_MIN" 8479 "Fid_StSysStrtTipGbxDat_MIN" 8480 "Fid_T15CDCanError_MIN" 8481 "Fid_T50CDSig_MIN" 8482 "Fid_UsrDa_FDCOff_MIN" 8483 "Fid_VehDaDist_MIN" 8484 "Fid_ZFCClbActv_MIN" 8485 "Fid_ZFCCldCmbCham_MIN" 16385 "Fid_ACCIRevErr_SIG" 16386 "Fid_ACCRevErr_SIG" 16387 "Fid_ACC_AliveErr_SIG" 16388 "Fid_ACC_CsErr_SIG" 16389 "Fid_ACC_TiOutErr_SIG" 16390 "Fid_ACCtl_SIG" 16391 "Fid_ACCtlDflt1_SIG" 16392 "Fid_ACCtlDflt2_SIG" 16393 "Fid_ACCtl_ACTrqErr_SIG" 16394 "Fid_ACCtl_CTSErr_SIG" 16395 "Fid_ACCtl_FanErr_SIG" 16396 "Fid_ACCtl_TGearbxErr_SIG" 16397 "Fid_ACCtl_VSSErr_SIG" 16398 "Fid_ACTrqC_SIG" 16399 "Fid_AFSCD_SIG" 16400 "Fid_AFSCD_AirPerTime_SIG" 16401 "Fid_AFSCD_PlOffsDrft_SIG" 16402 "Fid_AFSCD_PlSetyDrft_SIG" 16403 "Fid_AFSCD_SRCCorrAirm_SIG" 16404 "Fid_AFSCD_SRCDcyc_SIG" 16405 "Fid_AFSCD_SRCRawAirm_SIG" 16406 "Fid_AFSCD_SRCRefSig_SIG" 16407 "Fid_AFS_CanMon_SIG" 16408 "Fid_AFS_GenDisableCond_SIG" 16409 "Fid_AOHt_AltErr_SIG" 16410 "Fid_AOHt_ShutOffErr_SIG" 16411 "Fid_APP1_SIG" 16412 "Fid_APP2_SIG" 16413 "Fid_APPKickdown_SIG" 16414 "Fid_APSCD_SIG" 16415 "Fid_ARSOff_SIG" 16416 "Fid_ASDdc_SIG" 16417 "Fid_ASModSwtOffEng_SIG" 16418 "Fid_ASModSwtOffIndVol_SIG" 16419 "Fid_AccPed_SIG" 16420 "Fid_AccPedBrkPres_SIG" 16421 "Fid_AccPedVel_SIG" 16422 "Fid_AccPed_Brk_SIG" 16423 "Fid_AirCtl_SIG" 16424 "Fid_AirCtlNeg_SIG" 16425 "Fid_AirCtlNeg2_SIG" 16426 "Fid_AirCtlPFltEGRRed_SIG" 16427 "Fid_AirCtlPlateBreak_SIG" 16428 "Fid_AirCtlPlateBreakActv_SIG" 16429 "Fid_AirCtlPos_SIG" 16430 "Fid_AirCtlPos2_SIG" 16431 "Fid_AirCtl_Brk_SIG" 16432 "Fid_BPSCDMon_SIG" 16433 "Fid_CTSCDFlTemp_SIG" 16434 "Fid_CTSCD_Plaus_SIG" 16435 "Fid_ClgDynTst_SIG" 16436 "Fid_CmbChb_SIG" 16437 "Fid_CoDT_GripDeb_SIG" 16438 "Fid_CoEngIRevSys1_SIG" 16439 "Fid_CoEngIRevSys2_SIG" 16440 "Fid_CoEngIRevVeh_SIG" 16441 "Fid_CoEngPFltErr_SIG" 16442 "Fid_CoEngRevSys1_SIG" 16443 "Fid_CoEngRevSys2_SIG" 16444 "Fid_CoEngRevVeh_SIG" 16445 "Fid_CoEngShOffTst_SIG" 16446 "Fid_CoEngSoftShOffTV_SIG" 16447 "Fid_CoEng_ActrPrt_SIG" 16448 "Fid_CoEng_Nrml2Strt_SIG" 16449 "Fid_CoEng_PwrStgEnable_SIG" 16450 "Fid_CoEng_trqLimErr_SIG" 16451 "Fid_CoEng_trqLimErr1_SIG" 16452 "Fid_CoEng_trqLimErr2_SIG" 16453 "Fid_CoEng_trqLimErr3_SIG" 16454 "Fid_CoEng_trqLimErr4_SIG" 16455 "Fid_CoVM_StabDem_Err_SIG" 16456 "Fid_CoVehtrqLimErr_SIG" 16457 "Fid_CpBVlvOff_SIG" 16458 "Fid_CrCtlShutOffIr_SIG" 16459 "Fid_CrCtl_ASCTimeout_SIG" 16460 "Fid_CrCtl_CanDef_SIG" 16461 "Fid_CrCtl_KombiTimeout_SIG" 16462 "Fid_CrCtl_vCrCtl_SIG" 16463 "Fid_DCCIRevErr_SIG" 16464 "Fid_DCCRevErr_SIG" 16465 "Fid_DCC_AliveErr_SIG" 16466 "Fid_DCC_CsErr_SIG" 16467 "Fid_DCC_PlausErr_SIG" 16468 "Fid_DCC_TiOutErr_SIG" 16469 "Fid_DSM_Wuc_SIG" 16470 "Fid_EATSCDTSubs_SIG" 16471 "Fid_EBAFCD_SIG" 16472 "Fid_EBFCD_SIG" 16473 "Fid_ECU_SIG" 16474 "Fid_EGSysCoLSU0_SIG" 16475 "Fid_EGSysCoNSC_SIG" 16476 "Fid_EGSysCoOxi_SIG" 16477 "Fid_EGSysCoTrbn_SIG" 16478 "Fid_EGSysCoTube0_SIG" 16479 "Fid_EGSysCoTube1_SIG" 16480 "Fid_EGSysHtgDel_SIG" 16481 "Fid_EGSysNSC_SIG" 16482 "Fid_EGSysOxiCat_SIG" 16483 "Fid_EGSysPresEnv_SIG" 16484 "Fid_EGSysStrt_SIG" 16485 "Fid_EGSysTemp_SIG" 16486 "Fid_EGSysTrbn_SIG" 16487 "Fid_EGSysTube_SIG" 16488 "Fid_EGSys_AP_SIG" 16489 "Fid_EGTRgnLck_SIG" 16490 "Fid_EGTTempGvnrAirCtl_SIG" 16491 "Fid_EGTTempGvnrInr_SIG" 16492 "Fid_EGTTempGvnrOutr_SIG" 16493 "Fid_EMCCD_ShutOff_SIG" 16494 "Fid_ETClbCorActv_SIG" 16495 "Fid_EngCTSCD_SIG" 16496 "Fid_EngMCaSBackUp_SIG" 16497 "Fid_EngMCrSBackUp_SIG" 16498 "Fid_EngMTEng_SIG" 16499 "Fid_EngMTrqFrcPDiff_SIG" 16500 "Fid_EngMVVeh_SIG" 16501 "Fid_EngM_ChkStrtSpd_SIG" 16502 "Fid_EngPrt_nLimErr_SIG" 16503 "Fid_FBC_SIG" 16504 "Fid_FBCMonI_SIG" 16505 "Fid_FMASwtOff1_SIG" 16506 "Fid_FMASwtOff3_SIG" 16507 "Fid_FMTC_AirCorr_SIG" 16508 "Fid_FMTC_SOECorr_SIG" 16509 "Fid_FTSCDErr_SIG" 16510 "Fid_FWOscDet_SIG" 16511 "Fid_FanCtl_SIG" 16512 "Fid_FanGbxOil_SIG" 16513 "Fid_FlMngFullLdRglOff_SIG" 16514 "Fid_FlMngSmkDefect_SIG" 16515 "Fid_FlSysCTSSens_SIG" 16516 "Fid_FlSysDens_SIG" 16517 "Fid_FlSysFTSSens_SIG" 16518 "Fid_FrmMngAPP_SIG" 16519 "Fid_FrmMngARS_SIG" 16520 "Fid_FrmMngAddLevl_SIG" 16521 "Fid_FrmMngBrk_SIG" 16522 "Fid_FrmMngBrkDef_SIG" 16523 "Fid_FrmMngCoEng_SIG" 16524 "Fid_FrmMngCoEng_St2_SIG" 16525 "Fid_FrmMngConvDef_SIG" 16526 "Fid_FrmMngEngOvrSpd_SIG" 16527 "Fid_FrmMngEngRpmTemp_SIG" 16528 "Fid_FrmMngEngSpd_SIG" 16529 "Fid_FrmMngInjDU1_SIG" 16530 "Fid_FrmMngInjDU2_SIG" 16531 "Fid_FrmMngInjVlv_SIG" 16532 "Fid_FrmMngOBDCtl_SIG" 16533 "Fid_FrmMngPFltDef_SIG" 16534 "Fid_FrmMngParkConsumer_SIG" 16535 "Fid_FrmMngPla_DSC_SIG" 16536 "Fid_FrmMngPla_EGS_SIG" 16537 "Fid_FrmMngPowerTrainCAN_SIG" 16538 "Fid_FrmMngPwrMngLIGovSt_SIG" 16539 "Fid_FrmMngSIG_ARS_SIG" 16540 "Fid_FrmMngSIG_DSC_SIG" 16541 "Fid_FrmMngSig_EGS_SIG" 16542 "Fid_FrmMngTO_ARS_SIG" 16543 "Fid_FrmMngTO_DSC_SIG" 16544 "Fid_FrmMngTo_EGS_SIG" 16545 "Fid_FrmMngTrqGearbx_SIG" 16546 "Fid_FrmMngWaterVlv_SIG" 16547 "Fid_FrmMng_ST_TORQ_SIG" 16548 "Fid_FrmMng_stTrq_SIG" 16549 "Fid_FrmMngnSetpoint_SIG" 16550 "Fid_FrmMngpVal_SIG" 16551 "Fid_FrmMngtEng_SIG" 16552 "Fid_GearbxDrvAway_SIG" 16553 "Fid_GearbxDrvAwayInactiv_SIG" 16554 "Fid_GearbxPtCANErr_SIG" 16555 "Fid_GearbxTrqLimErr_SIG" 16556 "Fid_Gearbx_GearDet_SIG" 16557 "Fid_Gearbx_TrqIntv_Err_SIG" 16558 "Fid_GlwCtl1_SIG" 16559 "Fid_HDC_SIG" 16560 "Fid_IndSys1_SIG" 16561 "Fid_IndSys2_SIG" 16562 "Fid_InjCrvCoErr_SIG" 16563 "Fid_InjCtl_qLimErr_SIG" 16564 "Fid_InjVCDCls_SIG" 16565 "Fid_InjVlvActrTemp_SIG" 16566 "Fid_InjVlvInjLim_SIG" 16567 "Fid_InjVlvMon_SIG" 16568 "Fid_InjVlvNVC_SIG" 16569 "Fid_InjVlvSetUpVolt_SIG" 16570 "Fid_InjVlvWvCorOff_SIG" 16571 "Fid_LIGovSetpDrvAway_SIG" 16572 "Fid_LIGovSetpointDrvAwy_SIG" 16573 "Fid_LIGovUbr_SIG" 16574 "Fid_LSUCDMon0_SIG" 16575 "Fid_LSUCDO20_SIG" 16576 "Fid_LSUCDRi0_SIG" 16577 "Fid_LSUCDactiv0_SIG" 16578 "Fid_LSUCDlsu0_SIG" 16579 "Fid_LSUClbSched_SIG" 16580 "Fid_LSUCtl0_SIG" 16581 "Fid_LSUMonAllChecks_SIG" 16582 "Fid_LSUMonPlausChk_SIG" 16583 "Fid_Layer_FI_TANS_SIG" 16584 "Fid_Layer_FI_TUMG_SIG" 16585 "Fid_Layer_MANHYDR_SIG" 16586 "Fid_Layer_MANLUFT_SIG" 16587 "Fid_MSidCD_ECU_SIG" 16588 "Fid_MSidCD_Pin_SIG" 16589 "Fid_MeUnCDCalcI_SIG" 16590 "Fid_OTSCD_SIG" 16591 "Fid_PCR_SIG" 16592 "Fid_PCRBalGvnr_SIG" 16593 "Fid_PCRExtnLimActr_SIG" 16594 "Fid_PCRGvnrDvtNeg_SIG" 16595 "Fid_PCRGvnrDvtPos_SIG" 16596 "Fid_PCRLPGvnrDvtNeg_SIG" 16597 "Fid_PCRLPGvnrDvtPos_SIG" 16598 "Fid_PCRSurgeLIGov_SIG" 16599 "Fid_PCR_LP_SIG" 16600 "Fid_PCR_LPMS_SIG" 16601 "Fid_PCR_MS_SIG" 16602 "Fid_PCR_SurgeDet_SIG" 16603 "Fid_PCVCDCalcI_SIG" 16604 "Fid_PFltAshCor_SIG" 16605 "Fid_PFltAshCorRgn_SIG" 16606 "Fid_PFltBrk_SIG" 16607 "Fid_PFltChar_SIG" 16608 "Fid_PFltChngPar_SIG" 16609 "Fid_PFltClth_SIG" 16610 "Fid_PFltDiagRls1_SIG" 16611 "Fid_PFltDiagRls2_SIG" 16612 "Fid_PFltDynChk_SIG" 16613 "Fid_PFltEngPrtRgnMon_SIG" 16614 "Fid_PFltGearDet_SIG" 16615 "Fid_PFltHsLnChk_SIG" 16616 "Fid_PFltLckRgnErr_SIG" 16617 "Fid_PFltLckRgnFuel_SIG" 16618 "Fid_PFltNumPFltErr_SIG" 16619 "Fid_PFltNumPFltErrLck_SIG" 16620 "Fid_PFltPPreErr_SIG" 16621 "Fid_PFltPlausPres_SIG" 16622 "Fid_PFltPlausTemp_SIG" 16623 "Fid_PFltPresPlausProj_SIG" 16624 "Fid_PFltPresSensFrz_SIG" 16625 "Fid_PFltPresSensHsLn_SIG" 16626 "Fid_PFltSRCPres_SIG" 16627 "Fid_PFltSRCTemp_SIG" 16628 "Fid_PFltSimOn_SIG" 16629 "Fid_PFltSpdVeh_SIG" 16630 "Fid_PFltSuc_SIG" 16631 "Fid_PFltTempAir_SIG" 16632 "Fid_PFltTempClnt_SIG" 16633 "Fid_PFltTempOxiPre_SIG" 16634 "Fid_PFltTempPre_SIG" 16635 "Fid_PFltTempSensFrz_SIG" 16636 "Fid_PFltVltgBatt_SIG" 16637 "Fid_RailCDRPSErrChk_SIG" 16638 "Fid_RailCDSubstVal_SIG" 16639 "Fid_RailCD_PMonStrt_SIG" 16640 "Fid_RailCtlMode_SIG" 16641 "Fid_RailMeUn0Blk_SIG" 16642 "Fid_RailMeUn0Rls_SIG" 16643 "Fid_RailMeUn1Blk_SIG" 16644 "Fid_RailMeUn1Rls_SIG" 16645 "Fid_RailMeUn2Blk_SIG" 16646 "Fid_RailMeUn2Rls_SIG" 16647 "Fid_RailMeUn3Blk_SIG" 16648 "Fid_RailMeUn3Rls_SIG" 16649 "Fid_RailMeUn4Blk_SIG" 16650 "Fid_RailMeUn4Rls_SIG" 16651 "Fid_RailMeUnCtlMode_SIG" 16652 "Fid_RailPCV0Blk_SIG" 16653 "Fid_RailPCV0Rls_SIG" 16654 "Fid_RailPCV1Blk_SIG" 16655 "Fid_RailPCV1Rls_SIG" 16656 "Fid_RailPCV2Blk_SIG" 16657 "Fid_RailPCV2Rls_SIG" 16658 "Fid_RailPCV3Blk_SIG" 16659 "Fid_RailPCV3Rls_SIG" 16660 "Fid_RailPCV4Blk_SIG" 16661 "Fid_RailPCV4Rls_SIG" 16662 "Fid_RailPCV5Blk_SIG" 16663 "Fid_RailPCV5Rls_SIG" 16664 "Fid_RailPCVCtlMode_SIG" 16665 "Fid_RailSetPointLim_SIG" 16666 "Fid_RailSetPointRed_SIG" 16667 "Fid_ShuttrCTS_SIG" 16668 "Fid_ShuttrEGS_SIG" 16669 "Fid_SignalsTstNLim_SIG" 16670 "Fid_StSysImmo_SIG" 16671 "Fid_StSysStrtTipGbxDat_SIG" 16672 "Fid_T15CDCanError_SIG" 16673 "Fid_T50CDSig_SIG" 16674 "Fid_UsrDa_FDCOff_SIG" 16675 "Fid_VehDaDist_SIG" 16676 "Fid_ZFCClbActv_SIG" 16677 "Fid_ZFCCldCmbCham_SIG" 32769 "Fid_ACCIRevErr_NPL" 32770 "Fid_ACCRevErr_NPL" 32771 "Fid_ACC_AliveErr_NPL" 32772 "Fid_ACC_CsErr_NPL" 32773 "Fid_ACC_TiOutErr_NPL" 32774 "Fid_ACCtl_NPL" 32775 "Fid_ACCtlDflt1_NPL" 32776 "Fid_ACCtlDflt2_NPL" 32777 "Fid_ACCtl_ACTrqErr_NPL" 32778 "Fid_ACCtl_CTSErr_NPL" 32779 "Fid_ACCtl_FanErr_NPL" 32780 "Fid_ACCtl_TGearbxErr_NPL" 32781 "Fid_ACCtl_VSSErr_NPL" 32782 "Fid_ACTrqC_NPL" 32783 "Fid_AFSCD_NPL" 32784 "Fid_AFSCD_AirPerTime_NPL" 32785 "Fid_AFSCD_PlOffsDrft_NPL" 32786 "Fid_AFSCD_PlSetyDrft_NPL" 32787 "Fid_AFSCD_SRCCorrAirm_NPL" 32788 "Fid_AFSCD_SRCDcyc_NPL" 32789 "Fid_AFSCD_SRCRawAirm_NPL" 32790 "Fid_AFSCD_SRCRefSig_NPL" 32791 "Fid_AFS_CanMon_NPL" 32792 "Fid_AFS_GenDisableCond_NPL" 32793 "Fid_AOHt_AltErr_NPL" 32794 "Fid_AOHt_ShutOffErr_NPL" 32795 "Fid_APP1_NPL" 32796 "Fid_APP2_NPL" 32797 "Fid_APPKickdown_NPL" 32798 "Fid_APSCD_NPL" 32799 "Fid_ARSOff_NPL" 32800 "Fid_ASDdc_NPL" 32801 "Fid_ASModSwtOffEng_NPL" 32802 "Fid_ASModSwtOffIndVol_NPL" 32803 "Fid_AccPed_NPL" 32804 "Fid_AccPedBrkPres_NPL" 32805 "Fid_AccPedVel_NPL" 32806 "Fid_AccPed_Brk_NPL" 32807 "Fid_AirCtl_NPL" 32808 "Fid_AirCtlNeg_NPL" 32809 "Fid_AirCtlNeg2_NPL" 32810 "Fid_AirCtlPFltEGRRed_NPL" 32811 "Fid_AirCtlPlateBreak_NPL" 32812 "Fid_AirCtlPlateBreakActv_NPL" 32813 "Fid_AirCtlPos_NPL" 32814 "Fid_AirCtlPos2_NPL" 32815 "Fid_AirCtl_Brk_NPL" 32816 "Fid_BPSCDMon_NPL" 32817 "Fid_CTSCDFlTemp_NPL" 32818 "Fid_CTSCD_Plaus_NPL" 32819 "Fid_ClgDynTst_NPL" 32820 "Fid_CmbChb_NPL" 32821 "Fid_CoDT_GripDeb_NPL" 32822 "Fid_CoEngIRevSys1_NPL" 32823 "Fid_CoEngIRevSys2_NPL" 32824 "Fid_CoEngIRevVeh_NPL" 32825 "Fid_CoEngPFltErr_NPL" 32826 "Fid_CoEngRevSys1_NPL" 32827 "Fid_CoEngRevSys2_NPL" 32828 "Fid_CoEngRevVeh_NPL" 32829 "Fid_CoEngShOffTst_NPL" 32830 "Fid_CoEngSoftShOffTV_NPL" 32831 "Fid_CoEng_ActrPrt_NPL" 32832 "Fid_CoEng_Nrml2Strt_NPL" 32833 "Fid_CoEng_PwrStgEnable_NPL" 32834 "Fid_CoEng_trqLimErr_NPL" 32835 "Fid_CoEng_trqLimErr1_NPL" 32836 "Fid_CoEng_trqLimErr2_NPL" 32837 "Fid_CoEng_trqLimErr3_NPL" 32838 "Fid_CoEng_trqLimErr4_NPL" 32839 "Fid_CoVM_StabDem_Err_NPL" 32840 "Fid_CoVehtrqLimErr_NPL" 32841 "Fid_CpBVlvOff_NPL" 32842 "Fid_CrCtlShutOffIr_NPL" 32843 "Fid_CrCtl_ASCTimeout_NPL" 32844 "Fid_CrCtl_CanDef_NPL" 32845 "Fid_CrCtl_KombiTimeout_NPL" 32846 "Fid_CrCtl_vCrCtl_NPL" 32847 "Fid_DCCIRevErr_NPL" 32848 "Fid_DCCRevErr_NPL" 32849 "Fid_DCC_AliveErr_NPL" 32850 "Fid_DCC_CsErr_NPL" 32851 "Fid_DCC_PlausErr_NPL" 32852 "Fid_DCC_TiOutErr_NPL" 32853 "Fid_DSM_Wuc_NPL" 32854 "Fid_EATSCDTSubs_NPL" 32855 "Fid_EBAFCD_NPL" 32856 "Fid_EBFCD_NPL" 32857 "Fid_ECU_NPL" 32858 "Fid_EGSysCoLSU0_NPL" 32859 "Fid_EGSysCoNSC_NPL" 32860 "Fid_EGSysCoOxi_NPL" 32861 "Fid_EGSysCoTrbn_NPL" 32862 "Fid_EGSysCoTube0_NPL" 32863 "Fid_EGSysCoTube1_NPL" 32864 "Fid_EGSysHtgDel_NPL" 32865 "Fid_EGSysNSC_NPL" 32866 "Fid_EGSysOxiCat_NPL" 32867 "Fid_EGSysPresEnv_NPL" 32868 "Fid_EGSysStrt_NPL" 32869 "Fid_EGSysTemp_NPL" 32870 "Fid_EGSysTrbn_NPL" 32871 "Fid_EGSysTube_NPL" 32872 "Fid_EGSys_AP_NPL" 32873 "Fid_EGTRgnLck_NPL" 32874 "Fid_EGTTempGvnrAirCtl_NPL" 32875 "Fid_EGTTempGvnrInr_NPL" 32876 "Fid_EGTTempGvnrOutr_NPL" 32877 "Fid_EMCCD_ShutOff_NPL" 32878 "Fid_ETClbCorActv_NPL" 32879 "Fid_EngCTSCD_NPL" 32880 "Fid_EngMCaSBackUp_NPL" 32881 "Fid_EngMCrSBackUp_NPL" 32882 "Fid_EngMTEng_NPL" 32883 "Fid_EngMTrqFrcPDiff_NPL" 32884 "Fid_EngMVVeh_NPL" 32885 "Fid_EngM_ChkStrtSpd_NPL" 32886 "Fid_EngPrt_nLimErr_NPL" 32887 "Fid_FBC_NPL" 32888 "Fid_FBCMonI_NPL" 32889 "Fid_FMASwtOff1_NPL" 32890 "Fid_FMASwtOff3_NPL" 32891 "Fid_FMTC_AirCorr_NPL" 32892 "Fid_FMTC_SOECorr_NPL" 32893 "Fid_FTSCDErr_NPL" 32894 "Fid_FWOscDet_NPL" 32895 "Fid_FanCtl_NPL" 32896 "Fid_FanGbxOil_NPL" 32897 "Fid_FlMngFullLdRglOff_NPL" 32898 "Fid_FlMngSmkDefect_NPL" 32899 "Fid_FlSysCTSSens_NPL" 32900 "Fid_FlSysDens_NPL" 32901 "Fid_FlSysFTSSens_NPL" 32902 "Fid_FrmMngAPP_NPL" 32903 "Fid_FrmMngARS_NPL" 32904 "Fid_FrmMngAddLevl_NPL" 32905 "Fid_FrmMngBrk_NPL" 32906 "Fid_FrmMngBrkDef_NPL" 32907 "Fid_FrmMngCoEng_NPL" 32908 "Fid_FrmMngCoEng_St2_NPL" 32909 "Fid_FrmMngConvDef_NPL" 32910 "Fid_FrmMngEngOvrSpd_NPL" 32911 "Fid_FrmMngEngRpmTemp_NPL" 32912 "Fid_FrmMngEngSpd_NPL" 32913 "Fid_FrmMngInjDU1_NPL" 32914 "Fid_FrmMngInjDU2_NPL" 32915 "Fid_FrmMngInjVlv_NPL" 32916 "Fid_FrmMngOBDCtl_NPL" 32917 "Fid_FrmMngPFltDef_NPL" 32918 "Fid_FrmMngParkConsumer_NPL" 32919 "Fid_FrmMngPla_DSC_NPL" 32920 "Fid_FrmMngPla_EGS_NPL" 32921 "Fid_FrmMngPowerTrainCAN_NPL" 32922 "Fid_FrmMngPwrMngLIGovSt_NPL" 32923 "Fid_FrmMngSIG_ARS_NPL" 32924 "Fid_FrmMngSIG_DSC_NPL" 32925 "Fid_FrmMngSig_EGS_NPL" 32926 "Fid_FrmMngTO_ARS_NPL" 32927 "Fid_FrmMngTO_DSC_NPL" 32928 "Fid_FrmMngTo_EGS_NPL" 32929 "Fid_FrmMngTrqGearbx_NPL" 32930 "Fid_FrmMngWaterVlv_NPL" 32931 "Fid_FrmMng_ST_TORQ_NPL" 32932 "Fid_FrmMng_stTrq_NPL" 32933 "Fid_FrmMngnSetpoint_NPL" 32934 "Fid_FrmMngpVal_NPL" 32935 "Fid_FrmMngtEng_NPL" 32936 "Fid_GearbxDrvAway_NPL" 32937 "Fid_GearbxDrvAwayInactiv_NPL" 32938 "Fid_GearbxPtCANErr_NPL" 32939 "Fid_GearbxTrqLimErr_NPL" 32940 "Fid_Gearbx_GearDet_NPL" 32941 "Fid_Gearbx_TrqIntv_Err_NPL" 32942 "Fid_GlwCtl1_NPL" 32943 "Fid_HDC_NPL" 32944 "Fid_IndSys1_NPL" 32945 "Fid_IndSys2_NPL" 32946 "Fid_InjCrvCoErr_NPL" 32947 "Fid_InjCtl_qLimErr_NPL" 32948 "Fid_InjVCDCls_NPL" 32949 "Fid_InjVlvActrTemp_NPL" 32950 "Fid_InjVlvInjLim_NPL" 32951 "Fid_InjVlvMon_NPL" 32952 "Fid_InjVlvNVC_NPL" 32953 "Fid_InjVlvSetUpVolt_NPL" 32954 "Fid_InjVlvWvCorOff_NPL" 32955 "Fid_LIGovSetpDrvAway_NPL" 32956 "Fid_LIGovSetpointDrvAwy_NPL" 32957 "Fid_LIGovUbr_NPL" 32958 "Fid_LSUCDMon0_NPL" 32959 "Fid_LSUCDO20_NPL" 32960 "Fid_LSUCDRi0_NPL" 32961 "Fid_LSUCDactiv0_NPL" 32962 "Fid_LSUCDlsu0_NPL" 32963 "Fid_LSUClbSched_NPL" 32964 "Fid_LSUCtl0_NPL" 32965 "Fid_LSUMonAllChecks_NPL" 32966 "Fid_LSUMonPlausChk_NPL" 32967 "Fid_Layer_FI_TANS_NPL" 32968 "Fid_Layer_FI_TUMG_NPL" 32969 "Fid_Layer_MANHYDR_NPL" 32970 "Fid_Layer_MANLUFT_NPL" 32971 "Fid_MSidCD_ECU_NPL" 32972 "Fid_MSidCD_Pin_NPL" 32973 "Fid_MeUnCDCalcI_NPL" 32974 "Fid_OTSCD_NPL" 32975 "Fid_PCR_NPL" 32976 "Fid_PCRBalGvnr_NPL" 32977 "Fid_PCRExtnLimActr_NPL" 32978 "Fid_PCRGvnrDvtNeg_NPL" 32979 "Fid_PCRGvnrDvtPos_NPL" 32980 "Fid_PCRLPGvnrDvtNeg_NPL" 32981 "Fid_PCRLPGvnrDvtPos_NPL" 32982 "Fid_PCRSurgeLIGov_NPL" 32983 "Fid_PCR_LP_NPL" 32984 "Fid_PCR_LPMS_NPL" 32985 "Fid_PCR_MS_NPL" 32986 "Fid_PCR_SurgeDet_NPL" 32987 "Fid_PCVCDCalcI_NPL" 32988 "Fid_PFltAshCor_NPL" 32989 "Fid_PFltAshCorRgn_NPL" 32990 "Fid_PFltBrk_NPL" 32991 "Fid_PFltChar_NPL" 32992 "Fid_PFltChngPar_NPL" 32993 "Fid_PFltClth_NPL" 32994 "Fid_PFltDiagRls1_NPL" 32995 "Fid_PFltDiagRls2_NPL" 32996 "Fid_PFltDynChk_NPL" 32997 "Fid_PFltEngPrtRgnMon_NPL" 32998 "Fid_PFltGearDet_NPL" 32999 "Fid_PFltHsLnChk_NPL" 33000 "Fid_PFltLckRgnErr_NPL" 33001 "Fid_PFltLckRgnFuel_NPL" 33002 "Fid_PFltNumPFltErr_NPL" 33003 "Fid_PFltNumPFltErrLck_NPL" 33004 "Fid_PFltPPreErr_NPL" 33005 "Fid_PFltPlausPres_NPL" 33006 "Fid_PFltPlausTemp_NPL" 33007 "Fid_PFltPresPlausProj_NPL" 33008 "Fid_PFltPresSensFrz_NPL" 33009 "Fid_PFltPresSensHsLn_NPL" 33010 "Fid_PFltSRCPres_NPL" 33011 "Fid_PFltSRCTemp_NPL" 33012 "Fid_PFltSimOn_NPL" 33013 "Fid_PFltSpdVeh_NPL" 33014 "Fid_PFltSuc_NPL" 33015 "Fid_PFltTempAir_NPL" 33016 "Fid_PFltTempClnt_NPL" 33017 "Fid_PFltTempOxiPre_NPL" 33018 "Fid_PFltTempPre_NPL" 33019 "Fid_PFltTempSensFrz_NPL" 33020 "Fid_PFltVltgBatt_NPL" 33021 "Fid_RailCDRPSErrChk_NPL" 33022 "Fid_RailCDSubstVal_NPL" 33023 "Fid_RailCD_PMonStrt_NPL" 33024 "Fid_RailCtlMode_NPL" 33025 "Fid_RailMeUn0Blk_NPL" 33026 "Fid_RailMeUn0Rls_NPL" 33027 "Fid_RailMeUn1Blk_NPL" 33028 "Fid_RailMeUn1Rls_NPL" 33029 "Fid_RailMeUn2Blk_NPL" 33030 "Fid_RailMeUn2Rls_NPL" 33031 "Fid_RailMeUn3Blk_NPL" 33032 "Fid_RailMeUn3Rls_NPL" 33033 "Fid_RailMeUn4Blk_NPL" 33034 "Fid_RailMeUn4Rls_NPL" 33035 "Fid_RailMeUnCtlMode_NPL" 33036 "Fid_RailPCV0Blk_NPL" 33037 "Fid_RailPCV0Rls_NPL" 33038 "Fid_RailPCV1Blk_NPL" 33039 "Fid_RailPCV1Rls_NPL" 33040 "Fid_RailPCV2Blk_NPL" 33041 "Fid_RailPCV2Rls_NPL" 33042 "Fid_RailPCV3Blk_NPL" 33043 "Fid_RailPCV3Rls_NPL" 33044 "Fid_RailPCV4Blk_NPL" 33045 "Fid_RailPCV4Rls_NPL" 33046 "Fid_RailPCV5Blk_NPL" 33047 "Fid_RailPCV5Rls_NPL" 33048 "Fid_RailPCVCtlMode_NPL" 33049 "Fid_RailSetPointLim_NPL" 33050 "Fid_RailSetPointRed_NPL" 33051 "Fid_ShuttrCTS_NPL" 33052 "Fid_ShuttrEGS_NPL" 33053 "Fid_SignalsTstNLim_NPL" 33054 "Fid_StSysImmo_NPL" 33055 "Fid_StSysStrtTipGbxDat_NPL" 33056 "Fid_T15CDCanError_NPL" 33057 "Fid_T50CDSig_NPL" 33058 "Fid_UsrDa_FDCOff_NPL" 33059 "Fid_VehDaDist_NPL" 33060 "Fid_ZFCClbActv_NPL" 33061 "Fid_ZFCCldCmbCham_NPL" 61441 "Fid_ACCIRevErr" 61442 "Fid_ACCRevErr" 61443 "Fid_ACC_AliveErr" 61444 "Fid_ACC_CsErr" 61445 "Fid_ACC_TiOutErr" 61446 "Fid_ACCtl" 61447 "Fid_ACCtlDflt1" 61448 "Fid_ACCtlDflt2" 61449 "Fid_ACCtl_ACTrqErr" 61450 "Fid_ACCtl_CTSErr" 61451 "Fid_ACCtl_FanErr" 61452 "Fid_ACCtl_TGearbxErr" 61453 "Fid_ACCtl_VSSErr" 61454 "Fid_ACTrqC" 61455 "Fid_AFSCD" 61456 "Fid_AFSCD_AirPerTime" 61457 "Fid_AFSCD_PlOffsDrft" 61458 "Fid_AFSCD_PlSetyDrft" 61459 "Fid_AFSCD_SRCCorrAirm" 61460 "Fid_AFSCD_SRCDcyc" 61461 "Fid_AFSCD_SRCRawAirm" 61462 "Fid_AFSCD_SRCRefSig" 61463 "Fid_AFS_CanMon" 61464 "Fid_AFS_GenDisableCond" 61465 "Fid_AOHt_AltErr" 61466 "Fid_AOHt_ShutOffErr" 61467 "Fid_APP1" 61468 "Fid_APP2" 61469 "Fid_APPKickdown" 61470 "Fid_APSCD" 61471 "Fid_ARSOff" 61472 "Fid_ASDdc" 61473 "Fid_ASModSwtOffEng" 61474 "Fid_ASModSwtOffIndVol" 61475 "Fid_AccPed" 61476 "Fid_AccPedBrkPres" 61477 "Fid_AccPedVel" 61478 "Fid_AccPed_Brk" 61479 "Fid_AirCtl" 61480 "Fid_AirCtlNeg" 61481 "Fid_AirCtlNeg2" 61482 "Fid_AirCtlPFltEGRRed" 61483 "Fid_AirCtlPlateBreak" 61484 "Fid_AirCtlPlateBreakActv" 61485 "Fid_AirCtlPos" 61486 "Fid_AirCtlPos2" 61487 "Fid_AirCtl_Brk" 61488 "Fid_BPSCDMon" 61489 "Fid_CTSCDFlTemp" 61490 "Fid_CTSCD_Plaus" 61491 "Fid_ClgDynTst" 61492 "Fid_CmbChb" 61493 "Fid_CoDT_GripDeb" 61494 "Fid_CoEngIRevSys1" 61495 "Fid_CoEngIRevSys2" 61496 "Fid_CoEngIRevVeh" 61497 "Fid_CoEngPFltErr" 61498 "Fid_CoEngRevSys1" 61499 "Fid_CoEngRevSys2" 61500 "Fid_CoEngRevVeh" 61501 "Fid_CoEngShOffTst" 61502 "Fid_CoEngSoftShOffTV" 61503 "Fid_CoEng_ActrPrt" 61504 "Fid_CoEng_Nrml2Strt" 61505 "Fid_CoEng_PwrStgEnable" 61506 "Fid_CoEng_trqLimErr" 61507 "Fid_CoEng_trqLimErr1" 61508 "Fid_CoEng_trqLimErr2" 61509 "Fid_CoEng_trqLimErr3" 61510 "Fid_CoEng_trqLimErr4" 61511 "Fid_CoVM_StabDem_Err" 61512 "Fid_CoVehtrqLimErr" 61513 "Fid_CpBVlvOff" 61514 "Fid_CrCtlShutOffIr" 61515 "Fid_CrCtl_ASCTimeout" 61516 "Fid_CrCtl_CanDef" 61517 "Fid_CrCtl_KombiTimeout" 61518 "Fid_CrCtl_vCrCtl" 61519 "Fid_DCCIRevErr" 61520 "Fid_DCCRevErr" 61521 "Fid_DCC_AliveErr" 61522 "Fid_DCC_CsErr" 61523 "Fid_DCC_PlausErr" 61524 "Fid_DCC_TiOutErr" 61525 "Fid_DSM_Wuc" 61526 "Fid_EATSCDTSubs" 61527 "Fid_EBAFCD" 61528 "Fid_EBFCD" 61529 "Fid_ECU" 61530 "Fid_EGSysCoLSU0" 61531 "Fid_EGSysCoNSC" 61532 "Fid_EGSysCoOxi" 61533 "Fid_EGSysCoTrbn" 61534 "Fid_EGSysCoTube0" 61535 "Fid_EGSysCoTube1" 61536 "Fid_EGSysHtgDel" 61537 "Fid_EGSysNSC" 61538 "Fid_EGSysOxiCat" 61539 "Fid_EGSysPresEnv" 61540 "Fid_EGSysStrt" 61541 "Fid_EGSysTemp" 61542 "Fid_EGSysTrbn" 61543 "Fid_EGSysTube" 61544 "Fid_EGSys_AP" 61545 "Fid_EGTRgnLck" 61546 "Fid_EGTTempGvnrAirCtl" 61547 "Fid_EGTTempGvnrInr" 61548 "Fid_EGTTempGvnrOutr" 61549 "Fid_EMCCD_ShutOff" 61550 "Fid_ETClbCorActv" 61551 "Fid_EngCTSCD" 61552 "Fid_EngMCaSBackUp" 61553 "Fid_EngMCrSBackUp" 61554 "Fid_EngMTEng" 61555 "Fid_EngMTrqFrcPDiff" 61556 "Fid_EngMVVeh" 61557 "Fid_EngM_ChkStrtSpd" 61558 "Fid_EngPrt_nLimErr" 61559 "Fid_FBC" 61560 "Fid_FBCMonI" 61561 "Fid_FMASwtOff1" 61562 "Fid_FMASwtOff3" 61563 "Fid_FMTC_AirCorr" 61564 "Fid_FMTC_SOECorr" 61565 "Fid_FTSCDErr" 61566 "Fid_FWOscDet" 61567 "Fid_FanCtl" 61568 "Fid_FanGbxOil" 61569 "Fid_FlMngFullLdRglOff" 61570 "Fid_FlMngSmkDefect" 61571 "Fid_FlSysCTSSens" 61572 "Fid_FlSysDens" 61573 "Fid_FlSysFTSSens" 61574 "Fid_FrmMngAPP" 61575 "Fid_FrmMngARS" 61576 "Fid_FrmMngAddLevl" 61577 "Fid_FrmMngBrk" 61578 "Fid_FrmMngBrkDef" 61579 "Fid_FrmMngCoEng" 61580 "Fid_FrmMngCoEng_St2" 61581 "Fid_FrmMngConvDef" 61582 "Fid_FrmMngEngOvrSpd" 61583 "Fid_FrmMngEngRpmTemp" 61584 "Fid_FrmMngEngSpd" 61585 "Fid_FrmMngInjDU1" 61586 "Fid_FrmMngInjDU2" 61587 "Fid_FrmMngInjVlv" 61588 "Fid_FrmMngOBDCtl" 61589 "Fid_FrmMngPFltDef" 61590 "Fid_FrmMngParkConsumer" 61591 "Fid_FrmMngPla_DSC" 61592 "Fid_FrmMngPla_EGS" 61593 "Fid_FrmMngPowerTrainCAN" 61594 "Fid_FrmMngPwrMngLIGovSt" 61595 "Fid_FrmMngSIG_ARS" 61596 "Fid_FrmMngSIG_DSC" 61597 "Fid_FrmMngSig_EGS" 61598 "Fid_FrmMngTO_ARS" 61599 "Fid_FrmMngTO_DSC" 61600 "Fid_FrmMngTo_EGS" 61601 "Fid_FrmMngTrqGearbx" 61602 "Fid_FrmMngWaterVlv" 61603 "Fid_FrmMng_ST_TORQ" 61604 "Fid_FrmMng_stTrq" 61605 "Fid_FrmMngnSetpoint" 61606 "Fid_FrmMngpVal" 61607 "Fid_FrmMngtEng" 61608 "Fid_GearbxDrvAway" 61609 "Fid_GearbxDrvAwayInactiv" 61610 "Fid_GearbxPtCANErr" 61611 "Fid_GearbxTrqLimErr" 61612 "Fid_Gearbx_GearDet" 61613 "Fid_Gearbx_TrqIntv_Err" 61614 "Fid_GlwCtl1" 61615 "Fid_HDC" 61616 "Fid_IndSys1" 61617 "Fid_IndSys2" 61618 "Fid_InjCrvCoErr" 61619 "Fid_InjCtl_qLimErr" 61620 "Fid_InjVCDCls" 61621 "Fid_InjVlvActrTemp" 61622 "Fid_InjVlvInjLim" 61623 "Fid_InjVlvMon" 61624 "Fid_InjVlvNVC" 61625 "Fid_InjVlvSetUpVolt" 61626 "Fid_InjVlvWvCorOff" 61627 "Fid_LIGovSetpDrvAway" 61628 "Fid_LIGovSetpointDrvAwy" 61629 "Fid_LIGovUbr" 61630 "Fid_LSUCDMon0" 61631 "Fid_LSUCDO20" 61632 "Fid_LSUCDRi0" 61633 "Fid_LSUCDactiv0" 61634 "Fid_LSUCDlsu0" 61635 "Fid_LSUClbSched" 61636 "Fid_LSUCtl0" 61637 "Fid_LSUMonAllChecks" 61638 "Fid_LSUMonPlausChk" 61639 "Fid_Layer_FI_TANS" 61640 "Fid_Layer_FI_TUMG" 61641 "Fid_Layer_MANHYDR" 61642 "Fid_Layer_MANLUFT" 61643 "Fid_MSidCD_ECU" 61644 "Fid_MSidCD_Pin" 61645 "Fid_MeUnCDCalcI" 61646 "Fid_OTSCD" 61647 "Fid_PCR" 61648 "Fid_PCRBalGvnr" 61649 "Fid_PCRExtnLimActr" 61650 "Fid_PCRGvnrDvtNeg" 61651 "Fid_PCRGvnrDvtPos" 61652 "Fid_PCRLPGvnrDvtNeg" 61653 "Fid_PCRLPGvnrDvtPos" 61654 "Fid_PCRSurgeLIGov" 61655 "Fid_PCR_LP" 61656 "Fid_PCR_LPMS" 61657 "Fid_PCR_MS" 61658 "Fid_PCR_SurgeDet" 61659 "Fid_PCVCDCalcI" 61660 "Fid_PFltAshCor" 61661 "Fid_PFltAshCorRgn" 61662 "Fid_PFltBrk" 61663 "Fid_PFltChar" 61664 "Fid_PFltChngPar" 61665 "Fid_PFltClth" 61666 "Fid_PFltDiagRls1" 61667 "Fid_PFltDiagRls2" 61668 "Fid_PFltDynChk" 61669 "Fid_PFltEngPrtRgnMon" 61670 "Fid_PFltGearDet" 61671 "Fid_PFltHsLnChk" 61672 "Fid_PFltLckRgnErr" 61673 "Fid_PFltLckRgnFuel" 61674 "Fid_PFltNumPFltErr" 61675 "Fid_PFltNumPFltErrLck" 61676 "Fid_PFltPPreErr" 61677 "Fid_PFltPlausPres" 61678 "Fid_PFltPlausTemp" 61679 "Fid_PFltPresPlausProj" 61680 "Fid_PFltPresSensFrz" 61681 "Fid_PFltPresSensHsLn" 61682 "Fid_PFltSRCPres" 61683 "Fid_PFltSRCTemp" 61684 "Fid_PFltSimOn" 61685 "Fid_PFltSpdVeh" 61686 "Fid_PFltSuc" 61687 "Fid_PFltTempAir" 61688 "Fid_PFltTempClnt" 61689 "Fid_PFltTempOxiPre" 61690 "Fid_PFltTempPre" 61691 "Fid_PFltTempSensFrz" 61692 "Fid_PFltVltgBatt" 61693 "Fid_RailCDRPSErrChk" 61694 "Fid_RailCDSubstVal" 61695 "Fid_RailCD_PMonStrt" 61696 "Fid_RailCtlMode" 61697 "Fid_RailMeUn0Blk" 61698 "Fid_RailMeUn0Rls" 61699 "Fid_RailMeUn1Blk" 61700 "Fid_RailMeUn1Rls" 61701 "Fid_RailMeUn2Blk" 61702 "Fid_RailMeUn2Rls" 61703 "Fid_RailMeUn3Blk" 61704 "Fid_RailMeUn3Rls" 61705 "Fid_RailMeUn4Blk" 61706 "Fid_RailMeUn4Rls" 61707 "Fid_RailMeUnCtlMode" 61708 "Fid_RailPCV0Blk" 61709 "Fid_RailPCV0Rls" 61710 "Fid_RailPCV1Blk" 61711 "Fid_RailPCV1Rls" 61712 "Fid_RailPCV2Blk" 61713 "Fid_RailPCV2Rls" 61714 "Fid_RailPCV3Blk" 61715 "Fid_RailPCV3Rls" 61716 "Fid_RailPCV4Blk" 61717 "Fid_RailPCV4Rls" 61718 "Fid_RailPCV5Blk" 61719 "Fid_RailPCV5Rls" 61720 "Fid_RailPCVCtlMode" 61721 "Fid_RailSetPointLim" 61722 "Fid_RailSetPointRed" 61723 "Fid_ShuttrCTS" 61724 "Fid_ShuttrEGS" 61725 "Fid_SignalsTstNLim" 61726 "Fid_StSysImmo" 61727 "Fid_StSysStrtTipGbxDat" 61728 "Fid_T15CDCanError" 61729 "Fid_T50CDSig" 61730 "Fid_UsrDa_FDCOff" 61731 "Fid_VehDaDist" 61732 "Fid_ZFCClbActv" 61733 "Fid_ZFCCldCmbCham" /end COMPU_VTAB
/begin COMPU_METHOD LengthKm "Länge in Kilometer" RAT_FUNC "%6.2" "km" COEFFS 0 1 0 0 0 1 /end COMPU_METHOD
/begin COMPU_METHOD Mil "Verbale Umrechnung für DSM_Class%Mil_C" TAB_VERB "%6.3" "-" COMPU_TAB_REF Mil /end COMPU_METHOD
/begin COMPU_VTAB Mil "Verbale Umrechnung für DSM_Class%Mil_C" TAB_VERB 3 0 "Mil OFF" 1 "Mil ON" 2 "Mil BLINK" /end COMPU_VTAB
/begin COMPU_METHOD OneToOne "eins zu eins (physikalischer Wert ist gleich dem internen Wert)" RAT_FUNC "%6.2" "-" COEFFS 0 1 0 0 0 1 /end COMPU_METHOD
/begin COMPU_METHOD Readiness "Verbale Umrechnung für DSM_Class%Readiness_C" TAB_VERB "%6.3" "-" COMPU_TAB_REF Readiness /end COMPU_METHOD
/begin COMPU_VTAB Readiness "Verbale Umrechnung für DSM_Class%Readiness_C" TAB_VERB 8 0 "non" 1 "EGR system monitoring" 2 "catalyst monitoring" 4 "misfire monitoring" 8 "fuel system" 16 "comprehensive components" 32 "oxygen sensor" 64 "oxygen sensor heater" /end COMPU_VTAB
/begin COMPU_METHOD ResErf "Verbale Umrechnung für DSM_Class%ResErf_C" TAB_VERB "%6.3" "-" COMPU_TAB_REF ResErf /end COMPU_METHOD
/begin COMPU_VTAB ResErf "Verbale Umrechnung für DSM_Class%ResErf_C" TAB_VERB 4 0 "no Reset" 1 "Reset on Init" 2 "Reset on Restart" 3 "Reset on Init or Restart" /end COMPU_VTAB
/begin COMPU_METHOD Scatt "Verbale Umrechnugn für DSM_Class%Scatt_C" TAB_VERB "%6.3" "-" COMPU_TAB_REF Scatt /end COMPU_METHOD
/begin COMPU_VTAB Scatt "Verbale Umrechnugn für DSM_Class%Scatt_C" TAB_VERB 2 0 "not visible for OBD-Tester" 1 "visible for OBD-Tester" /end COMPU_VTAB
/begin COMPU_METHOD SigName "Verbale Umrechnung für Signal Referenz Nummern" TAB_VERB "%6.3" "-" COMPU_TAB_REF SigName /end COMPU_METHOD
/begin COMPU_VTAB SigName "Verbale Umrechnung für Signal Referenz Nummern" TAB_VERB 117 0 "Sig_unused" 4 "CoEng_rTrq__Carb_r_DLen1" 5 "CTSCD_tClntLin__Carb_t_DLen1" 11 "BPSCD_pLin__Carb_p_DLen1" 12 "Eng_nAvrg__Carb_n_DLen2" 13 "VSSCD_vSensVal__Carb_v_DLen1" 15 "AFSCD_tAir_mp__Carb_t_DLen1" 16 "AFSCD_dmAirRawPerTime__Carb_mAirTim_DLen2" 28 "Signals_PID0x1C_C__OneToOne_DLen1" 33 "DSMDur_ctDfctDur1__Carb_l_DLen2" 128 "AFSCD_dmAirPerTime__mAirTim_DLen2" 129 "AFSCD_mAirPerCyl__mAirCyl_DLen2" 131 "AFSCD_rAir__dcyc_DLen2" 133 "AOHtCD_rOut_mp__dcyc_DLen2" 134 "APPCD_rFlt__r_DLen2" 137 "APPCD_uRawAPP1__u_DLen2" 138 "APPCD_uRawAPP2__u_DLen2" 139 "APSCD_pVal__p_DLen2" 140 "APSCD_uRaw__u_DLen2" 141 "AirCtl_mDesVal__mAirCyl_DLen2" 142 "AltCD_rAltLoad__r_DLen2" 143 "BPACD_rOut__dcyc_DLen2" 145 "BPSCD_pOutVal__p_DLen2" 146 "BPSCD_uRawVal__u_DLen2" 147 "BattCD_u__uBatt_DLen2" 148 "CBACD_stLogicOut_mp__OneToOne_DLen1" 149 "CTSCD_tClnt__t_DLen2" 150 "CTSCD_uRaw__u_DLen2" 151 "CoEng_trq__trq_DLen2" 152 "EBAFCD_stSigOut__OneToOne_DLen1" 153 "EGRCD_rOut__dcyc_DLen2" 155 "EGT_st__ShftRght0Byte_DLen2" 156 "EngM_stOut__OneToOne_DLen1" 157 "EngM_stSync__OneToOne_DLen1" 158 "Eng_nAvrg__n_DLen2" 159 "FMTC_trqInr__trq_DLen2" 160 "FTSCD_tFuel__t_DLen2" 161 "FTSCD_uRaw__u_DLen2" 162 "FanCD_dcycRaw_mp__dcyc_DLen2" 163 "FlFCD_stFlFltRawVal__OneToOne_DLen1" 164 "FrmMng_nPSP__nPSPSpd_DLen2" 165 "FrmMng_rPSPSetPoint__r_DLen2" 166 "GlwCtl_rPwrOut__OneToOne_DLen1" 167 "GlwCtl_stLampOut__OneToOne_DLen1" 168 "HWEMon_numRecovery__ShftRght0Byte_DLen2" 169 "HWEMon_numRecovery__ShftRght1Byte_DLen2" 170 "HWEMon_recLocLow_mp__ShftRght0Byte_DLen2" 171 "HWEMon_recLocLow_mp__ShftRght1Byte_DLen2" 172 "HWEMon_recLocHigh_mp__ShftRght0Byte_DLen2" 173 "IATSCD_tAir__t_DLen2" 174 "IATSCD_tAirCats__t_DLen2" 176 "IATSCD_uRawCats__u_DLen2" 178 "Tn_abstell__DezUwQ1_DLen2" 179 "U_gen__UUwQ0p1_DLen2" 181 "InjCtl_qCurr__qInjMassCyc_DLen2" 182 "InjCtl_qSetUnBal__qInjMassCyc_DLen2" 183 "LIGov_nSetpoint__n_DLen2" 184 "LIGov_trq__trq_DLen2" 185 "LPACD_rOut__dcyc_DLen2" 186 "LSUCD_rO2Raw[0]__O2_DLen2" 187 "LSUCD_uO2Raw[0]__u_DLen2" 188 "LSU_rLmbd[0]__Lambda_DLen2" 189 "LSU_rO2Adpt[0]__O2_DLen2" 190 "MeUnCD_dcycOut_mp__dcyc_DLen2" 191 "OPSCD_stSigOut__OneToOne_DLen1" 192 "OPSCD_stpOEL__OneToOne_DLen1" 193 "OTSCD_tEngOil__t_DLen2" 194 "OxiCCD_tPre__tExhaustgas_DLen2" 196 "OxiCCD_uRawTempPre__u_DLen2" 198 "PCR_pDesVal__p_DLen2" 199 "PCVCD_dcycOut_mp__dcyc_DLen2" 200 "PFltCD_pPre__p_DLen2" 202 "PFltCD_tPre__tExhaustgas_DLen2" 204 "PFltCD_uRawPresPre_mp__u_DLen2" 206 "PFltCD_uRawTempPre__u_DLen2" 208 "PFlt_dvol__volph_DLen2" 209 "PFlt_lSnceRgnu16_mp__lenrgnu16PFlt_DLen2" 211 "PFlt_mAshOil__mSoot_DLen2" 212 "PFlt_mSot__mSoot_DLen2" 213 "PFlt_mSotSim__mSoot_DLen2" 214 "PFlt_numEngPOp__OneToOne_DLen1" 215 "PFlt_numRgn_mp__OneToOne_DLen1" 216 "PFlt_pDiff__p_DLen2" 217 "PFlt_qFl_mp__FlConPFlt_DLen2" 219 "PFlt_stEngPOp__OneToOne_DLen1" 220 "PFlt_stIntr_mp__OneToOne_DLen1" 221 "PFlt_stLck_mp__OneToOne_DLen1" 222 "PSPCD_dvolOut__FlCon_DLen2" 223 "RailCD_pPeak__pRail_DLen2" 224 "RailCD_uPeakRaw__u_DLen2" 225 "Rail_pSetPoint__pRail_DLen2" 226 "TVACD_rOut__dcyc_DLen2" 228 "VSACD_rOut__dcyc_DLen2" 229 "VSSCD_v__v_DLen2" 230 "VehDa_tiEngOn__timEng_DLen2" 231 "PFlt_pPreCorr_mp__p_DLen2" 232 "PFlt_stPresPlaus_mp__OneToOne_DLen1" 236 "OvRMon_tiTDCAvrg__InjTim_DLen2" 237 "OvRMon_tiOvRMonActive_mp__tims_DLen2" 238 "CoEng_trqInrSet__trq_DLen2" 239 "InjCtl_qSet__qInjMassCyc_DLen2" 240 "Absch_korr__FSwQ0p00153_DLen2" 241 "D_soc__FSwB100_DLen2" 242 "I_batt__IUwQ0p08O200_DLen2" 243 "Oz_oelkm__KmUwQ10_DLen2" 244 "Oz_oelnivkurz__TdUbQ0p5_DLen1" 245 "Oz_oelnivnorm__TdUbQ0p5_DLen1" 246 "Oz_oelnivori__TdUbQ0p5_DLen1" 247 "Pm_klemmstat__DezUbQ1_DLen1" 248 "Stat_sv_reg1__DezUbQ1_DLen1" 249 "Stat_sv_reg2__DezUbQ1_DLen1" 250 "T2histshort__TdUbQ14p9333_DLen1" 251 "T3histshort__TdUbQ14p9333_DLen1" 252 "T4histshort__TdUbQ14p9333_DLen1" 253 "Toel__TSwQ0p1_DLen2" 254 "T_batt__TSwQ0p1_DLen2" 255 "U_batt__UUwQ0p25em3_DLen2" /end COMPU_VTAB
/begin COMPU_METHOD SlopeRes1000 "Umrechnung für Slope: Slopewert mit Verhältnis 0,001" RAT_FUNC "%6.5" "-" COEFFS 0 1000 0 0 0 1 /end COMPU_METHOD
/begin COMPU_METHOD SysLamp "Verbale Umrechnung für DSM_Class%SysLamp_C" TAB_VERB "%6.3" "-" COMPU_TAB_REF SysLamp /end COMPU_METHOD
/begin COMPU_VTAB SysLamp "Verbale Umrechnung für DSM_Class%SysLamp_C" TAB_VERB 3 0 "SysLamp OFF" 1 "SysLamp ON" 2 "SysLamp BLINK" /end COMPU_VTAB
/begin COMPU_METHOD SysLampMode "Verbale Umrechnung für DSM_SysLampMode_C" TAB_VERB "%6.3" "-" COMPU_TAB_REF SysLampMode /end COMPU_METHOD
/begin COMPU_VTAB SysLampMode "Verbale Umrechnung für DSM_SysLampMode_C" TAB_VERB 3 0 "controlled by FCM Statemachine" 1 "controlled by entry defect Status" 2 "controlled by dfp Status" /end COMPU_VTAB
/begin COMPU_METHOD TempDiff_Cels "difference/offset temperature displayed in degree celcius" RAT_FUNC "%6.3" "deg C" COEFFS 0 10 0 0 0 1 /end COMPU_METHOD
/begin COMPU_METHOD Temp_Cels "Temperatur dargestellt in °C (gleiche interne Darstellung wie Temp_Kelv)" RAT_FUNC "%6.1" "deg C" COEFFS 0 10 2731.4 0 0 1 /end COMPU_METHOD
/begin COMPU_METHOD TimeDsmDC "Skalierung Zeit DSM Driving cycle Verzögerung" RAT_FUNC "%6.2" "s" COEFFS 0 1 0 0 0 1 /end COMPU_METHOD
/begin COMPU_METHOD Time_ms "Zeit in ms für Fehlerentprellung (DSM) und SW-Timer" RAT_FUNC "%6.1" "ms" COEFFS 0 0.1 0 0 0 1 /end COMPU_METHOD
/begin RECORD_LAYOUT Kwb_Wu16 FNC_VALUES 1 UWORD COLUMN_DIR DIRECT /end RECORD_LAYOUT
/begin RECORD_LAYOUT Kwb_Wu8 FNC_VALUES 1 UBYTE COLUMN_DIR DIRECT /end RECORD_LAYOUT
/begin RECORD_LAYOUT Kw_Ws16 FNC_VALUES 1 SWORD COLUMN_DIR DIRECT /end RECORD_LAYOUT
/begin RECORD_LAYOUT Kw_Wu16 FNC_VALUES 1 UWORD COLUMN_DIR DIRECT /end RECORD_LAYOUT
/begin RECORD_LAYOUT Kw_Wu8 FNC_VALUES 1 UBYTE COLUMN_DIR DIRECT /end RECORD_LAYOUT
/end MODULE
/end PROJECT
