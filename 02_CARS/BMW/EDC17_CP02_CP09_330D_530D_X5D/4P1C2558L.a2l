ASAP2_VERSION 1 4
/begin PROJECT P_558 "EDC17_CP02"
/begin HEADER "" VERSION "V1C1" PROJECT_NO P_558 /end HEADER
/begin MODULE DIM ""
/begin MOD_COMMON "" BYTE_ORDER MSB_LAST ALIGNMENT_BYTE 1 ALIGNMENT_WORD 2 ALIGNMENT_LONG 4 ALIGNMENT_FLOAT32_IEEE 4 /end MOD_COMMON
/begin CHARACTERISTIC K_DNMOT "" VALUE 0x800406CC TKW_VV_VV_SW 100.0 Def_n_sw_q1p0 -32768.0000 32767.0000 /end CHARACTERISTIC
/begin CHARACTERISTIC K_MAXDT1_HY "" VALUE 0x800406CE TKW_VV_VV_SW 100.0 Def_n_sw_q1p0 -32768.0000 32767.0000 /end CHARACTERISTIC
/begin CHARACTERISTIC K_MD_ELMOTENTL "" VALUE 0x800406D0 TKW_VV_VV_SW 100.0 Def_m_sw_q0p1 -3276.8000 3276.7000 FORMAT "%5.2" /end CHARACTERISTIC
/begin CHARACTERISTIC K_MINDT1_HY "" VALUE 0x800406D2 TKW_VV_VV_SW 100.0 Def_n_sw_q1p0 -32768.0000 32767.0000 /end CHARACTERISTIC
/begin CHARACTERISTIC K_NKWMAX_HS "" VALUE 0x800406D4 TKW_VV_VV_SW 100.0 Def_n_sw_q1p0 -32768.0000 32767.0000 /end CHARACTERISTIC
/begin CHARACTERISTIC K_NKWMIN_HY "" VALUE 0x800406D6 TKW_VV_VV_SW 100.0 Def_n_sw_q1p0 -32768.0000 32767.0000 /end CHARACTERISTIC
/begin CHARACTERISTIC K_PWGMAX_HY "" VALUE 0x800406D8 TKW_VV_VV_SW 100.0 Def_wdk_sw_q0p0244 -800.0000 799.9755 FORMAT "%5.2" /end CHARACTERISTIC
/begin CHARACTERISTIC K_PWGMIN_HY "" VALUE 0x800406DA TKW_VV_VV_SW 100.0 Def_wdk_sw_q0p0244 -800.0000 799.9755 FORMAT "%5.2" /end CHARACTERISTIC
/begin CHARACTERISTIC K_WAFS "" VALUE 0x800406DC TKW_VV_VV_SW 100.0 Def_w_sw_q0p1 -3276.8000 3276.7000 FORMAT "%5.2" /end CHARACTERISTIC
/begin CHARACTERISTIC K_WDAFS "" VALUE 0x800406DE TKW_VV_VV_SW 100.0 Def_w_sw_q0p1 -3276.8000 3276.7000 FORMAT "%5.2" /end CHARACTERISTIC
/begin CHARACTERISTIC K_TD_DELAY1 "" VALUE 0x800406E0 TKW_VV_VV_UW 100.0 Def_td_uw_q0p1 0.0 6553.5000 FORMAT "%4.1" /end CHARACTERISTIC
/begin CHARACTERISTIC K_TD_DELAY2 "" VALUE 0x800406E2 TKW_VV_VV_UW 100.0 Def_td_uw_q0p1 0.0 6553.5000 FORMAT "%4.1" /end CHARACTERISTIC
/begin CHARACTERISTIC K_TD_DELAY3 "" VALUE 0x800406E4 TKW_VV_VV_UW 100.0 Def_td_uw_q0p1 0.0 6553.5000 FORMAT "%4.1" /end CHARACTERISTIC
/begin CHARACTERISTIC K_TD_DOWN "" VALUE 0x800406E6 TKW_VV_VV_UW 100.0 Def_td_uw_q0p1 0.0 6553.5000 FORMAT "%4.1" /end CHARACTERISTIC
/begin CHARACTERISTIC K_TD_GEAR "" VALUE 0x800406E8 TKW_VV_VV_UW 100.0 Def_td_uw_q0p1 0.0 6553.5000 FORMAT "%4.1" /end CHARACTERISTIC
/begin CHARACTERISTIC K_TD_HOLD "" VALUE 0x800406EA TKW_VV_VV_UW 100.0 Def_td_uw_q0p1 0.0 6553.5000 FORMAT "%4.1" /end CHARACTERISTIC
/begin CHARACTERISTIC K_TD_HOLDNO "" VALUE 0x800406EC TKW_VV_VV_UW 100.0 Def_td_uw_q0p1 0.0 6553.5000 FORMAT "%4.1" /end CHARACTERISTIC
/begin CHARACTERISTIC K_TD_UP "" VALUE 0x800406EE TKW_VV_VV_UW 100.0 Def_td_uw_q0p1 0.0 6553.5000 FORMAT "%4.1" /end CHARACTERISTIC
/begin CHARACTERISTIC K_TODPRIO0 "" VALUE 0x800406F0 TKW_VV_VV_UW 100.0 Def_td_uw_q0p1 0.0 6553.5000 FORMAT "%4.1" /end CHARACTERISTIC
/begin CHARACTERISTIC K_TPDNMOT "" VALUE 0x800406F2 TKW_VV_VV_UW 100.0 Def_dez_uw_q1 1.0000 65535.0000 /end CHARACTERISTIC
/begin CHARACTERISTIC K_VMAX_HY "Fz-Geschwindigkeit" VALUE 0x800406F4 TKW_VV_VV_UW 100.0 Def_v_uw_q1p0 0.0 65535.0000 /end CHARACTERISTIC
/begin CHARACTERISTIC K_VMIN_HY "Fz-Geschwindigkeit" VALUE 0x800406F6 TKW_VV_VV_UW 100.0 Def_v_uw_q1p0 0.0 65535.0000 /end CHARACTERISTIC
/begin CHARACTERISTIC K_PR_ELMOTENTL "" VALUE 0x800406F8 TKW_VV_VV_UB 100.0 Def_dez_ub_q1 0.0 255.0000 /end CHARACTERISTIC
/begin CHARACTERISTIC S_ELMOTENTL "" VALUE 0x800406F9 TKW_VV_VV_UB 100.0 Identity 0.0 1.0000 /end CHARACTERISTIC
/begin CHARACTERISTIC KL_VLPRIO41 "" CURVE 0x800406FA TKL_SW_VV_UW 100.0 Def_td_uw_q0p1 0.0 6553.5000
 /begin AXIS_DESCR STD_AXIS Tmot Def_t_sw_q0p01 4 -327.6800 327.6700 FORMAT "%5.2" /end AXIS_DESCR
 FORMAT "%4.1" /end CHARACTERISTIC
/begin CHARACTERISTIC KL_VLPRIO42 "" CURVE 0x8004070C TKL_SW_VV_UW 100.0 Def_td_uw_q0p1 0.0 6553.5000
 /begin AXIS_DESCR STD_AXIS Tmot Def_t_sw_q0p01 4 -327.6800 327.6700 FORMAT "%5.2" /end AXIS_DESCR
 FORMAT "%4.1" /end CHARACTERISTIC
/begin CHARACTERISTIC KL_VLPRIO43 "" CURVE 0x8004071E TKL_SW_VV_UW 100.0 Def_td_uw_q0p1 0.0 6553.5000
 /begin AXIS_DESCR STD_AXIS Tmot Def_t_sw_q0p01 4 -327.6800 327.6700 FORMAT "%5.2" /end AXIS_DESCR
 FORMAT "%4.1" /end CHARACTERISTIC
/begin CHARACTERISTIC KF_PRIO_UP "" MAP 0x80040730 TKF_UW_SW_SW 100.0 Def_rf_sw_q0p01 -327.6800 327.6700
 /begin AXIS_DESCR STD_AXIS Tmot Def_t_sw_q0p01 8 -327.6800 327.6700 FORMAT "%5.2" /end AXIS_DESCR
 /begin AXIS_DESCR STD_AXIS Pu Def_p_uw_q0p039 8 0.0 2559.9609 FORMAT "%5.2" /end AXIS_DESCR
 FORMAT "%7.4" /end CHARACTERISTIC
/begin CHARACTERISTIC KF_PRIO_HOLD "" MAP 0x800407D2 TKF_UW_SW_SW 100.0 Def_dez_sw_q1 -32768.0000 32767.0000
 /begin AXIS_DESCR STD_AXIS Tmot Def_t_sw_q0p01 8 -327.6800 327.6700 FORMAT "%5.2" /end AXIS_DESCR
 /begin AXIS_DESCR STD_AXIS Pu Def_p_uw_q0p039 8 0.0 2559.9609 FORMAT "%5.2" /end AXIS_DESCR
/end CHARACTERISTIC
/begin CHARACTERISTIC KF_PRIO_4 "" MAP 0x80040874 TKF_UW_SW_SW 100.0 Def_rf_sw_q0p01 -327.6800 327.6700
 /begin AXIS_DESCR STD_AXIS Tmot Def_t_sw_q0p01 8 -327.6800 327.6700 FORMAT "%5.2" /end AXIS_DESCR
 /begin AXIS_DESCR STD_AXIS Pu Def_p_uw_q0p039 8 0.0 2559.9609 FORMAT "%5.2" /end AXIS_DESCR
 FORMAT "%7.4" /end CHARACTERISTIC
/begin CHARACTERISTIC KF_PRIO_NO "" MAP 0x80040916 TKF_UW_SW_SW 100.0 Def_dez_sw_q1 -32768.0000 32767.0000
 /begin AXIS_DESCR STD_AXIS Tmot Def_t_sw_q0p01 8 -327.6800 327.6700 FORMAT "%5.2" /end AXIS_DESCR
 /begin AXIS_DESCR STD_AXIS Pu Def_p_uw_q0p039 8 0.0 2559.9609 FORMAT "%5.2" /end AXIS_DESCR
/end CHARACTERISTIC
/begin CHARACTERISTIC KF_HFM_INIT "KF zur Initialisierung des Adaptiven Kannfeldes" MAP 0x800409BE TKF_UW_UW_UW 100.0 Def_hub_uw_q0p001 0.0 65.5350
 /begin AXIS_DESCR STD_AXIS Agrpos_mw Def_u_uw_q0p00488 8 0.0 4.9951 FORMAT "%6.3" /end AXIS_DESCR
 /begin AXIS_DESCR STD_AXIS Me_mw Def_dez_uw_q0p01 8 0.0 655.3500 FORMAT "%6.3" /end AXIS_DESCR
 FORMAT "%6.3" /end CHARACTERISTIC
/begin CHARACTERISTIC K_IV_AIRFILT "Initialisierungswert für PT1-Glied (Msair_filt)" VALUE 0x80040B26 TKW_VV_VV_SW 100.0 Def_ml_sw_q0p1 -3276.8000 3276.7000 FORMAT "%5.2" /end CHARACTERISTIC
/begin CHARACTERISTIC K_IV_AIRZFILT "Initialisierungswert für PT1-Glied (Msair_cylfilt)" VALUE 0x80040B28 TKW_VV_VV_SW 100.0 Def_ml_sw_q0p1 -3276.8000 3276.7000 FORMAT "%5.2" /end CHARACTERISTIC
/begin CHARACTERISTIC K_IV_MEFILT "Initialisierungswert für PT1-Glied (Me_filt)" VALUE 0x80040B2A TKW_VV_VV_SW 100.0 Def_me_sw_q0p01 -327.6800 327.6700 FORMAT "%6.3" /end CHARACTERISTIC
/begin CHARACTERISTIC K_MEMAXADAPT "Freigabe für max.Einspritzmenge zur KF Adaption" VALUE 0x80040B2C TKW_VV_VV_SW 100.0 Def_me_sw_q0p01 -327.6800 327.6700 FORMAT "%6.3" /end CHARACTERISTIC
/begin CHARACTERISTIC K_MEMINADAPT "Freigabe für min.Einspritzmenge zur KF Adaption" VALUE 0x80040B2E TKW_VV_VV_SW 100.0 Def_me_sw_q0p01 -327.6800 327.6700 FORMAT "%6.3" /end CHARACTERISTIC
/begin CHARACTERISTIC K_NKWAIR "minimale Drehzahlschwelle für die Ausgabe der Frischluftmasse Msair" VALUE 0x80040B30 TKW_VV_VV_SW 100.0 Def_n_sw_q1p0 -32768.0000 32767.0000 /end CHARACTERISTIC
/begin CHARACTERISTIC K_NKWMINADAPT "minimale Drehzahlschwelle ab der SM gerechnet wird" VALUE 0x80040B32 TKW_VV_VV_SW 100.0 Def_n_sw_q1p0 -32768.0000 32767.0000 /end CHARACTERISTIC
/begin CHARACTERISTIC K_WPTN_IV "wptn DT1-Filter Initialisierungsvektor" VALUE 0x80040B34 TKW_VV_VV_SW 100.0 Def_f_sw_p0q25 -8192.0000 8191.7500 FORMAT "%5.2" /end CHARACTERISTIC
/begin CHARACTERISTIC K_AGRKONST "Konstantbereich AGR" VALUE 0x80040B36 TKW_VV_VV_UW 100.0 Def_u_uw_q0p00488 0.0 5.0000 FORMAT "%6.3" /end CHARACTERISTIC
/begin CHARACTERISTIC K_AGRPOSMAX "maximale AGR-Ventilposition (100% == geschlossen)" VALUE 0x80040B38 TKW_VV_VV_UW 100.0 Def_u_uw_q0p00488 0.0 5.0000 FORMAT "%6.3" /end CHARACTERISTIC
/begin CHARACTERISTIC K_AGRPOSMIN "minimale AGR-Ventilposition (0% = offen)" VALUE 0x80040B3A TKW_VV_VV_UW 100.0 Def_u_uw_q0p00488 0.0 5.0000 FORMAT "%6.3" /end CHARACTERISTIC
/begin CHARACTERISTIC K_ANZMW "Anzahl der aufzusummierenden Messwerte (bzw. Divisionsfaktor zur Mittelwertberechnung)" VALUE 0x80040B3C TKW_VV_VV_UW 100.0 Def_dez_uw_q1 1.0000 65535.0000 /end CHARACTERISTIC
/begin CHARACTERISTIC K_FSTVE "Faktor für stöchiometrische Verbrennung" VALUE 0x80040B3E TKW_VV_VV_UW 100.0 Def_dez_uw_q0p01 0.0 655.3500 FORMAT "%6.3" /end CHARACTERISTIC
/begin CHARACTERISTIC K_HFMADAPTSCALE "HFM KF-Skalierung (1/Impl(KF_HFM_ZTAB))" VALUE 0x80040B40 TKW_VV_VV_UW 100.0 Def_dez_uw_q1 1.0000 65535.0000 /end CHARACTERISTIC
/begin CHARACTERISTIC K_HFM_LA "" VALUE 0x80040B42 TKW_VV_VV_UW 100.0 Def_f_uw_b16 0.0 15.9995 FORMAT "%7.4" /end CHARACTERISTIC
/begin CHARACTERISTIC K_HFM_VX "" VALUE 0x80040B44 TKW_VV_VV_UW 100.0 Def_u_uw_q0p00488 0.0 5.0000 FORMAT "%6.3" /end CHARACTERISTIC
/begin CHARACTERISTIC K_HFM_VY "" VALUE 0x80040B46 TKW_VV_VV_UW 100.0 Def_dez_uw_q0p01 0.0 655.3500 FORMAT "%6.3" /end CHARACTERISTIC
/begin CHARACTERISTIC K_HFM_Z "HFM Adaption Test yIndex" VALUE 0x80040B48 TKW_VV_VV_UW 100.0 Def_dez_uw_q1 0.0 65535.0000 /end CHARACTERISTIC
/begin CHARACTERISTIC K_IV_RAGRFILT "Initialisierungswert für PT1-Glied (Agrpos_filt)" VALUE 0x80040B4A TKW_VV_VV_UW 100.0 Def_u_uw_q0p00488 0.0 5.0000 FORMAT "%6.3" /end CHARACTERISTIC
/begin CHARACTERISTIC K_QSCHUB "Grenze für B_Motormodus" VALUE 0x80040B4C TKW_VV_VV_UW 100.0 Def_dez_uw_q0p01 0.0 327.6700 FORMAT "%6.3" /end CHARACTERISTIC
/begin CHARACTERISTIC K_T_AIRFILT "PT1-Glied: Zeitkonstante für Msair_filt" VALUE 0x80040B4E TKW_VV_VV_UW 100.0 Def_dez_uw_q1 0.0 65535.0000 /end CHARACTERISTIC
/begin CHARACTERISTIC K_T_AIRZFILT "PT1-Glied: Zeitkonstante für Msair_modfilt" VALUE 0x80040B50 TKW_VV_VV_UW 100.0 Def_dez_uw_q1 0.0 65535.0000 /end CHARACTERISTIC
/begin CHARACTERISTIC K_T_MEFILT "PT1-Glied: Zeitkonstante für Me_filt" VALUE 0x80040B52 TKW_VV_VV_UW 100.0 Def_dez_uw_q1 0.0 65535.0000 /end CHARACTERISTIC
/begin CHARACTERISTIC K_T_RAGRFILT "PT1-Glied: Zeitkonstante für AGRPOS" VALUE 0x80040B54 TKW_VV_VV_UW 100.0 Def_dez_uw_q1 0.0 65535.0000 /end CHARACTERISTIC
/begin CHARACTERISTIC K_VOLMOT "max. Füllungsvolumen Motor (alle Zylinder) in Liter" VALUE 0x80040B56 TKW_VV_VV_UW 100.0 Def_f_uw_b8 0.0 7.9998 FORMAT "%7.4" /end CHARACTERISTIC
/begin CHARACTERISTIC K_HFM_INIM "HFM Adaption Initialisierungsmode" VALUE 0x80040B58 TKW_VV_VV_UB 100.0 Identity 0.0 1.0000 /end CHARACTERISTIC
/begin CHARACTERISTIC K_HFM_IX "HFM Adaption Test xIndex" VALUE 0x80040B59 TKW_VV_VV_UB 100.0 Def_dez_ub_q1 0.0 8.0000 /end CHARACTERISTIC
/begin CHARACTERISTIC K_HFM_IY "HFM Adaption Test yIndex" VALUE 0x80040B5A TKW_VV_VV_UB 100.0 Def_dez_ub_q1 0.0 8.0000 /end CHARACTERISTIC
/begin CHARACTERISTIC K_WPTN_K "wptn DT1-Filter K-Faktor" VALUE 0x80040B5B TKW_VV_VV_UB 100.0 Def_f_ub_b2 0.0 1.9921 /end CHARACTERISTIC
/begin CHARACTERISTIC K_WPTN_T "wptn DT1-Filter T-Faktor" VALUE 0x80040B5C TKW_VV_VV_UB 100.0 Def_f_ub_b32 0.1250 31.8750 /end CHARACTERISTIC
/begin CHARACTERISTIC K_ZYL "Zylinderanzahl" VALUE 0x80040B5D TKW_VV_VV_UB 100.0 Def_dez_ub_q1 4.0000 8.0000 /end CHARACTERISTIC
/begin CHARACTERISTIC S_HFMADAPTS "Selektiere Test" VALUE 0x80040B5E TKW_VV_VV_UB 100.0 Identity 0.0 1.0000 /end CHARACTERISTIC
/begin CHARACTERISTIC S_HFMADAPTT "Enable Adaptionstest" VALUE 0x80040B5F TKW_VV_VV_UB 100.0 Identity 0.0 1.0000 /end CHARACTERISTIC
/begin CHARACTERISTIC S_HFMADAPTZ "" VALUE 0x80040B60 TKW_VV_VV_UB 100.0 Identity 0.0 1.0000 /end CHARACTERISTIC
/begin CHARACTERISTIC S_HFM_ADAPT "Schalter HFM-Adaptionstest Enable" VALUE 0x80040B61 TKW_VV_VV_UB 100.0 Identity 0.0 1.0000 /end CHARACTERISTIC
/begin CHARACTERISTIC S_HFM_INI "Schalter HFM-Adaption Grund-Initialisierung" VALUE 0x80040B62 TKW_VV_VV_UB 100.0 Identity 0.0 1.0000 /end CHARACTERISTIC
/begin CHARACTERISTIC S_HFM_LA "" VALUE 0x80040B63 TKW_VV_VV_UB 100.0 Identity 0.0 1.0000 /end CHARACTERISTIC
/begin CHARACTERISTIC S_HFM_TESTAD "Schalter Test Adaption" VALUE 0x80040B64 TKW_VV_VV_UB 100.0 Identity 0.0 1.0000 /end CHARACTERISTIC
/begin CHARACTERISTIC S_HFM_TRIG "HFM Adaption Test auslösen" VALUE 0x80040B65 TKW_VV_VV_UB 100.0 Def_dez_ub_q1 0.0 255.0000 /end CHARACTERISTIC
/begin CHARACTERISTIC KL_FAKLAM "Faktor aus Lambdawert (letzter Zyklus)" CURVE 0x80040A60 TKL_UW_VV_UW 100.0 Def_f_uw_b16 0.0 15.9997 /begin AXIS_DESCR STD_AXIS La_old Def_f_uw_b16 4 0.0 15.9997 FORMAT "%7.4" /end AXIS_DESCR FORMAT "%7.4" /end CHARACTERISTIC
/begin CHARACTERISTIC KL_FAKME "Faktor aus Einspritzwert (letzter Zyklus)" CURVE 0x80040A72 TKL_UW_VV_SW 100.0 Def_me_sw_q0p01 -327.6800 327.6700
 /begin AXIS_DESCR STD_AXIS Me_old Def_dez_uw_q0p01 4 0.0 655.3500 FORMAT "%6.3" /end AXIS_DESCR
 FORMAT "%6.3" /end CHARACTERISTIC
/begin CHARACTERISTIC KF_FAKVW "Ermittlung des volumetrischen Wirkungsgrades (Faktor) aus Nkw und Ps" MAP 0x80040A84 TKF_UW_SW_UW 100.0 Def_f_uw_b2 0.0 1.9999 /begin AXIS_DESCR STD_AXIS Nkw Def_n_sw_q1p0 8 -32768.0000 32767.0000 /end AXIS_DESCR
 /begin AXIS_DESCR STD_AXIS NO_INPUT_QUANTITY Def_p_uw_q0p039 8 0.0 2559.9609 FORMAT "%5.2" /end AXIS_DESCR
/end CHARACTERISTIC
/begin CHARACTERISTIC Hfm_adapt "" MAP 0xD0000064 TKF_UW_UW_UW 100.0 Def_dez_uw_q1 0.0 65535.0000
 /begin AXIS_DESCR STD_AXIS Agrpos_mw Def_u_uw_q0p00488 8 0.0 4.9951 FORMAT "%6.3" /end AXIS_DESCR
 /begin AXIS_DESCR STD_AXIS Me_mw Def_dez_uw_q0p01 8 0.0 655.3500 FORMAT "%6.3" /end AXIS_DESCR
/end CHARACTERISTIC
/begin CHARACTERISTIC K_HHSREGAKT "" VALUE 0x80040B68 TKW_VV_VV_UL 100.0 Def_dez_ul_q1 0.0 4294967295.0000 /end CHARACTERISTIC
/begin CHARACTERISTIC K_HHSDELAY "" VALUE 0x80040B6C TKW_VV_VV_UB 100.0 Def_td_ub_q0p1 0.0 25.5000 /end CHARACTERISTIC
/begin CHARACTERISTIC K_HHSLEVEL1 "" VALUE 0x80040B6D TKW_VV_VV_UB 100.0 Def_dez_ub_q1 0.0 255.0000 /end CHARACTERISTIC
/begin CHARACTERISTIC K_HHSLEVEL2 "" VALUE 0x80040B6E TKW_VV_VV_UB 100.0 Def_dez_ub_q1 0.0 255.0000 /end CHARACTERISTIC
/begin CHARACTERISTIC K_HHSVAUS "" VALUE 0x80040B6F TKW_VV_VV_UB 100.0 Def_dez_ub_q1 0.0 255.0000 /end CHARACTERISTIC
/begin CHARACTERISTIC K_HHSVEIN "" VALUE 0x80040B70 TKW_VV_VV_UB 100.0 Def_dez_ub_q1 0.0 255.0000 /end CHARACTERISTIC
/begin CHARACTERISTIC K_IGR_UDN "Maximale Spannungsrampe iGR (negativ)" VALUE 0x80040B71 TKW_VV_VV_UB 100.0 Def_u_ub_b0p5 0.0 0.4980 /end CHARACTERISTIC
/begin CHARACTERISTIC K_IGR_UDP "Maximale Spannungsrampe iGR (positiv)" VALUE 0x80040B72 TKW_VV_VV_UB 100.0 Def_u_ub_b0p5 0.0 0.4980 /end CHARACTERISTIC
/begin CHARACTERISTIC K_PR_IGRDN "Priorität iGR Spannungsrampe negativ" VALUE 0x80040B73 TKW_VV_VV_UB 100.0 Def_dez_ub_q1 0.0 255.0000 /end CHARACTERISTIC
/begin CHARACTERISTIC K_PR_IGRDP "Priorität iGR Spannungsrampe positiv" VALUE 0x80040B74 TKW_VV_VV_UB 100.0 Def_dez_ub_q1 0.0 255.0000 /end CHARACTERISTIC
/begin CHARACTERISTIC K_PR_IGRLOW "Priorität iGR- LOW" VALUE 0x80040B75 TKW_VV_VV_UB 100.0 Def_dez_ub_q1 0.0 255.0000 /end CHARACTERISTIC
/begin CHARACTERISTIC K_PR_IGRMH "Priorität iGR Medium und High" VALUE 0x80040B76 TKW_VV_VV_UB 100.0 Def_dez_ub_q1 0.0 255.0000 /end CHARACTERISTIC
/begin CHARACTERISTIC K_IGR_IHF "" VALUE 0x80040B82 TKW_VV_VV_SW 100.0 Def_i_sw_q0p02 -655.3600 655.3400 FORMAT "%6.3" /end CHARACTERISTIC
/begin CHARACTERISTIC K_IGR_IHIGH "Sollwert Batteriestrom für iGR High (Fahrerpotentialunabhängig)" VALUE 0x80040B84 TKW_VV_VV_SW 100.0 Def_i_sw_q0p02 -655.3600 655.3400 FORMAT "%6.3" /end CHARACTERISTIC
/begin CHARACTERISTIC K_IGR_IMED "Sollwert Batteriestrom für iGR Medium (Fahrerpotentialunabhängig)" VALUE 0x80040B86 TKW_VV_VV_SW 100.0 Def_i_sw_q0p02 -655.3600 655.3400 FORMAT "%6.3" /end CHARACTERISTIC
/begin CHARACTERISTIC K_IGR_IMF "" VALUE 0x80040B88 TKW_VV_VV_SW 100.0 Def_i_sw_q0p02 -655.3600 655.3400 FORMAT "%6.3" /end CHARACTERISTIC
/begin CHARACTERISTIC K_IGR_DI1 "Schwellwert Abweichung für Reglerzeittakt 1" VALUE 0x80040B8A TKW_VV_VV_UW 100.0 Def_i_uw_q0p02 0.0 1310.7000 FORMAT "%6.3" /end CHARACTERISTIC
/begin CHARACTERISTIC K_IGR_DI2 "Schwellwert Abweichung für Reglerzeittakt 2" VALUE 0x80040B8C TKW_VV_VV_UW 100.0 Def_i_uw_q0p02 0.0 1310.7000 FORMAT "%6.3" /end CHARACTERISTIC
/begin CHARACTERISTIC K_IGR_ISTEP "Schrittweite Regelschritt Batteriestromregelung" VALUE 0x80040B8E TKW_VV_VV_UW 100.0 Def_u_uw_q0p00488 0.0 1.2451 FORMAT "%6.3" /end CHARACTERISTIC
/begin CHARACTERISTIC K_IGR_OSDI1 "Toleranzschwelle Berechnung Regelzeittakt" VALUE 0x80040B90 TKW_VV_VV_UW 100.0 Def_i_uw_q0p02 0.0 1310.7000 FORMAT "%6.3" /end CHARACTERISTIC
/begin CHARACTERISTIC K_IGRDFGEN_MN "Mindestschwelle DF für Batteriestromregelung Generatorstromverringerung" VALUE 0x80040B77 TKW_VV_VV_UB 100.0 Def_f_ub_b100 0.0 99.6093 /end CHARACTERISTIC
/begin CHARACTERISTIC K_IGRDFGEN_MX "Maximalschwelle DF für Batteriestromregelung Generatorstromerhöhung" VALUE 0x80040B78 TKW_VV_VV_UB 100.0 Def_f_ub_b100 0.0 99.6093 /end CHARACTERISTIC
/begin CHARACTERISTIC K_IGRNL "Nachlauf iGR Rekuperationsanforderung" VALUE 0x80040B79 TKW_VV_VV_UB 100.0 Def_td_ub_q0p1 0.0 25.5000 /end CHARACTERISTIC
/begin CHARACTERISTIC K_IGRNL_MAX "Maximalwert Nachlauf iGR Rekuperationsanforderung" VALUE 0x80040B7A TKW_VV_VV_UB 100.0 Def_td_ub_q0p1 0.0 25.5000 /end CHARACTERISTIC
/begin CHARACTERISTIC K_IGRNL_MIN "Minimalwert Nachlauf iGR Rekuperationsanforderung" VALUE 0x80040B7B TKW_VV_VV_UB 100.0 Def_td_ub_q0p1 0.0 25.5000 /end CHARACTERISTIC
/begin CHARACTERISTIC K_IGRUMAX "Maximalwert Spannungsanforderung iGR" VALUE 0x80040B7C TKW_VV_VV_UB 100.0 Def_u_ub_q0p1 0.0 25.5000 /end CHARACTERISTIC
/begin CHARACTERISTIC K_IGRUMN "Minimalwert Spannungsanforderung iGR" VALUE 0x80040B7D TKW_VV_VV_UB 100.0 Def_u_ub_q0p1 0.0 25.5000 /end CHARACTERISTIC
/begin CHARACTERISTIC K_IGR_DI1DT "Reglerzeittakt 1" VALUE 0x80040B7E TKW_VV_VV_UB 100.0 Def_td_ub_q0p1 0.0 25.5000 /end CHARACTERISTIC
/begin CHARACTERISTIC K_IGR_DI2DT "Reglerzeittakt 2" VALUE 0x80040B7F TKW_VV_VV_UB 100.0 Def_td_ub_q0p1 0.0 25.5000 /end CHARACTERISTIC
/begin CHARACTERISTIC K_IGR_ENTPR "Entprellzeit iGR Rekuperationsanforderung" VALUE 0x80040B80 TKW_VV_VV_UB 100.0 Def_td_ub_q0p1 0.0 25.5000 /end CHARACTERISTIC
/begin CHARACTERISTIC K_U_SATDYN "Störabstand zu dynamischen BN- Spannungsgrenzen" VALUE 0x80040B81 TKW_VV_VV_UB 100.0 Def_u_ub_q0p1 0.0 25.5000 /end CHARACTERISTIC
/begin CHARACTERISTIC K_IGRINF_KPT "Infosp PT1-konst DF iGR-Low" VALUE 0x80040B92 TKW_VV_VV_UB 100.0 Def_dez_ub_q1 0.0 255.0000 /end CHARACTERISTIC
/begin CHARACTERISTIC K_IGRINF_TDF "Infosp TOD Info DF iGR-Low" VALUE 0x80040B93 TKW_VV_VV_UB 100.0 Def_td_ub_q0p1 0.0 25.5000 /end CHARACTERISTIC
/begin CHARACTERISTIC K_IGRINF_TSB "TOD Info BSA" VALUE 0x80040B94 TKW_VV_VV_UB 100.0 Def_td_ub_q0p1 0.0 25.5000 /end CHARACTERISTIC
/begin CHARACTERISTIC K_IGR_ETANTR "Infosp ETA-Antrieb iGR-Potential" VALUE 0x80040B95 TKW_VV_VV_UB 100.0 Def_f_ub_b4 0.0 3.9843 /end CHARACTERISTIC
/begin CHARACTERISTIC K_IGR_VMIN "Mindestgeschwindigkeit für Rekuperationsanforderung iGR" VALUE 0x80040B96 TKW_VV_VV_UW 100.0 Def_v_uw_q1p0 0.0 65535.0000 /end CHARACTERISTIC
/begin CHARACTERISTIC K_IGRBS "Auswahl des Basissignals für Rekuperationsanforderung iGR" VALUE 0x80040B98 TKW_VV_VV_UB 100.0 ident 0.0 10.0000 /end CHARACTERISTIC
/begin CHARACTERISTIC K_IGRLOW_EN "iGR Low freigeschalten" VALUE 0x80040B99 TKW_VV_VV_UB 100.0 Identity 0.0 1.0000 /end CHARACTERISTIC
/begin CHARACTERISTIC S_IGRLOW_MAN "Manuelles freischalten von iGR Low" VALUE 0x80040B9A TKW_VV_VV_UB 100.0 Identity 0.0 1.0000 /end CHARACTERISTIC
/begin CHARACTERISTIC K_GENMDNMOF "Offset des Generatormoments" VALUE 0x80040B9C TKW_VV_VV_SW 100.0 Def_m_sw_q0p1 -3276.8000 3276.7000 FORMAT "%5.2" /end CHARACTERISTIC
/begin CHARACTERISTIC K_GENUEBSETZ "Generatorübersetzung" VALUE 0x80040BAC TKW_VV_VV_UB 100.0 Def_f_ub_b4 0.0157 3.9843 /end CHARACTERISTIC
/begin CHARACTERISTIC KF_MU1T2_3 "" MAP 0x80040BB4 TKF_SW_SW_SW 100.0 Def_m_sw_q0p1 -3276.8000 3276.7000
 /begin AXIS_DESCR STD_AXIS Ierr Def_i_sw_q0p125 10 -4096.0000 4095.8750 FORMAT "%6.3" /end AXIS_DESCR
 /begin AXIS_DESCR STD_AXIS N_gen Def_n_sw_q1p0 10 -32768.0000 32767.0000 /end AXIS_DESCR
 FORMAT "%5.2" /end CHARACTERISTIC
/begin CHARACTERISTIC KF_MU1T1_6 "" MAP 0x80040CA6 TKF_SW_SW_SW 100.0 Def_m_sw_q0p1 -3276.8000 3276.7000
 /begin AXIS_DESCR STD_AXIS Ierr Def_i_sw_q0p125 10 -4096.0000 4095.8750 FORMAT "%6.3" /end AXIS_DESCR
 /begin AXIS_DESCR STD_AXIS N_gen Def_n_sw_q1p0 10 -32768.0000 32767.0000 /end AXIS_DESCR
 FORMAT "%5.2" /end CHARACTERISTIC
/begin CHARACTERISTIC KF_IU2T1_3 "" MAP 0x80040D98 TKF_SW_SW_SW 100.0 Def_i_sw_q0p03125 -1024.0000 1023.9687
 /begin AXIS_DESCR STD_AXIS NO_INPUT_QUANTITY Def_i_sw_q0p125 10 -4096.0000 4095.8750 FORMAT "%6.3" /end AXIS_DESCR
 /begin AXIS_DESCR STD_AXIS N_gen Def_n_sw_q1p0 10 -32768.0000 32767.0000 /end AXIS_DESCR
 FORMAT "%6.3" /end CHARACTERISTIC
/begin CHARACTERISTIC KF_IU1T2_5 "" MAP 0x80040E8A TKF_SW_SW_SW 100.0 Def_i_sw_q0p03125 -1024.0000 1023.9687
 /begin AXIS_DESCR STD_AXIS NO_INPUT_QUANTITY Def_i_sw_q0p125 10 -4096.0000 4095.8750 FORMAT "%6.3" /end AXIS_DESCR
 /begin AXIS_DESCR STD_AXIS N_gen Def_n_sw_q1p0 10 -32768.0000 32767.0000 /end AXIS_DESCR
 FORMAT "%6.3" /end CHARACTERISTIC
/begin CHARACTERISTIC KF_IU1T1_2 "" MAP 0x80040F7C TKF_SW_SW_SW 100.0 Def_i_sw_q0p03125 -1024.0000 1023.9687
 /begin AXIS_DESCR STD_AXIS NO_INPUT_QUANTITY Def_i_sw_q0p125 10 -4096.0000 4095.8750 FORMAT "%6.3" /end AXIS_DESCR
 /begin AXIS_DESCR STD_AXIS N_gen Def_n_sw_q1p0 10 -32768.0000 32767.0000 /end AXIS_DESCR
 FORMAT "%6.3" /end CHARACTERISTIC
/begin CHARACTERISTIC KF_MU2T1_2 "" MAP 0x8004106E TKF_SW_SW_SW 100.0 Def_m_sw_q0p1 -3276.8000 3276.7000
 /begin AXIS_DESCR STD_AXIS Ierr Def_i_sw_q0p125 10 -4096.0000 4095.8750 FORMAT "%6.3" /end AXIS_DESCR
 /begin AXIS_DESCR STD_AXIS N_gen Def_n_sw_q1p0 10 -32768.0000 32767.0000 /end AXIS_DESCR
 FORMAT "%5.2" /end CHARACTERISTIC
/begin CHARACTERISTIC KF_MU1T2_6 "" MAP 0x80041160 TKF_SW_SW_SW 100.0 Def_m_sw_q0p1 -3276.8000 3276.7000
 /begin AXIS_DESCR STD_AXIS Ierr Def_i_sw_q0p125 10 -4096.0000 4095.8750 FORMAT "%6.3" /end AXIS_DESCR
 /begin AXIS_DESCR STD_AXIS N_gen Def_n_sw_q1p0 10 -32768.0000 32767.0000 /end AXIS_DESCR
 FORMAT "%5.2" /end CHARACTERISTIC
/begin CHARACTERISTIC KF_IU1T2_2 "" MAP 0x80041252 TKF_SW_SW_SW 100.0 Def_i_sw_q0p03125 -1024.0000 1023.9687
 /begin AXIS_DESCR STD_AXIS NO_INPUT_QUANTITY Def_i_sw_q0p125 10 -4096.0000 4095.8750 FORMAT "%6.3" /end AXIS_DESCR
 /begin AXIS_DESCR STD_AXIS N_gen Def_n_sw_q1p0 10 -32768.0000 32767.0000 /end AXIS_DESCR
 FORMAT "%6.3" /end CHARACTERISTIC
/begin CHARACTERISTIC KF_IU2T1_2 "" MAP 0x80041344 TKF_SW_SW_SW 100.0 Def_i_sw_q0p03125 -1024.0000 1023.9687
 /begin AXIS_DESCR STD_AXIS NO_INPUT_QUANTITY Def_i_sw_q0p125 10 -4096.0000 4095.8750 FORMAT "%6.3" /end AXIS_DESCR
 /begin AXIS_DESCR STD_AXIS N_gen Def_n_sw_q1p0 10 -32768.0000 32767.0000 /end AXIS_DESCR
 FORMAT "%6.3" /end CHARACTERISTIC
/begin CHARACTERISTIC KF_MU1T2_4 "" MAP 0x80041436 TKF_SW_SW_SW 100.0 Def_m_sw_q0p1 -3276.8000 3276.7000
 /begin AXIS_DESCR STD_AXIS Ierr Def_i_sw_q0p125 10 -4096.0000 4095.8750 FORMAT "%6.3" /end AXIS_DESCR
 /begin AXIS_DESCR STD_AXIS N_gen Def_n_sw_q1p0 10 -32768.0000 32767.0000 /end AXIS_DESCR
 FORMAT "%5.2" /end CHARACTERISTIC
/begin CHARACTERISTIC KF_IU1T1_3 "" MAP 0x80041528 TKF_SW_SW_SW 100.0 Def_i_sw_q0p03125 -1024.0000 1023.9687
 /begin AXIS_DESCR STD_AXIS NO_INPUT_QUANTITY Def_i_sw_q0p125 10 -4096.0000 4095.8750 FORMAT "%6.3" /end AXIS_DESCR
 /begin AXIS_DESCR STD_AXIS N_gen Def_n_sw_q1p0 10 -32768.0000 32767.0000 /end AXIS_DESCR
 FORMAT "%6.3" /end CHARACTERISTIC
/begin CHARACTERISTIC KF_MU1T2_1 "" MAP 0x8004161A TKF_SW_SW_SW 100.0 Def_m_sw_q0p1 -3276.8000 3276.7000
 /begin AXIS_DESCR STD_AXIS Ierr Def_i_sw_q0p125 10 -4096.0000 4095.8750 FORMAT "%6.3" /end AXIS_DESCR
 /begin AXIS_DESCR STD_AXIS N_gen Def_n_sw_q1p0 10 -32768.0000 32767.0000 /end AXIS_DESCR
 FORMAT "%5.2" /end CHARACTERISTIC
/begin CHARACTERISTIC KF_IU1T1_5 "" MAP 0x8004170C TKF_SW_SW_SW 100.0 Def_i_sw_q0p03125 -1024.0000 1023.9687
 /begin AXIS_DESCR STD_AXIS NO_INPUT_QUANTITY Def_i_sw_q0p125 10 -4096.0000 4095.8750 FORMAT "%6.3" /end AXIS_DESCR
 /begin AXIS_DESCR STD_AXIS N_gen Def_n_sw_q1p0 10 -32768.0000 32767.0000 /end AXIS_DESCR
 FORMAT "%6.3" /end CHARACTERISTIC
/begin CHARACTERISTIC KF_IU1T1_4 "" MAP 0x800417FE TKF_SW_SW_SW 100.0 Def_i_sw_q0p03125 -1024.0000 1023.9687
 /begin AXIS_DESCR STD_AXIS NO_INPUT_QUANTITY Def_i_sw_q0p125 10 -4096.0000 4095.8750 FORMAT "%6.3" /end AXIS_DESCR
 /begin AXIS_DESCR STD_AXIS N_gen Def_n_sw_q1p0 10 -32768.0000 32767.0000 /end AXIS_DESCR
 FORMAT "%6.3" /end CHARACTERISTIC
/begin CHARACTERISTIC KF_IU2T1_4 "" MAP 0x800418F0 TKF_SW_SW_SW 100.0 Def_i_sw_q0p03125 -1024.0000 1023.9687
 /begin AXIS_DESCR STD_AXIS NO_INPUT_QUANTITY Def_i_sw_q0p125 10 -4096.0000 4095.8750 FORMAT "%6.3" /end AXIS_DESCR
 /begin AXIS_DESCR STD_AXIS N_gen Def_n_sw_q1p0 10 -32768.0000 32767.0000 /end AXIS_DESCR
 FORMAT "%6.3" /end CHARACTERISTIC
/begin CHARACTERISTIC KF_MU1T1_1 "" MAP 0x800419E2 TKF_SW_SW_SW 100.0 Def_m_sw_q0p1 -3276.8000 3276.7000
 /begin AXIS_DESCR STD_AXIS Ierr Def_i_sw_q0p125 10 -4096.0000 4095.8750 FORMAT "%6.3" /end AXIS_DESCR
 /begin AXIS_DESCR STD_AXIS N_gen Def_n_sw_q1p0 10 -32768.0000 32767.0000 /end AXIS_DESCR
 FORMAT "%5.2" /end CHARACTERISTIC
/begin CHARACTERISTIC KF_IU1T2_3 "" MAP 0x80041AD4 TKF_SW_SW_SW 100.0 Def_i_sw_q0p03125 -1024.0000 1023.9687
 /begin AXIS_DESCR STD_AXIS NO_INPUT_QUANTITY Def_i_sw_q0p125 10 -4096.0000 4095.8750 FORMAT "%6.3" /end AXIS_DESCR
 /begin AXIS_DESCR STD_AXIS N_gen Def_n_sw_q1p0 10 -32768.0000 32767.0000 /end AXIS_DESCR
 FORMAT "%6.3" /end CHARACTERISTIC
/begin CHARACTERISTIC KF_IU2T1_1 "" MAP 0x80041BC6 TKF_SW_SW_SW 100.0 Def_i_sw_q0p03125 -1024.0000 1023.9687
 /begin AXIS_DESCR STD_AXIS NO_INPUT_QUANTITY Def_i_sw_q0p125 10 -4096.0000 4095.8750 FORMAT "%6.3" /end AXIS_DESCR
 /begin AXIS_DESCR STD_AXIS N_gen Def_n_sw_q1p0 10 -32768.0000 32767.0000 /end AXIS_DESCR
 FORMAT "%6.3" /end CHARACTERISTIC
/begin CHARACTERISTIC KF_MU2T1_6 "" MAP 0x80041CB8 TKF_SW_SW_SW 100.0 Def_m_sw_q0p1 -3276.8000 3276.7000
 /begin AXIS_DESCR STD_AXIS Ierr Def_i_sw_q0p125 10 -4096.0000 4095.8750 FORMAT "%6.3" /end AXIS_DESCR
 /begin AXIS_DESCR STD_AXIS N_gen Def_n_sw_q1p0 10 -32768.0000 32767.0000 /end AXIS_DESCR
 FORMAT "%5.2" /end CHARACTERISTIC
/begin CHARACTERISTIC KF_IU1T1_6 "" MAP 0x80041DAA TKF_SW_SW_SW 100.0 Def_i_sw_q0p03125 -1024.0000 1023.9687
 /begin AXIS_DESCR STD_AXIS NO_INPUT_QUANTITY Def_i_sw_q0p125 10 -4096.0000 4095.8750 FORMAT "%6.3" /end AXIS_DESCR
 /begin AXIS_DESCR STD_AXIS N_gen Def_n_sw_q1p0 10 -32768.0000 32767.0000 /end AXIS_DESCR
 FORMAT "%6.3" /end CHARACTERISTIC
/begin CHARACTERISTIC KF_IU1T2_4 "" MAP 0x80041E9C TKF_SW_SW_SW 100.0 Def_i_sw_q0p03125 -1024.0000 1023.9687
 /begin AXIS_DESCR STD_AXIS NO_INPUT_QUANTITY Def_i_sw_q0p125 10 -4096.0000 4095.8750 FORMAT "%6.3" /end AXIS_DESCR
 /begin AXIS_DESCR STD_AXIS N_gen Def_n_sw_q1p0 10 -32768.0000 32767.0000 /end AXIS_DESCR
 FORMAT "%6.3" /end CHARACTERISTIC
/begin CHARACTERISTIC KF_IU1T2_6 "" MAP 0x80041F8E TKF_SW_SW_SW 100.0 Def_i_sw_q0p03125 -1024.0000 1023.9687
 /begin AXIS_DESCR STD_AXIS NO_INPUT_QUANTITY Def_i_sw_q0p125 10 -4096.0000 4095.8750 FORMAT "%6.3" /end AXIS_DESCR
 /begin AXIS_DESCR STD_AXIS N_gen Def_n_sw_q1p0 10 -32768.0000 32767.0000 /end AXIS_DESCR
 FORMAT "%6.3" /end CHARACTERISTIC
/begin CHARACTERISTIC KF_MU2T1_4 "" MAP 0x80042080 TKF_SW_SW_SW 100.0 Def_m_sw_q0p1 -3276.8000 3276.7000
 /begin AXIS_DESCR STD_AXIS Ierr Def_i_sw_q0p125 10 -4096.0000 4095.8750 FORMAT "%6.3" /end AXIS_DESCR
 /begin AXIS_DESCR STD_AXIS N_gen Def_n_sw_q1p0 10 -32768.0000 32767.0000 /end AXIS_DESCR
 FORMAT "%5.2" /end CHARACTERISTIC
/begin CHARACTERISTIC KF_MU1T2_5 "" MAP 0x80042172 TKF_SW_SW_SW 100.0 Def_m_sw_q0p1 -3276.8000 3276.7000
 /begin AXIS_DESCR STD_AXIS Ierr Def_i_sw_q0p125 10 -4096.0000 4095.8750 FORMAT "%6.3" /end AXIS_DESCR
 /begin AXIS_DESCR STD_AXIS N_gen Def_n_sw_q1p0 10 -32768.0000 32767.0000 /end AXIS_DESCR
 FORMAT "%5.2" /end CHARACTERISTIC
/begin CHARACTERISTIC KF_IU2T1_5 "" MAP 0x80042264 TKF_SW_SW_SW 100.0 Def_i_sw_q0p03125 -1024.0000 1023.9687
 /begin AXIS_DESCR STD_AXIS NO_INPUT_QUANTITY Def_i_sw_q0p125 10 -4096.0000 4095.8750 FORMAT "%6.3" /end AXIS_DESCR
 /begin AXIS_DESCR STD_AXIS N_gen Def_n_sw_q1p0 10 -32768.0000 32767.0000 /end AXIS_DESCR
 FORMAT "%6.3" /end CHARACTERISTIC
/begin CHARACTERISTIC KF_MU1T1_4 "" MAP 0x80042356 TKF_SW_SW_SW 100.0 Def_m_sw_q0p1 -3276.8000 3276.7000
 /begin AXIS_DESCR STD_AXIS Ierr Def_i_sw_q0p125 10 -4096.0000 4095.8750 FORMAT "%6.3" /end AXIS_DESCR
 /begin AXIS_DESCR STD_AXIS N_gen Def_n_sw_q1p0 10 -32768.0000 32767.0000 /end AXIS_DESCR
 FORMAT "%5.2" /end CHARACTERISTIC
/begin CHARACTERISTIC KF_MU2T1_1 "" MAP 0x80042448 TKF_SW_SW_SW 100.0 Def_m_sw_q0p1 -3276.8000 3276.7000
 /begin AXIS_DESCR STD_AXIS Ierr Def_i_sw_q0p125 10 -4096.0000 4095.8750 FORMAT "%6.3" /end AXIS_DESCR
 /begin AXIS_DESCR STD_AXIS N_gen Def_n_sw_q1p0 10 -32768.0000 32767.0000 /end AXIS_DESCR
 FORMAT "%5.2" /end CHARACTERISTIC
/begin CHARACTERISTIC KF_MU1T1_2 "" MAP 0x8004253A TKF_SW_SW_SW 100.0 Def_m_sw_q0p1 -3276.8000 3276.7000
 /begin AXIS_DESCR STD_AXIS Ierr Def_i_sw_q0p125 10 -4096.0000 4095.8750 FORMAT "%6.3" /end AXIS_DESCR
 /begin AXIS_DESCR STD_AXIS N_gen Def_n_sw_q1p0 10 -32768.0000 32767.0000 /end AXIS_DESCR
 FORMAT "%5.2" /end CHARACTERISTIC
/begin CHARACTERISTIC KF_MU2T1_5 "" MAP 0x8004262C TKF_SW_SW_SW 100.0 Def_m_sw_q0p1 -3276.8000 3276.7000
 /begin AXIS_DESCR STD_AXIS Ierr Def_i_sw_q0p125 10 -4096.0000 4095.8750 FORMAT "%6.3" /end AXIS_DESCR
 /begin AXIS_DESCR STD_AXIS N_gen Def_n_sw_q1p0 10 -32768.0000 32767.0000 /end AXIS_DESCR
 FORMAT "%5.2" /end CHARACTERISTIC
/begin CHARACTERISTIC KF_IU1T1_1 "" MAP 0x8004271E TKF_SW_SW_SW 100.0 Def_i_sw_q0p03125 -1024.0000 1023.9687
 /begin AXIS_DESCR STD_AXIS NO_INPUT_QUANTITY Def_i_sw_q0p125 10 -4096.0000 4095.8750 FORMAT "%6.3" /end AXIS_DESCR
 /begin AXIS_DESCR STD_AXIS N_gen Def_n_sw_q1p0 10 -32768.0000 32767.0000 /end AXIS_DESCR
 FORMAT "%6.3" /end CHARACTERISTIC
/begin CHARACTERISTIC KF_MU1T1_5 "" MAP 0x80042810 TKF_SW_SW_SW 100.0 Def_m_sw_q0p1 -3276.8000 3276.7000
 /begin AXIS_DESCR STD_AXIS Ierr Def_i_sw_q0p125 10 -4096.0000 4095.8750 FORMAT "%6.3" /end AXIS_DESCR
 /begin AXIS_DESCR STD_AXIS N_gen Def_n_sw_q1p0 10 -32768.0000 32767.0000 /end AXIS_DESCR
 FORMAT "%5.2" /end CHARACTERISTIC
/begin CHARACTERISTIC KF_IU1T2_1 "" MAP 0x80042902 TKF_SW_SW_SW 100.0 Def_i_sw_q0p03125 -1024.0000 1023.9687
 /begin AXIS_DESCR STD_AXIS NO_INPUT_QUANTITY Def_i_sw_q0p125 10 -4096.0000 4095.8750 FORMAT "%6.3" /end AXIS_DESCR
 /begin AXIS_DESCR STD_AXIS N_gen Def_n_sw_q1p0 10 -32768.0000 32767.0000 /end AXIS_DESCR
 FORMAT "%6.3" /end CHARACTERISTIC
/begin CHARACTERISTIC KF_MU1T2_2 "" MAP 0x800429F4 TKF_SW_SW_SW 100.0 Def_m_sw_q0p1 -3276.8000 3276.7000
 /begin AXIS_DESCR STD_AXIS Ierr Def_i_sw_q0p125 10 -4096.0000 4095.8750 FORMAT "%6.3" /end AXIS_DESCR
 /begin AXIS_DESCR STD_AXIS N_gen Def_n_sw_q1p0 10 -32768.0000 32767.0000 /end AXIS_DESCR
 FORMAT "%5.2" /end CHARACTERISTIC
/begin CHARACTERISTIC KF_MU1T1_3 "" MAP 0x80042AE6 TKF_SW_SW_SW 100.0 Def_m_sw_q0p1 -3276.8000 3276.7000
 /begin AXIS_DESCR STD_AXIS Ierr Def_i_sw_q0p125 10 -4096.0000 4095.8750 FORMAT "%6.3" /end AXIS_DESCR
 /begin AXIS_DESCR STD_AXIS N_gen Def_n_sw_q1p0 10 -32768.0000 32767.0000 /end AXIS_DESCR
 FORMAT "%5.2" /end CHARACTERISTIC
/begin CHARACTERISTIC KF_IU2T1_6 "" MAP 0x80042BD8 TKF_SW_SW_SW 100.0 Def_i_sw_q0p03125 -1024.0000 1023.9687
 /begin AXIS_DESCR STD_AXIS NO_INPUT_QUANTITY Def_i_sw_q0p125 10 -4096.0000 4095.8750 FORMAT "%6.3" /end AXIS_DESCR
 /begin AXIS_DESCR STD_AXIS N_gen Def_n_sw_q1p0 10 -32768.0000 32767.0000 /end AXIS_DESCR
 FORMAT "%6.3" /end CHARACTERISTIC
/begin CHARACTERISTIC KF_MU2T1_3 "" MAP 0x80042CCA TKF_SW_SW_SW 100.0 Def_m_sw_q0p1 -3276.8000 3276.7000
 /begin AXIS_DESCR STD_AXIS Ierr Def_i_sw_q0p125 10 -4096.0000 4095.8750 FORMAT "%6.3" /end AXIS_DESCR
 /begin AXIS_DESCR STD_AXIS N_gen Def_n_sw_q1p0 10 -32768.0000 32767.0000 /end AXIS_DESCR
 FORMAT "%5.2" /end CHARACTERISTIC
/begin CHARACTERISTIC K_IMDGENNRRW "Schwellwert zum Rechenrasterwechsel Momentenberechung" VALUE 0x80040B9E TKW_VV_VV_SW 100.0 Def_n_sw_q1p0 -32768.0000 32767.0000 /end CHARACTERISTIC
/begin CHARACTERISTIC K_NSCHW_CALC "" VALUE 0x80040BA0 TKW_VV_VV_SW 100.0 Def_n_sw_q1p0 0.0 32767.0000 /end CHARACTERISTIC
/begin CHARACTERISTIC K_GEN_IGOF "Offsetwert Generatorstrom" VALUE 0x80040BA2 TKW_VV_VV_UW 100.0 Def_f_uw_b2048 0.0 254.0000 FORMAT "%5.2" /end CHARACTERISTIC
/begin CHARACTERISTIC K_R_LADLTG "" VALUE 0x80040BA4 TKW_VV_VV_UW 100.0 Def_r_uw_b1024 0.0 1023.9843 /end CHARACTERISTIC
/begin CHARACTERISTIC K_TDFIERR "" VALUE 0x80040BA6 TKW_VV_VV_UW 100.0 Def_td_uw_q0p01 0.0 655.3500 FORMAT "%5.2" /end CHARACTERISTIC
/begin CHARACTERISTIC K_UBOFF "" VALUE 0x80040BA8 TKW_VV_VV_UW 100.0 Def_u_uw_q0p1 0.0 6553.5000 FORMAT "%6.3" /end CHARACTERISTIC
/begin CHARACTERISTIC K_ZMGENIG "" VALUE 0x80040BAA TKW_VV_VV_UW 100.0 Def_td_uw_q0p1 0.0 6553.5000 FORMAT "%4.1" /end CHARACTERISTIC
/begin CHARACTERISTIC K_DFFGENFIL "Filterkonstante Dffgen" VALUE 0x80040BAD TKW_VV_VV_UB 100.0 Def_f_ub_b1 0.0 0.9960 /end CHARACTERISTIC
/begin CHARACTERISTIC K_DF_DEAKAPP "Df-Schwelle für IG 0A Zwangssetzung" VALUE 0x80040BAE TKW_VV_VV_UB 100.0 Def_f_ub_b100 0.0 99.6093 /end CHARACTERISTIC
/begin CHARACTERISTIC K_EN_MDGEN "" VALUE 0x80040BAF TKW_VV_VV_UB 100.0 Def_st_ub_q1 0.0 255.0000 /end CHARACTERISTIC
/begin CHARACTERISTIC K_GENITYP "Generatorstrotyp 0=gerechnet / 1=gemessen" VALUE 0x80040BB0 TKW_VV_VV_UB 100.0 Def_st_ub_q1 0.0 1.0000 /end CHARACTERISTIC
/begin CHARACTERISTIC K_IGNOTWERT "" VALUE 0x80040BB1 TKW_VV_VV_UB 100.0 Def_i_ub_q1 0.0 255.0000 /end CHARACTERISTIC
/begin CHARACTERISTIC K_MANAWNUMM "Manuelle Vorgabe Generatortyp" VALUE 0x80040BB2 TKW_VV_VV_UB 100.0 Def_st_ub_q1 1.0000 6.0000 /end CHARACTERISTIC
/begin CHARACTERISTIC S_RDGENTYP "Schalter Freigabe Manuelle Vorgabe Generatortyp" VALUE 0x80040BB3 TKW_VV_VV_UB 100.0 Def_st_ub_q1 0.0 255.0000 /end CHARACTERISTIC
/begin CHARACTERISTIC KL_T_CHIP2 "" CURVE 0x80042DBC TKL_UB_VV_SW 100.0 Def_t_sw_q0p1 -3276.8000 3276.7000 /begin AXIS_DESCR STD_AXIS Gen_awnumm Def_st_ub_q1 6 0.0 255.0000 /end AXIS_DESCR FORMAT "%4.1" /end CHARACTERISTIC
/begin CHARACTERISTIC KL_T_CHIP1 "" CURVE 0x80042DD0 TKL_UB_VV_SW 100.0 Def_t_sw_q0p1 -3276.8000 3276.7000 /begin AXIS_DESCR STD_AXIS Gen_awnumm Def_st_ub_q1 6 0.0 255.0000 /end AXIS_DESCR FORMAT "%4.1" /end CHARACTERISTIC
/begin CHARACTERISTIC KF_MDGENFIL "Kennfeld Filterkonstante Generatormoment" MAP 0x80042DE4 TKF_SW_UW_UW 100.0 Def_f_uw_b1 0.0 9.99984741210938e-1
 /begin AXIS_DESCR STD_AXIS Dffgen_f Def_f_uw_b100 6 0.0 99.9984 FORMAT "%6.3" /end AXIS_DESCR
 /begin AXIS_DESCR STD_AXIS NO_INPUT_QUANTITY Def_dt_sw_b4096 6 -4096.0000 4095.8750 FORMAT "%5.2" /end AXIS_DESCR
/end CHARACTERISTIC
/begin CHARACTERISTIC KF_GENTYP_NEU "Auswahlkennfeld Generatortyp" MAP 0x80042E46 TKF_UB_UB_UB 100.0 Def_st_ub_q1 1.0000 7.0000 /begin AXIS_DESCR STD_AXIS Gen_manufak Def_st_ub_q1 6 0.0 255.0000 /end AXIS_DESCR /begin AXIS_DESCR STD_AXIS Gen_typkenn Def_st_ub_q1 32 0.0 255.0000 /end AXIS_DESCR /end CHARACTERISTIC
/begin MEASUREMENT St_elmot1.B_np0_rf "" UBYTE Def_bit_ub_0 0 0 0.0 255.0 ECU_ADDRESS 0xD0001474 BIT_MASK 0x1 /end MEASUREMENT
/begin MEASUREMENT St_elmot1.B_np0_v "" UBYTE Def_bit_ub_1 0 0 0.0 255.0 ECU_ADDRESS 0xD0001474 BIT_MASK 0x2 /end MEASUREMENT
/begin MEASUREMENT St_elmot1.B_np0_nkw "" UBYTE Def_bit_ub_3 0 0 0.0 255.0 ECU_ADDRESS 0xD0001474 BIT_MASK 0x8 /end MEASUREMENT
/begin MEASUREMENT St_elmot1.B_hp1_vtod "" UBYTE Def_bit_ub_5 0 0 0.0 255.0 ECU_ADDRESS 0xD0001474 BIT_MASK 0x20 /end MEASUREMENT
/begin MEASUREMENT St_elmot1.B_hp1_ntod "" UBYTE Def_bit_ub_6 0 0 0.0 255.0 ECU_ADDRESS 0xD0001474 BIT_MASK 0x40 /end MEASUREMENT
/begin MEASUREMENT St_elmot1.B_up_absafs "" UBYTE Def_bit_ub_7 0 0 0.0 255.0 ECU_ADDRESS 0xD0001474 BIT_MASK 0x80 /end MEASUREMENT
/begin MEASUREMENT St_elmot1 "Statuswort" UBYTE Def_st_ub_q1 0 0 0.0 255.0000 ECU_ADDRESS 0xD0001474 /end MEASUREMENT
/begin MEASUREMENT St_elmot2.B_hp2_vtod "" UBYTE Def_bit_ub_0 0 0 0.0 255.0 ECU_ADDRESS 0xD0001475 BIT_MASK 0x1 /end MEASUREMENT
/begin MEASUREMENT St_elmot2.B_hp2_ntod "" UBYTE Def_bit_ub_1 0 0 0.0 255.0 ECU_ADDRESS 0xD0001475 BIT_MASK 0x2 /end MEASUREMENT
/begin MEASUREMENT St_elmot2.B_up_rfvtod "" UBYTE Def_bit_ub_2 0 0 0.0 255.0 ECU_ADDRESS 0xD0001475 BIT_MASK 0x4 /end MEASUREMENT
/begin MEASUREMENT St_elmot2.B_up_rfntod "" UBYTE Def_bit_ub_3 0 0 0.0 255.0 ECU_ADDRESS 0xD0001475 BIT_MASK 0x8 /end MEASUREMENT
/begin MEASUREMENT St_elmot2.B_up_rf4 "" UBYTE Def_bit_ub_4 0 0 0.0 255.0 ECU_ADDRESS 0xD0001475 BIT_MASK 0x10 /end MEASUREMENT
/begin MEASUREMENT St_elmot2.B_nzgofsum "" UBYTE Def_bit_ub_5 0 0 0.0 255.0 ECU_ADDRESS 0xD0001475 BIT_MASK 0x20 /end MEASUREMENT
/begin MEASUREMENT St_elmot2.B_up_gangi0 "" UBYTE Def_bit_ub_7 0 0 0.0 255.0 ECU_ADDRESS 0xD0001475 BIT_MASK 0x80 /end MEASUREMENT
/begin MEASUREMENT St_elmot2 "Statuswort" UBYTE Def_st_ub_q1 0 0 0.0 255.0000 ECU_ADDRESS 0xD0001475 /end MEASUREMENT
/begin MEASUREMENT St_elmotentl.B_prio "" UBYTE Def_bit_ub_3 0 0 0.0 255.0 ECU_ADDRESS 0xD0001476 BIT_MASK 0x8 /end MEASUREMENT
/begin MEASUREMENT St_elmotentl.B_priovdelay "" UBYTE Def_bit_ub_4 0 0 0.0 255.0 ECU_ADDRESS 0xD0001476 BIT_MASK 0x10 /end MEASUREMENT
/begin MEASUREMENT St_elmotentl.B_nzgof1 "" UBYTE Def_bit_ub_5 0 0 0.0 255.0 ECU_ADDRESS 0xD0001476 BIT_MASK 0x20 /end MEASUREMENT
/begin MEASUREMENT St_elmotentl.B_nzgof2 "" UBYTE Def_bit_ub_6 0 0 0.0 255.0 ECU_ADDRESS 0xD0001476 BIT_MASK 0x40 /end MEASUREMENT
/begin MEASUREMENT St_elmotentl.B_nzgof3 "" UBYTE Def_bit_ub_7 0 0 0.0 255.0 ECU_ADDRESS 0xD0001476 BIT_MASK 0x80 /end MEASUREMENT
/begin MEASUREMENT St_elmotentl "Statuswort" UBYTE Def_st_ub_q1 0 0 0.0 255.0000 ECU_ADDRESS 0xD0001476 /end MEASUREMENT
/begin MEASUREMENT St_elmottime.B_inold_1 "" UBYTE Def_bit_ub_1 0 0 0.0 255.0 ECU_ADDRESS 0xD0001477 BIT_MASK 0x2 /end MEASUREMENT
/begin MEASUREMENT St_elmottime.B_inold_2 "" UBYTE Def_bit_ub_2 0 0 0.0 255.0 ECU_ADDRESS 0xD0001477 BIT_MASK 0x4 /end MEASUREMENT
/begin MEASUREMENT St_elmottime.B_inold_3 "" UBYTE Def_bit_ub_3 0 0 0.0 255.0 ECU_ADDRESS 0xD0001477 BIT_MASK 0x8 /end MEASUREMENT
/begin MEASUREMENT St_elmottime.B_inold_4 "" UBYTE Def_bit_ub_4 0 0 0.0 255.0 ECU_ADDRESS 0xD0001477 BIT_MASK 0x10 /end MEASUREMENT
/begin MEASUREMENT St_elmottime.B_inold_5 "" UBYTE Def_bit_ub_5 0 0 0.0 255.0 ECU_ADDRESS 0xD0001477 BIT_MASK 0x20 /end MEASUREMENT
/begin MEASUREMENT St_elmottime.B_inold_6 "" UBYTE Def_bit_ub_6 0 0 0.0 255.0 ECU_ADDRESS 0xD0001477 BIT_MASK 0x40 /end MEASUREMENT
/begin MEASUREMENT St_elmottime "Statuswort" UBYTE Def_st_ub_q1 0 0 0.0 255.0000 ECU_ADDRESS 0xD0001477 /end MEASUREMENT
/begin MEASUREMENT St_entlast_loc "" UBYTE Def_dez_ub_q1 0 0 0.0 255.0000 ECU_ADDRESS 0xD0001478 /end MEASUREMENT
/begin MEASUREMENT Stat_entl "" UBYTE Def_dez_ub_q1 0 0 0.0 255.0000 ECU_ADDRESS 0xD0001479 /end MEASUREMENT
/begin MEASUREMENT Dnmottp "" SWORD Def_n_sw_q1p0 0 0 -32768.0000 32767.0000 ECU_ADDRESS 0xD000147A /end MEASUREMENT
/begin MEASUREMENT Dnmotvtp "" SWORD Def_n_sw_q1p0 0 0 -32768.0000 32767.0000 ECU_ADDRESS 0xD000147C /end MEASUREMENT
/begin MEASUREMENT Timecount_0 "" UWORD Def_td_uw_q0p1 0 0 0.0 6553.5000 ECU_ADDRESS 0xD000147E /end MEASUREMENT
/begin MEASUREMENT Timecount_1 "" UWORD Def_td_uw_q0p1 0 0 0.0 6553.5000 ECU_ADDRESS 0xD0001480 /end MEASUREMENT
/begin MEASUREMENT Timecount_2 "" UWORD Def_td_uw_q0p1 0 0 0.0 6553.5000 ECU_ADDRESS 0xD0001482 /end MEASUREMENT
/begin MEASUREMENT Timecount_3 "" UWORD Def_td_uw_q0p1 0 0 0.0 6553.5000 ECU_ADDRESS 0xD0001484 /end MEASUREMENT
/begin MEASUREMENT Timecount_4 "" UWORD Def_td_uw_q0p1 0 0 0.0 6553.5000 ECU_ADDRESS 0xD0001486 /end MEASUREMENT
/begin MEASUREMENT Timecount_5 "" UWORD Def_td_uw_q0p1 0 0 0.0 6553.5000 ECU_ADDRESS 0xD0001488 /end MEASUREMENT
/begin MEASUREMENT Timecount_6 "" UWORD Def_td_uw_q0p1 0 0 0.0 6553.5000 ECU_ADDRESS 0xD000148A /end MEASUREMENT
/begin MEASUREMENT St_hfmmw.B_adaption "Bedingung KF Adaption" UBYTE Def_bit_ub_0 0 0 0.0 255.0 ECU_ADDRESS 0xD000019C BIT_MASK 0x1 /end MEASUREMENT
/begin MEASUREMENT St_hfmmw.B_motmode "Bedingung Motormodus - stat. Betrieb (aktiv, erkannt o. verlassen)" UBYTE Def_bit_ub_1 0 0 0.0 255.0 ECU_ADDRESS 0xD000019C BIT_MASK 0x2 /end MEASUREMENT
/begin MEASUREMENT St_hfmmw.B_sm_aktiv "Bedingung Freigabe Zustandsautomat (stat. Betrieb erkannt)" UBYTE Def_bit_ub_2 0 0 0.0 255.0 ECU_ADDRESS 0xD000019C BIT_MASK 0x4 /end MEASUREMENT
/begin MEASUREMENT St_hfmmw.B_hfm_update "" UBYTE Def_bit_ub_4 0 0 0.0 255.0 ECU_ADDRESS 0xD000019C BIT_MASK 0x10 /end MEASUREMENT
/begin MEASUREMENT St_hfmmw.B_hfm_inited "Bedingung HFM-KF wurde Initialisiert" UBYTE Def_bit_ub_5 0 0 0.0 255.0 ECU_ADDRESS 0xD000019C BIT_MASK 0x20 /end MEASUREMENT
/begin MEASUREMENT St_hfmmw "Statuswort" UBYTE Def_st_ub_q1 0 0 0.0 255.0000 ECU_ADDRESS 0xD000019C /end MEASUREMENT
/begin MEASUREMENT Ms_aircylfilt "AFSCD_mAirPerCyl - mg/Hub - gefilteter Luftmassenstrom (incl. AGR-Pfad)" SWORD Def_ml_sw_q0p1 0 0 -3276.8000 3276.7000 ECU_ADDRESS 0xD0000128 /end MEASUREMENT
/begin MEASUREMENT Ms_airfilt "AFSCD_dmAirPerTime - kg/h - gefilteter Luftmassenstrom (incl. AGR-Pfad) mit Berücksichtigung von Nkw und Zyl.Zahl" SWORD Def_ms_sw_q0p1 0 0 -3276.8000 3276.7000 ECU_ADDRESS 0xD000012A /end MEASUREMENT
/begin MEASUREMENT Zr_hfm_adapt "Anzahl der Addaptionen" UWORD Def_dez_uw_q1 0 0 0.0 65535.0000 ECU_ADDRESS 0xD00095EE /end MEASUREMENT
/begin MEASUREMENT Zr2hfm_adapt "Matrix - Anzahl der Addaptionen an der jeweiligen Stelle x/y im Kennfeld" UBYTE Def_dez_ub_q1 0 0 0.0 255.0000 ECU_ADDRESS 0xD00095F0 ARRAY_SIZE 64 /end MEASUREMENT
/begin MEASUREMENT Agrpos_stat "Summation der AGR-Ventilposition" ULONG Def_dez_ul_q1 0 0 0.0 4294901759.0000 ECU_ADDRESS 0xD0000A98 /end MEASUREMENT
/begin MEASUREMENT Me_stat "Summation der Einspritzmenge pro Zyl." ULONG Def_dez_ul_q1 0 0 0.0 4291690594.0000 ECU_ADDRESS 0xD0000A9C /end MEASUREMENT
/begin MEASUREMENT Msair_stat "Summation des Luftmassenstrom in den Motor" ULONG Def_dez_ul_q1 0 0 0.0 4294311935.0000 ECU_ADDRESS 0xD0000AA0 /end MEASUREMENT
/begin MEASUREMENT Msairlam_stat "Summation der rekonstruierte Frischluftmasse" ULONG Def_dez_ul_q1 0 0 0.0 4294311934.0000 ECU_ADDRESS 0xD0000AA4 /end MEASUREMENT
/begin MEASUREMENT Nkw_stat "Summation der stationäre Drehzahl" ULONG Def_dez_ul_q1 0 0 0.0 4294901759.0000 ECU_ADDRESS 0xD0000AA8 /end MEASUREMENT
/begin MEASUREMENT Pld_stat "Summation Ladedruck" ULONG Def_dez_ul_q1 0 0 0.0 4294901759.0000 ECU_ADDRESS 0xD0000AAC /end MEASUREMENT
/begin MEASUREMENT Msair "Luftmassenstrom (incl. AGR-Pfad) in den Motor " SWORD Def_ml_sw_q0p1 0 0 0.0 3276.7000 ECU_ADDRESS 0xD000012C /end MEASUREMENT
/begin MEASUREMENT Msairmf4 "" SWORD Def_f_sw_q0p1 0 0 0.0 3276.7000 ECU_ADDRESS 0xD000012E /end MEASUREMENT
/begin MEASUREMENT Msfrair "Frischluftmassenstrom in den Motor" SWORD Def_ml_sw_q0p1 0 0 0.0 3276.7000 ECU_ADDRESS 0xD0000130 /end MEASUREMENT
/begin MEASUREMENT Msfrair_korr "Korrigierte Frischluftmasse" SWORD Def_ml_sw_q0p1 0 0 0.0 3276.7000 ECU_ADDRESS 0xD0000132 /end MEASUREMENT
/begin MEASUREMENT Hfm_vx "HFM Adaption Test x-Stützstelle" UWORD Def_dez_uw_q1 0 0 0.0 65535.0000 ECU_ADDRESS 0xD000148C /end MEASUREMENT
/begin MEASUREMENT Hfm_vy "HFM Adaption Test y-Stützstelle" UWORD Def_dez_uw_q1 0 0 0.0 65535.0000 ECU_ADDRESS 0xD000148E /end MEASUREMENT
/begin MEASUREMENT Hfm_vz "HFM Adaption Test z-Stützwert" UWORD Def_dez_uw_q1 0 0 0.0 65535.0000 ECU_ADDRESS 0xD0001490 /end MEASUREMENT
/begin MEASUREMENT Hfm_x "" UWORD Def_u_uw_q0p00488 0 0 0.0 319.9951 ECU_ADDRESS 0xD0001492 /end MEASUREMENT
/begin MEASUREMENT Hfm_y "" UWORD Def_dez_uw_q0p01 0 0 0.0 655.3500 ECU_ADDRESS 0xD0001494 /end MEASUREMENT
/begin MEASUREMENT Hfm_z "" UWORD Def_dez_uw_q1 0 0 0.0 65535.0000 ECU_ADDRESS 0xD0001496 /end MEASUREMENT
/begin MEASUREMENT Agrpos "PID gefilterte AGR-Klappen-Position" UWORD Def_u_uw_q0p00488 0 0 0.0 5.0000 ECU_ADDRESS 0xD0000134 /end MEASUREMENT
/begin MEASUREMENT Agrpos_filt "LowPass gefilterte Agrpos-Variable" UWORD Def_u_uw_q0p00488 0 0 0.0 5.0000 ECU_ADDRESS 0xD0000136 /end MEASUREMENT
/begin MEASUREMENT Agrpos_mw "gemittelte AGR-Ventilposition" UWORD Def_u_uw_q0p00488 0 0 0.0 5.0000 ECU_ADDRESS 0xD0000138 /end MEASUREMENT
/begin MEASUREMENT Agrpos_old "Position des AGR-Ventils (letzter Zyklus)" UWORD Def_u_uw_q0p00488 0 0 0.0 5.0000 ECU_ADDRESS 0xD000013A /end MEASUREMENT
/begin MEASUREMENT Etavol "volumetrischer Wirkungsgrad" UWORD Def_f_uw_b2 0 0 0.0 1.9999 ECU_ADDRESS 0xD000013C /end MEASUREMENT
/begin MEASUREMENT Fairlam "Divisionsfaktor aus Msairlam_mw und Msfrair_mw" UWORD Def_f_uw_b100 0 0 0.0 99.9984 ECU_ADDRESS 0xD000013E /end MEASUREMENT
/begin MEASUREMENT Hfm_kf "" UWORD Def_dez_uw_q1 0 0 0.0 65535.0000 ECU_ADDRESS 0xD0000140 /end MEASUREMENT
/begin MEASUREMENT Hfm_kf_korr "HFM Kennfeld Korrekturwert" UWORD Def_dez_uw_q1 0 0 0.0 65535.0000 ECU_ADDRESS 0xD0000142 /end MEASUREMENT
/begin MEASUREMENT Hfm_kf_post "" UWORD Def_f_uw_b8 0 0 0.0 7.9998 ECU_ADDRESS 0xD0000144 /end MEASUREMENT
/begin MEASUREMENT Hfm_kf_pre "" UWORD Def_f_uw_b8 0 0 0.0 7.9998 ECU_ADDRESS 0xD0000146 /end MEASUREMENT
/begin MEASUREMENT La_old "Lambdasignal letzter Zyklus" UWORD Def_f_uw_b16 0 0 0.0 15.9997 ECU_ADDRESS 0xD0000148 /end MEASUREMENT
/begin MEASUREMENT Me_filt "Einspritzmenge pro Zyl. gefiltert" UWORD Def_dez_uw_q0p01 0 0 0.0 655.3500 ECU_ADDRESS 0xD000014A /end MEASUREMENT
/begin MEASUREMENT Me_mw "gefilterte Einspritzmenge pro Zyl." UWORD Def_dez_uw_q0p01 0 0 0.0 655.3500 ECU_ADDRESS 0xD000014C /end MEASUREMENT
/begin MEASUREMENT Me_old "Einspritzmenge pro Zyl. - letzter Zyklus" UWORD Def_dez_uw_q0p01 0 0 0.0 655.3500 ECU_ADDRESS 0xD000014E /end MEASUREMENT
/begin MEASUREMENT Msairlam "rekonstruierte Frischluftmasse aus Einspritzmenge und Lambdasignal" UWORD Def_ml_uw_q0p1 0 0 0.0 6553.5000 ECU_ADDRESS 0xD0000150 /end MEASUREMENT
/begin MEASUREMENT Msairlam_mw "mittlere rekonstruierte Frischluftmasse" UWORD Def_ml_uw_q0p1 0 0 0.0 6553.5000 ECU_ADDRESS 0xD0000152 /end MEASUREMENT
/begin MEASUREMENT Msairlam_old "rekonstruierte Frischluftmasse (letzter Zyklus)" UWORD Def_ml_uw_q0p1 0 0 0.0 6553.5000 ECU_ADDRESS 0xD0000154 /end MEASUREMENT
/begin MEASUREMENT Msfrair_mw "mittlerer Frischluftmassenstrom" UWORD Def_dez_uw_q0p01 0 0 0.0 655.3500 ECU_ADDRESS 0xD0000156 /end MEASUREMENT
/begin MEASUREMENT Nkw_mw "gemittelte Motordrehzahl" UWORD Def_dez_uw_q1 0 0 0.0 5000.0000 ECU_ADDRESS 0xD0000158 /end MEASUREMENT
/begin MEASUREMENT Pld_mw "Ladedruck Mittelwert" UWORD Def_dez_uw_q1 0 0 0.0 65535.0000 ECU_ADDRESS 0xD000015A /end MEASUREMENT
/begin MEASUREMENT Zanzmw "Zähler - zeigt die Anzahl der aufsummierten Messwerte (*_stat) an" UWORD Def_dez_uw_q1 0 0 0.0 65534.0000 ECU_ADDRESS 0xD000015C /end MEASUREMENT
/begin MEASUREMENT wptn_ohneeta "Luftmasse DT1 gefiltert one volumetrischen Wirkungsgrad" UWORD Def_dez_uw_q1 0 0 0.0 4000.0000 ECU_ADDRESS 0xD000015E /end MEASUREMENT
/begin MEASUREMENT Hfm_xs "HFM Adaption Test xSize" UBYTE Def_dez_ub_q1 0 0 0.0 255.0000 ECU_ADDRESS 0xD0001498 /end MEASUREMENT
/begin MEASUREMENT Hfm_ys "HFM Adaption Test ySize" UBYTE Def_dez_ub_q1 0 0 0.0 255.0000 ECU_ADDRESS 0xD0001499 /end MEASUREMENT
/begin MEASUREMENT Hfm_ix "" UBYTE Def_dez_ub_q1 0 0 0.0 255.0000 ECU_ADDRESS 0xD000019D /end MEASUREMENT
/begin MEASUREMENT Hfm_iy "" UBYTE Def_dez_ub_q1 0 0 0.0 255.0000 ECU_ADDRESS 0xD000019E /end MEASUREMENT
/begin MEASUREMENT Hfm_result "" UBYTE Def_dez_ub_q1 0 0 0.0 255.0000 ECU_ADDRESS 0xD000019F /end MEASUREMENT
/begin MEASUREMENT St_hhs.B_hhs_ein "heizbare Heckscheibe ein" UBYTE Def_bit_ub_0 0 0 0.0 255.0 ECU_ADDRESS 0xD00014A4 BIT_MASK 0x1 /end MEASUREMENT
/begin MEASUREMENT St_hhs "Statuswort" UBYTE Def_st_ub_q1 0 0 0.0 255.0000 ECU_ADDRESS 0xD00014A4 /end MEASUREMENT
/begin MEASUREMENT St_igr1.B_igrlow "Bedingung iGR LOW" UBYTE Def_bit_ub_0 0 0 0.0 255.0 ECU_ADDRESS 0xD00014C0 BIT_MASK 0x1 /end MEASUREMENT
/begin MEASUREMENT St_igr1.B_igr_on "" UBYTE Def_bit_ub_1 0 0 0.0 255.0 ECU_ADDRESS 0xD00014C0 BIT_MASK 0x2 /end MEASUREMENT
/begin MEASUREMENT St_igr1.B_igrrekup "Bedingung iGR Rekuperationsanforderung" UBYTE Def_bit_ub_2 0 0 0.0 255.0 ECU_ADDRESS 0xD00014C0 BIT_MASK 0x4 /end MEASUREMENT
/begin MEASUREMENT St_igr1.B_igrbsactr "" UBYTE Def_bit_ub_3 0 0 0.0 255.0 ECU_ADDRESS 0xD00014C0 BIT_MASK 0x8 /end MEASUREMENT
/begin MEASUREMENT St_igr1.B_regelakt "Bedingung Batteriestromregelung aktiv" UBYTE Def_bit_ub_4 0 0 0.0 255.0 ECU_ADDRESS 0xD00014C0 BIT_MASK 0x10 /end MEASUREMENT
/begin MEASUREMENT St_igr1 "Statuswort" UBYTE Def_st_ub_q1 0 0 0.0 255.0000 ECU_ADDRESS 0xD00014C0 /end MEASUREMENT
/begin MEASUREMENT St_igroutnv.B_cdigronr "IGR-Codierdaten mit Tester lesen" UBYTE Def_bit_ub_0 0 0 0.0 255.0 ECU_ADDRESS 0xD0009630 BIT_MASK 0x1 /end MEASUREMENT
/begin MEASUREMENT St_igroutnv.B_cdxenonr "Xenonverbau - Codierdaten mit Tester lesen" UBYTE Def_bit_ub_1 0 0 0.0 255.0 ECU_ADDRESS 0xD0009630 BIT_MASK 0x2 /end MEASUREMENT
/begin MEASUREMENT St_igroutnv "Statuswort" UBYTE Def_st_ub_q1 0 0 0.0 255.0000 ECU_ADDRESS 0xD0009630 /end MEASUREMENT
/begin MEASUREMENT Pr_igr_dn "Priorität iGR Spannungsrampe negativ" UBYTE Def_dez_ub_q1 0 0 0.0 255.0000 ECU_ADDRESS 0xD00014C1 /end MEASUREMENT
/begin MEASUREMENT Pr_igr_dp "Priorität iGR Spannungsrampe positiv" UBYTE Def_dez_ub_q1 0 0 0.0 255.0000 ECU_ADDRESS 0xD00014C2 /end MEASUREMENT
/begin MEASUREMENT Pr_igr_soll "Priorität iGR Sollspannungsanforderung" UBYTE Def_dez_ub_q1 0 0 0.0 255.0000 ECU_ADDRESS 0xD00014C3 /end MEASUREMENT
/begin MEASUREMENT U_igr_dn "" UBYTE Def_u_ub_b0p5 0 0 0.0 0.4980 ECU_ADDRESS 0xD00014C4 /end MEASUREMENT
/begin MEASUREMENT U_igr_dp "" UBYTE Def_u_ub_b0p5 0 0 0.0 0.4980 ECU_ADDRESS 0xD00014C5 /end MEASUREMENT
/begin MEASUREMENT U_igr_soll "Spannungsanforderung iGR" UBYTE Def_u_ub_q0p1 0 0 0.0 25.5000 ECU_ADDRESS 0xD00014C6 /end MEASUREMENT
/begin MEASUREMENT I_batt_f "" SWORD Def_i_sw_q0p02 0 0 -655.3600 655.3400 ECU_ADDRESS 0xD00014D0 /end MEASUREMENT
/begin MEASUREMENT I_igr_high "" SWORD Def_i_sw_q0p02 0 0 -655.3600 655.3400 ECU_ADDRESS 0xD00014D2 /end MEASUREMENT
/begin MEASUREMENT I_igr_med "Stromsollwertvorgabe für iGR Betriebsmodus Medium" SWORD Def_i_sw_q0p02 0 0 -655.3600 655.3400 ECU_ADDRESS 0xD00014D4 /end MEASUREMENT
/begin MEASUREMENT I_igr_mh "Stromsollwertvorgabe Batteriestromregelung" SWORD Def_i_sw_q0p02 0 0 -655.3600 655.3400 ECU_ADDRESS 0xD00014D6 /end MEASUREMENT
/begin MEASUREMENT I_igrdelta "Abweichung Batteriestrom Sollwert - Istwert" SWORD Def_i_sw_q0p02 0 0 -655.3600 655.3400 ECU_ADDRESS 0xD00014D8 /end MEASUREMENT
/begin MEASUREMENT I_igrfahr_h "Fahrerpotentialadaptive Anpassung Batteriestromsollwert High" SWORD Def_i_sw_q0p02 0 0 -655.3600 655.3400 ECU_ADDRESS 0xD00014DA /end MEASUREMENT
/begin MEASUREMENT I_igrfahr_m "Fahrerpotentialadaptive Anpassung Batteriestromsollwert Medium" SWORD Def_i_sw_q0p02 0 0 -655.3600 655.3400 ECU_ADDRESS 0xD00014DC /end MEASUREMENT
/begin MEASUREMENT I_igrdelta_abs "Betrag Abweichung Batteriestrom Sollwert - Istwert" UWORD Def_i_uw_q0p02 0 0 0.0 1310.7000 ECU_ADDRESS 0xD00014DE /end MEASUREMENT
/begin MEASUREMENT U_igrmedhi "" UWORD Def_u_uw_q0p00488 0 0 0.0 319.9951 ECU_ADDRESS 0xD00014E0 /end MEASUREMENT
/begin MEASUREMENT St_igrdiag_a0.B_igra0_0 "" UBYTE Def_bit_ub_0 0 0 0.0 255.0 ECU_ADDRESS 0xD000157C BIT_MASK 0x1 /end MEASUREMENT
/begin MEASUREMENT St_igrdiag_a0.B_igra0_1 "" UBYTE Def_bit_ub_1 0 0 0.0 255.0 ECU_ADDRESS 0xD000157C BIT_MASK 0x2 /end MEASUREMENT
/begin MEASUREMENT St_igrdiag_a0.B_igra0_2 "" UBYTE Def_bit_ub_2 0 0 0.0 255.0 ECU_ADDRESS 0xD000157C BIT_MASK 0x4 /end MEASUREMENT
/begin MEASUREMENT St_igrdiag_a0.B_igra0_3 "" UBYTE Def_bit_ub_3 0 0 0.0 255.0 ECU_ADDRESS 0xD000157C BIT_MASK 0x8 /end MEASUREMENT
/begin MEASUREMENT St_igrdiag_a0.B_igra0_4 "" UBYTE Def_bit_ub_4 0 0 0.0 255.0 ECU_ADDRESS 0xD000157C BIT_MASK 0x10 /end MEASUREMENT
/begin MEASUREMENT St_igrdiag_a0.B_igra0_5 "" UBYTE Def_bit_ub_5 0 0 0.0 255.0 ECU_ADDRESS 0xD000157C BIT_MASK 0x20 /end MEASUREMENT
/begin MEASUREMENT St_igrdiag_a0.B_igra0_6 "" UBYTE Def_bit_ub_6 0 0 0.0 255.0 ECU_ADDRESS 0xD000157C BIT_MASK 0x40 /end MEASUREMENT
/begin MEASUREMENT St_igrdiag_a0.B_igra0_7 "" UBYTE Def_bit_ub_7 0 0 0.0 255.0 ECU_ADDRESS 0xD000157C BIT_MASK 0x80 /end MEASUREMENT
/begin MEASUREMENT St_igrdiag_a0 "Statuswort" UBYTE Def_st_ub_q1 0 0 0.0 255.0000 ECU_ADDRESS 0xD000157C /end MEASUREMENT
/begin MEASUREMENT Qlad_igrlow "IGR-Info Ladung bei iGR-Low" UWORD Def_ql_uw_q0p0182 0 0 0.0 1192.7502 ECU_ADDRESS 0xD0001586 /end MEASUREMENT
/begin MEASUREMENT Igrinfo "Infospeicher iGR" UBYTE Def_dez_ub_q1 0 0 0.0 255.0000 ECU_ADDRESS 0xD0009631 ARRAY_SIZE 30 /end MEASUREMENT
/begin MEASUREMENT T_igr_hwl "IGR-Zeit in High+Low" ULONG Def_dez_ul_q1 0 0 0.0 4294967295.0000 ECU_ADDRESS 0xD0001550 /end MEASUREMENT
/begin MEASUREMENT T_igr_hwol "IGR-Zeit in High ohne Low" ULONG Def_dez_ul_q1 0 0 0.0 4294967295.0000 ECU_ADDRESS 0xD0001554 /end MEASUREMENT
/begin MEASUREMENT T_igr_lwomh "IGR-Zeit in Low ohne Med+High" ULONG Def_dez_ul_q1 0 0 0.0 4294967295.0000 ECU_ADDRESS 0xD0001558 /end MEASUREMENT
/begin MEASUREMENT T_igr_mwl "IGR-Zeit in Med+Low" ULONG Def_dez_ul_q1 0 0 0.0 4294967295.0000 ECU_ADDRESS 0xD000155C /end MEASUREMENT
/begin MEASUREMENT T_igr_none "IGR-Zeit nicht aktiv" ULONG Def_dez_ul_q1 0 0 0.0 4294967295.0000 ECU_ADDRESS 0xD0001560 /end MEASUREMENT
/begin MEASUREMENT Qelad_igrhi "IGR-Info Entladung bei iGR-High" UWORD Def_ql_uw_q0p0182 0 0 0.0 1192.7502 ECU_ADDRESS 0xD0001588 /end MEASUREMENT
/begin MEASUREMENT Qelad_start "IGR-Info Startwert iGR-High" UWORD Def_ql_uw_q0p0182 0 0 0.0 1192.7502 ECU_ADDRESS 0xD000158A /end MEASUREMENT
/begin MEASUREMENT Qlad_start "IGR-Info Startwert iGR-Low" UWORD Def_ql_uw_q0p0182 0 0 0.0 1192.7502 ECU_ADDRESS 0xD000158C /end MEASUREMENT
/begin MEASUREMENT W_gen_igr "IGR-Leistung Generator" UWORD Def_f_uw_b8192 0 0 0.0 8191.8750 ECU_ADDRESS 0xD000158E /end MEASUREMENT
/begin MEASUREMENT Dff_igrlow "DFF-Durchschnitt bei iGR-Low" UBYTE Def_f_ub_b100 0 0 0.0 99.6093 ECU_ADDRESS 0xD000157D /end MEASUREMENT
/begin MEASUREMENT Igr_info_a0 "IGR-Infospeicherstati in Array 0" UBYTE Def_dez_ub_q1 0 0 0.0 255.0000 ECU_ADDRESS 0xD000157E /end MEASUREMENT
/begin MEASUREMENT T_igrant_h "IGR-Anteil High" UBYTE Def_f_ub_b100 0 0 0.0 99.6093 ECU_ADDRESS 0xD000157F /end MEASUREMENT
/begin MEASUREMENT T_igrant_hl "IGR-Anteil High+Low" UBYTE Def_f_ub_b100 0 0 0.0 99.6093 ECU_ADDRESS 0xD0001580 /end MEASUREMENT
/begin MEASUREMENT T_igrant_l "IGR-Anteil Low" UBYTE Def_f_ub_b100 0 0 0.0 99.6093 ECU_ADDRESS 0xD0001581 /end MEASUREMENT
/begin MEASUREMENT T_igrant_m "IGR-Anteil Medium" UBYTE Def_f_ub_b100 0 0 0.0 99.6093 ECU_ADDRESS 0xD0001582 /end MEASUREMENT
/begin MEASUREMENT T_igrant_ml "IGR-Anteil Medium+Low" UBYTE Def_f_ub_b100 0 0 0.0 99.6093 ECU_ADDRESS 0xD0001583 /end MEASUREMENT
/begin MEASUREMENT T_igrant_none "IGR-Anteil nicht aktiv" UBYTE Def_f_ub_b100 0 0 0.0 99.6093 ECU_ADDRESS 0xD0001584 /end MEASUREMENT
/begin MEASUREMENT St_igrsbcalc.B_sa_igr "Energierekuperationsanforderung iGR" UBYTE Def_bit_ub_0 0 0 0.0 255.0 ECU_ADDRESS 0xD0001590 BIT_MASK 0x1 /end MEASUREMENT
/begin MEASUREMENT St_igrsbcalc.B_igrlow_on "Bedingung iGR Low aktiviert" UBYTE Def_bit_ub_1 0 0 0.0 255.0 ECU_ADDRESS 0xD0001590 BIT_MASK 0x2 /end MEASUREMENT
/begin MEASUREMENT St_igrsbcalc "Statuswort" UBYTE Def_st_ub_q1 0 0 0.0 255.0000 ECU_ADDRESS 0xD0001590 /end MEASUREMENT
/begin MEASUREMENT St_imdgen0.B_gene "Generatormoment enable/disable" UBYTE Def_bit_ub_1 0 0 0.0 255.0 ECU_ADDRESS 0xD00001FC BIT_MASK 0x2 /end MEASUREMENT
/begin MEASUREMENT St_imdgen0.B_generken "Generatorerkennung noch nicht erfolgt" UBYTE Def_bit_ub_2 0 0 0.0 255.0 ECU_ADDRESS 0xD00001FC BIT_MASK 0x4 /end MEASUREMENT
/begin MEASUREMENT St_imdgen0.B_mod_calc "Bedingung Momentenmodell muß gerechnet werden" UBYTE Def_bit_ub_3 0 0 0.0 255.0 ECU_ADDRESS 0xD00001FC BIT_MASK 0x8 /end MEASUREMENT
/begin MEASUREMENT St_imdgen0 "Statuswort" UBYTE Def_st_ub_q1 0 0 0.0 255.0000 ECU_ADDRESS 0xD00001FC /end MEASUREMENT
/begin MEASUREMENT St_imdgen_nv0.B_genfkupl "Generatortyp unplausibel" UBYTE Def_bit_ub_0 0 0 0.0 255.0 ECU_ADDRESS 0xD00001FD BIT_MASK 0x1 /end MEASUREMENT
/begin MEASUREMENT St_imdgen_nv0 "Statuswort" UBYTE Def_st_ub_q1 0 0 0.0 255.0000 ECU_ADDRESS 0xD00001FD /end MEASUREMENT
/begin MEASUREMENT Tchip_diff1 "" SWORD Def_t_sw_q0p1 0 0 -3276.8000 3276.7000 ECU_ADDRESS 0xD0001592 /end MEASUREMENT
/begin MEASUREMENT Tchip_diff2 "" SWORD Def_t_sw_q0p1 0 0 -3276.8000 3276.7000 ECU_ADDRESS 0xD0001594 /end MEASUREMENT
/begin MEASUREMENT Md_gennm "gefiltertes Generatormoment absolut Ausgang" SWORD Def_m_sw_q0p1 0 0 -3276.8000 3276.7000 ECU_ADDRESS 0xD00001B8 /end MEASUREMENT
/begin MEASUREMENT Md_gennmtp "Ungefiltertes unkorrigiertes Generatormoment" SWORD Def_m_sw_q0p1 0 0 -3276.8000 3276.7000 ECU_ADDRESS 0xD00001BA /end MEASUREMENT
/begin MEASUREMENT N_gen "Generatordrehzahl" SWORD Def_n_sw_q1p0 0 0 0.0 32767.0000 ECU_ADDRESS 0xD00001BC /end MEASUREMENT
/begin MEASUREMENT N_gen_tmp "Temporäre Generatordrehzahl" SWORD Def_n_sw_q1p0 0 0 0.0 32767.0000 ECU_ADDRESS 0xD00001BE /end MEASUREMENT
/begin MEASUREMENT Tgen "Generatortemperatur" SWORD Def_t_sw_q0p1 0 0 -3276.8000 3276.7000 ECU_ADDRESS 0xD00001C0 /end MEASUREMENT
/begin MEASUREMENT Md_genvf "relatives Generatordrehmoment" UWORD Def_f_uw_b100 0 0 0.0 99.9984 ECU_ADDRESS 0xD00001C2 /end MEASUREMENT
/begin MEASUREMENT Ugen_calc "Berechnete Generatorspannung" UWORD Def_u_uw_q0p1 0 0 0.0 6553.5000 ECU_ADDRESS 0xD00001C4 /end MEASUREMENT
/begin MEASUREMENT I_gen "Generatorstrom" UBYTE Def_i_ub_q1 0 0 0.0 255.0000 ECU_ADDRESS 0xD00001FE /end MEASUREMENT
/begin MEASUREMENT I_genmax "korrigiertes DF Signal ueber Temperatur, Generatordrehzahl, Generatorspannung" UBYTE Def_i_ub_q1 0 0 0.0 255.0000 ECU_ADDRESS 0xD00001FF /end MEASUREMENT
/begin MEASUREMENT Gen_awnumm "Generatorkennfeldnummer" UBYTE Def_st_ub_q1 0 0 1.0000 7.0000 ECU_ADDRESS 0xD000964F /end MEASUREMENT
/begin MEASUREMENT Kf_iu1 "Ausgang Kennfeldipol 1" SWORD Def_i_sw_q0p03125 0 0 -1024.0000 1023.9687 ECU_ADDRESS 0xD0001596 /end MEASUREMENT
/begin MEASUREMENT Kf_iu2 "Ausgang Kennfeldipol 2" SWORD Def_i_sw_q0p03125 0 0 -1024.0000 1023.9687 ECU_ADDRESS 0xD0001598 /end MEASUREMENT
/begin MEASUREMENT Kf_iu3 "Ausgang Kennfeldipol 3" SWORD Def_i_sw_q0p03125 0 0 -1024.0000 1023.9687 ECU_ADDRESS 0xD000159A /end MEASUREMENT
/begin MEASUREMENT Dffgen_dt "Ableitung Dffgensignal" SWORD Def_dt_sw_b4096 0 0 -4096.0000 4095.8750 ECU_ADDRESS 0xD00001C6 /end MEASUREMENT
/begin MEASUREMENT Md_gen_roh "" SWORD Def_m_sw_q0p1 0 0 -3276.8000 3276.7000 ECU_ADDRESS 0xD00001C8 /end MEASUREMENT
/begin MEASUREMENT Md_genfil "gefiltertes Generatormoment absolut" SWORD Def_m_sw_q0p1 0 0 -3276.8000 3276.7000 ECU_ADDRESS 0xD00001CA /end MEASUREMENT
/begin MEASUREMENT Md_gennm_end "temporäre Grösse Generatormomentberechnung" SWORD Def_m_sw_q0p1 0 0 -3276.8000 3276.7000 ECU_ADDRESS 0xD00001CC /end MEASUREMENT
/begin MEASUREMENT I_gen_nafil "Generatorstrom nach Filter" UWORD Def_i_uw_q0p03125 0 0 0.0 256.0000 ECU_ADDRESS 0xD00001CE /end MEASUREMENT
/begin MEASUREMENT I_gen_vorfil "Generatorstrom vor Filter" UWORD Def_i_uw_q0p03125 0 0 0.0 256.0000 ECU_ADDRESS 0xD00001D0 /end MEASUREMENT
/begin MEASUREMENT I_gentmp "Temporäre Größe zur Generatorstromberechnung" UWORD Def_i_uw_q0p03125 0 0 0.0 256.0000 ECU_ADDRESS 0xD00001D2 /end MEASUREMENT
/begin MEASUREMENT I_gentp "Temporäre Größe zur Generatorstromberechnung" UWORD Def_i_uw_q0p03125 0 0 0.0 256.0000 ECU_ADDRESS 0xD00001D4 /end MEASUREMENT
/begin MEASUREMENT Md_genrel "relatives Generatormoment Ausgang" UWORD Def_f_uw_b100 0 0 0.0 99.9984 ECU_ADDRESS 0xD00001D6 /end MEASUREMENT
/begin MEASUREMENT Dffgen_f "Gefiltertes Dffgen" UBYTE Def_f_ub_b100 0 0 0.0 99.6093 ECU_ADDRESS 0xD0000200 /end MEASUREMENT
/begin MEASUREMENT I_gen_end "Generatorstrom gemessen / gerechnet" UBYTE Def_i_ub_q1 0 0 0.0 254.0000 ECU_ADDRESS 0xD0000201 /end MEASUREMENT
/begin MEASUREMENT I_gen_g "Generatorstrom gesamt" UBYTE Def_i_ub_q1 0 0 0.0 255.0000 ECU_ADDRESS 0xD0000202 /end MEASUREMENT
/begin FUNCTION ELMOTENTL ""
 /begin DEF_CHARACTERISTIC KF_PRIO_4 KF_PRIO_HOLD KF_PRIO_NO KF_PRIO_UP KL_VLPRIO41 KL_VLPRIO42 KL_VLPRIO43 K_DNMOT K_MAXDT1_HY K_MD_ELMOTENTL K_MINDT1_HY K_NKWMAX_HS K_NKWMIN_HY K_PR_ELMOTENTL K_PWGMAX_HY K_PWGMIN_HY K_TD_DELAY1 K_TD_DELAY2 K_TD_DELAY3 K_TD_DOWN K_TD_GEAR K_TD_HOLD K_TD_HOLDNO K_TD_UP K_TODPRIO0 K_TPDNMOT K_VMAX_HY K_VMIN_HY K_WAFS K_WDAFS S_ELMOTENTL /end DEF_CHARACTERISTIC
 /begin REF_CHARACTERISTIC /end REF_CHARACTERISTIC
 /begin IN_MEASUREMENT /end IN_MEASUREMENT
 /begin OUT_MEASUREMENT Dnmottp Dnmotvtp St_elmot1 St_elmot1.B_hp1_ntod St_elmot1.B_hp1_vtod St_elmot1.B_np0_nkw St_elmot1.B_np0_rf St_elmot1.B_np0_v St_elmot1.B_up_absafs St_elmot2 St_elmot2.B_hp2_ntod St_elmot2.B_hp2_vtod St_elmot2.B_nzgofsum St_elmot2.B_up_gangi0 St_elmot2.B_up_rf4 St_elmot2.B_up_rfntod St_elmot2.B_up_rfvtod St_elmotentl St_elmotentl.B_nzgof1 St_elmotentl.B_nzgof2 St_elmotentl.B_nzgof3 St_elmotentl.B_prio St_elmotentl.B_priovdelay St_elmottime St_elmottime.B_inold_1 St_elmottime.B_inold_2 St_elmottime.B_inold_3 St_elmottime.B_inold_4 St_elmottime.B_inold_5 St_elmottime.B_inold_6 St_entlast_loc Stat_entl Timecount_0 Timecount_1 Timecount_2 Timecount_3 Timecount_4 Timecount_5 Timecount_6 /end OUT_MEASUREMENT
/end FUNCTION
/begin FUNCTION HFM_MW ""
 /begin DEF_CHARACTERISTIC Hfm_adapt KF_FAKVW KF_HFM_INIT KL_FAKLAM KL_FAKME K_AGRKONST K_AGRPOSMAX K_AGRPOSMIN K_ANZMW K_FSTVE K_HFMADAPTSCALE K_HFM_INIM K_HFM_IX K_HFM_IY K_HFM_LA K_HFM_VX K_HFM_VY K_HFM_Z K_IV_AIRFILT K_IV_AIRZFILT K_IV_MEFILT K_IV_RAGRFILT K_MEMAXADAPT K_MEMINADAPT K_NKWAIR K_NKWMINADAPT K_QSCHUB K_T_AIRFILT K_T_AIRZFILT K_T_MEFILT K_T_RAGRFILT K_VOLMOT K_WPTN_IV K_WPTN_K K_WPTN_T K_ZYL S_HFMADAPTS S_HFMADAPTT S_HFMADAPTZ S_HFM_ADAPT S_HFM_INI S_HFM_LA S_HFM_TESTAD S_HFM_TRIG /end DEF_CHARACTERISTIC
 /begin REF_CHARACTERISTIC /end REF_CHARACTERISTIC
 /begin IN_MEASUREMENT /end IN_MEASUREMENT
 /begin OUT_MEASUREMENT Agrpos Agrpos_filt Agrpos_mw Agrpos_old Agrpos_stat Etavol Fairlam Hfm_ix Hfm_iy Hfm_kf Hfm_kf_korr Hfm_kf_post Hfm_kf_pre Hfm_result Hfm_vx Hfm_vy Hfm_vz Hfm_x Hfm_xs Hfm_y Hfm_ys Hfm_z La_old Me_filt Me_mw Me_old Me_stat Ms_aircylfilt Ms_airfilt Msair Msair_stat Msairlam Msairlam_mw Msairlam_old Msairlam_stat Msairmf4 Msfrair Msfrair_korr Msfrair_mw Nkw_mw Nkw_stat Pld_mw Pld_stat St_hfmmw St_hfmmw.B_adaption St_hfmmw.B_hfm_inited St_hfmmw.B_hfm_update St_hfmmw.B_motmode St_hfmmw.B_sm_aktiv Zanzmw Zr2hfm_adapt Zr_hfm_adapt wptn_ohneeta /end OUT_MEASUREMENT
/end FUNCTION
/begin FUNCTION HHS_REG ""
 /begin DEF_CHARACTERISTIC K_HHSDELAY K_HHSLEVEL1 K_HHSLEVEL2 K_HHSREGAKT K_HHSVAUS K_HHSVEIN /end DEF_CHARACTERISTIC
 /begin REF_CHARACTERISTIC /end REF_CHARACTERISTIC
 /begin IN_MEASUREMENT /end IN_MEASUREMENT
 /begin OUT_MEASUREMENT St_hhs St_hhs.B_hhs_ein /end OUT_MEASUREMENT
/end FUNCTION
/begin FUNCTION IGR ""
 /begin DEF_CHARACTERISTIC K_IGRDFGEN_MN K_IGRDFGEN_MX K_IGRNL K_IGRNL_MAX K_IGRNL_MIN K_IGRUMAX K_IGRUMN K_IGR_DI1 K_IGR_DI1DT K_IGR_DI2 K_IGR_DI2DT K_IGR_ENTPR K_IGR_IHF K_IGR_IHIGH K_IGR_IMED K_IGR_IMF K_IGR_ISTEP K_IGR_OSDI1 K_IGR_UDN K_IGR_UDP K_PR_IGRDN K_PR_IGRDP K_PR_IGRLOW K_PR_IGRMH K_U_SATDYN /end DEF_CHARACTERISTIC
 /begin REF_CHARACTERISTIC /end REF_CHARACTERISTIC
 /begin IN_MEASUREMENT /end IN_MEASUREMENT
 /begin OUT_MEASUREMENT I_batt_f I_igr_high I_igr_med I_igr_mh I_igrdelta I_igrdelta_abs I_igrfahr_h I_igrfahr_m Pr_igr_dn Pr_igr_dp Pr_igr_soll St_igr1 St_igr1.B_igr_on St_igr1.B_igrbsactr St_igr1.B_igrlow St_igr1.B_igrrekup St_igr1.B_regelakt St_igroutnv St_igroutnv.B_cdigronr St_igroutnv.B_cdxenonr U_igr_dn U_igr_dp U_igr_soll U_igrmedhi /end OUT_MEASUREMENT
/end FUNCTION
/begin FUNCTION IGRDIAG "" /begin DEF_CHARACTERISTIC K_IGRINF_KPT K_IGRINF_TDF K_IGRINF_TSB K_IGR_ETANTR /end DEF_CHARACTERISTIC /begin REF_CHARACTERISTIC /end REF_CHARACTERISTIC /begin IN_MEASUREMENT /end IN_MEASUREMENT
 /begin OUT_MEASUREMENT Dff_igrlow Igr_info_a0 Igrinfo Qelad_igrhi Qelad_start Qlad_igrlow Qlad_start St_igrdiag_a0 St_igrdiag_a0.B_igra0_0 St_igrdiag_a0.B_igra0_1 St_igrdiag_a0.B_igra0_2 St_igrdiag_a0.B_igra0_3 St_igrdiag_a0.B_igra0_4 St_igrdiag_a0.B_igra0_5 St_igrdiag_a0.B_igra0_6 St_igrdiag_a0.B_igra0_7 T_igr_hwl T_igr_hwol T_igr_lwomh T_igr_mwl T_igr_none T_igrant_h T_igrant_hl T_igrant_l T_igrant_m T_igrant_ml T_igrant_none W_gen_igr /end OUT_MEASUREMENT
/end FUNCTION
/begin FUNCTION IGRSBCALC "" /begin DEF_CHARACTERISTIC K_IGRBS K_IGRLOW_EN K_IGR_VMIN S_IGRLOW_MAN /end DEF_CHARACTERISTIC /begin REF_CHARACTERISTIC /end REF_CHARACTERISTIC /begin IN_MEASUREMENT /end IN_MEASUREMENT
 /begin OUT_MEASUREMENT St_igrsbcalc St_igrsbcalc.B_igrlow_on St_igrsbcalc.B_sa_igr /end OUT_MEASUREMENT
/end FUNCTION
/begin FUNCTION IMDGEN ""
 /begin DEF_CHARACTERISTIC KF_GENTYP_NEU KF_IU1T1_1 KF_IU1T1_2 KF_IU1T1_3 KF_IU1T1_4 KF_IU1T1_5 KF_IU1T1_6 KF_IU1T2_1 KF_IU1T2_2 KF_IU1T2_3 KF_IU1T2_4 KF_IU1T2_5 KF_IU1T2_6 KF_IU2T1_1 KF_IU2T1_2 KF_IU2T1_3 KF_IU2T1_4 KF_IU2T1_5 KF_IU2T1_6 KF_MDGENFIL KF_MU1T1_1 KF_MU1T1_2 KF_MU1T1_3 KF_MU1T1_4 KF_MU1T1_5 KF_MU1T1_6 KF_MU1T2_1 KF_MU1T2_2 KF_MU1T2_3 KF_MU1T2_4 KF_MU1T2_5 KF_MU1T2_6 KF_MU2T1_1 KF_MU2T1_2 KF_MU2T1_3 KF_MU2T1_4 KF_MU2T1_5 KF_MU2T1_6 KL_T_CHIP1 KL_T_CHIP2 K_DFFGENFIL K_DF_DEAKAPP K_EN_MDGEN K_GENITYP K_GENMDNMOF K_GENUEBSETZ K_GEN_IGOF K_IGNOTWERT K_IMDGENNRRW K_MANAWNUMM K_NSCHW_CALC K_R_LADLTG K_TDFIERR K_UBOFF K_ZMGENIG S_RDGENTYP /end DEF_CHARACTERISTIC
 /begin REF_CHARACTERISTIC /end REF_CHARACTERISTIC
 /begin IN_MEASUREMENT /end IN_MEASUREMENT
 /begin OUT_MEASUREMENT Dffgen_dt Dffgen_f Gen_awnumm I_gen I_gen_end I_gen_g I_gen_nafil I_gen_vorfil I_genmax I_gentmp I_gentp Kf_iu1 Kf_iu2 Kf_iu3 Md_gen_roh Md_genfil Md_gennm Md_gennm_end Md_gennmtp Md_genrel Md_genvf N_gen N_gen_tmp St_imdgen0 St_imdgen0.B_gene St_imdgen0.B_generken St_imdgen0.B_mod_calc St_imdgen_nv0 St_imdgen_nv0.B_genfkupl Tchip_diff1 Tchip_diff2 Tgen Ugen_calc /end OUT_MEASUREMENT
/end FUNCTION
/begin COMPU_METHOD Def_dez_ub_q1 "Def_dez_ub_q1" RAT_FUNC "%3.0" "-" COEFFS 0 1 0 0 0 1 /end COMPU_METHOD
/begin COMPU_METHOD Def_dez_ul_q1 "Def_dez_ul_q1" RAT_FUNC "%7.0" "-" COEFFS 0 1 0 0 0 1 /end COMPU_METHOD
/begin COMPU_METHOD Def_dez_uw_q1 "Def_dez_uw_q1" RAT_FUNC "%5.0" "-" COEFFS 0 1 0 0 0 1 /end COMPU_METHOD
/begin COMPU_METHOD Def_st_ub_q1 "Def_st_ub_q1" RAT_FUNC "%3.0" "-" COEFFS 0 1 0 0 0 1 /end COMPU_METHOD
/begin COMPU_METHOD Def_dez_sw_q1 "Def_dez_sw_q1" RAT_FUNC "%5.0" "-" COEFFS 0 1 0 0 0 1 /end COMPU_METHOD
/begin COMPU_METHOD Def_f_ub_b100 "Def_f_ub_b100" RAT_FUNC "%5.2" "%" COEFFS 0 256 0 0 0 100 /end COMPU_METHOD
/begin COMPU_METHOD Def_f_uw_b2 "Def_f_uw_b2" RAT_FUNC "%14.5" "-" COEFFS 0 65536 0 0 0 2 /end COMPU_METHOD
/begin COMPU_METHOD Def_f_uw_b16 "Def_f_uw_b16" RAT_FUNC "%9.4" "-" COEFFS 0 65536 0 0 0 16 /end COMPU_METHOD
/begin COMPU_METHOD Def_m_sw_q0p1 "Def_m_sw_q0p1" RAT_FUNC "%7.2" "Nm" COEFFS 0 10 0 0 0 1 /end COMPU_METHOD
/begin COMPU_METHOD Def_me_sw_q0p01 "Def_me_sw_q0p01" RAT_FUNC "%8.3" "mg/cyc" COEFFS 0 100 0 0 0 1 /end COMPU_METHOD
/begin COMPU_METHOD Def_ml_sw_q0p1 "Def_ml_sw_q0p1" RAT_FUNC "%7.2" "mg/Hub" COEFFS 0 10 0 0 0 1 /end COMPU_METHOD
/begin COMPU_METHOD Def_f_ub_b2 "Def_f_ub_b2" RAT_FUNC "%6.3" "-" COEFFS 0 256 0 0 0 2 /end COMPU_METHOD
/begin COMPU_METHOD Def_n_sw_q1p0 "Def_n_sw_q1p0" RAT_FUNC "%5.0" "Upm" COEFFS 0 1 0 0 0 1 /end COMPU_METHOD
/begin COMPU_METHOD Def_dez_uw_q0p01 "Def_dez_uw_q0p01" RAT_FUNC "%8.3" "-" COEFFS 0 100 0 0 0 1 /end COMPU_METHOD
/begin COMPU_METHOD Def_p_uw_q0p039 "Def_p_uw_q0p039" RAT_FUNC "%7.2" "hPa" COEFFS 0 256 0 0 0 10 /end COMPU_METHOD
/begin COMPU_METHOD Def_wdk_sw_q0p0244 "Def_wdk_sw_q0p0244" RAT_FUNC "%7.2" "%" COEFFS 0 4096 0 0 0 100 /end COMPU_METHOD
/begin COMPU_METHOD Def_rf_sw_q0p01 "Def_rf_sw_q0p01" RAT_FUNC "%9.4" "%" COEFFS 0 100 0 0 0 1 /end COMPU_METHOD
/begin COMPU_METHOD Def_bit_ub_1 "Def_bit_ub_1" TAB_VERB "%5.2" "-" COMPU_TAB_REF Def_bit_ub_1_VTAB /end COMPU_METHOD
/begin COMPU_METHOD Def_bit_ub_2 "Def_bit_ub_2" TAB_VERB "%5.2" "-" COMPU_TAB_REF Def_bit_ub_2_VTAB /end COMPU_METHOD
/begin COMPU_METHOD Def_bit_ub_0 "Def_bit_ub_0" TAB_VERB "%5.2" "-" COMPU_TAB_REF Def_bit_ub_0_VTAB /end COMPU_METHOD
/begin COMPU_METHOD Def_bit_ub_3 "Def_bit_ub_3" TAB_VERB "%5.2" "-" COMPU_TAB_REF Def_bit_ub_3_VTAB /end COMPU_METHOD
/begin COMPU_METHOD Def_bit_ub_4 "Def_bit_ub_4" TAB_VERB "%5.2" "-" COMPU_TAB_REF Def_bit_ub_4_VTAB /end COMPU_METHOD
/begin COMPU_METHOD Def_bit_ub_5 "Def_bit_ub_5" TAB_VERB "%5.2" "-" COMPU_TAB_REF Def_bit_ub_5_VTAB /end COMPU_METHOD
/begin COMPU_METHOD Def_bit_ub_6 "Def_bit_ub_6" TAB_VERB "%5.2" "-" COMPU_TAB_REF Def_bit_ub_6_VTAB /end COMPU_METHOD
/begin COMPU_METHOD Def_bit_ub_7 "Def_bit_ub_7" TAB_VERB "%5.2" "-" COMPU_TAB_REF Def_bit_ub_7_VTAB /end COMPU_METHOD
/begin COMPU_METHOD Def_t_sw_q0p1 "Def_t_sw_q0p1" RAT_FUNC "%6.1" "°C" COEFFS 0 10 0 0 0 1 /end COMPU_METHOD
/begin COMPU_METHOD Def_td_uw_q0p01 "Def_td_uw_q0p01" RAT_FUNC "%7.2" "s" COEFFS 0 100 0 0 0 1 /end COMPU_METHOD
/begin COMPU_METHOD Def_td_uw_q0p1 "Def_td_uw_q0p1" RAT_FUNC "%6.1" "s" COEFFS 0 10 0 0 0 1 /end COMPU_METHOD
/begin COMPU_METHOD Def_td_ub_q0p1 "Def_td_ub_q0p1" RAT_FUNC "%4.1" "s" COEFFS 0 10 0 0 0 1 /end COMPU_METHOD
/begin COMPU_METHOD Def_t_sw_q0p01 "Def_t_sw_q0p01" RAT_FUNC "%7.2" "°C" COEFFS 0 100 0 0 0 1 /end COMPU_METHOD
/begin COMPU_METHOD Def_u_uw_q0p1 "Def_u_uw_q0p1" RAT_FUNC "%8.3" "V" COEFFS 0 10 0 0 0 1 /end COMPU_METHOD
/begin COMPU_METHOD Def_u_ub_q0p1 "Def_u_ub_q0p1" RAT_FUNC "%5.2" "V" COEFFS 0 10 0 0 0 1 /end COMPU_METHOD
/begin COMPU_METHOD Def_v_uw_q1p0 "Def_v_uw_q1p0" RAT_FUNC "%5.0" "km/h" COEFFS 0 1 0 0 0 1 /end COMPU_METHOD
/begin COMPU_METHOD Def_bit_ub_0 "Def_bit_ub_0" TAB_VERB "%5.2" "-" COMPU_TAB_REF Def_bit_ub_0_VTAB /end COMPU_METHOD
/begin COMPU_METHOD Def_bit_ub_1 "Def_bit_ub_1" TAB_VERB "%5.2" "-" COMPU_TAB_REF Def_bit_ub_1_VTAB /end COMPU_METHOD
/begin COMPU_METHOD Def_bit_ub_2 "Def_bit_ub_2" TAB_VERB "%5.2" "-" COMPU_TAB_REF Def_bit_ub_2_VTAB /end COMPU_METHOD
/begin COMPU_METHOD Def_bit_ub_3 "Def_bit_ub_3" TAB_VERB "%5.2" "-" COMPU_TAB_REF Def_bit_ub_3_VTAB /end COMPU_METHOD
/begin COMPU_METHOD Def_st_ub_q1 "Def_st_ub_q1" RAT_FUNC "%3.0" "-" COEFFS 0 1 0 0 0 1 /end COMPU_METHOD
/begin COMPU_METHOD Def_wdk_sw_q0p0244 "Def_wdk_sw_q0p0244" RAT_FUNC "%7.2" "%" COEFFS 0 4096 0 0 0 100 /end COMPU_METHOD
/begin COMPU_METHOD Def_v_uw_q1p0 "Def_v_uw_q1p0" RAT_FUNC "%5.0" "km/h" COEFFS 0 1 0 0 0 1 /end COMPU_METHOD
/begin COMPU_METHOD Def_bit_ub_0 "Def_bit_ub_0" TAB_VERB "%5.2" "-" COMPU_TAB_REF Def_bit_ub_0_VTAB /end COMPU_METHOD
/begin COMPU_METHOD Def_st_ub_q1 "Def_st_ub_q1" RAT_FUNC "%3.0" "-" COEFFS 0 1 0 0 0 1 /end COMPU_METHOD
/begin COMPU_METHOD Def_dez_ul_q1 "Def_dez_ul_q1" RAT_FUNC "%7.0" "-" COEFFS 0 1 0 0 0 1 /end COMPU_METHOD
/begin COMPU_METHOD Def_dez_ub_q1 "Def_dez_ub_q1" RAT_FUNC "%3.0" "-" COEFFS 0 1 0 0 0 1 /end COMPU_METHOD
/begin COMPU_METHOD Def_t_sw_q0p1 "Def_t_sw_q0p1" RAT_FUNC "%6.1" "°C" COEFFS 0 10 0 0 0 1 /end COMPU_METHOD
/begin COMPU_METHOD Def_t_sw_q0p01 "Def_t_sw_q0p01" RAT_FUNC "%7.2" "°C" COEFFS 0 100 0 0 0 1 /end COMPU_METHOD
/begin COMPU_METHOD Def_bit_ub_0 "Def_bit_ub_0" TAB_VERB "%5.2" "-" COMPU_TAB_REF Def_bit_ub_0_VTAB /end COMPU_METHOD
/begin COMPU_METHOD Def_bit_ub_1 "Def_bit_ub_1" TAB_VERB "%5.2" "-" COMPU_TAB_REF Def_bit_ub_1_VTAB /end COMPU_METHOD
/begin COMPU_METHOD Def_bit_ub_2 "Def_bit_ub_2" TAB_VERB "%5.2" "-" COMPU_TAB_REF Def_bit_ub_2_VTAB /end COMPU_METHOD
/begin COMPU_METHOD Def_st_ub_q1 "Def_st_ub_q1" RAT_FUNC "%3.0" "-" COEFFS 0 1 0 0 0 1 /end COMPU_METHOD
/begin COMPU_METHOD Def_bit_ub_3 "Def_bit_ub_3" TAB_VERB "%5.2" "-" COMPU_TAB_REF Def_bit_ub_3_VTAB /end COMPU_METHOD
/begin COMPU_METHOD Def_bit_ub_4 "Def_bit_ub_4" TAB_VERB "%5.2" "-" COMPU_TAB_REF Def_bit_ub_4_VTAB /end COMPU_METHOD
/begin COMPU_METHOD Def_bit_ub_5 "Def_bit_ub_5" TAB_VERB "%5.2" "-" COMPU_TAB_REF Def_bit_ub_5_VTAB /end COMPU_METHOD
/begin COMPU_METHOD Def_bit_ub_6 "Def_bit_ub_6" TAB_VERB "%5.2" "-" COMPU_TAB_REF Def_bit_ub_6_VTAB /end COMPU_METHOD
/begin COMPU_METHOD Def_bit_ub_7 "Def_bit_ub_7" TAB_VERB "%5.2" "-" COMPU_TAB_REF Def_bit_ub_7_VTAB /end COMPU_METHOD
/begin COMPU_METHOD Def_dez_ul_q1 "Def_dez_ul_q1" RAT_FUNC "%7.0" "-" COEFFS 0 1 0 0 0 1 /end COMPU_METHOD
/begin COMPU_METHOD Def_v_uw_q1p0 "Def_v_uw_q1p0" RAT_FUNC "%5.0" "km/h" COEFFS 0 1 0 0 0 1 /end COMPU_METHOD
/begin COMPU_METHOD Def_n_sw_q1p0 "Def_n_sw_q1p0" RAT_FUNC "%5.0" "Upm" COEFFS 0 1 0 0 0 1 /end COMPU_METHOD
/begin COMPU_METHOD Def_dez_ub_q1 "Def_dez_ub_q1" RAT_FUNC "%3.0" "-" COEFFS 0 1 0 0 0 1 /end COMPU_METHOD
/begin COMPU_METHOD Def_bit_ub_0 "Def_bit_ub_0" TAB_VERB "%5.2" "-" COMPU_TAB_REF Def_bit_ub_0_VTAB /end COMPU_METHOD
/begin COMPU_METHOD Def_bit_ub_1 "Def_bit_ub_1" TAB_VERB "%5.2" "-" COMPU_TAB_REF Def_bit_ub_1_VTAB /end COMPU_METHOD
/begin COMPU_METHOD Def_bit_ub_2 "Def_bit_ub_2" TAB_VERB "%5.2" "-" COMPU_TAB_REF Def_bit_ub_2_VTAB /end COMPU_METHOD
/begin COMPU_METHOD Def_st_ub_q1 "Def_st_ub_q1" RAT_FUNC "%3.0" "-" COEFFS 0 1 0 0 0 1 /end COMPU_METHOD
/begin COMPU_METHOD Def_dez_ub_q1 "Def_dez_ub_q1" RAT_FUNC "%3.0" "-" COEFFS 0 1 0 0 0 1 /end COMPU_METHOD
/begin COMPU_METHOD Def_wdk_sw_q0p0244 "Def_wdk_sw_q0p0244" RAT_FUNC "%7.2" "%" COEFFS 0 4096 0 0 0 100 /end COMPU_METHOD
/begin COMPU_METHOD Def_v_uw_q1p0 "Def_v_uw_q1p0" RAT_FUNC "%5.0" "km/h" COEFFS 0 1 0 0 0 1 /end COMPU_METHOD
/begin COMPU_METHOD Def_bit_ub_0 "Def_bit_ub_0" TAB_VERB "%5.2" "-" COMPU_TAB_REF Def_bit_ub_0_VTAB /end COMPU_METHOD
/begin COMPU_METHOD Def_bit_ub_1 "Def_bit_ub_1" TAB_VERB "%5.2" "-" COMPU_TAB_REF Def_bit_ub_1_VTAB /end COMPU_METHOD
/begin COMPU_METHOD Def_st_ub_q1 "Def_st_ub_q1" RAT_FUNC "%3.0" "-" COEFFS 0 1 0 0 0 1 /end COMPU_METHOD
/begin COMPU_METHOD Def_td_ub_q0p1 "Def_td_ub_q0p1" RAT_FUNC "%4.1" "s" COEFFS 0 10 0 0 0 1 /end COMPU_METHOD
/begin COMPU_METHOD Def_bit_ub_0 "Def_bit_ub_0" TAB_VERB "%5.2" "-" COMPU_TAB_REF Def_bit_ub_0_VTAB /end COMPU_METHOD
/begin COMPU_METHOD Def_bit_ub_1 "Def_bit_ub_1" TAB_VERB "%5.2" "-" COMPU_TAB_REF Def_bit_ub_1_VTAB /end COMPU_METHOD
/begin COMPU_METHOD Def_st_ub_q1 "Def_st_ub_q1" RAT_FUNC "%3.0" "-" COEFFS 0 1 0 0 0 1 /end COMPU_METHOD
/begin COMPU_METHOD Def_dez_ub_q1 "Def_dez_ub_q1" RAT_FUNC "%3.0" "-" COEFFS 0 1 0 0 0 1 /end COMPU_METHOD
/begin COMPU_METHOD Def_t_sw_q0p1 "Def_t_sw_q0p1" RAT_FUNC "%6.1" "°C" COEFFS 0 10 0 0 0 1 /end COMPU_METHOD
/begin COMPU_METHOD Def_v_uw_q1p0 "Def_v_uw_q1p0" RAT_FUNC "%5.0" "km/h" COEFFS 0 1 0 0 0 1 /end COMPU_METHOD
/begin COMPU_METHOD Def_bit_ub_0 "Def_bit_ub_0" TAB_VERB "%5.2" "-" COMPU_TAB_REF Def_bit_ub_0_VTAB /end COMPU_METHOD
/begin COMPU_METHOD Def_st_ub_q1 "Def_st_ub_q1" RAT_FUNC "%3.0" "-" COEFFS 0 1 0 0 0 1 /end COMPU_METHOD
/begin COMPU_METHOD Def_n_sw_q1p0 "Def_n_sw_q1p0" RAT_FUNC "%5.0" "Upm" COEFFS 0 1 0 0 0 1 /end COMPU_METHOD
/begin COMPU_METHOD Def_f_ub_b100 "Def_f_ub_b100" RAT_FUNC "%5.2" "%" COEFFS 0 256 0 0 0 100 /end COMPU_METHOD
/begin COMPU_METHOD Def_f_ub_b1 "Def_f_ub_b1" RAT_FUNC "%6.3" "-" COEFFS 0 256 0 0 0 1 /end COMPU_METHOD
/begin COMPU_METHOD Def_i_ub_q1 "Def_i_ub_q1" RAT_FUNC "%6.3" "" COEFFS 0 1 0 0 0 1 /end COMPU_METHOD
/begin COMPU_METHOD Def_td_ub_q0p1 "Def_td_ub_q0p1" RAT_FUNC "%4.1" "s" COEFFS 0 10 0 0 0 1 /end COMPU_METHOD
/begin COMPU_METHOD Def_t_sw_q0p1 "Def_t_sw_q0p1" RAT_FUNC "%6.1" "°C" COEFFS 0 10 0 0 0 1 /end COMPU_METHOD
/begin COMPU_METHOD Def_t_sw_q0p01 "Def_t_sw_q0p01" RAT_FUNC "%7.2" "°C" COEFFS 0 100 0 0 0 1 /end COMPU_METHOD
/begin COMPU_METHOD Def_me_sw_q0p01 "Def_me_sw_q0p01" RAT_FUNC "%8.3" "mg/cyc" COEFFS 0 100 0 0 0 1 /end COMPU_METHOD
/begin COMPU_METHOD Def_dez_uw_q1 "Def_dez_uw_q1" RAT_FUNC "%5.0" "-" COEFFS 0 1 0 0 0 1 /end COMPU_METHOD
/begin COMPU_METHOD ident "ident" RAT_FUNC "%3.0" "-" COEFFS 0 1 0 0 0 1 /end COMPU_METHOD
/begin COMPU_METHOD Def_dez_ub_q1 "Def_dez_ub_q1" RAT_FUNC "%3.0" "-" COEFFS 0 1 0 0 0 1 /end COMPU_METHOD
/begin COMPU_METHOD Def_f_ub_b1 "Def_f_ub_b1" RAT_FUNC "%6.3" "-" COEFFS 0 256 0 0 0 1 /end COMPU_METHOD
/begin COMPU_METHOD Def_ml_sw_q0p1 "Def_ml_sw_q0p1" RAT_FUNC "%7.2" "mg/Hub" COEFFS 0 10 0 0 0 1 /end COMPU_METHOD
/begin COMPU_METHOD Def_n_sw_q1p0 "Def_n_sw_q1p0" RAT_FUNC "%5.0" "Upm" COEFFS 0 1 0 0 0 1 /end COMPU_METHOD
/begin COMPU_METHOD Def_bit_ub_0 "Def_bit_ub_0" TAB_VERB "%5.2" "-" COMPU_TAB_REF Def_bit_ub_0_VTAB /end COMPU_METHOD
/begin COMPU_METHOD Def_bit_ub_1 "Def_bit_ub_1" TAB_VERB "%5.2" "-" COMPU_TAB_REF Def_bit_ub_1_VTAB /end COMPU_METHOD
/begin COMPU_METHOD Def_bit_ub_2 "Def_bit_ub_2" TAB_VERB "%5.2" "-" COMPU_TAB_REF Def_bit_ub_2_VTAB /end COMPU_METHOD
/begin COMPU_METHOD Def_bit_ub_3 "Def_bit_ub_3" TAB_VERB "%5.2" "-" COMPU_TAB_REF Def_bit_ub_3_VTAB /end COMPU_METHOD
/begin COMPU_METHOD Def_bit_ub_4 "Def_bit_ub_4" TAB_VERB "%5.2" "-" COMPU_TAB_REF Def_bit_ub_4_VTAB /end COMPU_METHOD
/begin COMPU_METHOD Def_bit_ub_5 "Def_bit_ub_5" TAB_VERB "%5.2" "-" COMPU_TAB_REF Def_bit_ub_5_VTAB /end COMPU_METHOD
/begin COMPU_METHOD Def_bit_ub_6 "Def_bit_ub_6" TAB_VERB "%5.2" "-" COMPU_TAB_REF Def_bit_ub_6_VTAB /end COMPU_METHOD
/begin COMPU_METHOD Def_bit_ub_7 "Def_bit_ub_7" TAB_VERB "%5.2" "-" COMPU_TAB_REF Def_bit_ub_7_VTAB /end COMPU_METHOD
/begin COMPU_METHOD Def_st_ub_q1 "Def_st_ub_q1" RAT_FUNC "%3.0" "-" COEFFS 0 1 0 0 0 1 /end COMPU_METHOD
/begin COMPU_METHOD Identity "Identity" RAT_FUNC "%3.0" "-" COEFFS 0 1 0 0 0 1 /end COMPU_METHOD
/begin COMPU_METHOD Def_bit_ub_0 "Def_bit_ub_0" TAB_VERB "%5.2" "-" COMPU_TAB_REF Def_bit_ub_0_VTAB /end COMPU_METHOD
/begin COMPU_METHOD Def_bit_ub_1 "Def_bit_ub_1" TAB_VERB "%5.2" "-" COMPU_TAB_REF Def_bit_ub_1_VTAB /end COMPU_METHOD
/begin COMPU_METHOD Def_bit_ub_2 "Def_bit_ub_2" TAB_VERB "%5.2" "-" COMPU_TAB_REF Def_bit_ub_2_VTAB /end COMPU_METHOD
/begin COMPU_METHOD Def_bit_ub_3 "Def_bit_ub_3" TAB_VERB "%5.2" "-" COMPU_TAB_REF Def_bit_ub_3_VTAB /end COMPU_METHOD
/begin COMPU_METHOD Def_bit_ub_4 "Def_bit_ub_4" TAB_VERB "%5.2" "-" COMPU_TAB_REF Def_bit_ub_4_VTAB /end COMPU_METHOD
/begin COMPU_METHOD Def_bit_ub_5 "Def_bit_ub_5" TAB_VERB "%5.2" "-" COMPU_TAB_REF Def_bit_ub_5_VTAB /end COMPU_METHOD
/begin COMPU_METHOD Def_bit_ub_6 "Def_bit_ub_6" TAB_VERB "%5.2" "-" COMPU_TAB_REF Def_bit_ub_6_VTAB /end COMPU_METHOD
/begin COMPU_METHOD Def_bit_ub_7 "Def_bit_ub_7" TAB_VERB "%5.2" "-" COMPU_TAB_REF Def_bit_ub_7_VTAB /end COMPU_METHOD
/begin COMPU_METHOD Def_st_ub_q1 "Def_st_ub_q1" RAT_FUNC "%3.0" "-" COEFFS 0 1 0 0 0 1 /end COMPU_METHOD
/begin COMPU_METHOD Def_n_sw_q1p0 "Def_n_sw_q1p0" RAT_FUNC "%5.0" "Upm" COEFFS 0 1 0 0 0 1 /end COMPU_METHOD
/begin COMPU_METHOD Def_td_uw_q0p1 "Def_td_uw_q0p1" RAT_FUNC "%6.1" "s" COEFFS 0 10 0 0 0 1 /end COMPU_METHOD
/begin COMPU_METHOD Def_td_ub_q0p1 "Def_td_ub_q0p1" RAT_FUNC "%4.1" "s" COEFFS 0 10 0 0 0 1 /end COMPU_METHOD
/begin COMPU_METHOD Identity "Identity" RAT_FUNC "%3.0" "-" COEFFS 0 1 0 0 0 1 /end COMPU_METHOD
/begin COMPU_METHOD Def_bit_ub_2 "Def_bit_ub_2" TAB_VERB "%5.2" "-" COMPU_TAB_REF Def_bit_ub_2_VTAB /end COMPU_METHOD
/begin COMPU_METHOD Def_bit_ub_3 "Def_bit_ub_3" TAB_VERB "%5.2" "-" COMPU_TAB_REF Def_bit_ub_3_VTAB /end COMPU_METHOD
/begin COMPU_METHOD Def_bit_ub_4 "Def_bit_ub_4" TAB_VERB "%5.2" "-" COMPU_TAB_REF Def_bit_ub_4_VTAB /end COMPU_METHOD
/begin COMPU_METHOD Def_st_ub_q1 "Def_st_ub_q1" RAT_FUNC "%3.0" "-" COEFFS 0 1 0 0 0 1 /end COMPU_METHOD
/begin COMPU_METHOD Def_bit_ub_0 "Def_bit_ub_0" TAB_VERB "%5.2" "-" COMPU_TAB_REF Def_bit_ub_0_VTAB /end COMPU_METHOD
/begin COMPU_METHOD Def_bit_ub_1 "Def_bit_ub_1" TAB_VERB "%5.2" "-" COMPU_TAB_REF Def_bit_ub_1_VTAB /end COMPU_METHOD
/begin COMPU_METHOD Def_bit_ub_5 "Def_bit_ub_5" TAB_VERB "%5.2" "-" COMPU_TAB_REF Def_bit_ub_5_VTAB /end COMPU_METHOD
/begin COMPU_METHOD Def_i_ub_q1 "Def_i_ub_q1" RAT_FUNC "%6.3" "" COEFFS 0 1 0 0 0 1 /end COMPU_METHOD
/begin COMPU_METHOD ident "ident" RAT_FUNC "%3.0" "-" COEFFS 0 1 0 0 0 1 /end COMPU_METHOD
/begin COMPU_METHOD Def_dez_uw_q1 "Def_dez_uw_q1" RAT_FUNC "%5.0" "-" COEFFS 0 1 0 0 0 1 /end COMPU_METHOD
/begin COMPU_METHOD Def_dez_ub_q1 "Def_dez_ub_q1" RAT_FUNC "%3.0" "-" COEFFS 0 1 0 0 0 1 /end COMPU_METHOD
/begin COMPU_METHOD Identity "Identity" RAT_FUNC "%3.0" "-" COEFFS 0 1 0 0 0 1 /end COMPU_METHOD
/begin COMPU_METHOD Def_bit_ub_0 "Def_bit_ub_0" TAB_VERB "%5.2" "-" COMPU_TAB_REF Def_bit_ub_0_VTAB /end COMPU_METHOD
/begin COMPU_METHOD Def_bit_ub_1 "Def_bit_ub_1" TAB_VERB "%5.2" "-" COMPU_TAB_REF Def_bit_ub_1_VTAB /end COMPU_METHOD
/begin COMPU_METHOD Def_bit_ub_2 "Def_bit_ub_2" TAB_VERB "%5.2" "-" COMPU_TAB_REF Def_bit_ub_2_VTAB /end COMPU_METHOD
/begin COMPU_METHOD Def_bit_ub_3 "Def_bit_ub_3" TAB_VERB "%5.2" "-" COMPU_TAB_REF Def_bit_ub_3_VTAB /end COMPU_METHOD
/begin COMPU_METHOD Def_bit_ub_4 "Def_bit_ub_4" TAB_VERB "%5.2" "-" COMPU_TAB_REF Def_bit_ub_4_VTAB /end COMPU_METHOD
/begin COMPU_METHOD Def_bit_ub_5 "Def_bit_ub_5" TAB_VERB "%5.2" "-" COMPU_TAB_REF Def_bit_ub_5_VTAB /end COMPU_METHOD
/begin COMPU_METHOD Def_bit_ub_6 "Def_bit_ub_6" TAB_VERB "%5.2" "-" COMPU_TAB_REF Def_bit_ub_6_VTAB /end COMPU_METHOD
/begin COMPU_METHOD Def_bit_ub_7 "Def_bit_ub_7" TAB_VERB "%5.2" "-" COMPU_TAB_REF Def_bit_ub_7_VTAB /end COMPU_METHOD
/begin COMPU_METHOD Def_st_ub_q1 "Def_st_ub_q1" RAT_FUNC "%3.0" "-" COEFFS 0 1 0 0 0 1 /end COMPU_METHOD
/begin COMPU_METHOD Def_dez_ub_q1 "Def_dez_ub_q1" RAT_FUNC "%3.0" "-" COEFFS 0 1 0 0 0 1 /end COMPU_METHOD
/begin COMPU_METHOD Def_dez_uw_q1 "Def_dez_uw_q1" RAT_FUNC "%5.0" "-" COEFFS 0 1 0 0 0 1 /end COMPU_METHOD
/begin COMPU_METHOD Def_n_sw_q1p0 "Def_n_sw_q1p0" RAT_FUNC "%5.0" "Upm" COEFFS 0 1 0 0 0 1 /end COMPU_METHOD
/begin COMPU_METHOD Def_t_sw_q0p1 "Def_t_sw_q0p1" RAT_FUNC "%6.1" "°C" COEFFS 0 10 0 0 0 1 /end COMPU_METHOD
/begin COMPU_METHOD Def_td_uw_q0p01 "Def_td_uw_q0p01" RAT_FUNC "%7.2" "s" COEFFS 0 100 0 0 0 1 /end COMPU_METHOD
/begin COMPU_METHOD Def_bit_ub_0 "Def_bit_ub_0" TAB_VERB "%5.2" "-" COMPU_TAB_REF Def_bit_ub_0_VTAB /end COMPU_METHOD
/begin COMPU_METHOD Def_bit_ub_1 "Def_bit_ub_1" TAB_VERB "%5.2" "-" COMPU_TAB_REF Def_bit_ub_1_VTAB /end COMPU_METHOD
/begin COMPU_METHOD Def_bit_ub_3 "Def_bit_ub_3" TAB_VERB "%5.2" "-" COMPU_TAB_REF Def_bit_ub_3_VTAB /end COMPU_METHOD
/begin COMPU_METHOD Def_bit_ub_5 "Def_bit_ub_5" TAB_VERB "%5.2" "-" COMPU_TAB_REF Def_bit_ub_5_VTAB /end COMPU_METHOD
/begin COMPU_METHOD Def_bit_ub_6 "Def_bit_ub_6" TAB_VERB "%5.2" "-" COMPU_TAB_REF Def_bit_ub_6_VTAB /end COMPU_METHOD
/begin COMPU_METHOD Def_bit_ub_7 "Def_bit_ub_7" TAB_VERB "%5.2" "-" COMPU_TAB_REF Def_bit_ub_7_VTAB /end COMPU_METHOD
/begin COMPU_METHOD Def_st_ub_q1 "Def_st_ub_q1" RAT_FUNC "%3.0" "-" COEFFS 0 1 0 0 0 1 /end COMPU_METHOD
/begin COMPU_METHOD Def_bit_ub_2 "Def_bit_ub_2" TAB_VERB "%5.2" "-" COMPU_TAB_REF Def_bit_ub_2_VTAB /end COMPU_METHOD
/begin COMPU_METHOD Def_bit_ub_4 "Def_bit_ub_4" TAB_VERB "%5.2" "-" COMPU_TAB_REF Def_bit_ub_4_VTAB /end COMPU_METHOD
/begin COMPU_METHOD Def_dez_ub_q1 "Def_dez_ub_q1" RAT_FUNC "%3.0" "-" COEFFS 0 1 0 0 0 1 /end COMPU_METHOD
/begin COMPU_METHOD Def_n_sw_q1p0 "Def_n_sw_q1p0" RAT_FUNC "%5.0" "Upm" COEFFS 0 1 0 0 0 1 /end COMPU_METHOD
/begin COMPU_METHOD Def_td_uw_q0p1 "Def_td_uw_q0p1" RAT_FUNC "%6.1" "s" COEFFS 0 10 0 0 0 1 /end COMPU_METHOD
/begin COMPU_METHOD Def_m_sw_q0p1 "Def_m_sw_q0p1" RAT_FUNC "%7.2" "Nm" COEFFS 0 10 0 0 0 1 /end COMPU_METHOD
/begin COMPU_METHOD Def_wdk_sw_q0p0244 "Def_wdk_sw_q0p0244" RAT_FUNC "%7.2" "%" COEFFS 0 4096 0 0 0 100 /end COMPU_METHOD
/begin COMPU_METHOD Def_w_sw_q0p1 "Def_w_sw_q0p1" RAT_FUNC "%7.2" "øKW" COEFFS 0 10 0 0 0 1 /end COMPU_METHOD
/begin COMPU_METHOD Def_dez_uw_q1 "Def_dez_uw_q1" RAT_FUNC "%5.0" "-" COEFFS 0 1 0 0 0 1 /end COMPU_METHOD
/begin COMPU_METHOD Def_v_uw_q1p0 "Def_v_uw_q1p0" RAT_FUNC "%5.0" "km/h" COEFFS 0 1 0 0 0 1 /end COMPU_METHOD
/begin COMPU_METHOD Identity "Identity" RAT_FUNC "%3.0" "-" COEFFS 0 1 0 0 0 1 /end COMPU_METHOD
/begin COMPU_METHOD Def_t_sw_q0p01 "Def_t_sw_q0p01" RAT_FUNC "%7.2" "°C" COEFFS 0 100 0 0 0 1 /end COMPU_METHOD
/begin COMPU_METHOD Def_rf_sw_q0p01 "Def_rf_sw_q0p01" RAT_FUNC "%9.4" "%" COEFFS 0 100 0 0 0 1 /end COMPU_METHOD
/begin COMPU_METHOD Def_p_uw_q0p039 "Def_p_uw_q0p039" RAT_FUNC "%7.2" "hPa" COEFFS 0 256 0 0 0 10 /end COMPU_METHOD
/begin COMPU_METHOD Def_dez_sw_q1 "Def_dez_sw_q1" RAT_FUNC "%5.0" "-" COEFFS 0 1 0 0 0 1 /end COMPU_METHOD
/begin COMPU_METHOD Def_bit_ub_0 "Def_bit_ub_0" TAB_VERB "%5.2" "-" COMPU_TAB_REF Def_bit_ub_0_VTAB /end COMPU_METHOD
/begin COMPU_METHOD Def_bit_ub_1 "Def_bit_ub_1" TAB_VERB "%5.2" "-" COMPU_TAB_REF Def_bit_ub_1_VTAB /end COMPU_METHOD
/begin COMPU_METHOD Def_bit_ub_2 "Def_bit_ub_2" TAB_VERB "%5.2" "-" COMPU_TAB_REF Def_bit_ub_2_VTAB /end COMPU_METHOD
/begin COMPU_METHOD Def_bit_ub_4 "Def_bit_ub_4" TAB_VERB "%5.2" "-" COMPU_TAB_REF Def_bit_ub_4_VTAB /end COMPU_METHOD
/begin COMPU_METHOD Def_bit_ub_5 "Def_bit_ub_5" TAB_VERB "%5.2" "-" COMPU_TAB_REF Def_bit_ub_5_VTAB /end COMPU_METHOD
/begin COMPU_METHOD Def_st_ub_q1 "Def_st_ub_q1" RAT_FUNC "%3.0" "-" COEFFS 0 1 0 0 0 1 /end COMPU_METHOD
/begin COMPU_METHOD Def_ml_sw_q0p1 "Def_ml_sw_q0p1" RAT_FUNC "%7.2" "mg/Hub" COEFFS 0 10 0 0 0 1 /end COMPU_METHOD
/begin COMPU_METHOD Def_ms_sw_q0p1 "Def_ms_sw_q0p1" RAT_FUNC "%7.2" "kg/h" COEFFS 0 10 0 0 0 1 /end COMPU_METHOD
/begin COMPU_METHOD Def_dez_uw_q1 "Def_dez_uw_q1" RAT_FUNC "%5.0" "-" COEFFS 0 1 0 0 0 1 /end COMPU_METHOD
/begin COMPU_METHOD Def_dez_ub_q1 "Def_dez_ub_q1" RAT_FUNC "%3.0" "-" COEFFS 0 1 0 0 0 1 /end COMPU_METHOD
/begin COMPU_METHOD Def_hub_uw_q0p001 "Def_hub_uw_q0p001" RAT_FUNC "%8.3" "mm" COEFFS 0 1000 0 0 0 1 /end COMPU_METHOD
/begin COMPU_METHOD Def_dez_uw_q0p01 "Def_dez_uw_q0p01" RAT_FUNC "%8.3" "-" COEFFS 0 100 0 0 0 1 /end COMPU_METHOD
/begin COMPU_METHOD Def_u_uw_q0p00488 "Def_u_uw_q0p00488" RAT_FUNC "%8.3" "V" COEFFS 0 1024 0 0 0 5 /end COMPU_METHOD
/begin COMPU_METHOD Def_dez_ul_q1 "Def_dez_ul_q1" RAT_FUNC "%7.0" "-" COEFFS 0 1 0 0 0 1 /end COMPU_METHOD
/begin COMPU_METHOD Def_f_sw_q0p1 "Def_f_sw_q0p1" RAT_FUNC "%7.2" "-" COEFFS 0 10 0 0 0 1 /end COMPU_METHOD
/begin COMPU_METHOD Def_f_uw_b2 "Def_f_uw_b2" RAT_FUNC "%14.5" "-" COEFFS 0 65536 0 0 0 2 /end COMPU_METHOD
/begin COMPU_METHOD Def_f_uw_b100 "Def_f_uw_b100" RAT_FUNC "%8.3" "%" COEFFS 0 65536 0 0 0 100 /end COMPU_METHOD
/begin COMPU_METHOD Def_f_uw_b8 "Def_f_uw_b8" RAT_FUNC "%9.4" "-" COEFFS 0 65536 0 0 0 8 /end COMPU_METHOD
/begin COMPU_METHOD Def_f_uw_b16 "Def_f_uw_b16" RAT_FUNC "%9.4" "-" COEFFS 0 65536 0 0 0 16 /end COMPU_METHOD
/begin COMPU_METHOD Def_ml_uw_q0p1 "Def_ml_uw_q0p1" RAT_FUNC "%6.1" "kg/h" COEFFS 0 10 0 0 0 1 /end COMPU_METHOD
/begin COMPU_METHOD Def_me_sw_q0p01 "Def_me_sw_q0p01" RAT_FUNC "%8.3" "mg/cyc" COEFFS 0 100 0 0 0 1 /end COMPU_METHOD
/begin COMPU_METHOD Def_n_sw_q1p0 "Def_n_sw_q1p0" RAT_FUNC "%5.0" "Upm" COEFFS 0 1 0 0 0 1 /end COMPU_METHOD
/begin COMPU_METHOD Def_f_sw_p0q25 "Def_f_sw_p0q25" RAT_FUNC "%7.2" "" COEFFS 0 4 0 0 0 1 /end COMPU_METHOD
/begin COMPU_METHOD Identity "Identity" RAT_FUNC "%3.0" "-" COEFFS 0 1 0 0 0 1 /end COMPU_METHOD
/begin COMPU_METHOD Def_f_ub_b2 "Def_f_ub_b2" RAT_FUNC "%6.3" "-" COEFFS 0 256 0 0 0 2 /end COMPU_METHOD
/begin COMPU_METHOD Def_f_ub_b32 "Def_f_ub_b32" RAT_FUNC "%5.2" "-" COEFFS 0 256 0 0 0 32 /end COMPU_METHOD
/begin COMPU_METHOD Def_p_uw_q0p039 "Def_p_uw_q0p039" RAT_FUNC "%7.2" "hPa" COEFFS 0 256 0 0 0 10 /end COMPU_METHOD
/begin COMPU_METHOD Def_bit_ub_0 "Def_bit_ub_0" TAB_VERB "%5.2" "-" COMPU_TAB_REF Def_bit_ub_0_VTAB /end COMPU_METHOD
/begin COMPU_METHOD Def_st_ub_q1 "Def_st_ub_q1" RAT_FUNC "%3.0" "-" COEFFS 0 1 0 0 0 1 /end COMPU_METHOD
/begin COMPU_METHOD Def_dez_ul_q1 "Def_dez_ul_q1" RAT_FUNC "%7.0" "-" COEFFS 0 1 0 0 0 1 /end COMPU_METHOD
/begin COMPU_METHOD Def_td_ub_q0p1 "Def_td_ub_q0p1" RAT_FUNC "%4.1" "s" COEFFS 0 10 0 0 0 1 /end COMPU_METHOD
/begin COMPU_METHOD Def_dez_ub_q1 "Def_dez_ub_q1" RAT_FUNC "%3.0" "-" COEFFS 0 1 0 0 0 1 /end COMPU_METHOD
/begin COMPU_METHOD Def_bit_ub_0 "Def_bit_ub_0" TAB_VERB "%5.2" "-" COMPU_TAB_REF Def_bit_ub_0_VTAB /end COMPU_METHOD
/begin COMPU_METHOD Def_bit_ub_1 "Def_bit_ub_1" TAB_VERB "%5.2" "-" COMPU_TAB_REF Def_bit_ub_1_VTAB /end COMPU_METHOD
/begin COMPU_METHOD Def_bit_ub_2 "Def_bit_ub_2" TAB_VERB "%5.2" "-" COMPU_TAB_REF Def_bit_ub_2_VTAB /end COMPU_METHOD
/begin COMPU_METHOD Def_bit_ub_3 "Def_bit_ub_3" TAB_VERB "%5.2" "-" COMPU_TAB_REF Def_bit_ub_3_VTAB /end COMPU_METHOD
/begin COMPU_METHOD Def_bit_ub_4 "Def_bit_ub_4" TAB_VERB "%5.2" "-" COMPU_TAB_REF Def_bit_ub_4_VTAB /end COMPU_METHOD
/begin COMPU_METHOD Def_st_ub_q1 "Def_st_ub_q1" RAT_FUNC "%3.0" "-" COEFFS 0 1 0 0 0 1 /end COMPU_METHOD
/begin COMPU_METHOD Def_dez_ub_q1 "Def_dez_ub_q1" RAT_FUNC "%3.0" "-" COEFFS 0 1 0 0 0 1 /end COMPU_METHOD
/begin COMPU_METHOD Def_u_ub_b0p5 "Def_u_ub_b0p5" RAT_FUNC "%7.4" "V" COEFFS 0 256 0 0 0 0.5 /end COMPU_METHOD
/begin COMPU_METHOD Def_u_ub_q0p1 "Def_u_ub_q0p1" RAT_FUNC "%5.2" "V" COEFFS 0 10 0 0 0 1 /end COMPU_METHOD
/begin COMPU_METHOD Def_i_sw_q0p02 "Def_i_sw_q0p02" RAT_FUNC "%8.3" "A" COEFFS 0 50 0 0 0 1 /end COMPU_METHOD
/begin COMPU_METHOD Def_i_uw_q0p02 "Def_i_uw_q0p02" RAT_FUNC "%8.3" "A" COEFFS 0 1 0 0 0 0.02 /end COMPU_METHOD
/begin COMPU_METHOD Def_u_uw_q0p00488 "Def_u_uw_q0p00488" RAT_FUNC "%8.3" "V" COEFFS 0 1024 0 0 0 5 /end COMPU_METHOD
/begin COMPU_METHOD Def_f_ub_b100 "Def_f_ub_b100" RAT_FUNC "%5.2" "%" COEFFS 0 256 0 0 0 100 /end COMPU_METHOD
/begin COMPU_METHOD Def_td_ub_q0p1 "Def_td_ub_q0p1" RAT_FUNC "%4.1" "s" COEFFS 0 10 0 0 0 1 /end COMPU_METHOD
/begin COMPU_METHOD Def_bit_ub_0 "Def_bit_ub_0" TAB_VERB "%5.2" "-" COMPU_TAB_REF Def_bit_ub_0_VTAB /end COMPU_METHOD
/begin COMPU_METHOD Def_bit_ub_1 "Def_bit_ub_1" TAB_VERB "%5.2" "-" COMPU_TAB_REF Def_bit_ub_1_VTAB /end COMPU_METHOD
/begin COMPU_METHOD Def_bit_ub_2 "Def_bit_ub_2" TAB_VERB "%5.2" "-" COMPU_TAB_REF Def_bit_ub_2_VTAB /end COMPU_METHOD
/begin COMPU_METHOD Def_bit_ub_3 "Def_bit_ub_3" TAB_VERB "%5.2" "-" COMPU_TAB_REF Def_bit_ub_3_VTAB /end COMPU_METHOD
/begin COMPU_METHOD Def_bit_ub_4 "Def_bit_ub_4" TAB_VERB "%5.2" "-" COMPU_TAB_REF Def_bit_ub_4_VTAB /end COMPU_METHOD
/begin COMPU_METHOD Def_bit_ub_5 "Def_bit_ub_5" TAB_VERB "%5.2" "-" COMPU_TAB_REF Def_bit_ub_5_VTAB /end COMPU_METHOD
/begin COMPU_METHOD Def_bit_ub_6 "Def_bit_ub_6" TAB_VERB "%5.2" "-" COMPU_TAB_REF Def_bit_ub_6_VTAB /end COMPU_METHOD
/begin COMPU_METHOD Def_bit_ub_7 "Def_bit_ub_7" TAB_VERB "%5.2" "-" COMPU_TAB_REF Def_bit_ub_7_VTAB /end COMPU_METHOD
/begin COMPU_METHOD Def_st_ub_q1 "Def_st_ub_q1" RAT_FUNC "%3.0" "-" COEFFS 0 1 0 0 0 1 /end COMPU_METHOD
/begin COMPU_METHOD Def_ql_uw_q0p0182 "Def_ql_uw_q0p0182" RAT_FUNC "%8.3" "Ah" COEFFS 0 989 0 0 0 18 /end COMPU_METHOD
/begin COMPU_METHOD Def_dez_ub_q1 "Def_dez_ub_q1" RAT_FUNC "%3.0" "-" COEFFS 0 1 0 0 0 1 /end COMPU_METHOD
/begin COMPU_METHOD Def_dez_ul_q1 "Def_dez_ul_q1" RAT_FUNC "%7.0" "-" COEFFS 0 1 0 0 0 1 /end COMPU_METHOD
/begin COMPU_METHOD Def_f_uw_b8192 "Def_f_uw_b8192" RAT_FUNC "%7.2" "-" COEFFS 0 65536 0 0 0 8192 /end COMPU_METHOD
/begin COMPU_METHOD Def_f_ub_b100 "Def_f_ub_b100" RAT_FUNC "%5.2" "%" COEFFS 0 256 0 0 0 100 /end COMPU_METHOD
/begin COMPU_METHOD Def_td_ub_q0p1 "Def_td_ub_q0p1" RAT_FUNC "%4.1" "s" COEFFS 0 10 0 0 0 1 /end COMPU_METHOD
/begin COMPU_METHOD Def_f_ub_b4 "Def_f_ub_b4" RAT_FUNC "%5.2" "-" COEFFS 0 256 0 0 0 4 /end COMPU_METHOD
/begin COMPU_METHOD Def_bit_ub_0 "Def_bit_ub_0" TAB_VERB "%5.2" "-" COMPU_TAB_REF Def_bit_ub_0_VTAB /end COMPU_METHOD
/begin COMPU_METHOD Def_bit_ub_1 "Def_bit_ub_1" TAB_VERB "%5.2" "-" COMPU_TAB_REF Def_bit_ub_1_VTAB /end COMPU_METHOD
/begin COMPU_METHOD Def_st_ub_q1 "Def_st_ub_q1" RAT_FUNC "%3.0" "-" COEFFS 0 1 0 0 0 1 /end COMPU_METHOD
/begin COMPU_METHOD Def_v_uw_q1p0 "Def_v_uw_q1p0" RAT_FUNC "%5.0" "km/h" COEFFS 0 1 0 0 0 1 /end COMPU_METHOD
/begin COMPU_METHOD ident "ident" RAT_FUNC "%3.0" "-" COEFFS 0 1 0 0 0 1 /end COMPU_METHOD
/begin COMPU_METHOD Identity "Identity" RAT_FUNC "%3.0" "-" COEFFS 0 1 0 0 0 1 /end COMPU_METHOD
/begin COMPU_METHOD Def_bit_ub_1 "Def_bit_ub_1" TAB_VERB "%5.2" "-" COMPU_TAB_REF Def_bit_ub_1_VTAB /end COMPU_METHOD
/begin COMPU_METHOD Def_bit_ub_2 "Def_bit_ub_2" TAB_VERB "%5.2" "-" COMPU_TAB_REF Def_bit_ub_2_VTAB /end COMPU_METHOD
/begin COMPU_METHOD Def_bit_ub_3 "Def_bit_ub_3" TAB_VERB "%5.2" "-" COMPU_TAB_REF Def_bit_ub_3_VTAB /end COMPU_METHOD
/begin COMPU_METHOD Def_st_ub_q1 "Def_st_ub_q1" RAT_FUNC "%3.0" "-" COEFFS 0 1 0 0 0 1 /end COMPU_METHOD
/begin COMPU_METHOD Def_bit_ub_0 "Def_bit_ub_0" TAB_VERB "%5.2" "-" COMPU_TAB_REF Def_bit_ub_0_VTAB /end COMPU_METHOD
/begin COMPU_METHOD Def_t_sw_q0p1 "Def_t_sw_q0p1" RAT_FUNC "%6.1" "°C" COEFFS 0 10 0 0 0 1 /end COMPU_METHOD
/begin COMPU_METHOD Def_m_sw_q0p1 "Def_m_sw_q0p1" RAT_FUNC "%7.2" "Nm" COEFFS 0 10 0 0 0 1 /end COMPU_METHOD
/begin COMPU_METHOD Def_n_sw_q1p0 "Def_n_sw_q1p0" RAT_FUNC "%5.0" "Upm" COEFFS 0 1 0 0 0 1 /end COMPU_METHOD
/begin COMPU_METHOD Def_f_uw_b100 "Def_f_uw_b100" RAT_FUNC "%8.3" "%" COEFFS 0 65536 0 0 0 100 /end COMPU_METHOD
/begin COMPU_METHOD Def_u_uw_q0p1 "Def_u_uw_q0p1" RAT_FUNC "%8.3" "V" COEFFS 0 10 0 0 0 1 /end COMPU_METHOD
/begin COMPU_METHOD Def_i_ub_q1 "Def_i_ub_q1" RAT_FUNC "%6.3" "" COEFFS 0 1 0 0 0 1 /end COMPU_METHOD
/begin COMPU_METHOD Def_f_ub_b4 "Def_f_ub_b4" RAT_FUNC "%5.2" "-" COEFFS 0 256 0 0 0 4 /end COMPU_METHOD
/begin COMPU_METHOD Def_i_sw_q0p125 "Def_i_sw_q0p125" RAT_FUNC "%8.3" "A" COEFFS 0 8 0 0 0 1 /end COMPU_METHOD
/begin COMPU_METHOD Def_i_sw_q0p03125 "Def_i_sw_q0p03125" RAT_FUNC "%8.3" "A" COEFFS 0 32 0 0 0 1 /end COMPU_METHOD
/begin COMPU_METHOD Def_dt_sw_b4096 "Def_dt_sw_b4096" RAT_FUNC "%7.2" "m/s" COEFFS 0 32768 0 0 0 4096 /end COMPU_METHOD
/begin COMPU_METHOD Def_i_uw_q0p03125 "Def_i_uw_q0p03125" RAT_FUNC "%8.3" "A" COEFFS 0 65536 0 0 0 2048 /end COMPU_METHOD
/begin COMPU_METHOD Def_f_ub_b100 "Def_f_ub_b100" RAT_FUNC "%5.2" "%" COEFFS 0 256 0 0 0 100 /end COMPU_METHOD
/begin COMPU_METHOD Def_f_uw_b2048 "Def_f_uw_b2048" RAT_FUNC "%7.2" "-" COEFFS 0 65536 0 0 0 2048 /end COMPU_METHOD
/begin COMPU_METHOD Def_r_uw_b1024 "Def_r_uw_b1024" RAT_FUNC "%5.0" "mOhm" COEFFS 0 64 0 0 0 1 /end COMPU_METHOD
/begin COMPU_METHOD Def_td_uw_q0p01 "Def_td_uw_q0p01" RAT_FUNC "%7.2" "s" COEFFS 0 100 0 0 0 1 /end COMPU_METHOD
/begin COMPU_METHOD Def_td_uw_q0p1 "Def_td_uw_q0p1" RAT_FUNC "%6.1" "s" COEFFS 0 10 0 0 0 1 /end COMPU_METHOD
/begin COMPU_METHOD Def_f_ub_b1 "Def_f_ub_b1" RAT_FUNC "%6.3" "-" COEFFS 0 256 0 0 0 1 /end COMPU_METHOD
/begin COMPU_METHOD Def_f_uw_b1 "Def_f_uw_b1" RAT_FUNC "%14.5" "-" COEFFS 0 65536 0 0 0 1 /end COMPU_METHOD
/begin COMPU_METHOD Def_bit_ub_0 "Def_bit_ub_0" TAB_VERB "%5.2" "-" COMPU_TAB_REF Def_bit_ub_0_VTAB /end COMPU_METHOD
/begin COMPU_METHOD Def_bit_ub_1 "Def_bit_ub_1" TAB_VERB "%5.2" "-" COMPU_TAB_REF Def_bit_ub_1_VTAB /end COMPU_METHOD
/begin COMPU_METHOD Def_st_ub_q1 "Def_st_ub_q1" RAT_FUNC "%3.0" "-" COEFFS 0 1 0 0 0 1 /end COMPU_METHOD
/begin COMPU_METHOD Def_m_sw_q0p1 "Def_m_sw_q0p1" RAT_FUNC "%7.2" "Nm" COEFFS 0 10 0 0 0 1 /end COMPU_METHOD
/begin COMPU_METHOD Def_dez_ub_q1 "Def_dez_ub_q1" RAT_FUNC "%3.0" "-" COEFFS 0 1 0 0 0 1 /end COMPU_METHOD
/begin COMPU_METHOD Def_i_sw_q0p125 "Def_i_sw_q0p125" RAT_FUNC "%8.3" "A" COEFFS 0 8 0 0 0 1 /end COMPU_METHOD
/begin COMPU_METHOD Def_n_sw_q1p0 "Def_n_sw_q1p0" RAT_FUNC "%5.0" "Upm" COEFFS 0 1 0 0 0 1 /end COMPU_METHOD
/begin COMPU_METHOD Def_f_uw_b2 "Def_f_uw_b2" RAT_FUNC "%14.5" "-" COEFFS 0 65536 0 0 0 2 /end COMPU_METHOD
/begin COMPU_METHOD Def_td_uw_q0p01 "Def_td_uw_q0p01" RAT_FUNC "%7.2" "s" COEFFS 0 100 0 0 0 1 /end COMPU_METHOD
/begin COMPU_METHOD Def_f_uw_b1 "Def_f_uw_b1" RAT_FUNC "%14.5" "-" COEFFS 0 65536 0 0 0 1 /end COMPU_METHOD
/begin COMPU_METHOD Identity "Identity" RAT_FUNC "%3.0" "-" COEFFS 0 1 0 0 0 1 /end COMPU_METHOD
/begin COMPU_METHOD Def_st_ub_q1 "Def_st_ub_q1" RAT_FUNC "%3.0" "-" COEFFS 0 1 0 0 0 1 /end COMPU_METHOD
/begin COMPU_METHOD Def_bit_ub_0 "Def_bit_ub_0" TAB_VERB "%5.2" "-" COMPU_TAB_REF Def_bit_ub_0_VTAB /end COMPU_METHOD
/begin COMPU_METHOD Def_dez_ub_q1 "Def_dez_ub_q1" RAT_FUNC "%3.0" "-" COEFFS 0 1 0 0 0 1 /end COMPU_METHOD
/begin COMPU_METHOD Def_m_sw_q0p1 "Def_m_sw_q0p1" RAT_FUNC "%7.2" "Nm" COEFFS 0 10 0 0 0 1 /end COMPU_METHOD
/begin COMPU_METHOD Def_dez_uw_q1 "Def_dez_uw_q1" RAT_FUNC "%5.0" "-" COEFFS 0 1 0 0 0 1 /end COMPU_METHOD
/begin COMPU_METHOD Def_dez_ul_q1 "Def_dez_ul_q1" RAT_FUNC "%7.0" "-" COEFFS 0 1 0 0 0 1 /end COMPU_METHOD
/begin COMPU_METHOD Def_bit_ub_0 "Def_bit_ub_0" TAB_VERB "%5.2" "-" COMPU_TAB_REF Def_bit_ub_0_VTAB /end COMPU_METHOD
/begin COMPU_METHOD Def_bit_ub_1 "Def_bit_ub_1" TAB_VERB "%5.2" "-" COMPU_TAB_REF Def_bit_ub_1_VTAB /end COMPU_METHOD
/begin COMPU_METHOD Def_st_ub_q1 "Def_st_ub_q1" RAT_FUNC "%3.0" "-" COEFFS 0 1 0 0 0 1 /end COMPU_METHOD
/begin COMPU_METHOD Def_m_sw_q0p1 "Def_m_sw_q0p1" RAT_FUNC "%7.2" "Nm" COEFFS 0 10 0 0 0 1 /end COMPU_METHOD
/begin COMPU_METHOD Def_dez_ub_q1 "Def_dez_ub_q1" RAT_FUNC "%3.0" "-" COEFFS 0 1 0 0 0 1 /end COMPU_METHOD
/begin COMPU_METHOD Def_n_sw_q1p0 "Def_n_sw_q1p0" RAT_FUNC "%5.0" "Upm" COEFFS 0 1 0 0 0 1 /end COMPU_METHOD
/begin COMPU_METHOD Def_rf_sw_q0p01 "Def_rf_sw_q0p01" RAT_FUNC "%9.4" "%" COEFFS 0 100 0 0 0 1 /end COMPU_METHOD
/begin COMPU_METHOD Def_t_sw_q0p1 "Def_t_sw_q0p1" RAT_FUNC "%6.1" "°C" COEFFS 0 10 0 0 0 1 /end COMPU_METHOD
/begin COMPU_METHOD Def_t_sw_q0p01 "Def_t_sw_q0p01" RAT_FUNC "%7.2" "°C" COEFFS 0 100 0 0 0 1 /end COMPU_METHOD
/begin COMPU_METHOD Def_td_uw_q0p1 "Def_td_uw_q0p1" RAT_FUNC "%6.1" "s" COEFFS 0 10 0 0 0 1 /end COMPU_METHOD
/begin COMPU_METHOD Def_v_uw_q1p0 "Def_v_uw_q1p0" RAT_FUNC "%5.0" "km/h" COEFFS 0 1 0 0 0 1 /end COMPU_METHOD
/begin COMPU_METHOD Def_f_ub_b4 "Def_f_ub_b4" RAT_FUNC "%5.2" "-" COEFFS 0 256 0 0 0 4 /end COMPU_METHOD
/begin COMPU_METHOD Identity "Identity" RAT_FUNC "%3.0" "-" COEFFS 0 1 0 0 0 1 /end COMPU_METHOD
/begin COMPU_METHOD Def_bit_ub_0 "Def_bit_ub_0" TAB_VERB "%5.2" "-" COMPU_TAB_REF Def_bit_ub_0_VTAB /end COMPU_METHOD
/begin COMPU_METHOD Def_bit_ub_1 "Def_bit_ub_1" TAB_VERB "%5.2" "-" COMPU_TAB_REF Def_bit_ub_1_VTAB /end COMPU_METHOD
/begin COMPU_METHOD Def_st_ub_q1 "Def_st_ub_q1" RAT_FUNC "%3.0" "-" COEFFS 0 1 0 0 0 1 /end COMPU_METHOD
/begin COMPU_METHOD Def_m_sw_q0p1 "Def_m_sw_q0p1" RAT_FUNC "%7.2" "Nm" COEFFS 0 10 0 0 0 1 /end COMPU_METHOD
/begin COMPU_METHOD Def_td_ub_q0p1 "Def_td_ub_q0p1" RAT_FUNC "%4.1" "s" COEFFS 0 10 0 0 0 1 /end COMPU_METHOD
/begin COMPU_METHOD Def_dez_ub_q1 "Def_dez_ub_q1" RAT_FUNC "%3.0" "-" COEFFS 0 1 0 0 0 1 /end COMPU_METHOD
/begin COMPU_METHOD Identity "Identity" RAT_FUNC "%3.0" "-" COEFFS 0 1 0 0 0 1 /end COMPU_METHOD
/begin COMPU_METHOD Def_f_ub_b4 "Def_f_ub_b4" RAT_FUNC "%5.2" "-" COEFFS 0 256 0 0 0 4 /end COMPU_METHOD
/begin COMPU_METHOD Def_t_sw_q0p01 "Def_t_sw_q0p01" RAT_FUNC "%7.2" "°C" COEFFS 0 100 0 0 0 1 /end COMPU_METHOD
/begin COMPU_METHOD Def_n_sw_q1p0 "Def_n_sw_q1p0" RAT_FUNC "%5.0" "Upm" COEFFS 0 1 0 0 0 1 /end COMPU_METHOD
/begin COMPU_METHOD Def_rf_sw_q0p01 "Def_rf_sw_q0p01" RAT_FUNC "%9.4" "%" COEFFS 0 100 0 0 0 1 /end COMPU_METHOD
/begin COMPU_METHOD Def_i_sw_q0p125 "Def_i_sw_q0p125" RAT_FUNC "%8.3" "A" COEFFS 0 8 0 0 0 1 /end COMPU_METHOD
/begin COMPU_METHOD Def_m_sw_q0p1 "Def_m_sw_q0p1" RAT_FUNC "%7.2" "Nm" COEFFS 0 10 0 0 0 1 /end COMPU_METHOD
/begin COMPU_METHOD Def_st_ub_q1 "Def_st_ub_q1" RAT_FUNC "%3.0" "-" COEFFS 0 1 0 0 0 1 /end COMPU_METHOD
/begin COMPU_METHOD Def_bit_ub_0 "Def_bit_ub_0" TAB_VERB "%5.2" "-" COMPU_TAB_REF Def_bit_ub_0_VTAB /end COMPU_METHOD
/begin COMPU_METHOD Def_bit_ub_1 "Def_bit_ub_1" TAB_VERB "%5.2" "-" COMPU_TAB_REF Def_bit_ub_1_VTAB /end COMPU_METHOD
/begin COMPU_METHOD Def_bit_ub_2 "Def_bit_ub_2" TAB_VERB "%5.2" "-" COMPU_TAB_REF Def_bit_ub_2_VTAB /end COMPU_METHOD
/begin COMPU_METHOD Def_bit_ub_3 "Def_bit_ub_3" TAB_VERB "%5.2" "-" COMPU_TAB_REF Def_bit_ub_3_VTAB /end COMPU_METHOD
/begin COMPU_METHOD Def_bit_ub_4 "Def_bit_ub_4" TAB_VERB "%5.2" "-" COMPU_TAB_REF Def_bit_ub_4_VTAB /end COMPU_METHOD
/begin COMPU_METHOD Def_dez_ub_q1 "Def_dez_ub_q1" RAT_FUNC "%3.0" "-" COEFFS 0 1 0 0 0 1 /end COMPU_METHOD
/begin COMPU_METHOD Def_m_sw_q0p1 "Def_m_sw_q0p1" RAT_FUNC "%7.2" "Nm" COEFFS 0 10 0 0 0 1 /end COMPU_METHOD
/begin COMPU_METHOD Def_td_uw_q0p01 "Def_td_uw_q0p01" RAT_FUNC "%7.2" "s" COEFFS 0 100 0 0 0 1 /end COMPU_METHOD
/begin COMPU_METHOD Def_wdk_sw_q0p0244 "Def_wdk_sw_q0p0244" RAT_FUNC "%7.2" "%" COEFFS 0 4096 0 0 0 100 /end COMPU_METHOD
/begin COMPU_METHOD Def_n_sw_q1p0 "Def_n_sw_q1p0" RAT_FUNC "%5.0" "Upm" COEFFS 0 1 0 0 0 1 /end COMPU_METHOD
/begin COMPU_METHOD Def_td_ub_q0p1 "Def_td_ub_q0p1" RAT_FUNC "%4.1" "s" COEFFS 0 10 0 0 0 1 /end COMPU_METHOD
/begin COMPU_METHOD Def_t_sw_q0p1 "Def_t_sw_q0p1" RAT_FUNC "%6.1" "°C" COEFFS 0 10 0 0 0 1 /end COMPU_METHOD
/begin COMPU_METHOD Def_v_uw_q1p0 "Def_v_uw_q1p0" RAT_FUNC "%5.0" "km/h" COEFFS 0 1 0 0 0 1 /end COMPU_METHOD
/begin COMPU_METHOD Def_t_sw_q0p01 "Def_t_sw_q0p01" RAT_FUNC "%7.2" "°C" COEFFS 0 100 0 0 0 1 /end COMPU_METHOD
/begin COMPU_METHOD Def_dez_ub_q1 "Def_dez_ub_q1" RAT_FUNC "%3.0" "-" COEFFS 0 1 0 0 0 1 /end COMPU_METHOD
/begin COMPU_METHOD Def_u_ub_q0p1 "Def_u_ub_q0p1" RAT_FUNC "%5.2" "V" COEFFS 0 10 0 0 0 1 /end COMPU_METHOD
/begin COMPU_METHOD Def_m_sw_q0p1 "Def_m_sw_q0p1" RAT_FUNC "%7.2" "Nm" COEFFS 0 10 0 0 0 1 /end COMPU_METHOD
/begin COMPU_METHOD Def_st_ub_q1 "Def_st_ub_q1" RAT_FUNC "%3.0" "-" COEFFS 0 1 0 0 0 1 /end COMPU_METHOD
/begin COMPU_METHOD Def_bit_ub_0 "Def_bit_ub_0" TAB_VERB "%5.2" "-" COMPU_TAB_REF Def_bit_ub_0_VTAB /end COMPU_METHOD
/begin COMPU_METHOD Def_bit_ub_1 "Def_bit_ub_1" TAB_VERB "%5.2" "-" COMPU_TAB_REF Def_bit_ub_1_VTAB /end COMPU_METHOD
/begin COMPU_METHOD Def_bit_ub_2 "Def_bit_ub_2" TAB_VERB "%5.2" "-" COMPU_TAB_REF Def_bit_ub_2_VTAB /end COMPU_METHOD
/begin COMPU_METHOD Def_bit_ub_0 "Def_bit_ub_0" TAB_VERB "%5.2" "-" COMPU_TAB_REF Def_bit_ub_0_VTAB /end COMPU_METHOD
/begin COMPU_METHOD Def_st_ub_q1 "Def_st_ub_q1" RAT_FUNC "%3.0" "-" COEFFS 0 1 0 0 0 1 /end COMPU_METHOD
/begin COMPU_METHOD Def_bit_ub_1 "Def_bit_ub_1" TAB_VERB "%5.2" "-" COMPU_TAB_REF Def_bit_ub_1_VTAB /end COMPU_METHOD
/begin COMPU_METHOD Def_bit_ub_4 "Def_bit_ub_4" TAB_VERB "%5.2" "-" COMPU_TAB_REF Def_bit_ub_4_VTAB /end COMPU_METHOD
/begin COMPU_METHOD Def_bit_ub_5 "Def_bit_ub_5" TAB_VERB "%5.2" "-" COMPU_TAB_REF Def_bit_ub_5_VTAB /end COMPU_METHOD
/begin COMPU_METHOD Def_bit_ub_3 "Def_bit_ub_3" TAB_VERB "%5.2" "-" COMPU_TAB_REF Def_bit_ub_3_VTAB /end COMPU_METHOD
/begin COMPU_METHOD Def_dez_ub_q1 "Def_dez_ub_q1" RAT_FUNC "%3.0" "-" COEFFS 0 1 0 0 0 1 /end COMPU_METHOD
/begin COMPU_METHOD Def_bit_ub_2 "Def_bit_ub_2" TAB_VERB "%5.2" "-" COMPU_TAB_REF Def_bit_ub_2_VTAB /end COMPU_METHOD
/begin COMPU_METHOD Def_dez_uw_q1 "Def_dez_uw_q1" RAT_FUNC "%5.0" "-" COEFFS 0 1 0 0 0 1 /end COMPU_METHOD
/begin COMPU_METHOD Def_ql_uw_q0p0182 "Def_ql_uw_q0p0182" RAT_FUNC "%8.3" "Ah" COEFFS 0 989 0 0 0 18 /end COMPU_METHOD
/begin COMPU_METHOD Def_i_sw_q0p02 "Def_i_sw_q0p02" RAT_FUNC "%8.3" "A" COEFFS 0 50 0 0 0 1 /end COMPU_METHOD
/begin COMPU_METHOD Def_t_sw_q0p1 "Def_t_sw_q0p1" RAT_FUNC "%6.1" "°C" COEFFS 0 10 0 0 0 1 /end COMPU_METHOD
/begin COMPU_METHOD Def_i_uw_q0p02 "Def_i_uw_q0p02" RAT_FUNC "%8.3" "A" COEFFS 0 1 0 0 0 0.02 /end COMPU_METHOD
/begin COMPU_METHOD Def_dez_ul_q1 "Def_dez_ul_q1" RAT_FUNC "%7.0" "-" COEFFS 0 1 0 0 0 1 /end COMPU_METHOD
/begin COMPU_METHOD ident "ident" RAT_FUNC "%3.0" "-" COEFFS 0 1 0 0 0 1 /end COMPU_METHOD
/begin COMPU_METHOD Def_bit_ub_0 "Def_bit_ub_0" TAB_VERB "%5.2" "-" COMPU_TAB_REF Def_bit_ub_0_VTAB /end COMPU_METHOD
/begin COMPU_METHOD Def_st_ub_q1 "Def_st_ub_q1" RAT_FUNC "%3.0" "-" COEFFS 0 1 0 0 0 1 /end COMPU_METHOD
/begin COMPU_METHOD Def_n_sw_q1p0 "Def_n_sw_q1p0" RAT_FUNC "%5.0" "Upm" COEFFS 0 1 0 0 0 1 /end COMPU_METHOD
/begin COMPU_METHOD Def_f_ub_b100 "Def_f_ub_b100" RAT_FUNC "%5.2" "%" COEFFS 0 256 0 0 0 100 /end COMPU_METHOD
/begin COMPU_METHOD Def_dez_ub_q1 "Def_dez_ub_q1" RAT_FUNC "%3.0" "-" COEFFS 0 1 0 0 0 1 /end COMPU_METHOD
/begin COMPU_METHOD Def_td_uw_q0p01 "Def_td_uw_q0p01" RAT_FUNC "%7.2" "s" COEFFS 0 100 0 0 0 1 /end COMPU_METHOD
/begin COMPU_METHOD Def_f_ub_b1 "Def_f_ub_b1" RAT_FUNC "%6.3" "-" COEFFS 0 256 0 0 0 1 /end COMPU_METHOD
/begin COMPU_METHOD Def_t_sw_q0p1 "Def_t_sw_q0p1" RAT_FUNC "%6.1" "°C" COEFFS 0 10 0 0 0 1 /end COMPU_METHOD
/begin COMPU_METHOD Def_st_ub_q1 "Def_st_ub_q1" RAT_FUNC "%3.0" "-" COEFFS 0 1 0 0 0 1 /end COMPU_METHOD
/begin COMPU_METHOD Def_n_sw_q1p0 "Def_n_sw_q1p0" RAT_FUNC "%5.0" "Upm" COEFFS 0 1 0 0 0 1 /end COMPU_METHOD
/begin COMPU_METHOD Def_f_ub_b100 "Def_f_ub_b100" RAT_FUNC "%5.2" "%" COEFFS 0 256 0 0 0 100 /end COMPU_METHOD
/begin COMPU_METHOD Identity "Identity" RAT_FUNC "%3.0" "-" COEFFS 0 1 0 0 0 1 /end COMPU_METHOD
/begin COMPU_METHOD Def_bit_ub_0 "Def_bit_ub_0" TAB_VERB "%5.2" "-" COMPU_TAB_REF Def_bit_ub_0_VTAB /end COMPU_METHOD
/begin COMPU_METHOD Def_bit_ub_1 "Def_bit_ub_1" TAB_VERB "%5.2" "-" COMPU_TAB_REF Def_bit_ub_1_VTAB /end COMPU_METHOD
/begin COMPU_METHOD Def_bit_ub_2 "Def_bit_ub_2" TAB_VERB "%5.2" "-" COMPU_TAB_REF Def_bit_ub_2_VTAB /end COMPU_METHOD
/begin COMPU_METHOD Def_st_ub_q1 "Def_st_ub_q1" RAT_FUNC "%3.0" "-" COEFFS 0 1 0 0 0 1 /end COMPU_METHOD
/begin COMPU_METHOD Def_n_sw_q1p0 "Def_n_sw_q1p0" RAT_FUNC "%5.0" "Upm" COEFFS 0 1 0 0 0 1 /end COMPU_METHOD
/begin COMPU_METHOD Def_dez_ul_q1 "Def_dez_ul_q1" RAT_FUNC "%7.0" "-" COEFFS 0 1 0 0 0 1 /end COMPU_METHOD
/begin COMPU_METHOD Def_f_uw_b100 "Def_f_uw_b100" RAT_FUNC "%8.3" "%" COEFFS 0 65536 0 0 0 100 /end COMPU_METHOD
/begin COMPU_METHOD Def_dez_uw_q1 "Def_dez_uw_q1" RAT_FUNC "%5.0" "-" COEFFS 0 1 0 0 0 1 /end COMPU_METHOD
/begin COMPU_METHOD Def_dez_ub_q1 "Def_dez_ub_q1" RAT_FUNC "%3.0" "-" COEFFS 0 1 0 0 0 1 /end COMPU_METHOD
/begin COMPU_METHOD Def_f_ub_b2 "Def_f_ub_b2" RAT_FUNC "%6.3" "-" COEFFS 0 256 0 0 0 2 /end COMPU_METHOD
/begin COMPU_METHOD Def_me_sw_q0p01 "Def_me_sw_q0p01" RAT_FUNC "%8.3" "mg/cyc" COEFFS 0 100 0 0 0 1 /end COMPU_METHOD
/begin COMPU_METHOD Def_ml_sw_q0p1 "Def_ml_sw_q0p1" RAT_FUNC "%7.2" "mg/Hub" COEFFS 0 10 0 0 0 1 /end COMPU_METHOD
/begin COMPU_METHOD Def_f_uw_b16 "Def_f_uw_b16" RAT_FUNC "%9.4" "-" COEFFS 0 65536 0 0 0 16 /end COMPU_METHOD
/begin COMPU_METHOD Def_n_sw_q1p0 "Def_n_sw_q1p0" RAT_FUNC "%5.0" "Upm" COEFFS 0 1 0 0 0 1 /end COMPU_METHOD
/begin COMPU_METHOD Def_t_sw_q0p01 "Def_t_sw_q0p01" RAT_FUNC "%7.2" "°C" COEFFS 0 100 0 0 0 1 /end COMPU_METHOD
/begin COMPU_METHOD Def_f_ub_b1 "Def_f_ub_b1" RAT_FUNC "%6.3" "-" COEFFS 0 256 0 0 0 1 /end COMPU_METHOD
/begin COMPU_METHOD Def_bit_ub_0 "Def_bit_ub_0" TAB_VERB "%5.2" "-" COMPU_TAB_REF Def_bit_ub_0_VTAB /end COMPU_METHOD
/begin COMPU_METHOD Def_st_ub_q1 "Def_st_ub_q1" RAT_FUNC "%3.0" "-" COEFFS 0 1 0 0 0 1 /end COMPU_METHOD
/begin COMPU_METHOD Def_dez_uw_q1 "Def_dez_uw_q1" RAT_FUNC "%5.0" "-" COEFFS 0 1 0 0 0 1 /end COMPU_METHOD
/begin COMPU_METHOD Def_rf_sw_q0p01 "Def_rf_sw_q0p01" RAT_FUNC "%9.4" "%" COEFFS 0 100 0 0 0 1 /end COMPU_METHOD
/begin COMPU_METHOD Def_dez_ul_q1 "Def_dez_ul_q1" RAT_FUNC "%7.0" "-" COEFFS 0 1 0 0 0 1 /end COMPU_METHOD
/begin COMPU_METHOD Def_t_sw_q0p01 "Def_t_sw_q0p01" RAT_FUNC "%7.2" "°C" COEFFS 0 100 0 0 0 1 /end COMPU_METHOD
/begin COMPU_METHOD Def_n_sw_q1p0 "Def_n_sw_q1p0" RAT_FUNC "%5.0" "Upm" COEFFS 0 1 0 0 0 1 /end COMPU_METHOD
/begin COMPU_METHOD Def_me_sw_q0p01 "Def_me_sw_q0p01" RAT_FUNC "%8.3" "mg/cyc" COEFFS 0 100 0 0 0 1 /end COMPU_METHOD
/begin COMPU_METHOD Def_f_uw_b100 "Def_f_uw_b100" RAT_FUNC "%8.3" "%" COEFFS 0 65536 0 0 0 100 /end COMPU_METHOD
/begin COMPU_METHOD Def_f_uw_b2 "Def_f_uw_b2" RAT_FUNC "%14.5" "-" COEFFS 0 65536 0 0 0 2 /end COMPU_METHOD
/begin COMPU_METHOD Def_bit_ub_0 "Def_bit_ub_0" TAB_VERB "%5.2" "-" COMPU_TAB_REF Def_bit_ub_0_VTAB /end COMPU_METHOD
/begin COMPU_METHOD Def_bit_ub_1 "Def_bit_ub_1" TAB_VERB "%5.2" "-" COMPU_TAB_REF Def_bit_ub_1_VTAB /end COMPU_METHOD
/begin COMPU_METHOD Def_bit_ub_2 "Def_bit_ub_2" TAB_VERB "%5.2" "-" COMPU_TAB_REF Def_bit_ub_2_VTAB /end COMPU_METHOD
/begin COMPU_METHOD Def_bit_ub_3 "Def_bit_ub_3" TAB_VERB "%5.2" "-" COMPU_TAB_REF Def_bit_ub_3_VTAB /end COMPU_METHOD
/begin COMPU_METHOD Def_bit_ub_4 "Def_bit_ub_4" TAB_VERB "%5.2" "-" COMPU_TAB_REF Def_bit_ub_4_VTAB /end COMPU_METHOD
/begin COMPU_METHOD Def_bit_ub_5 "Def_bit_ub_5" TAB_VERB "%5.2" "-" COMPU_TAB_REF Def_bit_ub_5_VTAB /end COMPU_METHOD
/begin COMPU_METHOD Def_bit_ub_6 "Def_bit_ub_6" TAB_VERB "%5.2" "-" COMPU_TAB_REF Def_bit_ub_6_VTAB /end COMPU_METHOD
/begin COMPU_METHOD Def_bit_ub_7 "Def_bit_ub_7" TAB_VERB "%5.2" "-" COMPU_TAB_REF Def_bit_ub_7_VTAB /end COMPU_METHOD
/begin COMPU_METHOD Def_st_ub_q1 "Def_st_ub_q1" RAT_FUNC "%3.0" "-" COEFFS 0 1 0 0 0 1 /end COMPU_METHOD
/begin COMPU_METHOD Def_t_sw_q0p1 "Def_t_sw_q0p1" RAT_FUNC "%6.1" "°C" COEFFS 0 10 0 0 0 1 /end COMPU_METHOD
/begin COMPU_METHOD Def_dez_uw_q1 "Def_dez_uw_q1" RAT_FUNC "%5.0" "-" COEFFS 0 1 0 0 0 1 /end COMPU_METHOD
/begin COMPU_METHOD Def_dez_ub_q1 "Def_dez_ub_q1" RAT_FUNC "%3.0" "-" COEFFS 0 1 0 0 0 1 /end COMPU_METHOD
/begin COMPU_METHOD Def_dez_sw_q1 "Def_dez_sw_q1" RAT_FUNC "%5.0" "-" COEFFS 0 1 0 0 0 1 /end COMPU_METHOD
/begin COMPU_METHOD Def_bit_ub_0 "Def_bit_ub_0" TAB_VERB "%5.2" "-" COMPU_TAB_REF Def_bit_ub_0_VTAB /end COMPU_METHOD
/begin COMPU_METHOD Def_bit_ub_1 "Def_bit_ub_1" TAB_VERB "%5.2" "-" COMPU_TAB_REF Def_bit_ub_1_VTAB /end COMPU_METHOD
/begin COMPU_METHOD Def_bit_ub_2 "Def_bit_ub_2" TAB_VERB "%5.2" "-" COMPU_TAB_REF Def_bit_ub_2_VTAB /end COMPU_METHOD
/begin COMPU_METHOD Def_bit_ub_3 "Def_bit_ub_3" TAB_VERB "%5.2" "-" COMPU_TAB_REF Def_bit_ub_3_VTAB /end COMPU_METHOD
/begin COMPU_METHOD Def_bit_ub_4 "Def_bit_ub_4" TAB_VERB "%5.2" "-" COMPU_TAB_REF Def_bit_ub_4_VTAB /end COMPU_METHOD
/begin COMPU_METHOD Def_bit_ub_5 "Def_bit_ub_5" TAB_VERB "%5.2" "-" COMPU_TAB_REF Def_bit_ub_5_VTAB /end COMPU_METHOD
/begin COMPU_METHOD Def_bit_ub_6 "Def_bit_ub_6" TAB_VERB "%5.2" "-" COMPU_TAB_REF Def_bit_ub_6_VTAB /end COMPU_METHOD
/begin COMPU_METHOD Def_bit_ub_7 "Def_bit_ub_7" TAB_VERB "%5.2" "-" COMPU_TAB_REF Def_bit_ub_7_VTAB /end COMPU_METHOD
/begin COMPU_METHOD Def_st_ub_q1 "Def_st_ub_q1" RAT_FUNC "%3.0" "-" COEFFS 0 1 0 0 0 1 /end COMPU_METHOD
/begin COMPU_METHOD Def_t_sw_q0p1 "Def_t_sw_q0p1" RAT_FUNC "%6.1" "°C" COEFFS 0 10 0 0 0 1 /end COMPU_METHOD
/begin COMPU_METHOD Def_dez_ub_q1 "Def_dez_ub_q1" RAT_FUNC "%3.0" "-" COEFFS 0 1 0 0 0 1 /end COMPU_METHOD
/begin COMPU_METHOD Def_dez_uw_q1 "Def_dez_uw_q1" RAT_FUNC "%5.0" "-" COEFFS 0 1 0 0 0 1 /end COMPU_METHOD
/begin COMPU_METHOD Def_td_uw_q0p01 "Def_td_uw_q0p01" RAT_FUNC "%7.2" "s" COEFFS 0 100 0 0 0 1 /end COMPU_METHOD
/begin COMPU_METHOD Def_td_uw_q0p1 "Def_td_uw_q0p1" RAT_FUNC "%6.1" "s" COEFFS 0 10 0 0 0 1 /end COMPU_METHOD
/begin COMPU_METHOD Def_dez_ub_q1 "Def_dez_ub_q1" RAT_FUNC "%3.0" "-" COEFFS 0 1 0 0 0 1 /end COMPU_METHOD
/begin COMPU_METHOD Def_bit_ub_0 "Def_bit_ub_0" TAB_VERB "%5.2" "-" COMPU_TAB_REF Def_bit_ub_0_VTAB /end COMPU_METHOD
/begin COMPU_METHOD Def_bit_ub_1 "Def_bit_ub_1" TAB_VERB "%5.2" "-" COMPU_TAB_REF Def_bit_ub_1_VTAB /end COMPU_METHOD
/begin COMPU_METHOD Def_bit_ub_2 "Def_bit_ub_2" TAB_VERB "%5.2" "-" COMPU_TAB_REF Def_bit_ub_2_VTAB /end COMPU_METHOD
/begin COMPU_METHOD Def_bit_ub_3 "Def_bit_ub_3" TAB_VERB "%5.2" "-" COMPU_TAB_REF Def_bit_ub_3_VTAB /end COMPU_METHOD
/begin COMPU_METHOD Def_bit_ub_4 "Def_bit_ub_4" TAB_VERB "%5.2" "-" COMPU_TAB_REF Def_bit_ub_4_VTAB /end COMPU_METHOD
/begin COMPU_METHOD Def_bit_ub_5 "Def_bit_ub_5" TAB_VERB "%5.2" "-" COMPU_TAB_REF Def_bit_ub_5_VTAB /end COMPU_METHOD
/begin COMPU_METHOD Def_bit_ub_6 "Def_bit_ub_6" TAB_VERB "%5.2" "-" COMPU_TAB_REF Def_bit_ub_6_VTAB /end COMPU_METHOD
/begin COMPU_METHOD Def_bit_ub_7 "Def_bit_ub_7" TAB_VERB "%5.2" "-" COMPU_TAB_REF Def_bit_ub_7_VTAB /end COMPU_METHOD
/begin COMPU_METHOD Def_st_ub_q1 "Def_st_ub_q1" RAT_FUNC "%3.0" "-" COEFFS 0 1 0 0 0 1 /end COMPU_METHOD
/begin COMPU_METHOD Def_dez_ub_q1 "Def_dez_ub_q1" RAT_FUNC "%3.0" "-" COEFFS 0 1 0 0 0 1 /end COMPU_METHOD
/begin COMPU_METHOD Def_dez_uw_q1 "Def_dez_uw_q1" RAT_FUNC "%5.0" "-" COEFFS 0 1 0 0 0 1 /end COMPU_METHOD
/begin COMPU_METHOD Def_n_sw_q1p0 "Def_n_sw_q1p0" RAT_FUNC "%5.0" "Upm" COEFFS 0 1 0 0 0 1 /end COMPU_METHOD
/begin COMPU_METHOD Def_t_sw_q0p1 "Def_t_sw_q0p1" RAT_FUNC "%6.1" "°C" COEFFS 0 10 0 0 0 1 /end COMPU_METHOD
/begin COMPU_METHOD Def_td_uw_q0p01 "Def_td_uw_q0p01" RAT_FUNC "%7.2" "s" COEFFS 0 100 0 0 0 1 /end COMPU_METHOD
/begin COMPU_METHOD Def_f_uw_b2 "Def_f_uw_b2" RAT_FUNC "%14.5" "-" COEFFS 0 65536 0 0 0 2 /end COMPU_METHOD
/begin COMPU_METHOD Def_t_sw_q0p01 "Def_t_sw_q0p01" RAT_FUNC "%7.2" "°C" COEFFS 0 100 0 0 0 1 /end COMPU_METHOD
/begin COMPU_METHOD Def_bit_ub_0 "Def_bit_ub_0" TAB_VERB "%5.2" "-" COMPU_TAB_REF Def_bit_ub_0_VTAB /end COMPU_METHOD
/begin COMPU_METHOD Def_bit_ub_1 "Def_bit_ub_1" TAB_VERB "%5.2" "-" COMPU_TAB_REF Def_bit_ub_1_VTAB /end COMPU_METHOD
/begin COMPU_METHOD Def_bit_ub_2 "Def_bit_ub_2" TAB_VERB "%5.2" "-" COMPU_TAB_REF Def_bit_ub_2_VTAB /end COMPU_METHOD
/begin COMPU_METHOD Def_bit_ub_3 "Def_bit_ub_3" TAB_VERB "%5.2" "-" COMPU_TAB_REF Def_bit_ub_3_VTAB /end COMPU_METHOD
/begin COMPU_METHOD Def_st_ub_q1 "Def_st_ub_q1" RAT_FUNC "%3.0" "-" COEFFS 0 1 0 0 0 1 /end COMPU_METHOD
/begin COMPU_METHOD Def_bit_ub_4 "Def_bit_ub_4" TAB_VERB "%5.2" "-" COMPU_TAB_REF Def_bit_ub_4_VTAB /end COMPU_METHOD
/begin COMPU_METHOD Def_bit_ub_5 "Def_bit_ub_5" TAB_VERB "%5.2" "-" COMPU_TAB_REF Def_bit_ub_5_VTAB /end COMPU_METHOD
/begin COMPU_METHOD Def_dez_uw_q1 "Def_dez_uw_q1" RAT_FUNC "%5.0" "-" COEFFS 0 1 0 0 0 1 /end COMPU_METHOD
/begin COMPU_METHOD Def_n_sw_q1p0 "Def_n_sw_q1p0" RAT_FUNC "%5.0" "Upm" COEFFS 0 1 0 0 0 1 /end COMPU_METHOD
/begin COMPU_METHOD Def_t_sw_q0p1 "Def_t_sw_q0p1" RAT_FUNC "%6.1" "°C" COEFFS 0 10 0 0 0 1 /end COMPU_METHOD
/begin COMPU_METHOD Def_bit_ub_0 "Def_bit_ub_0" TAB_VERB "%5.2" "-" COMPU_TAB_REF Def_bit_ub_0_VTAB /end COMPU_METHOD
/begin COMPU_METHOD Def_st_ub_q1 "Def_st_ub_q1" RAT_FUNC "%3.0" "-" COEFFS 0 1 0 0 0 1 /end COMPU_METHOD
/begin COMPU_METHOD Def_bit_ub_1 "Def_bit_ub_1" TAB_VERB "%5.2" "-" COMPU_TAB_REF Def_bit_ub_1_VTAB /end COMPU_METHOD
/begin COMPU_METHOD Def_bit_ub_2 "Def_bit_ub_2" TAB_VERB "%5.2" "-" COMPU_TAB_REF Def_bit_ub_2_VTAB /end COMPU_METHOD
/begin COMPU_METHOD Def_bit_ub_3 "Def_bit_ub_3" TAB_VERB "%5.2" "-" COMPU_TAB_REF Def_bit_ub_3_VTAB /end COMPU_METHOD
/begin COMPU_METHOD Def_dez_uw_q1 "Def_dez_uw_q1" RAT_FUNC "%5.0" "-" COEFFS 0 1 0 0 0 1 /end COMPU_METHOD
/begin COMPU_METHOD Def_dez_ub_q1 "Def_dez_ub_q1" RAT_FUNC "%3.0" "-" COEFFS 0 1 0 0 0 1 /end COMPU_METHOD
/begin COMPU_METHOD Def_dez_sw_q1 "Def_dez_sw_q1" RAT_FUNC "%5.0" "-" COEFFS 0 1 0 0 0 1 /end COMPU_METHOD
/begin COMPU_METHOD Def_f_ub_b1 "Def_f_ub_b1" RAT_FUNC "%6.3" "-" COEFFS 0 256 0 0 0 1 /end COMPU_METHOD
/begin COMPU_METHOD Def_t_sw_q0p1 "Def_t_sw_q0p1" RAT_FUNC "%6.1" "°C" COEFFS 0 10 0 0 0 1 /end COMPU_METHOD
/begin COMPU_METHOD Def_f_ub_b32 "Def_f_ub_b32" RAT_FUNC "%5.2" "-" COEFFS 0 256 0 0 0 32 /end COMPU_METHOD
/begin COMPU_METHOD Def_f_uw_b1 "Def_f_uw_b1" RAT_FUNC "%14.5" "-" COEFFS 0 65536 0 0 0 1 /end COMPU_METHOD
/begin COMPU_METHOD Def_t_sw_q0p1 "Def_t_sw_q0p1" RAT_FUNC "%6.1" "°C" COEFFS 0 10 0 0 0 1 /end COMPU_METHOD
/begin COMPU_METHOD Def_f_uw_b100 "Def_f_uw_b100" RAT_FUNC "%8.3" "%" COEFFS 0 65536 0 0 0 100 /end COMPU_METHOD
/begin COMPU_METHOD Def_n_sw_q1p0 "Def_n_sw_q1p0" RAT_FUNC "%5.0" "Upm" COEFFS 0 1 0 0 0 1 /end COMPU_METHOD
/begin COMPU_METHOD Def_t_sw_q0p01 "Def_t_sw_q0p01" RAT_FUNC "%7.2" "°C" COEFFS 0 100 0 0 0 1 /end COMPU_METHOD
/begin COMPU_METHOD Def_dez_ub_q1 "Def_dez_ub_q1" RAT_FUNC "%3.0" "-" COEFFS 0 1 0 0 0 1 /end COMPU_METHOD
/begin COMPU_METHOD Def_bit_ub_0 "Def_bit_ub_0" TAB_VERB "%5.2" "-" COMPU_TAB_REF Def_bit_ub_0_VTAB /end COMPU_METHOD
/begin COMPU_METHOD Def_bit_ub_1 "Def_bit_ub_1" TAB_VERB "%5.2" "-" COMPU_TAB_REF Def_bit_ub_1_VTAB /end COMPU_METHOD
/begin COMPU_METHOD Def_bit_ub_2 "Def_bit_ub_2" TAB_VERB "%5.2" "-" COMPU_TAB_REF Def_bit_ub_2_VTAB /end COMPU_METHOD
/begin COMPU_METHOD Def_st_ub_q1 "Def_st_ub_q1" RAT_FUNC "%3.0" "-" COEFFS 0 1 0 0 0 1 /end COMPU_METHOD
/begin COMPU_METHOD Def_bit_ub_3 "Def_bit_ub_3" TAB_VERB "%5.2" "-" COMPU_TAB_REF Def_bit_ub_3_VTAB /end COMPU_METHOD
/begin COMPU_METHOD Def_bit_ub_4 "Def_bit_ub_4" TAB_VERB "%5.2" "-" COMPU_TAB_REF Def_bit_ub_4_VTAB /end COMPU_METHOD
/begin COMPU_METHOD Def_dez_ub_q1 "Def_dez_ub_q1" RAT_FUNC "%3.0" "-" COEFFS 0 1 0 0 0 1 /end COMPU_METHOD
/begin COMPU_METHOD Def_n_sw_q1p0 "Def_n_sw_q1p0" RAT_FUNC "%5.0" "Upm" COEFFS 0 1 0 0 0 1 /end COMPU_METHOD
/begin COMPU_METHOD Def_wdk_sw_q0p0244 "Def_wdk_sw_q0p0244" RAT_FUNC "%7.2" "%" COEFFS 0 4096 0 0 0 100 /end COMPU_METHOD
/begin COMPU_METHOD Def_t_sw_q0p01 "Def_t_sw_q0p01" RAT_FUNC "%7.2" "°C" COEFFS 0 100 0 0 0 1 /end COMPU_METHOD
/begin COMPU_METHOD Def_td_uw_q0p01 "Def_td_uw_q0p01" RAT_FUNC "%7.2" "s" COEFFS 0 100 0 0 0 1 /end COMPU_METHOD
/begin COMPU_METHOD Def_f_uw_b1 "Def_f_uw_b1" RAT_FUNC "%14.5" "-" COEFFS 0 65536 0 0 0 1 /end COMPU_METHOD
/begin COMPU_METHOD Def_v_uw_q1p0 "Def_v_uw_q1p0" RAT_FUNC "%5.0" "km/h" COEFFS 0 1 0 0 0 1 /end COMPU_METHOD
/begin COMPU_METHOD Def_f_ub_b100 "Def_f_ub_b100" RAT_FUNC "%5.2" "%" COEFFS 0 256 0 0 0 100 /end COMPU_METHOD
/begin COMPU_METHOD Def_f_ub_b1 "Def_f_ub_b1" RAT_FUNC "%6.3" "-" COEFFS 0 256 0 0 0 1 /end COMPU_METHOD
/begin COMPU_METHOD Identity "Identity" RAT_FUNC "%3.0" "-" COEFFS 0 1 0 0 0 1 /end COMPU_METHOD
/begin COMPU_METHOD Def_f_ub_b2 "Def_f_ub_b2" RAT_FUNC "%6.3" "-" COEFFS 0 256 0 0 0 2 /end COMPU_METHOD
/begin COMPU_METHOD Def_bit_ub_0 "Def_bit_ub_0" TAB_VERB "%5.2" "-" COMPU_TAB_REF Def_bit_ub_0_VTAB /end COMPU_METHOD
/begin COMPU_METHOD Def_bit_ub_1 "Def_bit_ub_1" TAB_VERB "%5.2" "-" COMPU_TAB_REF Def_bit_ub_1_VTAB /end COMPU_METHOD
/begin COMPU_METHOD Def_bit_ub_2 "Def_bit_ub_2" TAB_VERB "%5.2" "-" COMPU_TAB_REF Def_bit_ub_2_VTAB /end COMPU_METHOD
/begin COMPU_METHOD Def_bit_ub_3 "Def_bit_ub_3" TAB_VERB "%5.2" "-" COMPU_TAB_REF Def_bit_ub_3_VTAB /end COMPU_METHOD
/begin COMPU_METHOD Def_bit_ub_4 "Def_bit_ub_4" TAB_VERB "%5.2" "-" COMPU_TAB_REF Def_bit_ub_4_VTAB /end COMPU_METHOD
/begin COMPU_METHOD Def_bit_ub_5 "Def_bit_ub_5" TAB_VERB "%5.2" "-" COMPU_TAB_REF Def_bit_ub_5_VTAB /end COMPU_METHOD
/begin COMPU_METHOD Def_st_ub_q1 "Def_st_ub_q1" RAT_FUNC "%3.0" "-" COEFFS 0 1 0 0 0 1 /end COMPU_METHOD
/begin COMPU_METHOD Def_t_sw_q0p1 "Def_t_sw_q0p1" RAT_FUNC "%6.1" "°C" COEFFS 0 10 0 0 0 1 /end COMPU_METHOD
/begin COMPU_METHOD Def_u_uw_q0p00488 "Def_u_uw_q0p00488" RAT_FUNC "%8.3" "V" COEFFS 0 1024 0 0 0 5 /end COMPU_METHOD
/begin COMPU_METHOD Def_n_sw_q1p0 "Def_n_sw_q1p0" RAT_FUNC "%5.0" "Upm" COEFFS 0 1 0 0 0 1 /end COMPU_METHOD
/begin COMPU_METHOD Def_f_uw_b1 "Def_f_uw_b1" RAT_FUNC "%14.5" "-" COEFFS 0 65536 0 0 0 1 /end COMPU_METHOD
/begin COMPU_METHOD Def_f_ub_b4 "Def_f_ub_b4" RAT_FUNC "%5.2" "-" COEFFS 0 256 0 0 0 4 /end COMPU_METHOD
/begin COMPU_METHOD Def_f_ub_b1 "Def_f_ub_b1" RAT_FUNC "%6.3" "-" COEFFS 0 256 0 0 0 1 /end COMPU_METHOD
/begin COMPU_METHOD Identity "Identity" RAT_FUNC "%3.0" "-" COEFFS 0 1 0 0 0 1 /end COMPU_METHOD
/begin COMPU_METHOD Def_f_uw_b100 "Def_f_uw_b100" RAT_FUNC "%8.3" "%" COEFFS 0 65536 0 0 0 100 /end COMPU_METHOD
/begin COMPU_METHOD Def_bit_ub_0 "Def_bit_ub_0" TAB_VERB "%5.2" "-" COMPU_TAB_REF Def_bit_ub_0_VTAB /end COMPU_METHOD
/begin COMPU_METHOD Def_bit_ub_1 "Def_bit_ub_1" TAB_VERB "%5.2" "-" COMPU_TAB_REF Def_bit_ub_1_VTAB /end COMPU_METHOD
/begin COMPU_METHOD Def_bit_ub_2 "Def_bit_ub_2" TAB_VERB "%5.2" "-" COMPU_TAB_REF Def_bit_ub_2_VTAB /end COMPU_METHOD
/begin COMPU_METHOD Def_bit_ub_4 "Def_bit_ub_4" TAB_VERB "%5.2" "-" COMPU_TAB_REF Def_bit_ub_4_VTAB /end COMPU_METHOD
/begin COMPU_METHOD Def_bit_ub_5 "Def_bit_ub_5" TAB_VERB "%5.2" "-" COMPU_TAB_REF Def_bit_ub_5_VTAB /end COMPU_METHOD
/begin COMPU_METHOD Def_bit_ub_6 "Def_bit_ub_6" TAB_VERB "%5.2" "-" COMPU_TAB_REF Def_bit_ub_6_VTAB /end COMPU_METHOD
/begin COMPU_METHOD Def_bit_ub_7 "Def_bit_ub_7" TAB_VERB "%5.2" "-" COMPU_TAB_REF Def_bit_ub_7_VTAB /end COMPU_METHOD
/begin COMPU_METHOD Def_st_ub_q1 "Def_st_ub_q1" RAT_FUNC "%3.0" "-" COEFFS 0 1 0 0 0 1 /end COMPU_METHOD
/begin COMPU_METHOD Def_bit_ub_3 "Def_bit_ub_3" TAB_VERB "%5.2" "-" COMPU_TAB_REF Def_bit_ub_3_VTAB /end COMPU_METHOD
/begin COMPU_METHOD Def_t_sw_q0p1 "Def_t_sw_q0p1" RAT_FUNC "%6.1" "°C" COEFFS 0 10 0 0 0 1 /end COMPU_METHOD
/begin COMPU_METHOD Def_f_uw_b1 "Def_f_uw_b1" RAT_FUNC "%14.5" "-" COEFFS 0 65536 0 0 0 1 /end COMPU_METHOD
/begin COMPU_METHOD Def_td_uw_q0p1 "Def_td_uw_q0p1" RAT_FUNC "%6.1" "s" COEFFS 0 10 0 0 0 1 /end COMPU_METHOD
/begin COMPU_METHOD Def_dez_ub_q1 "Def_dez_ub_q1" RAT_FUNC "%3.0" "-" COEFFS 0 1 0 0 0 1 /end COMPU_METHOD
/begin COMPU_METHOD Def_u_ub_q0p1 "Def_u_ub_q0p1" RAT_FUNC "%5.2" "V" COEFFS 0 10 0 0 0 1 /end COMPU_METHOD
/begin COMPU_METHOD Def_n_sw_q1p0 "Def_n_sw_q1p0" RAT_FUNC "%5.0" "Upm" COEFFS 0 1 0 0 0 1 /end COMPU_METHOD
/begin COMPU_METHOD Def_v_uw_q1p0 "Def_v_uw_q1p0" RAT_FUNC "%5.0" "km/h" COEFFS 0 1 0 0 0 1 /end COMPU_METHOD
/begin COMPU_METHOD Identity "Identity" RAT_FUNC "%3.0" "-" COEFFS 0 1 0 0 0 1 /end COMPU_METHOD
/begin COMPU_METHOD Def_f_ub_b4 "Def_f_ub_b4" RAT_FUNC "%5.2" "-" COEFFS 0 256 0 0 0 4 /end COMPU_METHOD
/begin COMPU_METHOD Def_td_ub_q0p1 "Def_td_ub_q0p1" RAT_FUNC "%4.1" "s" COEFFS 0 10 0 0 0 1 /end COMPU_METHOD
/begin COMPU_METHOD Def_f_ub_b100 "Def_f_ub_b100" RAT_FUNC "%5.2" "%" COEFFS 0 256 0 0 0 100 /end COMPU_METHOD
/begin COMPU_METHOD Def_f_uw_b100 "Def_f_uw_b100" RAT_FUNC "%8.3" "%" COEFFS 0 65536 0 0 0 100 /end COMPU_METHOD
/begin COMPU_METHOD Def_bit_ub_0 "Def_bit_ub_0" TAB_VERB "%5.2" "-" COMPU_TAB_REF Def_bit_ub_0_VTAB /end COMPU_METHOD
/begin COMPU_METHOD Def_bit_ub_1 "Def_bit_ub_1" TAB_VERB "%5.2" "-" COMPU_TAB_REF Def_bit_ub_1_VTAB /end COMPU_METHOD
/begin COMPU_METHOD Def_bit_ub_2 "Def_bit_ub_2" TAB_VERB "%5.2" "-" COMPU_TAB_REF Def_bit_ub_2_VTAB /end COMPU_METHOD
/begin COMPU_METHOD Def_bit_ub_3 "Def_bit_ub_3" TAB_VERB "%5.2" "-" COMPU_TAB_REF Def_bit_ub_3_VTAB /end COMPU_METHOD
/begin COMPU_METHOD Def_st_ub_q1 "Def_st_ub_q1" RAT_FUNC "%3.0" "-" COEFFS 0 1 0 0 0 1 /end COMPU_METHOD
/begin COMPU_METHOD Def_ql_uw_q0p0182 "Def_ql_uw_q0p0182" RAT_FUNC "%8.3" "Ah" COEFFS 0 989 0 0 0 18 /end COMPU_METHOD
/begin COMPU_METHOD Def_td_uw_q0p01 "Def_td_uw_q0p01" RAT_FUNC "%7.2" "s" COEFFS 0 100 0 0 0 1 /end COMPU_METHOD
/begin COMPU_METHOD Def_f_ub_b100 "Def_f_ub_b100" RAT_FUNC "%5.2" "%" COEFFS 0 256 0 0 0 100 /end COMPU_METHOD
/begin COMPU_METHOD Def_u_ub_q0p1 "Def_u_ub_q0p1" RAT_FUNC "%5.2" "V" COEFFS 0 10 0 0 0 1 /end COMPU_METHOD
/begin COMPU_METHOD Def_td_ub_q0p1 "Def_td_ub_q0p1" RAT_FUNC "%4.1" "s" COEFFS 0 10 0 0 0 1 /end COMPU_METHOD
/begin COMPU_METHOD Def_dez_ub_q1 "Def_dez_ub_q1" RAT_FUNC "%3.0" "-" COEFFS 0 1 0 0 0 1 /end COMPU_METHOD
/begin COMPU_METHOD Def_f_uw_b100 "Def_f_uw_b100" RAT_FUNC "%8.3" "%" COEFFS 0 65536 0 0 0 100 /end COMPU_METHOD
/begin COMPU_METHOD Identity "Identity" RAT_FUNC "%3.0" "-" COEFFS 0 1 0 0 0 1 /end COMPU_METHOD
/begin COMPU_METHOD Def_f_ub_b1 "Def_f_ub_b1" RAT_FUNC "%6.3" "-" COEFFS 0 256 0 0 0 1 /end COMPU_METHOD
/begin COMPU_METHOD Def_f_ub_b32 "Def_f_ub_b32" RAT_FUNC "%5.2" "-" COEFFS 0 256 0 0 0 32 /end COMPU_METHOD
/begin COMPU_METHOD Def_f_ub_b4 "Def_f_ub_b4" RAT_FUNC "%5.2" "-" COEFFS 0 256 0 0 0 4 /end COMPU_METHOD
/begin COMPU_METHOD Def_f_ub_b2 "Def_f_ub_b2" RAT_FUNC "%6.3" "-" COEFFS 0 256 0 0 0 2 /end COMPU_METHOD
/begin COMPU_METHOD Def_bit_ub_0 "Def_bit_ub_0" TAB_VERB "%5.2" "-" COMPU_TAB_REF Def_bit_ub_0_VTAB /end COMPU_METHOD
/begin COMPU_METHOD Def_bit_ub_1 "Def_bit_ub_1" TAB_VERB "%5.2" "-" COMPU_TAB_REF Def_bit_ub_1_VTAB /end COMPU_METHOD
/begin COMPU_METHOD Def_bit_ub_2 "Def_bit_ub_2" TAB_VERB "%5.2" "-" COMPU_TAB_REF Def_bit_ub_2_VTAB /end COMPU_METHOD
/begin COMPU_METHOD Def_bit_ub_3 "Def_bit_ub_3" TAB_VERB "%5.2" "-" COMPU_TAB_REF Def_bit_ub_3_VTAB /end COMPU_METHOD
/begin COMPU_METHOD Def_bit_ub_4 "Def_bit_ub_4" TAB_VERB "%5.2" "-" COMPU_TAB_REF Def_bit_ub_4_VTAB /end COMPU_METHOD
/begin COMPU_METHOD Def_bit_ub_5 "Def_bit_ub_5" TAB_VERB "%5.2" "-" COMPU_TAB_REF Def_bit_ub_5_VTAB /end COMPU_METHOD
/begin COMPU_METHOD Def_st_ub_q1 "Def_st_ub_q1" RAT_FUNC "%3.0" "-" COEFFS 0 1 0 0 0 1 /end COMPU_METHOD
/begin COMPU_METHOD Def_dez_sw_q1 "Def_dez_sw_q1" RAT_FUNC "%5.0" "-" COEFFS 0 1 0 0 0 1 /end COMPU_METHOD
/begin COMPU_METHOD Def_dez_uw_q1 "Def_dez_uw_q1" RAT_FUNC "%5.0" "-" COEFFS 0 1 0 0 0 1 /end COMPU_METHOD
/begin COMPU_METHOD Def_f_uw_b8192 "Def_f_uw_b8192" RAT_FUNC "%7.2" "-" COEFFS 0 65536 0 0 0 8192 /end COMPU_METHOD
/begin COMPU_METHOD Def_dez_ub_q1 "Def_dez_ub_q1" RAT_FUNC "%3.0" "-" COEFFS 0 1 0 0 0 1 /end COMPU_METHOD
/begin COMPU_METHOD Def_bit_ub_0 "Def_bit_ub_0" TAB_VERB "%5.2" "-" COMPU_TAB_REF Def_bit_ub_0_VTAB /end COMPU_METHOD
/begin COMPU_METHOD Def_bit_ub_1 "Def_bit_ub_1" TAB_VERB "%5.2" "-" COMPU_TAB_REF Def_bit_ub_1_VTAB /end COMPU_METHOD
/begin COMPU_METHOD Def_bit_ub_2 "Def_bit_ub_2" TAB_VERB "%5.2" "-" COMPU_TAB_REF Def_bit_ub_2_VTAB /end COMPU_METHOD
/begin COMPU_METHOD Def_bit_ub_3 "Def_bit_ub_3" TAB_VERB "%5.2" "-" COMPU_TAB_REF Def_bit_ub_3_VTAB /end COMPU_METHOD
/begin COMPU_METHOD Def_bit_ub_4 "Def_bit_ub_4" TAB_VERB "%5.2" "-" COMPU_TAB_REF Def_bit_ub_4_VTAB /end COMPU_METHOD
/begin COMPU_METHOD Def_bit_ub_5 "Def_bit_ub_5" TAB_VERB "%5.2" "-" COMPU_TAB_REF Def_bit_ub_5_VTAB /end COMPU_METHOD
/begin COMPU_METHOD Def_bit_ub_6 "Def_bit_ub_6" TAB_VERB "%5.2" "-" COMPU_TAB_REF Def_bit_ub_6_VTAB /end COMPU_METHOD
/begin COMPU_METHOD Def_bit_ub_7 "Def_bit_ub_7" TAB_VERB "%5.2" "-" COMPU_TAB_REF Def_bit_ub_7_VTAB /end COMPU_METHOD
/begin COMPU_METHOD Def_st_ub_q1 "Def_st_ub_q1" RAT_FUNC "%3.0" "-" COEFFS 0 1 0 0 0 1 /end COMPU_METHOD
/begin COMPU_METHOD Def_dez_uw_q1 "Def_dez_uw_q1" RAT_FUNC "%5.0" "-" COEFFS 0 1 0 0 0 1 /end COMPU_METHOD
/begin COMPU_METHOD Def_td_uw_q0p1 "Def_td_uw_q0p1" RAT_FUNC "%6.1" "s" COEFFS 0 10 0 0 0 1 /end COMPU_METHOD
/begin COMPU_METHOD Def_dez_ub_q1 "Def_dez_ub_q1" RAT_FUNC "%3.0" "-" COEFFS 0 1 0 0 0 1 /end COMPU_METHOD
/begin COMPU_METHOD Def_td_ub_q0p1 "Def_td_ub_q0p1" RAT_FUNC "%4.1" "s" COEFFS 0 10 0 0 0 1 /end COMPU_METHOD
/begin COMPU_METHOD Identity "Identity" RAT_FUNC "%3.0" "-" COEFFS 0 1 0 0 0 1 /end COMPU_METHOD
/begin COMPU_METHOD Def_ql_uw_q0p0182 "Def_ql_uw_q0p0182" RAT_FUNC "%8.3" "Ah" COEFFS 0 989 0 0 0 18 /end COMPU_METHOD
/begin COMPU_METHOD Def_bit_ub_0 "Def_bit_ub_0" TAB_VERB "%5.2" "-" COMPU_TAB_REF Def_bit_ub_0_VTAB /end COMPU_METHOD
/begin COMPU_METHOD Def_bit_ub_1 "Def_bit_ub_1" TAB_VERB "%5.2" "-" COMPU_TAB_REF Def_bit_ub_1_VTAB /end COMPU_METHOD
/begin COMPU_METHOD Def_bit_ub_2 "Def_bit_ub_2" TAB_VERB "%5.2" "-" COMPU_TAB_REF Def_bit_ub_2_VTAB /end COMPU_METHOD
/begin COMPU_METHOD Def_bit_ub_3 "Def_bit_ub_3" TAB_VERB "%5.2" "-" COMPU_TAB_REF Def_bit_ub_3_VTAB /end COMPU_METHOD
/begin COMPU_METHOD Def_bit_ub_4 "Def_bit_ub_4" TAB_VERB "%5.2" "-" COMPU_TAB_REF Def_bit_ub_4_VTAB /end COMPU_METHOD
/begin COMPU_METHOD Def_bit_ub_5 "Def_bit_ub_5" TAB_VERB "%5.2" "-" COMPU_TAB_REF Def_bit_ub_5_VTAB /end COMPU_METHOD
/begin COMPU_METHOD Def_st_ub_q1 "Def_st_ub_q1" RAT_FUNC "%3.0" "-" COEFFS 0 1 0 0 0 1 /end COMPU_METHOD
/begin COMPU_METHOD Def_bit_ub_6 "Def_bit_ub_6" TAB_VERB "%5.2" "-" COMPU_TAB_REF Def_bit_ub_6_VTAB /end COMPU_METHOD
/begin COMPU_METHOD Def_dez_ub_q1 "Def_dez_ub_q1" RAT_FUNC "%3.0" "-" COEFFS 0 1 0 0 0 1 /end COMPU_METHOD
/begin COMPU_METHOD Def_t_sw_q0p1 "Def_t_sw_q0p1" RAT_FUNC "%6.1" "°C" COEFFS 0 10 0 0 0 1 /end COMPU_METHOD
/begin COMPU_METHOD Def_dez_uw_q1 "Def_dez_uw_q1" RAT_FUNC "%5.0" "-" COEFFS 0 1 0 0 0 1 /end COMPU_METHOD
/begin COMPU_METHOD Def_f_ub_b2 "Def_f_ub_b2" RAT_FUNC "%6.3" "-" COEFFS 0 256 0 0 0 2 /end COMPU_METHOD
/begin COMPU_METHOD Def_i_ub_q1 "Def_i_ub_q1" RAT_FUNC "%6.3" "" COEFFS 0 1 0 0 0 1 /end COMPU_METHOD
/begin COMPU_METHOD Def_t_sw_q0p01 "Def_t_sw_q0p01" RAT_FUNC "%7.2" "°C" COEFFS 0 100 0 0 0 1 /end COMPU_METHOD
/begin COMPU_METHOD Def_bit_ub_0 "Def_bit_ub_0" TAB_VERB "%5.2" "-" COMPU_TAB_REF Def_bit_ub_0_VTAB /end COMPU_METHOD
/begin COMPU_METHOD Def_st_ub_q1 "Def_st_ub_q1" RAT_FUNC "%3.0" "-" COEFFS 0 1 0 0 0 1 /end COMPU_METHOD
/begin COMPU_METHOD Def_dez_ul_q1 "Def_dez_ul_q1" RAT_FUNC "%7.0" "-" COEFFS 0 1 0 0 0 1 /end COMPU_METHOD
/begin COMPU_METHOD Def_dez_ub_q1 "Def_dez_ub_q1" RAT_FUNC "%3.0" "-" COEFFS 0 1 0 0 0 1 /end COMPU_METHOD
/begin COMPU_METHOD Def_dez_uw_q1 "Def_dez_uw_q1" RAT_FUNC "%5.0" "-" COEFFS 0 1 0 0 0 1 /end COMPU_METHOD
/begin COMPU_METHOD Identity "Identity" RAT_FUNC "%3.0" "-" COEFFS 0 1 0 0 0 1 /end COMPU_METHOD
/begin COMPU_METHOD Def_ql_uw_q0p0182 "Def_ql_uw_q0p0182" RAT_FUNC "%8.3" "Ah" COEFFS 0 989 0 0 0 18 /end COMPU_METHOD
/begin COMPU_METHOD Def_bit_ub_0 "Def_bit_ub_0" TAB_VERB "%5.2" "-" COMPU_TAB_REF Def_bit_ub_0_VTAB /end COMPU_METHOD
/begin COMPU_METHOD Def_bit_ub_1 "Def_bit_ub_1" TAB_VERB "%5.2" "-" COMPU_TAB_REF Def_bit_ub_1_VTAB /end COMPU_METHOD
/begin COMPU_METHOD Def_bit_ub_2 "Def_bit_ub_2" TAB_VERB "%5.2" "-" COMPU_TAB_REF Def_bit_ub_2_VTAB /end COMPU_METHOD
/begin COMPU_METHOD Def_bit_ub_3 "Def_bit_ub_3" TAB_VERB "%5.2" "-" COMPU_TAB_REF Def_bit_ub_3_VTAB /end COMPU_METHOD
/begin COMPU_METHOD Def_bit_ub_4 "Def_bit_ub_4" TAB_VERB "%5.2" "-" COMPU_TAB_REF Def_bit_ub_4_VTAB /end COMPU_METHOD
/begin COMPU_METHOD Def_bit_ub_5 "Def_bit_ub_5" TAB_VERB "%5.2" "-" COMPU_TAB_REF Def_bit_ub_5_VTAB /end COMPU_METHOD
/begin COMPU_METHOD Def_bit_ub_6 "Def_bit_ub_6" TAB_VERB "%5.2" "-" COMPU_TAB_REF Def_bit_ub_6_VTAB /end COMPU_METHOD
/begin COMPU_METHOD Def_bit_ub_7 "Def_bit_ub_7" TAB_VERB "%5.2" "-" COMPU_TAB_REF Def_bit_ub_7_VTAB /end COMPU_METHOD
/begin COMPU_METHOD Def_st_ub_q1 "Def_st_ub_q1" RAT_FUNC "%3.0" "-" COEFFS 0 1 0 0 0 1 /end COMPU_METHOD
/begin COMPU_METHOD Def_f_sw_p0q25 "Def_f_sw_p0q25" RAT_FUNC "%7.2" "" COEFFS 0 4 0 0 0 1 /end COMPU_METHOD
/begin COMPU_METHOD Def_dez_uw_q1 "Def_dez_uw_q1" RAT_FUNC "%5.0" "-" COEFFS 0 1 0 0 0 1 /end COMPU_METHOD
/begin COMPU_METHOD Def_f_uw_b100 "Def_f_uw_b100" RAT_FUNC "%8.3" "%" COEFFS 0 65536 0 0 0 100 /end COMPU_METHOD
/begin COMPU_METHOD Def_dez_ub_q1 "Def_dez_ub_q1" RAT_FUNC "%3.0" "-" COEFFS 0 1 0 0 0 1 /end COMPU_METHOD
/begin COMPU_METHOD Def_f_ub_b100 "Def_f_ub_b100" RAT_FUNC "%5.2" "%" COEFFS 0 256 0 0 0 100 /end COMPU_METHOD
/begin COMPU_METHOD Def_i_ub_q1 "Def_i_ub_q1" RAT_FUNC "%6.3" "" COEFFS 0 1 0 0 0 1 /end COMPU_METHOD
/begin COMPU_METHOD Def_td_ub_q0p1 "Def_td_ub_q0p1" RAT_FUNC "%4.1" "s" COEFFS 0 10 0 0 0 1 /end COMPU_METHOD
/begin COMPU_METHOD Def_ql_uw_q0p0182 "Def_ql_uw_q0p0182" RAT_FUNC "%8.3" "Ah" COEFFS 0 989 0 0 0 18 /end COMPU_METHOD
/begin COMPU_METHOD Def_n_sw_q1p0 "Def_n_sw_q1p0" RAT_FUNC "%5.0" "Upm" COEFFS 0 1 0 0 0 1 /end COMPU_METHOD
/begin COMPU_METHOD Def_f_uw_b1 "Def_f_uw_b1" RAT_FUNC "%14.5" "-" COEFFS 0 65536 0 0 0 1 /end COMPU_METHOD
/begin COMPU_METHOD Def_td_uw_q0p1 "Def_td_uw_q0p1" RAT_FUNC "%6.1" "s" COEFFS 0 10 0 0 0 1 /end COMPU_METHOD
/begin COMPU_METHOD Def_f_ub_b1 "Def_f_ub_b1" RAT_FUNC "%6.3" "-" COEFFS 0 256 0 0 0 1 /end COMPU_METHOD
/begin COMPU_METHOD Identity "Identity" RAT_FUNC "%3.0" "-" COEFFS 0 1 0 0 0 1 /end COMPU_METHOD
/begin COMPU_METHOD Def_t_sw_q0p1 "Def_t_sw_q0p1" RAT_FUNC "%6.1" "°C" COEFFS 0 10 0 0 0 1 /end COMPU_METHOD
/begin COMPU_METHOD Def_f_ub_b4 "Def_f_ub_b4" RAT_FUNC "%5.2" "-" COEFFS 0 256 0 0 0 4 /end COMPU_METHOD
/begin COMPU_METHOD Def_bit_ub_1 "Def_bit_ub_1" TAB_VERB "%5.2" "-" COMPU_TAB_REF Def_bit_ub_1_VTAB /end COMPU_METHOD
/begin COMPU_METHOD Def_bit_ub_2 "Def_bit_ub_2" TAB_VERB "%5.2" "-" COMPU_TAB_REF Def_bit_ub_2_VTAB /end COMPU_METHOD
/begin COMPU_METHOD Def_st_ub_q1 "Def_st_ub_q1" RAT_FUNC "%3.0" "-" COEFFS 0 1 0 0 0 1 /end COMPU_METHOD
/begin COMPU_METHOD Def_bit_ub_0 "Def_bit_ub_0" TAB_VERB "%5.2" "-" COMPU_TAB_REF Def_bit_ub_0_VTAB /end COMPU_METHOD
/begin COMPU_METHOD Def_i_sw_q0p02 "Def_i_sw_q0p02" RAT_FUNC "%8.3" "A" COEFFS 0 50 0 0 0 1 /end COMPU_METHOD
/begin COMPU_METHOD Def_t_sw_q0p1 "Def_t_sw_q0p1" RAT_FUNC "%6.1" "°C" COEFFS 0 10 0 0 0 1 /end COMPU_METHOD
/begin COMPU_METHOD Def_ql_uw_q0p0182 "Def_ql_uw_q0p0182" RAT_FUNC "%8.3" "Ah" COEFFS 0 989 0 0 0 18 /end COMPU_METHOD
/begin COMPU_METHOD Def_f_uw_b100 "Def_f_uw_b100" RAT_FUNC "%8.3" "%" COEFFS 0 65536 0 0 0 100 /end COMPU_METHOD
/begin COMPU_METHOD Def_dez_ub_q1 "Def_dez_ub_q1" RAT_FUNC "%3.0" "-" COEFFS 0 1 0 0 0 1 /end COMPU_METHOD
/begin COMPU_METHOD Def_f_ub_b2 "Def_f_ub_b2" RAT_FUNC "%6.3" "-" COEFFS 0 256 0 0 0 2 /end COMPU_METHOD
/begin COMPU_METHOD Def_f_ub_b4 "Def_f_ub_b4" RAT_FUNC "%5.2" "-" COEFFS 0 256 0 0 0 4 /end COMPU_METHOD
/begin COMPU_METHOD Def_f_uw_b100 "Def_f_uw_b100" RAT_FUNC "%8.3" "%" COEFFS 0 65536 0 0 0 100 /end COMPU_METHOD
/begin COMPU_METHOD Def_f_uw_b1 "Def_f_uw_b1" RAT_FUNC "%14.5" "-" COEFFS 0 65536 0 0 0 1 /end COMPU_METHOD
/begin COMPU_METHOD Def_dez_ub_q1 "Def_dez_ub_q1" RAT_FUNC "%3.0" "-" COEFFS 0 1 0 0 0 1 /end COMPU_METHOD
/begin COMPU_METHOD Def_t_sw_q0p1 "Def_t_sw_q0p1" RAT_FUNC "%6.1" "°C" COEFFS 0 10 0 0 0 1 /end COMPU_METHOD
/begin COMPU_METHOD Def_bit_ub_0 "Def_bit_ub_0" TAB_VERB "%5.2" "-" COMPU_TAB_REF Def_bit_ub_0_VTAB /end COMPU_METHOD
/begin COMPU_METHOD Def_bit_ub_1 "Def_bit_ub_1" TAB_VERB "%5.2" "-" COMPU_TAB_REF Def_bit_ub_1_VTAB /end COMPU_METHOD
/begin COMPU_METHOD Def_bit_ub_2 "Def_bit_ub_2" TAB_VERB "%5.2" "-" COMPU_TAB_REF Def_bit_ub_2_VTAB /end COMPU_METHOD
/begin COMPU_METHOD Def_bit_ub_3 "Def_bit_ub_3" TAB_VERB "%5.2" "-" COMPU_TAB_REF Def_bit_ub_3_VTAB /end COMPU_METHOD
/begin COMPU_METHOD Def_bit_ub_4 "Def_bit_ub_4" TAB_VERB "%5.2" "-" COMPU_TAB_REF Def_bit_ub_4_VTAB /end COMPU_METHOD
/begin COMPU_METHOD Def_bit_ub_5 "Def_bit_ub_5" TAB_VERB "%5.2" "-" COMPU_TAB_REF Def_bit_ub_5_VTAB /end COMPU_METHOD
/begin COMPU_METHOD Def_st_ub_q1 "Def_st_ub_q1" RAT_FUNC "%3.0" "-" COEFFS 0 1 0 0 0 1 /end COMPU_METHOD
/begin COMPU_METHOD Def_t_sw_q0p1 "Def_t_sw_q0p1" RAT_FUNC "%6.1" "°C" COEFFS 0 10 0 0 0 1 /end COMPU_METHOD
/begin COMPU_METHOD Def_f_uw_b100 "Def_f_uw_b100" RAT_FUNC "%8.3" "%" COEFFS 0 65536 0 0 0 100 /end COMPU_METHOD
/begin COMPU_METHOD Def_ql_uw_q0p0182 "Def_ql_uw_q0p0182" RAT_FUNC "%8.3" "Ah" COEFFS 0 989 0 0 0 18 /end COMPU_METHOD
/begin COMPU_METHOD Identity "Identity" RAT_FUNC "%3.0" "-" COEFFS 0 1 0 0 0 1 /end COMPU_METHOD
/begin COMPU_METHOD Def_dez_uw_q1 "Def_dez_uw_q1" RAT_FUNC "%5.0" "-" COEFFS 0 1 0 0 0 1 /end COMPU_METHOD
/begin COMPU_METHOD Def_dez_ub_q1 "Def_dez_ub_q1" RAT_FUNC "%3.0" "-" COEFFS 0 1 0 0 0 1 /end COMPU_METHOD
/begin COMPU_METHOD Def_bit_ub_0 "Def_bit_ub_0" TAB_VERB "%5.2" "-" COMPU_TAB_REF Def_bit_ub_0_VTAB /end COMPU_METHOD
/begin COMPU_METHOD Def_bit_ub_1 "Def_bit_ub_1" TAB_VERB "%5.2" "-" COMPU_TAB_REF Def_bit_ub_1_VTAB /end COMPU_METHOD
/begin COMPU_METHOD Def_bit_ub_2 "Def_bit_ub_2" TAB_VERB "%5.2" "-" COMPU_TAB_REF Def_bit_ub_2_VTAB /end COMPU_METHOD
/begin COMPU_METHOD Def_bit_ub_3 "Def_bit_ub_3" TAB_VERB "%5.2" "-" COMPU_TAB_REF Def_bit_ub_3_VTAB /end COMPU_METHOD
/begin COMPU_METHOD Def_st_ub_q1 "Def_st_ub_q1" RAT_FUNC "%3.0" "-" COEFFS 0 1 0 0 0 1 /end COMPU_METHOD
/begin COMPU_METHOD Def_n_sw_q1p0 "Def_n_sw_q1p0" RAT_FUNC "%5.0" "Upm" COEFFS 0 1 0 0 0 1 /end COMPU_METHOD
/begin COMPU_METHOD Def_i_uw_q0p02 "Def_i_uw_q0p02" RAT_FUNC "%8.3" "A" COEFFS 0 1 0 0 0 0.02 /end COMPU_METHOD
/begin COMPU_METHOD Def_dez_ub_q1 "Def_dez_ub_q1" RAT_FUNC "%3.0" "-" COEFFS 0 1 0 0 0 1 /end COMPU_METHOD
/begin COMPU_METHOD Def_f_ub_b32 "Def_f_ub_b32" RAT_FUNC "%5.2" "-" COEFFS 0 256 0 0 0 32 /end COMPU_METHOD
/begin COMPU_METHOD Def_td_uw_q0p01 "Def_td_uw_q0p01" RAT_FUNC "%7.2" "s" COEFFS 0 100 0 0 0 1 /end COMPU_METHOD
/begin COMPU_METHOD Identity "Identity" RAT_FUNC "%3.0" "-" COEFFS 0 1 0 0 0 1 /end COMPU_METHOD
/begin COMPU_METHOD Def_t_sw_q0p1 "Def_t_sw_q0p1" RAT_FUNC "%6.1" "°C" COEFFS 0 10 0 0 0 1 /end COMPU_METHOD
/begin COMPU_METHOD Def_bit_ub_0 "Def_bit_ub_0" TAB_VERB "%5.2" "-" COMPU_TAB_REF Def_bit_ub_0_VTAB /end COMPU_METHOD
/begin COMPU_METHOD Def_bit_ub_1 "Def_bit_ub_1" TAB_VERB "%5.2" "-" COMPU_TAB_REF Def_bit_ub_1_VTAB /end COMPU_METHOD
/begin COMPU_METHOD Def_bit_ub_2 "Def_bit_ub_2" TAB_VERB "%5.2" "-" COMPU_TAB_REF Def_bit_ub_2_VTAB /end COMPU_METHOD
/begin COMPU_METHOD Def_bit_ub_3 "Def_bit_ub_3" TAB_VERB "%5.2" "-" COMPU_TAB_REF Def_bit_ub_3_VTAB /end COMPU_METHOD
/begin COMPU_METHOD Def_bit_ub_4 "Def_bit_ub_4" TAB_VERB "%5.2" "-" COMPU_TAB_REF Def_bit_ub_4_VTAB /end COMPU_METHOD
/begin COMPU_METHOD Def_st_ub_q1 "Def_st_ub_q1" RAT_FUNC "%3.0" "-" COEFFS 0 1 0 0 0 1 /end COMPU_METHOD
/begin COMPU_METHOD Def_dez_uw_q1 "Def_dez_uw_q1" RAT_FUNC "%5.0" "-" COEFFS 0 1 0 0 0 1 /end COMPU_METHOD
/begin COMPU_METHOD Def_dez_ub_q1 "Def_dez_ub_q1" RAT_FUNC "%3.0" "-" COEFFS 0 1 0 0 0 1 /end COMPU_METHOD
/begin COMPU_METHOD Def_u_ub_q0p1 "Def_u_ub_q0p1" RAT_FUNC "%5.2" "V" COEFFS 0 10 0 0 0 1 /end COMPU_METHOD
/begin COMPU_METHOD Def_v_uw_q1p0 "Def_v_uw_q1p0" RAT_FUNC "%5.0" "km/h" COEFFS 0 1 0 0 0 1 /end COMPU_METHOD
/begin COMPU_METHOD Def_td_uw_q0p01 "Def_td_uw_q0p01" RAT_FUNC "%7.2" "s" COEFFS 0 100 0 0 0 1 /end COMPU_METHOD
/begin COMPU_METHOD Def_f_ub_b100 "Def_f_ub_b100" RAT_FUNC "%5.2" "%" COEFFS 0 256 0 0 0 100 /end COMPU_METHOD
/begin COMPU_METHOD Def_f_ub_b2 "Def_f_ub_b2" RAT_FUNC "%6.3" "-" COEFFS 0 256 0 0 0 2 /end COMPU_METHOD
/begin COMPU_METHOD Def_bit_ub_0 "Def_bit_ub_0" TAB_VERB "%5.2" "-" COMPU_TAB_REF Def_bit_ub_0_VTAB /end COMPU_METHOD
/begin COMPU_METHOD Def_bit_ub_1 "Def_bit_ub_1" TAB_VERB "%5.2" "-" COMPU_TAB_REF Def_bit_ub_1_VTAB /end COMPU_METHOD
/begin COMPU_METHOD Def_st_ub_q1 "Def_st_ub_q1" RAT_FUNC "%3.0" "-" COEFFS 0 1 0 0 0 1 /end COMPU_METHOD
/begin COMPU_METHOD Def_u_uw_q0p1 "Def_u_uw_q0p1" RAT_FUNC "%8.3" "V" COEFFS 0 10 0 0 0 1 /end COMPU_METHOD
/begin COMPU_METHOD Def_dez_ub_q1 "Def_dez_ub_q1" RAT_FUNC "%3.0" "-" COEFFS 0 1 0 0 0 1 /end COMPU_METHOD
/begin COMPU_METHOD Def_u_ub_q0p1 "Def_u_ub_q0p1" RAT_FUNC "%5.2" "V" COEFFS 0 10 0 0 0 1 /end COMPU_METHOD
/begin COMPU_METHOD Def_u_ub_b0p5 "Def_u_ub_b0p5" RAT_FUNC "%7.4" "V" COEFFS 0 256 0 0 0 0.5 /end COMPU_METHOD
/begin COMPU_METHOD Def_bit_ub_3 "Def_bit_ub_3" TAB_VERB "%5.2" "-" COMPU_TAB_REF Def_bit_ub_3_VTAB /end COMPU_METHOD
/begin COMPU_METHOD Def_bit_ub_4 "Def_bit_ub_4" TAB_VERB "%5.2" "-" COMPU_TAB_REF Def_bit_ub_4_VTAB /end COMPU_METHOD
/begin COMPU_METHOD Def_st_ub_q1 "Def_st_ub_q1" RAT_FUNC "%3.0" "-" COEFFS 0 1 0 0 0 1 /end COMPU_METHOD
/begin COMPU_METHOD Def_bit_ub_0 "Def_bit_ub_0" TAB_VERB "%5.2" "-" COMPU_TAB_REF Def_bit_ub_0_VTAB /end COMPU_METHOD
/begin COMPU_METHOD Def_u_uw_q0p1 "Def_u_uw_q0p1" RAT_FUNC "%8.3" "V" COEFFS 0 10 0 0 0 1 /end COMPU_METHOD
/begin COMPU_METHOD Def_f_uw_b2 "Def_f_uw_b2" RAT_FUNC "%14.5" "-" COEFFS 0 65536 0 0 0 2 /end COMPU_METHOD
/begin COMPU_METHOD Def_u_ub_q0p1 "Def_u_ub_q0p1" RAT_FUNC "%5.2" "V" COEFFS 0 10 0 0 0 1 /end COMPU_METHOD
/begin COMPU_METHOD Def_dez_uw_q1 "Def_dez_uw_q1" RAT_FUNC "%5.0" "-" COEFFS 0 1 0 0 0 1 /end COMPU_METHOD
/begin COMPU_METHOD Def_dez_ub_q1 "Def_dez_ub_q1" RAT_FUNC "%3.0" "-" COEFFS 0 1 0 0 0 1 /end COMPU_METHOD
/begin COMPU_METHOD Def_f_ub_b100 "Def_f_ub_b100" RAT_FUNC "%5.2" "%" COEFFS 0 256 0 0 0 100 /end COMPU_METHOD
/begin COMPU_METHOD Def_i_ub_q1 "Def_i_ub_q1" RAT_FUNC "%6.3" "" COEFFS 0 1 0 0 0 1 /end COMPU_METHOD
/begin COMPU_METHOD Def_f_ub_b32 "Def_f_ub_b32" RAT_FUNC "%5.2" "-" COEFFS 0 256 0 0 0 32 /end COMPU_METHOD
/begin COMPU_METHOD Identity "Identity" RAT_FUNC "%3.0" "-" COEFFS 0 1 0 0 0 1 /end COMPU_METHOD
/begin COMPU_METHOD Def_dez_uw_q1 "Def_dez_uw_q1" RAT_FUNC "%5.0" "-" COEFFS 0 1 0 0 0 1 /end COMPU_METHOD
/begin COMPU_METHOD Def_bit_ub_0 "Def_bit_ub_0" TAB_VERB "%5.2" "-" COMPU_TAB_REF Def_bit_ub_0_VTAB /end COMPU_METHOD
/begin COMPU_METHOD Def_bit_ub_1 "Def_bit_ub_1" TAB_VERB "%5.2" "-" COMPU_TAB_REF Def_bit_ub_1_VTAB /end COMPU_METHOD
/begin COMPU_METHOD Def_bit_ub_2 "Def_bit_ub_2" TAB_VERB "%5.2" "-" COMPU_TAB_REF Def_bit_ub_2_VTAB /end COMPU_METHOD
/begin COMPU_METHOD Def_bit_ub_3 "Def_bit_ub_3" TAB_VERB "%5.2" "-" COMPU_TAB_REF Def_bit_ub_3_VTAB /end COMPU_METHOD
/begin COMPU_METHOD Def_bit_ub_4 "Def_bit_ub_4" TAB_VERB "%5.2" "-" COMPU_TAB_REF Def_bit_ub_4_VTAB /end COMPU_METHOD
/begin COMPU_METHOD Def_bit_ub_5 "Def_bit_ub_5" TAB_VERB "%5.2" "-" COMPU_TAB_REF Def_bit_ub_5_VTAB /end COMPU_METHOD
/begin COMPU_METHOD Def_st_ub_q1 "Def_st_ub_q1" RAT_FUNC "%3.0" "-" COEFFS 0 1 0 0 0 1 /end COMPU_METHOD
/begin COMPU_METHOD Def_dez_ub_q1 "Def_dez_ub_q1" RAT_FUNC "%3.0" "-" COEFFS 0 1 0 0 0 1 /end COMPU_METHOD
/begin COMPU_METHOD Def_u_ub_q0p1 "Def_u_ub_q0p1" RAT_FUNC "%5.2" "V" COEFFS 0 10 0 0 0 1 /end COMPU_METHOD
/begin COMPU_METHOD Def_u_ub_b0p5 "Def_u_ub_b0p5" RAT_FUNC "%7.4" "V" COEFFS 0 256 0 0 0 0.5 /end COMPU_METHOD
/begin COMPU_METHOD Identity "Identity" RAT_FUNC "%3.0" "-" COEFFS 0 1 0 0 0 1 /end COMPU_METHOD
/begin COMPU_METHOD Def_t_sw_q0p1 "Def_t_sw_q0p1" RAT_FUNC "%6.1" "°C" COEFFS 0 10 0 0 0 1 /end COMPU_METHOD
/begin COMPU_METHOD Def_bit_ub_0 "Def_bit_ub_0" TAB_VERB "%5.2" "-" COMPU_TAB_REF Def_bit_ub_0_VTAB /end COMPU_METHOD
/begin COMPU_METHOD Def_st_ub_q1 "Def_st_ub_q1" RAT_FUNC "%3.0" "-" COEFFS 0 1 0 0 0 1 /end COMPU_METHOD
/begin COMPU_METHOD Def_dez_ub_q1 "Def_dez_ub_q1" RAT_FUNC "%3.0" "-" COEFFS 0 1 0 0 0 1 /end COMPU_METHOD
/begin COMPU_METHOD Def_td_uw_q0p1 "Def_td_uw_q0p1" RAT_FUNC "%6.1" "s" COEFFS 0 10 0 0 0 1 /end COMPU_METHOD
/begin COMPU_METHOD Def_dez_uw_q1 "Def_dez_uw_q1" RAT_FUNC "%5.0" "-" COEFFS 0 1 0 0 0 1 /end COMPU_METHOD
/begin COMPU_METHOD Def_u_ub_q0p1 "Def_u_ub_q0p1" RAT_FUNC "%5.2" "V" COEFFS 0 10 0 0 0 1 /end COMPU_METHOD
/begin COMPU_METHOD Def_bit_ub_0 "Def_bit_ub_0" TAB_VERB "%5.2" "-" COMPU_TAB_REF Def_bit_ub_0_VTAB /end COMPU_METHOD
/begin COMPU_METHOD Def_st_ub_q1 "Def_st_ub_q1" RAT_FUNC "%3.0" "-" COEFFS 0 1 0 0 0 1 /end COMPU_METHOD
/begin COMPU_METHOD Def_dez_ul_q1 "Def_dez_ul_q1" RAT_FUNC "%7.0" "-" COEFFS 0 1 0 0 0 1 /end COMPU_METHOD
/begin COMPU_METHOD Def_dez_uw_q1 "Def_dez_uw_q1" RAT_FUNC "%5.0" "-" COEFFS 0 1 0 0 0 1 /end COMPU_METHOD
/begin COMPU_METHOD Def_f_ub_b100 "Def_f_ub_b100" RAT_FUNC "%5.2" "%" COEFFS 0 256 0 0 0 100 /end COMPU_METHOD
/begin COMPU_METHOD Def_n_sw_q1p0 "Def_n_sw_q1p0" RAT_FUNC "%5.0" "Upm" COEFFS 0 1 0 0 0 1 /end COMPU_METHOD
/begin COMPU_VTAB Def_bit_ub_1_VTAB "Def_bit_ub_1_VTAB" TAB_VERB 2 0 "FALSE" 1 "TRUE" DEFAULT_VALUE "TRUE" /end COMPU_VTAB
/begin COMPU_VTAB Def_bit_ub_2_VTAB "Def_bit_ub_2_VTAB" TAB_VERB 2 0 "FALSE" 1 "TRUE" DEFAULT_VALUE "TRUE" /end COMPU_VTAB
/begin COMPU_VTAB Def_bit_ub_0_VTAB "Def_bit_ub_0_VTAB" TAB_VERB 2 0 "FALSE" 1 "TRUE" DEFAULT_VALUE "TRUE" /end COMPU_VTAB
/begin COMPU_VTAB Def_bit_ub_3_VTAB "Def_bit_ub_3_VTAB" TAB_VERB 2 0 "FALSE" 1 "TRUE" DEFAULT_VALUE "TRUE" /end COMPU_VTAB
/begin COMPU_VTAB Def_bit_ub_4_VTAB "Def_bit_ub_4_VTAB" TAB_VERB 2 0 "FALSE" 1 "TRUE" DEFAULT_VALUE "TRUE" /end COMPU_VTAB
/begin COMPU_VTAB Def_bit_ub_5_VTAB "Def_bit_ub_5_VTAB" TAB_VERB 2 0 "FALSE" 1 "TRUE" DEFAULT_VALUE "TRUE" /end COMPU_VTAB
/begin COMPU_VTAB Def_bit_ub_6_VTAB "Def_bit_ub_6_VTAB" TAB_VERB 2 0 "FALSE" 1 "TRUE" DEFAULT_VALUE "TRUE" /end COMPU_VTAB
/begin COMPU_VTAB Def_bit_ub_7_VTAB "Def_bit_ub_7_VTAB" TAB_VERB 2 0 "FALSE" 1 "TRUE" DEFAULT_VALUE "TRUE" /end COMPU_VTAB
/begin COMPU_VTAB Def_bit_ub_0_VTAB "Def_bit_ub_0_VTAB" TAB_VERB 2 0 "FALSE" 1 "TRUE" DEFAULT_VALUE "TRUE" /end COMPU_VTAB
/begin COMPU_VTAB Def_bit_ub_1_VTAB "Def_bit_ub_1_VTAB" TAB_VERB 2 0 "FALSE" 1 "TRUE" DEFAULT_VALUE "TRUE" /end COMPU_VTAB
/begin COMPU_VTAB Def_bit_ub_2_VTAB "Def_bit_ub_2_VTAB" TAB_VERB 2 0 "FALSE" 1 "TRUE" DEFAULT_VALUE "TRUE" /end COMPU_VTAB
/begin COMPU_VTAB Def_bit_ub_3_VTAB "Def_bit_ub_3_VTAB" TAB_VERB 2 0 "FALSE" 1 "TRUE" DEFAULT_VALUE "TRUE" /end COMPU_VTAB
/begin COMPU_VTAB Def_bit_ub_0_VTAB "Def_bit_ub_0_VTAB" TAB_VERB 2 0 "FALSE" 1 "TRUE" DEFAULT_VALUE "TRUE" /end COMPU_VTAB
/begin COMPU_VTAB Def_bit_ub_0_VTAB "Def_bit_ub_0_VTAB" TAB_VERB 2 0 "FALSE" 1 "TRUE" DEFAULT_VALUE "TRUE" /end COMPU_VTAB
/begin COMPU_VTAB Def_bit_ub_1_VTAB "Def_bit_ub_1_VTAB" TAB_VERB 2 0 "FALSE" 1 "TRUE" DEFAULT_VALUE "TRUE" /end COMPU_VTAB
/begin COMPU_VTAB Def_bit_ub_2_VTAB "Def_bit_ub_2_VTAB" TAB_VERB 2 0 "FALSE" 1 "TRUE" DEFAULT_VALUE "TRUE" /end COMPU_VTAB
/begin COMPU_VTAB Def_bit_ub_3_VTAB "Def_bit_ub_3_VTAB" TAB_VERB 2 0 "FALSE" 1 "TRUE" DEFAULT_VALUE "TRUE" /end COMPU_VTAB
/begin COMPU_VTAB Def_bit_ub_4_VTAB "Def_bit_ub_4_VTAB" TAB_VERB 2 0 "FALSE" 1 "TRUE" DEFAULT_VALUE "TRUE" /end COMPU_VTAB
/begin COMPU_VTAB Def_bit_ub_5_VTAB "Def_bit_ub_5_VTAB" TAB_VERB 2 0 "FALSE" 1 "TRUE" DEFAULT_VALUE "TRUE" /end COMPU_VTAB
/begin COMPU_VTAB Def_bit_ub_6_VTAB "Def_bit_ub_6_VTAB" TAB_VERB 2 0 "FALSE" 1 "TRUE" DEFAULT_VALUE "TRUE" /end COMPU_VTAB
/begin COMPU_VTAB Def_bit_ub_7_VTAB "Def_bit_ub_7_VTAB" TAB_VERB 2 0 "FALSE" 1 "TRUE" DEFAULT_VALUE "TRUE" /end COMPU_VTAB
/begin COMPU_VTAB Def_bit_ub_0_VTAB "Def_bit_ub_0_VTAB" TAB_VERB 2 0 "FALSE" 1 "TRUE" DEFAULT_VALUE "TRUE" /end COMPU_VTAB
/begin COMPU_VTAB Def_bit_ub_1_VTAB "Def_bit_ub_1_VTAB" TAB_VERB 2 0 "FALSE" 1 "TRUE" DEFAULT_VALUE "TRUE" /end COMPU_VTAB
/begin COMPU_VTAB Def_bit_ub_2_VTAB "Def_bit_ub_2_VTAB" TAB_VERB 2 0 "FALSE" 1 "TRUE" DEFAULT_VALUE "TRUE" /end COMPU_VTAB
/begin COMPU_VTAB Def_bit_ub_0_VTAB "Def_bit_ub_0_VTAB" TAB_VERB 2 0 "FALSE" 1 "TRUE" DEFAULT_VALUE "TRUE" /end COMPU_VTAB
/begin COMPU_VTAB Def_bit_ub_1_VTAB "Def_bit_ub_1_VTAB" TAB_VERB 2 0 "FALSE" 1 "TRUE" DEFAULT_VALUE "TRUE" /end COMPU_VTAB
/begin COMPU_VTAB Def_bit_ub_0_VTAB "Def_bit_ub_0_VTAB" TAB_VERB 2 0 "FALSE" 1 "TRUE" DEFAULT_VALUE "TRUE" /end COMPU_VTAB
/begin COMPU_VTAB Def_bit_ub_1_VTAB "Def_bit_ub_1_VTAB" TAB_VERB 2 0 "FALSE" 1 "TRUE" DEFAULT_VALUE "TRUE" /end COMPU_VTAB
/begin COMPU_VTAB Def_bit_ub_0_VTAB "Def_bit_ub_0_VTAB" TAB_VERB 2 0 "FALSE" 1 "TRUE" DEFAULT_VALUE "TRUE" /end COMPU_VTAB
/begin COMPU_VTAB Def_bit_ub_0_VTAB "Def_bit_ub_0_VTAB" TAB_VERB 2 0 "FALSE" 1 "TRUE" DEFAULT_VALUE "TRUE" /end COMPU_VTAB
/begin COMPU_VTAB Def_bit_ub_1_VTAB "Def_bit_ub_1_VTAB" TAB_VERB 2 0 "FALSE" 1 "TRUE" DEFAULT_VALUE "TRUE" /end COMPU_VTAB
/begin COMPU_VTAB Def_bit_ub_2_VTAB "Def_bit_ub_2_VTAB" TAB_VERB 2 0 "FALSE" 1 "TRUE" DEFAULT_VALUE "TRUE" /end COMPU_VTAB
/begin COMPU_VTAB Def_bit_ub_3_VTAB "Def_bit_ub_3_VTAB" TAB_VERB 2 0 "FALSE" 1 "TRUE" DEFAULT_VALUE "TRUE" /end COMPU_VTAB
/begin COMPU_VTAB Def_bit_ub_4_VTAB "Def_bit_ub_4_VTAB" TAB_VERB 2 0 "FALSE" 1 "TRUE" DEFAULT_VALUE "TRUE" /end COMPU_VTAB
/begin COMPU_VTAB Def_bit_ub_5_VTAB "Def_bit_ub_5_VTAB" TAB_VERB 2 0 "FALSE" 1 "TRUE" DEFAULT_VALUE "TRUE" /end COMPU_VTAB
/begin COMPU_VTAB Def_bit_ub_6_VTAB "Def_bit_ub_6_VTAB" TAB_VERB 2 0 "FALSE" 1 "TRUE" DEFAULT_VALUE "TRUE" /end COMPU_VTAB
/begin COMPU_VTAB Def_bit_ub_7_VTAB "Def_bit_ub_7_VTAB" TAB_VERB 2 0 "FALSE" 1 "TRUE" DEFAULT_VALUE "TRUE" /end COMPU_VTAB
/begin COMPU_VTAB Def_bit_ub_0_VTAB "Def_bit_ub_0_VTAB" TAB_VERB 2 0 "FALSE" 1 "TRUE" DEFAULT_VALUE "TRUE" /end COMPU_VTAB
/begin COMPU_VTAB Def_bit_ub_1_VTAB "Def_bit_ub_1_VTAB" TAB_VERB 2 0 "FALSE" 1 "TRUE" DEFAULT_VALUE "TRUE" /end COMPU_VTAB
/begin COMPU_VTAB Def_bit_ub_2_VTAB "Def_bit_ub_2_VTAB" TAB_VERB 2 0 "FALSE" 1 "TRUE" DEFAULT_VALUE "TRUE" /end COMPU_VTAB
/begin COMPU_VTAB Def_bit_ub_3_VTAB "Def_bit_ub_3_VTAB" TAB_VERB 2 0 "FALSE" 1 "TRUE" DEFAULT_VALUE "TRUE" /end COMPU_VTAB
/begin COMPU_VTAB Def_bit_ub_4_VTAB "Def_bit_ub_4_VTAB" TAB_VERB 2 0 "FALSE" 1 "TRUE" DEFAULT_VALUE "TRUE" /end COMPU_VTAB
/begin COMPU_VTAB Def_bit_ub_5_VTAB "Def_bit_ub_5_VTAB" TAB_VERB 2 0 "FALSE" 1 "TRUE" DEFAULT_VALUE "TRUE" /end COMPU_VTAB
/begin COMPU_VTAB Def_bit_ub_6_VTAB "Def_bit_ub_6_VTAB" TAB_VERB 2 0 "FALSE" 1 "TRUE" DEFAULT_VALUE "TRUE" /end COMPU_VTAB
/begin COMPU_VTAB Def_bit_ub_7_VTAB "Def_bit_ub_7_VTAB" TAB_VERB 2 0 "FALSE" 1 "TRUE" DEFAULT_VALUE "TRUE" /end COMPU_VTAB
/begin COMPU_VTAB Def_bit_ub_2_VTAB "Def_bit_ub_2_VTAB" TAB_VERB 2 0 "FALSE" 1 "TRUE" DEFAULT_VALUE "TRUE" /end COMPU_VTAB
/begin COMPU_VTAB Def_bit_ub_3_VTAB "Def_bit_ub_3_VTAB" TAB_VERB 2 0 "FALSE" 1 "TRUE" DEFAULT_VALUE "TRUE" /end COMPU_VTAB
/begin COMPU_VTAB Def_bit_ub_4_VTAB "Def_bit_ub_4_VTAB" TAB_VERB 2 0 "FALSE" 1 "TRUE" DEFAULT_VALUE "TRUE" /end COMPU_VTAB
/begin COMPU_VTAB Def_bit_ub_0_VTAB "Def_bit_ub_0_VTAB" TAB_VERB 2 0 "FALSE" 1 "TRUE" DEFAULT_VALUE "TRUE" /end COMPU_VTAB
/begin COMPU_VTAB Def_bit_ub_1_VTAB "Def_bit_ub_1_VTAB" TAB_VERB 2 0 "FALSE" 1 "TRUE" DEFAULT_VALUE "TRUE" /end COMPU_VTAB
/begin COMPU_VTAB Def_bit_ub_5_VTAB "Def_bit_ub_5_VTAB" TAB_VERB 2 0 "FALSE" 1 "TRUE" DEFAULT_VALUE "TRUE" /end COMPU_VTAB
/begin COMPU_VTAB Def_bit_ub_0_VTAB "Def_bit_ub_0_VTAB" TAB_VERB 2 0 "FALSE" 1 "TRUE" DEFAULT_VALUE "TRUE" /end COMPU_VTAB
/begin COMPU_VTAB Def_bit_ub_1_VTAB "Def_bit_ub_1_VTAB" TAB_VERB 2 0 "FALSE" 1 "TRUE" DEFAULT_VALUE "TRUE" /end COMPU_VTAB
/begin COMPU_VTAB Def_bit_ub_2_VTAB "Def_bit_ub_2_VTAB" TAB_VERB 2 0 "FALSE" 1 "TRUE" DEFAULT_VALUE "TRUE" /end COMPU_VTAB
/begin COMPU_VTAB Def_bit_ub_3_VTAB "Def_bit_ub_3_VTAB" TAB_VERB 2 0 "FALSE" 1 "TRUE" DEFAULT_VALUE "TRUE" /end COMPU_VTAB
/begin COMPU_VTAB Def_bit_ub_4_VTAB "Def_bit_ub_4_VTAB" TAB_VERB 2 0 "FALSE" 1 "TRUE" DEFAULT_VALUE "TRUE" /end COMPU_VTAB
/begin COMPU_VTAB Def_bit_ub_5_VTAB "Def_bit_ub_5_VTAB" TAB_VERB 2 0 "FALSE" 1 "TRUE" DEFAULT_VALUE "TRUE" /end COMPU_VTAB
/begin COMPU_VTAB Def_bit_ub_6_VTAB "Def_bit_ub_6_VTAB" TAB_VERB 2 0 "FALSE" 1 "TRUE" DEFAULT_VALUE "TRUE" /end COMPU_VTAB
/begin COMPU_VTAB Def_bit_ub_7_VTAB "Def_bit_ub_7_VTAB" TAB_VERB 2 0 "FALSE" 1 "TRUE" DEFAULT_VALUE "TRUE" /end COMPU_VTAB
/begin COMPU_VTAB Def_bit_ub_0_VTAB "Def_bit_ub_0_VTAB" TAB_VERB 2 0 "FALSE" 1 "TRUE" DEFAULT_VALUE "TRUE" /end COMPU_VTAB
/begin COMPU_VTAB Def_bit_ub_1_VTAB "Def_bit_ub_1_VTAB" TAB_VERB 2 0 "FALSE" 1 "TRUE" DEFAULT_VALUE "TRUE" /end COMPU_VTAB
/begin COMPU_VTAB Def_bit_ub_3_VTAB "Def_bit_ub_3_VTAB" TAB_VERB 2 0 "FALSE" 1 "TRUE" DEFAULT_VALUE "TRUE" /end COMPU_VTAB
/begin COMPU_VTAB Def_bit_ub_5_VTAB "Def_bit_ub_5_VTAB" TAB_VERB 2 0 "FALSE" 1 "TRUE" DEFAULT_VALUE "TRUE" /end COMPU_VTAB
/begin COMPU_VTAB Def_bit_ub_6_VTAB "Def_bit_ub_6_VTAB" TAB_VERB 2 0 "FALSE" 1 "TRUE" DEFAULT_VALUE "TRUE" /end COMPU_VTAB
/begin COMPU_VTAB Def_bit_ub_7_VTAB "Def_bit_ub_7_VTAB" TAB_VERB 2 0 "FALSE" 1 "TRUE" DEFAULT_VALUE "TRUE" /end COMPU_VTAB
/begin COMPU_VTAB Def_bit_ub_2_VTAB "Def_bit_ub_2_VTAB" TAB_VERB 2 0 "FALSE" 1 "TRUE" DEFAULT_VALUE "TRUE" /end COMPU_VTAB
/begin COMPU_VTAB Def_bit_ub_4_VTAB "Def_bit_ub_4_VTAB" TAB_VERB 2 0 "FALSE" 1 "TRUE" DEFAULT_VALUE "TRUE" /end COMPU_VTAB
/begin COMPU_VTAB Def_bit_ub_0_VTAB "Def_bit_ub_0_VTAB" TAB_VERB 2 0 "FALSE" 1 "TRUE" DEFAULT_VALUE "TRUE" /end COMPU_VTAB
/begin COMPU_VTAB Def_bit_ub_1_VTAB "Def_bit_ub_1_VTAB" TAB_VERB 2 0 "FALSE" 1 "TRUE" DEFAULT_VALUE "TRUE" /end COMPU_VTAB
/begin COMPU_VTAB Def_bit_ub_2_VTAB "Def_bit_ub_2_VTAB" TAB_VERB 2 0 "FALSE" 1 "TRUE" DEFAULT_VALUE "TRUE" /end COMPU_VTAB
/begin COMPU_VTAB Def_bit_ub_4_VTAB "Def_bit_ub_4_VTAB" TAB_VERB 2 0 "FALSE" 1 "TRUE" DEFAULT_VALUE "TRUE" /end COMPU_VTAB
/begin COMPU_VTAB Def_bit_ub_5_VTAB "Def_bit_ub_5_VTAB" TAB_VERB 2 0 "FALSE" 1 "TRUE" DEFAULT_VALUE "TRUE" /end COMPU_VTAB
/begin COMPU_VTAB Def_bit_ub_0_VTAB "Def_bit_ub_0_VTAB" TAB_VERB 2 0 "FALSE" 1 "TRUE" DEFAULT_VALUE "TRUE" /end COMPU_VTAB
/begin COMPU_VTAB Def_bit_ub_0_VTAB "Def_bit_ub_0_VTAB" TAB_VERB 2 0 "FALSE" 1 "TRUE" DEFAULT_VALUE "TRUE" /end COMPU_VTAB
/begin COMPU_VTAB Def_bit_ub_1_VTAB "Def_bit_ub_1_VTAB" TAB_VERB 2 0 "FALSE" 1 "TRUE" DEFAULT_VALUE "TRUE" /end COMPU_VTAB
/begin COMPU_VTAB Def_bit_ub_2_VTAB "Def_bit_ub_2_VTAB" TAB_VERB 2 0 "FALSE" 1 "TRUE" DEFAULT_VALUE "TRUE" /end COMPU_VTAB
/begin COMPU_VTAB Def_bit_ub_3_VTAB "Def_bit_ub_3_VTAB" TAB_VERB 2 0 "FALSE" 1 "TRUE" DEFAULT_VALUE "TRUE" /end COMPU_VTAB
/begin COMPU_VTAB Def_bit_ub_4_VTAB "Def_bit_ub_4_VTAB" TAB_VERB 2 0 "FALSE" 1 "TRUE" DEFAULT_VALUE "TRUE" /end COMPU_VTAB
/begin COMPU_VTAB Def_bit_ub_0_VTAB "Def_bit_ub_0_VTAB" TAB_VERB 2 0 "FALSE" 1 "TRUE" DEFAULT_VALUE "TRUE" /end COMPU_VTAB
/begin COMPU_VTAB Def_bit_ub_1_VTAB "Def_bit_ub_1_VTAB" TAB_VERB 2 0 "FALSE" 1 "TRUE" DEFAULT_VALUE "TRUE" /end COMPU_VTAB
/begin COMPU_VTAB Def_bit_ub_2_VTAB "Def_bit_ub_2_VTAB" TAB_VERB 2 0 "FALSE" 1 "TRUE" DEFAULT_VALUE "TRUE" /end COMPU_VTAB
/begin COMPU_VTAB Def_bit_ub_3_VTAB "Def_bit_ub_3_VTAB" TAB_VERB 2 0 "FALSE" 1 "TRUE" DEFAULT_VALUE "TRUE" /end COMPU_VTAB
/begin COMPU_VTAB Def_bit_ub_4_VTAB "Def_bit_ub_4_VTAB" TAB_VERB 2 0 "FALSE" 1 "TRUE" DEFAULT_VALUE "TRUE" /end COMPU_VTAB
/begin COMPU_VTAB Def_bit_ub_5_VTAB "Def_bit_ub_5_VTAB" TAB_VERB 2 0 "FALSE" 1 "TRUE" DEFAULT_VALUE "TRUE" /end COMPU_VTAB
/begin COMPU_VTAB Def_bit_ub_6_VTAB "Def_bit_ub_6_VTAB" TAB_VERB 2 0 "FALSE" 1 "TRUE" DEFAULT_VALUE "TRUE" /end COMPU_VTAB
/begin COMPU_VTAB Def_bit_ub_7_VTAB "Def_bit_ub_7_VTAB" TAB_VERB 2 0 "FALSE" 1 "TRUE" DEFAULT_VALUE "TRUE" /end COMPU_VTAB
/begin COMPU_VTAB Def_bit_ub_0_VTAB "Def_bit_ub_0_VTAB" TAB_VERB 2 0 "FALSE" 1 "TRUE" DEFAULT_VALUE "TRUE" /end COMPU_VTAB
/begin COMPU_VTAB Def_bit_ub_1_VTAB "Def_bit_ub_1_VTAB" TAB_VERB 2 0 "FALSE" 1 "TRUE" DEFAULT_VALUE "TRUE" /end COMPU_VTAB
/begin COMPU_VTAB Def_bit_ub_1_VTAB "Def_bit_ub_1_VTAB" TAB_VERB 2 0 "FALSE" 1 "TRUE" DEFAULT_VALUE "TRUE" /end COMPU_VTAB
/begin COMPU_VTAB Def_bit_ub_2_VTAB "Def_bit_ub_2_VTAB" TAB_VERB 2 0 "FALSE" 1 "TRUE" DEFAULT_VALUE "TRUE" /end COMPU_VTAB
/begin COMPU_VTAB Def_bit_ub_3_VTAB "Def_bit_ub_3_VTAB" TAB_VERB 2 0 "FALSE" 1 "TRUE" DEFAULT_VALUE "TRUE" /end COMPU_VTAB
/begin COMPU_VTAB Def_bit_ub_0_VTAB "Def_bit_ub_0_VTAB" TAB_VERB 2 0 "FALSE" 1 "TRUE" DEFAULT_VALUE "TRUE" /end COMPU_VTAB
/begin COMPU_VTAB Def_bit_ub_0_VTAB "Def_bit_ub_0_VTAB" TAB_VERB 2 0 "FALSE" 1 "TRUE" DEFAULT_VALUE "TRUE" /end COMPU_VTAB
/begin COMPU_VTAB Def_bit_ub_1_VTAB "Def_bit_ub_1_VTAB" TAB_VERB 2 0 "FALSE" 1 "TRUE" DEFAULT_VALUE "TRUE" /end COMPU_VTAB
/begin COMPU_VTAB Def_bit_ub_0_VTAB "Def_bit_ub_0_VTAB" TAB_VERB 2 0 "FALSE" 1 "TRUE" DEFAULT_VALUE "TRUE" /end COMPU_VTAB
/begin COMPU_VTAB Def_bit_ub_0_VTAB "Def_bit_ub_0_VTAB" TAB_VERB 2 0 "FALSE" 1 "TRUE" DEFAULT_VALUE "TRUE" /end COMPU_VTAB
/begin COMPU_VTAB Def_bit_ub_1_VTAB "Def_bit_ub_1_VTAB" TAB_VERB 2 0 "FALSE" 1 "TRUE" DEFAULT_VALUE "TRUE" /end COMPU_VTAB
/begin COMPU_VTAB Def_bit_ub_0_VTAB "Def_bit_ub_0_VTAB" TAB_VERB 2 0 "FALSE" 1 "TRUE" DEFAULT_VALUE "TRUE" /end COMPU_VTAB
/begin COMPU_VTAB Def_bit_ub_1_VTAB "Def_bit_ub_1_VTAB" TAB_VERB 2 0 "FALSE" 1 "TRUE" DEFAULT_VALUE "TRUE" /end COMPU_VTAB
/begin COMPU_VTAB Def_bit_ub_0_VTAB "Def_bit_ub_0_VTAB" TAB_VERB 2 0 "FALSE" 1 "TRUE" DEFAULT_VALUE "TRUE" /end COMPU_VTAB
/begin COMPU_VTAB Def_bit_ub_1_VTAB "Def_bit_ub_1_VTAB" TAB_VERB 2 0 "FALSE" 1 "TRUE" DEFAULT_VALUE "TRUE" /end COMPU_VTAB
/begin COMPU_VTAB Def_bit_ub_2_VTAB "Def_bit_ub_2_VTAB" TAB_VERB 2 0 "FALSE" 1 "TRUE" DEFAULT_VALUE "TRUE" /end COMPU_VTAB
/begin COMPU_VTAB Def_bit_ub_3_VTAB "Def_bit_ub_3_VTAB" TAB_VERB 2 0 "FALSE" 1 "TRUE" DEFAULT_VALUE "TRUE" /end COMPU_VTAB
/begin COMPU_VTAB Def_bit_ub_4_VTAB "Def_bit_ub_4_VTAB" TAB_VERB 2 0 "FALSE" 1 "TRUE" DEFAULT_VALUE "TRUE" /end COMPU_VTAB
/begin COMPU_VTAB Def_bit_ub_0_VTAB "Def_bit_ub_0_VTAB" TAB_VERB 2 0 "FALSE" 1 "TRUE" DEFAULT_VALUE "TRUE" /end COMPU_VTAB
/begin COMPU_VTAB Def_bit_ub_1_VTAB "Def_bit_ub_1_VTAB" TAB_VERB 2 0 "FALSE" 1 "TRUE" DEFAULT_VALUE "TRUE" /end COMPU_VTAB
/begin COMPU_VTAB Def_bit_ub_2_VTAB "Def_bit_ub_2_VTAB" TAB_VERB 2 0 "FALSE" 1 "TRUE" DEFAULT_VALUE "TRUE" /end COMPU_VTAB
/begin COMPU_VTAB Def_bit_ub_0_VTAB "Def_bit_ub_0_VTAB" TAB_VERB 2 0 "FALSE" 1 "TRUE" DEFAULT_VALUE "TRUE" /end COMPU_VTAB
/begin COMPU_VTAB Def_bit_ub_1_VTAB "Def_bit_ub_1_VTAB" TAB_VERB 2 0 "FALSE" 1 "TRUE" DEFAULT_VALUE "TRUE" /end COMPU_VTAB
/begin COMPU_VTAB Def_bit_ub_4_VTAB "Def_bit_ub_4_VTAB" TAB_VERB 2 0 "FALSE" 1 "TRUE" DEFAULT_VALUE "TRUE" /end COMPU_VTAB
/begin COMPU_VTAB Def_bit_ub_5_VTAB "Def_bit_ub_5_VTAB" TAB_VERB 2 0 "FALSE" 1 "TRUE" DEFAULT_VALUE "TRUE" /end COMPU_VTAB
/begin COMPU_VTAB Def_bit_ub_3_VTAB "Def_bit_ub_3_VTAB" TAB_VERB 2 0 "FALSE" 1 "TRUE" DEFAULT_VALUE "TRUE" /end COMPU_VTAB
/begin COMPU_VTAB Def_bit_ub_2_VTAB "Def_bit_ub_2_VTAB" TAB_VERB 2 0 "FALSE" 1 "TRUE" DEFAULT_VALUE "TRUE" /end COMPU_VTAB
/begin COMPU_VTAB Def_bit_ub_0_VTAB "Def_bit_ub_0_VTAB" TAB_VERB 2 0 "FALSE" 1 "TRUE" DEFAULT_VALUE "TRUE" /end COMPU_VTAB
/begin COMPU_VTAB Def_bit_ub_0_VTAB "Def_bit_ub_0_VTAB" TAB_VERB 2 0 "FALSE" 1 "TRUE" DEFAULT_VALUE "TRUE" /end COMPU_VTAB
/begin COMPU_VTAB Def_bit_ub_1_VTAB "Def_bit_ub_1_VTAB" TAB_VERB 2 0 "FALSE" 1 "TRUE" DEFAULT_VALUE "TRUE" /end COMPU_VTAB
/begin COMPU_VTAB Def_bit_ub_2_VTAB "Def_bit_ub_2_VTAB" TAB_VERB 2 0 "FALSE" 1 "TRUE" DEFAULT_VALUE "TRUE" /end COMPU_VTAB
/begin COMPU_VTAB Def_bit_ub_0_VTAB "Def_bit_ub_0_VTAB" TAB_VERB 2 0 "FALSE" 1 "TRUE" DEFAULT_VALUE "TRUE" /end COMPU_VTAB
/begin COMPU_VTAB Def_bit_ub_0_VTAB "Def_bit_ub_0_VTAB" TAB_VERB 2 0 "FALSE" 1 "TRUE" DEFAULT_VALUE "TRUE" /end COMPU_VTAB
/begin COMPU_VTAB Def_bit_ub_1_VTAB "Def_bit_ub_1_VTAB" TAB_VERB 2 0 "FALSE" 1 "TRUE" DEFAULT_VALUE "TRUE" /end COMPU_VTAB
/begin COMPU_VTAB Def_bit_ub_2_VTAB "Def_bit_ub_2_VTAB" TAB_VERB 2 0 "FALSE" 1 "TRUE" DEFAULT_VALUE "TRUE" /end COMPU_VTAB
/begin COMPU_VTAB Def_bit_ub_3_VTAB "Def_bit_ub_3_VTAB" TAB_VERB 2 0 "FALSE" 1 "TRUE" DEFAULT_VALUE "TRUE" /end COMPU_VTAB
/begin COMPU_VTAB Def_bit_ub_4_VTAB "Def_bit_ub_4_VTAB" TAB_VERB 2 0 "FALSE" 1 "TRUE" DEFAULT_VALUE "TRUE" /end COMPU_VTAB
/begin COMPU_VTAB Def_bit_ub_5_VTAB "Def_bit_ub_5_VTAB" TAB_VERB 2 0 "FALSE" 1 "TRUE" DEFAULT_VALUE "TRUE" /end COMPU_VTAB
/begin COMPU_VTAB Def_bit_ub_6_VTAB "Def_bit_ub_6_VTAB" TAB_VERB 2 0 "FALSE" 1 "TRUE" DEFAULT_VALUE "TRUE" /end COMPU_VTAB
/begin COMPU_VTAB Def_bit_ub_7_VTAB "Def_bit_ub_7_VTAB" TAB_VERB 2 0 "FALSE" 1 "TRUE" DEFAULT_VALUE "TRUE" /end COMPU_VTAB
/begin COMPU_VTAB Def_bit_ub_0_VTAB "Def_bit_ub_0_VTAB" TAB_VERB 2 0 "FALSE" 1 "TRUE" DEFAULT_VALUE "TRUE" /end COMPU_VTAB
/begin COMPU_VTAB Def_bit_ub_1_VTAB "Def_bit_ub_1_VTAB" TAB_VERB 2 0 "FALSE" 1 "TRUE" DEFAULT_VALUE "TRUE" /end COMPU_VTAB
/begin COMPU_VTAB Def_bit_ub_2_VTAB "Def_bit_ub_2_VTAB" TAB_VERB 2 0 "FALSE" 1 "TRUE" DEFAULT_VALUE "TRUE" /end COMPU_VTAB
/begin COMPU_VTAB Def_bit_ub_3_VTAB "Def_bit_ub_3_VTAB" TAB_VERB 2 0 "FALSE" 1 "TRUE" DEFAULT_VALUE "TRUE" /end COMPU_VTAB
/begin COMPU_VTAB Def_bit_ub_4_VTAB "Def_bit_ub_4_VTAB" TAB_VERB 2 0 "FALSE" 1 "TRUE" DEFAULT_VALUE "TRUE" /end COMPU_VTAB
/begin COMPU_VTAB Def_bit_ub_5_VTAB "Def_bit_ub_5_VTAB" TAB_VERB 2 0 "FALSE" 1 "TRUE" DEFAULT_VALUE "TRUE" /end COMPU_VTAB
/begin COMPU_VTAB Def_bit_ub_6_VTAB "Def_bit_ub_6_VTAB" TAB_VERB 2 0 "FALSE" 1 "TRUE" DEFAULT_VALUE "TRUE" /end COMPU_VTAB
/begin COMPU_VTAB Def_bit_ub_7_VTAB "Def_bit_ub_7_VTAB" TAB_VERB 2 0 "FALSE" 1 "TRUE" DEFAULT_VALUE "TRUE" /end COMPU_VTAB
/begin COMPU_VTAB Def_bit_ub_0_VTAB "Def_bit_ub_0_VTAB" TAB_VERB 2 0 "FALSE" 1 "TRUE" DEFAULT_VALUE "TRUE" /end COMPU_VTAB
/begin COMPU_VTAB Def_bit_ub_1_VTAB "Def_bit_ub_1_VTAB" TAB_VERB 2 0 "FALSE" 1 "TRUE" DEFAULT_VALUE "TRUE" /end COMPU_VTAB
/begin COMPU_VTAB Def_bit_ub_2_VTAB "Def_bit_ub_2_VTAB" TAB_VERB 2 0 "FALSE" 1 "TRUE" DEFAULT_VALUE "TRUE" /end COMPU_VTAB
/begin COMPU_VTAB Def_bit_ub_3_VTAB "Def_bit_ub_3_VTAB" TAB_VERB 2 0 "FALSE" 1 "TRUE" DEFAULT_VALUE "TRUE" /end COMPU_VTAB
/begin COMPU_VTAB Def_bit_ub_4_VTAB "Def_bit_ub_4_VTAB" TAB_VERB 2 0 "FALSE" 1 "TRUE" DEFAULT_VALUE "TRUE" /end COMPU_VTAB
/begin COMPU_VTAB Def_bit_ub_5_VTAB "Def_bit_ub_5_VTAB" TAB_VERB 2 0 "FALSE" 1 "TRUE" DEFAULT_VALUE "TRUE" /end COMPU_VTAB
/begin COMPU_VTAB Def_bit_ub_6_VTAB "Def_bit_ub_6_VTAB" TAB_VERB 2 0 "FALSE" 1 "TRUE" DEFAULT_VALUE "TRUE" /end COMPU_VTAB
/begin COMPU_VTAB Def_bit_ub_7_VTAB "Def_bit_ub_7_VTAB" TAB_VERB 2 0 "FALSE" 1 "TRUE" DEFAULT_VALUE "TRUE" /end COMPU_VTAB
/begin COMPU_VTAB Def_bit_ub_0_VTAB "Def_bit_ub_0_VTAB" TAB_VERB 2 0 "FALSE" 1 "TRUE" DEFAULT_VALUE "TRUE" /end COMPU_VTAB
/begin COMPU_VTAB Def_bit_ub_1_VTAB "Def_bit_ub_1_VTAB" TAB_VERB 2 0 "FALSE" 1 "TRUE" DEFAULT_VALUE "TRUE" /end COMPU_VTAB
/begin COMPU_VTAB Def_bit_ub_2_VTAB "Def_bit_ub_2_VTAB" TAB_VERB 2 0 "FALSE" 1 "TRUE" DEFAULT_VALUE "TRUE" /end COMPU_VTAB
/begin COMPU_VTAB Def_bit_ub_3_VTAB "Def_bit_ub_3_VTAB" TAB_VERB 2 0 "FALSE" 1 "TRUE" DEFAULT_VALUE "TRUE" /end COMPU_VTAB
/begin COMPU_VTAB Def_bit_ub_4_VTAB "Def_bit_ub_4_VTAB" TAB_VERB 2 0 "FALSE" 1 "TRUE" DEFAULT_VALUE "TRUE" /end COMPU_VTAB
/begin COMPU_VTAB Def_bit_ub_5_VTAB "Def_bit_ub_5_VTAB" TAB_VERB 2 0 "FALSE" 1 "TRUE" DEFAULT_VALUE "TRUE" /end COMPU_VTAB
/begin COMPU_VTAB Def_bit_ub_0_VTAB "Def_bit_ub_0_VTAB" TAB_VERB 2 0 "FALSE" 1 "TRUE" DEFAULT_VALUE "TRUE" /end COMPU_VTAB
/begin COMPU_VTAB Def_bit_ub_1_VTAB "Def_bit_ub_1_VTAB" TAB_VERB 2 0 "FALSE" 1 "TRUE" DEFAULT_VALUE "TRUE" /end COMPU_VTAB
/begin COMPU_VTAB Def_bit_ub_2_VTAB "Def_bit_ub_2_VTAB" TAB_VERB 2 0 "FALSE" 1 "TRUE" DEFAULT_VALUE "TRUE" /end COMPU_VTAB
/begin COMPU_VTAB Def_bit_ub_3_VTAB "Def_bit_ub_3_VTAB" TAB_VERB 2 0 "FALSE" 1 "TRUE" DEFAULT_VALUE "TRUE" /end COMPU_VTAB
/begin COMPU_VTAB Def_bit_ub_0_VTAB "Def_bit_ub_0_VTAB" TAB_VERB 2 0 "FALSE" 1 "TRUE" DEFAULT_VALUE "TRUE" /end COMPU_VTAB
/begin COMPU_VTAB Def_bit_ub_1_VTAB "Def_bit_ub_1_VTAB" TAB_VERB 2 0 "FALSE" 1 "TRUE" DEFAULT_VALUE "TRUE" /end COMPU_VTAB
/begin COMPU_VTAB Def_bit_ub_2_VTAB "Def_bit_ub_2_VTAB" TAB_VERB 2 0 "FALSE" 1 "TRUE" DEFAULT_VALUE "TRUE" /end COMPU_VTAB
/begin COMPU_VTAB Def_bit_ub_3_VTAB "Def_bit_ub_3_VTAB" TAB_VERB 2 0 "FALSE" 1 "TRUE" DEFAULT_VALUE "TRUE" /end COMPU_VTAB
/begin COMPU_VTAB Def_bit_ub_4_VTAB "Def_bit_ub_4_VTAB" TAB_VERB 2 0 "FALSE" 1 "TRUE" DEFAULT_VALUE "TRUE" /end COMPU_VTAB
/begin COMPU_VTAB Def_bit_ub_0_VTAB "Def_bit_ub_0_VTAB" TAB_VERB 2 0 "FALSE" 1 "TRUE" DEFAULT_VALUE "TRUE" /end COMPU_VTAB
/begin COMPU_VTAB Def_bit_ub_1_VTAB "Def_bit_ub_1_VTAB" TAB_VERB 2 0 "FALSE" 1 "TRUE" DEFAULT_VALUE "TRUE" /end COMPU_VTAB
/begin COMPU_VTAB Def_bit_ub_2_VTAB "Def_bit_ub_2_VTAB" TAB_VERB 2 0 "FALSE" 1 "TRUE" DEFAULT_VALUE "TRUE" /end COMPU_VTAB
/begin COMPU_VTAB Def_bit_ub_3_VTAB "Def_bit_ub_3_VTAB" TAB_VERB 2 0 "FALSE" 1 "TRUE" DEFAULT_VALUE "TRUE" /end COMPU_VTAB
/begin COMPU_VTAB Def_bit_ub_4_VTAB "Def_bit_ub_4_VTAB" TAB_VERB 2 0 "FALSE" 1 "TRUE" DEFAULT_VALUE "TRUE" /end COMPU_VTAB
/begin COMPU_VTAB Def_bit_ub_5_VTAB "Def_bit_ub_5_VTAB" TAB_VERB 2 0 "FALSE" 1 "TRUE" DEFAULT_VALUE "TRUE" /end COMPU_VTAB
/begin COMPU_VTAB Def_bit_ub_0_VTAB "Def_bit_ub_0_VTAB" TAB_VERB 2 0 "FALSE" 1 "TRUE" DEFAULT_VALUE "TRUE" /end COMPU_VTAB
/begin COMPU_VTAB Def_bit_ub_1_VTAB "Def_bit_ub_1_VTAB" TAB_VERB 2 0 "FALSE" 1 "TRUE" DEFAULT_VALUE "TRUE" /end COMPU_VTAB
/begin COMPU_VTAB Def_bit_ub_2_VTAB "Def_bit_ub_2_VTAB" TAB_VERB 2 0 "FALSE" 1 "TRUE" DEFAULT_VALUE "TRUE" /end COMPU_VTAB
/begin COMPU_VTAB Def_bit_ub_4_VTAB "Def_bit_ub_4_VTAB" TAB_VERB 2 0 "FALSE" 1 "TRUE" DEFAULT_VALUE "TRUE" /end COMPU_VTAB
/begin COMPU_VTAB Def_bit_ub_5_VTAB "Def_bit_ub_5_VTAB" TAB_VERB 2 0 "FALSE" 1 "TRUE" DEFAULT_VALUE "TRUE" /end COMPU_VTAB
/begin COMPU_VTAB Def_bit_ub_6_VTAB "Def_bit_ub_6_VTAB" TAB_VERB 2 0 "FALSE" 1 "TRUE" DEFAULT_VALUE "TRUE" /end COMPU_VTAB
/begin COMPU_VTAB Def_bit_ub_7_VTAB "Def_bit_ub_7_VTAB" TAB_VERB 2 0 "FALSE" 1 "TRUE" DEFAULT_VALUE "TRUE" /end COMPU_VTAB
/begin COMPU_VTAB Def_bit_ub_3_VTAB "Def_bit_ub_3_VTAB" TAB_VERB 2 0 "FALSE" 1 "TRUE" DEFAULT_VALUE "TRUE" /end COMPU_VTAB
/begin COMPU_VTAB Def_bit_ub_0_VTAB "Def_bit_ub_0_VTAB" TAB_VERB 2 0 "FALSE" 1 "TRUE" DEFAULT_VALUE "TRUE" /end COMPU_VTAB
/begin COMPU_VTAB Def_bit_ub_1_VTAB "Def_bit_ub_1_VTAB" TAB_VERB 2 0 "FALSE" 1 "TRUE" DEFAULT_VALUE "TRUE" /end COMPU_VTAB
/begin COMPU_VTAB Def_bit_ub_2_VTAB "Def_bit_ub_2_VTAB" TAB_VERB 2 0 "FALSE" 1 "TRUE" DEFAULT_VALUE "TRUE" /end COMPU_VTAB
/begin COMPU_VTAB Def_bit_ub_3_VTAB "Def_bit_ub_3_VTAB" TAB_VERB 2 0 "FALSE" 1 "TRUE" DEFAULT_VALUE "TRUE" /end COMPU_VTAB
/begin COMPU_VTAB Def_bit_ub_0_VTAB "Def_bit_ub_0_VTAB" TAB_VERB 2 0 "FALSE" 1 "TRUE" DEFAULT_VALUE "TRUE" /end COMPU_VTAB
/begin COMPU_VTAB Def_bit_ub_1_VTAB "Def_bit_ub_1_VTAB" TAB_VERB 2 0 "FALSE" 1 "TRUE" DEFAULT_VALUE "TRUE" /end COMPU_VTAB
/begin COMPU_VTAB Def_bit_ub_2_VTAB "Def_bit_ub_2_VTAB" TAB_VERB 2 0 "FALSE" 1 "TRUE" DEFAULT_VALUE "TRUE" /end COMPU_VTAB
/begin COMPU_VTAB Def_bit_ub_3_VTAB "Def_bit_ub_3_VTAB" TAB_VERB 2 0 "FALSE" 1 "TRUE" DEFAULT_VALUE "TRUE" /end COMPU_VTAB
/begin COMPU_VTAB Def_bit_ub_4_VTAB "Def_bit_ub_4_VTAB" TAB_VERB 2 0 "FALSE" 1 "TRUE" DEFAULT_VALUE "TRUE" /end COMPU_VTAB
/begin COMPU_VTAB Def_bit_ub_5_VTAB "Def_bit_ub_5_VTAB" TAB_VERB 2 0 "FALSE" 1 "TRUE" DEFAULT_VALUE "TRUE" /end COMPU_VTAB
/begin COMPU_VTAB Def_bit_ub_0_VTAB "Def_bit_ub_0_VTAB" TAB_VERB 2 0 "FALSE" 1 "TRUE" DEFAULT_VALUE "TRUE" /end COMPU_VTAB
/begin COMPU_VTAB Def_bit_ub_1_VTAB "Def_bit_ub_1_VTAB" TAB_VERB 2 0 "FALSE" 1 "TRUE" DEFAULT_VALUE "TRUE" /end COMPU_VTAB
/begin COMPU_VTAB Def_bit_ub_2_VTAB "Def_bit_ub_2_VTAB" TAB_VERB 2 0 "FALSE" 1 "TRUE" DEFAULT_VALUE "TRUE" /end COMPU_VTAB
/begin COMPU_VTAB Def_bit_ub_3_VTAB "Def_bit_ub_3_VTAB" TAB_VERB 2 0 "FALSE" 1 "TRUE" DEFAULT_VALUE "TRUE" /end COMPU_VTAB
/begin COMPU_VTAB Def_bit_ub_4_VTAB "Def_bit_ub_4_VTAB" TAB_VERB 2 0 "FALSE" 1 "TRUE" DEFAULT_VALUE "TRUE" /end COMPU_VTAB
/begin COMPU_VTAB Def_bit_ub_5_VTAB "Def_bit_ub_5_VTAB" TAB_VERB 2 0 "FALSE" 1 "TRUE" DEFAULT_VALUE "TRUE" /end COMPU_VTAB
/begin COMPU_VTAB Def_bit_ub_6_VTAB "Def_bit_ub_6_VTAB" TAB_VERB 2 0 "FALSE" 1 "TRUE" DEFAULT_VALUE "TRUE" /end COMPU_VTAB
/begin COMPU_VTAB Def_bit_ub_7_VTAB "Def_bit_ub_7_VTAB" TAB_VERB 2 0 "FALSE" 1 "TRUE" DEFAULT_VALUE "TRUE" /end COMPU_VTAB
/begin COMPU_VTAB Def_bit_ub_0_VTAB "Def_bit_ub_0_VTAB" TAB_VERB 2 0 "FALSE" 1 "TRUE" DEFAULT_VALUE "TRUE" /end COMPU_VTAB
/begin COMPU_VTAB Def_bit_ub_1_VTAB "Def_bit_ub_1_VTAB" TAB_VERB 2 0 "FALSE" 1 "TRUE" DEFAULT_VALUE "TRUE" /end COMPU_VTAB
/begin COMPU_VTAB Def_bit_ub_2_VTAB "Def_bit_ub_2_VTAB" TAB_VERB 2 0 "FALSE" 1 "TRUE" DEFAULT_VALUE "TRUE" /end COMPU_VTAB
/begin COMPU_VTAB Def_bit_ub_3_VTAB "Def_bit_ub_3_VTAB" TAB_VERB 2 0 "FALSE" 1 "TRUE" DEFAULT_VALUE "TRUE" /end COMPU_VTAB
/begin COMPU_VTAB Def_bit_ub_4_VTAB "Def_bit_ub_4_VTAB" TAB_VERB 2 0 "FALSE" 1 "TRUE" DEFAULT_VALUE "TRUE" /end COMPU_VTAB
/begin COMPU_VTAB Def_bit_ub_5_VTAB "Def_bit_ub_5_VTAB" TAB_VERB 2 0 "FALSE" 1 "TRUE" DEFAULT_VALUE "TRUE" /end COMPU_VTAB
/begin COMPU_VTAB Def_bit_ub_6_VTAB "Def_bit_ub_6_VTAB" TAB_VERB 2 0 "FALSE" 1 "TRUE" DEFAULT_VALUE "TRUE" /end COMPU_VTAB
/begin COMPU_VTAB Def_bit_ub_0_VTAB "Def_bit_ub_0_VTAB" TAB_VERB 2 0 "FALSE" 1 "TRUE" DEFAULT_VALUE "TRUE" /end COMPU_VTAB
/begin COMPU_VTAB Def_bit_ub_0_VTAB "Def_bit_ub_0_VTAB" TAB_VERB 2 0 "FALSE" 1 "TRUE" DEFAULT_VALUE "TRUE" /end COMPU_VTAB
/begin COMPU_VTAB Def_bit_ub_1_VTAB "Def_bit_ub_1_VTAB" TAB_VERB 2 0 "FALSE" 1 "TRUE" DEFAULT_VALUE "TRUE" /end COMPU_VTAB
/begin COMPU_VTAB Def_bit_ub_2_VTAB "Def_bit_ub_2_VTAB" TAB_VERB 2 0 "FALSE" 1 "TRUE" DEFAULT_VALUE "TRUE" /end COMPU_VTAB
/begin COMPU_VTAB Def_bit_ub_3_VTAB "Def_bit_ub_3_VTAB" TAB_VERB 2 0 "FALSE" 1 "TRUE" DEFAULT_VALUE "TRUE" /end COMPU_VTAB
/begin COMPU_VTAB Def_bit_ub_4_VTAB "Def_bit_ub_4_VTAB" TAB_VERB 2 0 "FALSE" 1 "TRUE" DEFAULT_VALUE "TRUE" /end COMPU_VTAB
/begin COMPU_VTAB Def_bit_ub_5_VTAB "Def_bit_ub_5_VTAB" TAB_VERB 2 0 "FALSE" 1 "TRUE" DEFAULT_VALUE "TRUE" /end COMPU_VTAB
/begin COMPU_VTAB Def_bit_ub_6_VTAB "Def_bit_ub_6_VTAB" TAB_VERB 2 0 "FALSE" 1 "TRUE" DEFAULT_VALUE "TRUE" /end COMPU_VTAB
/begin COMPU_VTAB Def_bit_ub_7_VTAB "Def_bit_ub_7_VTAB" TAB_VERB 2 0 "FALSE" 1 "TRUE" DEFAULT_VALUE "TRUE" /end COMPU_VTAB
/begin COMPU_VTAB Def_bit_ub_1_VTAB "Def_bit_ub_1_VTAB" TAB_VERB 2 0 "FALSE" 1 "TRUE" DEFAULT_VALUE "TRUE" /end COMPU_VTAB
/begin COMPU_VTAB Def_bit_ub_2_VTAB "Def_bit_ub_2_VTAB" TAB_VERB 2 0 "FALSE" 1 "TRUE" DEFAULT_VALUE "TRUE" /end COMPU_VTAB
/begin COMPU_VTAB Def_bit_ub_0_VTAB "Def_bit_ub_0_VTAB" TAB_VERB 2 0 "FALSE" 1 "TRUE" DEFAULT_VALUE "TRUE" /end COMPU_VTAB
/begin COMPU_VTAB Def_bit_ub_0_VTAB "Def_bit_ub_0_VTAB" TAB_VERB 2 0 "FALSE" 1 "TRUE" DEFAULT_VALUE "TRUE" /end COMPU_VTAB
/begin COMPU_VTAB Def_bit_ub_1_VTAB "Def_bit_ub_1_VTAB" TAB_VERB 2 0 "FALSE" 1 "TRUE" DEFAULT_VALUE "TRUE" /end COMPU_VTAB
/begin COMPU_VTAB Def_bit_ub_2_VTAB "Def_bit_ub_2_VTAB" TAB_VERB 2 0 "FALSE" 1 "TRUE" DEFAULT_VALUE "TRUE" /end COMPU_VTAB
/begin COMPU_VTAB Def_bit_ub_3_VTAB "Def_bit_ub_3_VTAB" TAB_VERB 2 0 "FALSE" 1 "TRUE" DEFAULT_VALUE "TRUE" /end COMPU_VTAB
/begin COMPU_VTAB Def_bit_ub_4_VTAB "Def_bit_ub_4_VTAB" TAB_VERB 2 0 "FALSE" 1 "TRUE" DEFAULT_VALUE "TRUE" /end COMPU_VTAB
/begin COMPU_VTAB Def_bit_ub_5_VTAB "Def_bit_ub_5_VTAB" TAB_VERB 2 0 "FALSE" 1 "TRUE" DEFAULT_VALUE "TRUE" /end COMPU_VTAB
/begin COMPU_VTAB Def_bit_ub_0_VTAB "Def_bit_ub_0_VTAB" TAB_VERB 2 0 "FALSE" 1 "TRUE" DEFAULT_VALUE "TRUE" /end COMPU_VTAB
/begin COMPU_VTAB Def_bit_ub_1_VTAB "Def_bit_ub_1_VTAB" TAB_VERB 2 0 "FALSE" 1 "TRUE" DEFAULT_VALUE "TRUE" /end COMPU_VTAB
/begin COMPU_VTAB Def_bit_ub_2_VTAB "Def_bit_ub_2_VTAB" TAB_VERB 2 0 "FALSE" 1 "TRUE" DEFAULT_VALUE "TRUE" /end COMPU_VTAB
/begin COMPU_VTAB Def_bit_ub_3_VTAB "Def_bit_ub_3_VTAB" TAB_VERB 2 0 "FALSE" 1 "TRUE" DEFAULT_VALUE "TRUE" /end COMPU_VTAB
/begin COMPU_VTAB Def_bit_ub_0_VTAB "Def_bit_ub_0_VTAB" TAB_VERB 2 0 "FALSE" 1 "TRUE" DEFAULT_VALUE "TRUE" /end COMPU_VTAB
/begin COMPU_VTAB Def_bit_ub_1_VTAB "Def_bit_ub_1_VTAB" TAB_VERB 2 0 "FALSE" 1 "TRUE" DEFAULT_VALUE "TRUE" /end COMPU_VTAB
/begin COMPU_VTAB Def_bit_ub_2_VTAB "Def_bit_ub_2_VTAB" TAB_VERB 2 0 "FALSE" 1 "TRUE" DEFAULT_VALUE "TRUE" /end COMPU_VTAB
/begin COMPU_VTAB Def_bit_ub_3_VTAB "Def_bit_ub_3_VTAB" TAB_VERB 2 0 "FALSE" 1 "TRUE" DEFAULT_VALUE "TRUE" /end COMPU_VTAB
/begin COMPU_VTAB Def_bit_ub_4_VTAB "Def_bit_ub_4_VTAB" TAB_VERB 2 0 "FALSE" 1 "TRUE" DEFAULT_VALUE "TRUE" /end COMPU_VTAB
/begin COMPU_VTAB Def_bit_ub_0_VTAB "Def_bit_ub_0_VTAB" TAB_VERB 2 0 "FALSE" 1 "TRUE" DEFAULT_VALUE "TRUE" /end COMPU_VTAB
/begin COMPU_VTAB Def_bit_ub_1_VTAB "Def_bit_ub_1_VTAB" TAB_VERB 2 0 "FALSE" 1 "TRUE" DEFAULT_VALUE "TRUE" /end COMPU_VTAB
/begin COMPU_VTAB Def_bit_ub_3_VTAB "Def_bit_ub_3_VTAB" TAB_VERB 2 0 "FALSE" 1 "TRUE" DEFAULT_VALUE "TRUE" /end COMPU_VTAB
/begin COMPU_VTAB Def_bit_ub_4_VTAB "Def_bit_ub_4_VTAB" TAB_VERB 2 0 "FALSE" 1 "TRUE" DEFAULT_VALUE "TRUE" /end COMPU_VTAB
/begin COMPU_VTAB Def_bit_ub_0_VTAB "Def_bit_ub_0_VTAB" TAB_VERB 2 0 "FALSE" 1 "TRUE" DEFAULT_VALUE "TRUE" /end COMPU_VTAB
/begin COMPU_VTAB Def_bit_ub_0_VTAB "Def_bit_ub_0_VTAB" TAB_VERB 2 0 "FALSE" 1 "TRUE" DEFAULT_VALUE "TRUE" /end COMPU_VTAB
/begin COMPU_VTAB Def_bit_ub_1_VTAB "Def_bit_ub_1_VTAB" TAB_VERB 2 0 "FALSE" 1 "TRUE" DEFAULT_VALUE "TRUE" /end COMPU_VTAB
/begin COMPU_VTAB Def_bit_ub_2_VTAB "Def_bit_ub_2_VTAB" TAB_VERB 2 0 "FALSE" 1 "TRUE" DEFAULT_VALUE "TRUE" /end COMPU_VTAB
/begin COMPU_VTAB Def_bit_ub_3_VTAB "Def_bit_ub_3_VTAB" TAB_VERB 2 0 "FALSE" 1 "TRUE" DEFAULT_VALUE "TRUE" /end COMPU_VTAB
/begin COMPU_VTAB Def_bit_ub_4_VTAB "Def_bit_ub_4_VTAB" TAB_VERB 2 0 "FALSE" 1 "TRUE" DEFAULT_VALUE "TRUE" /end COMPU_VTAB
/begin COMPU_VTAB Def_bit_ub_5_VTAB "Def_bit_ub_5_VTAB" TAB_VERB 2 0 "FALSE" 1 "TRUE" DEFAULT_VALUE "TRUE" /end COMPU_VTAB
/begin COMPU_VTAB Def_bit_ub_0_VTAB "Def_bit_ub_0_VTAB" TAB_VERB 2 0 "FALSE" 1 "TRUE" DEFAULT_VALUE "TRUE" /end COMPU_VTAB
/begin COMPU_VTAB Def_bit_ub_0_VTAB "Def_bit_ub_0_VTAB" TAB_VERB 2 0 "FALSE" 1 "TRUE" DEFAULT_VALUE "TRUE" /end COMPU_VTAB
/begin COMPU_METHOD TrqInrKi_8 "" RAT_FUNC "%6.5" "%/(Nm*s)" COEFFS 0 2684.35456 0 0 0 1 /end COMPU_METHOD
/begin RECORD_LAYOUT TKW_VV_VV_UW FNC_VALUES 1 UWORD COLUMN_DIR DIRECT /end RECORD_LAYOUT
/begin RECORD_LAYOUT TKW_VV_VV_SW FNC_VALUES 1 SWORD COLUMN_DIR DIRECT /end RECORD_LAYOUT
/begin RECORD_LAYOUT TKW_VV_VV_UB FNC_VALUES 1 UBYTE COLUMN_DIR DIRECT /end RECORD_LAYOUT
/begin RECORD_LAYOUT TKW_VV_VV_UW FNC_VALUES 1 UWORD COLUMN_DIR DIRECT /end RECORD_LAYOUT
/begin RECORD_LAYOUT TKW_VV_VV_SW FNC_VALUES 1 SWORD COLUMN_DIR DIRECT /end RECORD_LAYOUT
/begin RECORD_LAYOUT TKW_VV_VV_UL FNC_VALUES 1 ULONG COLUMN_DIR DIRECT /end RECORD_LAYOUT
/begin RECORD_LAYOUT TKW_VV_VV_UB FNC_VALUES 1 UBYTE COLUMN_DIR DIRECT /end RECORD_LAYOUT
/begin RECORD_LAYOUT TKW_VV_VV_UW FNC_VALUES 1 UWORD COLUMN_DIR DIRECT /end RECORD_LAYOUT
/begin RECORD_LAYOUT TKW_VV_VV_SW FNC_VALUES 1 SWORD COLUMN_DIR DIRECT /end RECORD_LAYOUT
/begin RECORD_LAYOUT TKW_VV_VV_UB FNC_VALUES 1 UBYTE COLUMN_DIR DIRECT /end RECORD_LAYOUT
/begin RECORD_LAYOUT TKW_VV_VV_UW FNC_VALUES 1 UWORD COLUMN_DIR DIRECT /end RECORD_LAYOUT
/begin RECORD_LAYOUT TKW_VV_VV_SW FNC_VALUES 1 SWORD COLUMN_DIR DIRECT /end RECORD_LAYOUT
/begin RECORD_LAYOUT TKW_VV_VV_UB FNC_VALUES 1 UBYTE COLUMN_DIR DIRECT /end RECORD_LAYOUT
/begin RECORD_LAYOUT TKW_VV_VV_UB FNC_VALUES 1 UBYTE COLUMN_DIR DIRECT /end RECORD_LAYOUT
/begin RECORD_LAYOUT TKW_VV_VV_UW FNC_VALUES 1 UWORD COLUMN_DIR DIRECT /end RECORD_LAYOUT
/begin RECORD_LAYOUT TKW_VV_VV_UW FNC_VALUES 1 UWORD COLUMN_DIR DIRECT /end RECORD_LAYOUT
/begin RECORD_LAYOUT TKW_VV_VV_SW FNC_VALUES 1 SWORD COLUMN_DIR DIRECT /end RECORD_LAYOUT
/begin RECORD_LAYOUT TKL_UW_VV_UW NO_AXIS_PTS_X 1 UBYTE RESERVED 2 BYTE AXIS_PTS_X 3 UWORD INDEX_INCR DIRECT FNC_VALUES 4 UWORD COLUMN_DIR DIRECT /end RECORD_LAYOUT
/begin RECORD_LAYOUT TKL_SW_VV_UW NO_AXIS_PTS_X 1 UBYTE RESERVED 2 BYTE AXIS_PTS_X 3 SWORD INDEX_INCR DIRECT FNC_VALUES 4 UWORD COLUMN_DIR DIRECT /end RECORD_LAYOUT
/begin RECORD_LAYOUT TKW_VV_VV_UB FNC_VALUES 1 UBYTE COLUMN_DIR DIRECT /end RECORD_LAYOUT
/begin RECORD_LAYOUT TKW_VV_VV_UB FNC_VALUES 1 UBYTE COLUMN_DIR DIRECT /end RECORD_LAYOUT
/begin RECORD_LAYOUT TKW_VV_VV_UW FNC_VALUES 1 UWORD COLUMN_DIR DIRECT /end RECORD_LAYOUT
/begin RECORD_LAYOUT TKW_VV_VV_SW FNC_VALUES 1 SWORD COLUMN_DIR DIRECT /end RECORD_LAYOUT
/begin RECORD_LAYOUT TKF_SW_SW_SW NO_AXIS_PTS_X 1 UBYTE NO_AXIS_PTS_Y 2 UBYTE AXIS_PTS_X 3 SWORD INDEX_INCR DIRECT AXIS_PTS_Y 4 SWORD INDEX_INCR DIRECT FNC_VALUES 5 SWORD COLUMN_DIR DIRECT /end RECORD_LAYOUT
/begin RECORD_LAYOUT TKW_VV_VV_UB FNC_VALUES 1 UBYTE COLUMN_DIR DIRECT /end RECORD_LAYOUT
/begin RECORD_LAYOUT TKW_VV_VV_UW FNC_VALUES 1 UWORD COLUMN_DIR DIRECT /end RECORD_LAYOUT
/begin RECORD_LAYOUT TKW_VV_VV_SW FNC_VALUES 1 SWORD COLUMN_DIR DIRECT /end RECORD_LAYOUT
/begin RECORD_LAYOUT TKW_VV_VV_UB FNC_VALUES 1 UBYTE COLUMN_DIR DIRECT /end RECORD_LAYOUT
/begin RECORD_LAYOUT TKW_VV_VV_UW FNC_VALUES 1 UWORD COLUMN_DIR DIRECT /end RECORD_LAYOUT
/begin RECORD_LAYOUT TKW_VV_VV_SW FNC_VALUES 1 SWORD COLUMN_DIR DIRECT /end RECORD_LAYOUT
/begin RECORD_LAYOUT TKW_VV_VV_UB FNC_VALUES 1 UBYTE COLUMN_DIR DIRECT /end RECORD_LAYOUT
/begin RECORD_LAYOUT TKW_VV_VV_UB FNC_VALUES 1 UBYTE COLUMN_DIR DIRECT /end RECORD_LAYOUT
/begin RECORD_LAYOUT TKW_VV_VV_UW FNC_VALUES 1 UWORD COLUMN_DIR DIRECT /end RECORD_LAYOUT
/begin RECORD_LAYOUT TKW_VV_VV_SW FNC_VALUES 1 SWORD COLUMN_DIR DIRECT /end RECORD_LAYOUT
/begin RECORD_LAYOUT TKW_VV_VV_UB FNC_VALUES 1 UBYTE COLUMN_DIR DIRECT /end RECORD_LAYOUT
/begin RECORD_LAYOUT TKW_VV_VV_UW FNC_VALUES 1 UWORD COLUMN_DIR DIRECT /end RECORD_LAYOUT
/begin RECORD_LAYOUT TKW_VV_VV_SW FNC_VALUES 1 SWORD COLUMN_DIR DIRECT /end RECORD_LAYOUT
/begin RECORD_LAYOUT TKL_SW_VV_UW NO_AXIS_PTS_X 1 UBYTE RESERVED 2 BYTE AXIS_PTS_X 3 SWORD INDEX_INCR DIRECT FNC_VALUES 4 UWORD COLUMN_DIR DIRECT /end RECORD_LAYOUT
/begin RECORD_LAYOUT TKF_UW_SW_SW NO_AXIS_PTS_X 1 UBYTE NO_AXIS_PTS_Y 2 UBYTE AXIS_PTS_X 3 SWORD INDEX_INCR DIRECT AXIS_PTS_Y 4 UWORD INDEX_INCR DIRECT FNC_VALUES 5 SWORD COLUMN_DIR DIRECT /end RECORD_LAYOUT
/begin RECORD_LAYOUT TKW_VV_VV_UB FNC_VALUES 1 UBYTE COLUMN_DIR DIRECT /end RECORD_LAYOUT
/begin RECORD_LAYOUT TKW_VV_VV_UW FNC_VALUES 1 UWORD COLUMN_DIR DIRECT /end RECORD_LAYOUT
/begin RECORD_LAYOUT TKW_VV_VV_SW FNC_VALUES 1 SWORD COLUMN_DIR DIRECT /end RECORD_LAYOUT
/begin RECORD_LAYOUT TKL_UW_VV_UW NO_AXIS_PTS_X 1 UBYTE RESERVED 2 BYTE AXIS_PTS_X 3 UWORD INDEX_INCR DIRECT FNC_VALUES 4 UWORD COLUMN_DIR DIRECT /end RECORD_LAYOUT
/begin RECORD_LAYOUT TKL_UW_VV_SW NO_AXIS_PTS_X 1 UBYTE RESERVED 2 BYTE AXIS_PTS_X 3 UWORD INDEX_INCR DIRECT FNC_VALUES 4 SWORD COLUMN_DIR DIRECT /end RECORD_LAYOUT
/begin RECORD_LAYOUT TKF_UW_UW_UW NO_AXIS_PTS_X 1 UBYTE NO_AXIS_PTS_Y 2 UBYTE AXIS_PTS_X 3 UWORD INDEX_INCR DIRECT AXIS_PTS_Y 4 UWORD INDEX_INCR DIRECT FNC_VALUES 5 UWORD COLUMN_DIR DIRECT /end RECORD_LAYOUT
/begin RECORD_LAYOUT TKF_UW_SW_UW NO_AXIS_PTS_X 1 UBYTE NO_AXIS_PTS_Y 2 UBYTE AXIS_PTS_X 3 SWORD INDEX_INCR DIRECT AXIS_PTS_Y 4 UWORD INDEX_INCR DIRECT FNC_VALUES 5 UWORD COLUMN_DIR DIRECT /end RECORD_LAYOUT
/begin RECORD_LAYOUT TKW_VV_VV_UB FNC_VALUES 1 UBYTE COLUMN_DIR DIRECT /end RECORD_LAYOUT
/begin RECORD_LAYOUT TKW_VV_VV_UL FNC_VALUES 1 ULONG COLUMN_DIR DIRECT /end RECORD_LAYOUT
/begin RECORD_LAYOUT TKW_VV_VV_UB FNC_VALUES 1 UBYTE COLUMN_DIR DIRECT /end RECORD_LAYOUT
/begin RECORD_LAYOUT TKW_VV_VV_UW FNC_VALUES 1 UWORD COLUMN_DIR DIRECT /end RECORD_LAYOUT
/begin RECORD_LAYOUT TKW_VV_VV_SW FNC_VALUES 1 SWORD COLUMN_DIR DIRECT /end RECORD_LAYOUT
/begin RECORD_LAYOUT TKW_VV_VV_UB FNC_VALUES 1 UBYTE COLUMN_DIR DIRECT /end RECORD_LAYOUT
/begin RECORD_LAYOUT TKW_VV_VV_UB FNC_VALUES 1 UBYTE COLUMN_DIR DIRECT /end RECORD_LAYOUT
/begin RECORD_LAYOUT TKW_VV_VV_UW FNC_VALUES 1 UWORD COLUMN_DIR DIRECT /end RECORD_LAYOUT
/begin RECORD_LAYOUT TKW_VV_VV_UB FNC_VALUES 1 UBYTE COLUMN_DIR DIRECT /end RECORD_LAYOUT
/begin RECORD_LAYOUT TKW_VV_VV_UW FNC_VALUES 1 UWORD COLUMN_DIR DIRECT /end RECORD_LAYOUT
/begin RECORD_LAYOUT TKW_VV_VV_SW FNC_VALUES 1 SWORD COLUMN_DIR DIRECT /end RECORD_LAYOUT
/begin RECORD_LAYOUT TKL_UB_VV_SW NO_AXIS_PTS_X 1 UBYTE RESERVED 2 BYTE AXIS_PTS_X 3 UBYTE INDEX_INCR DIRECT FNC_VALUES 4 SWORD COLUMN_DIR DIRECT /end RECORD_LAYOUT
/begin RECORD_LAYOUT TKF_UB_UB_UB NO_AXIS_PTS_X 1 UBYTE NO_AXIS_PTS_Y 2 UBYTE AXIS_PTS_X 3 UBYTE INDEX_INCR DIRECT AXIS_PTS_Y 4 UBYTE INDEX_INCR DIRECT FNC_VALUES 5 UBYTE COLUMN_DIR DIRECT /end RECORD_LAYOUT
/begin RECORD_LAYOUT TKF_SW_UW_UW NO_AXIS_PTS_X 1 UBYTE NO_AXIS_PTS_Y 2 UBYTE AXIS_PTS_X 3 UWORD INDEX_INCR DIRECT AXIS_PTS_Y 4 SWORD INDEX_INCR DIRECT FNC_VALUES 5 UWORD COLUMN_DIR DIRECT /end RECORD_LAYOUT
/begin RECORD_LAYOUT TKF_SW_SW_SW NO_AXIS_PTS_X 1 UBYTE NO_AXIS_PTS_Y 2 UBYTE AXIS_PTS_X 3 SWORD INDEX_INCR DIRECT AXIS_PTS_Y 4 SWORD INDEX_INCR DIRECT FNC_VALUES 5 SWORD COLUMN_DIR DIRECT /end RECORD_LAYOUT
/begin RECORD_LAYOUT TKW_VV_VV_UB FNC_VALUES 1 UBYTE COLUMN_DIR DIRECT /end RECORD_LAYOUT
/begin RECORD_LAYOUT TKW_VV_VV_UW FNC_VALUES 1 UWORD COLUMN_DIR DIRECT /end RECORD_LAYOUT
/begin RECORD_LAYOUT TKW_VV_VV_SW FNC_VALUES 1 SWORD COLUMN_DIR DIRECT /end RECORD_LAYOUT
/begin RECORD_LAYOUT TKL_UB_VV_SW NO_AXIS_PTS_X 1 UBYTE RESERVED 2 BYTE AXIS_PTS_X 3 UBYTE INDEX_INCR DIRECT FNC_VALUES 4 SWORD COLUMN_DIR DIRECT /end RECORD_LAYOUT
/begin RECORD_LAYOUT TKW_VV_VV_UB FNC_VALUES 1 UBYTE COLUMN_DIR DIRECT /end RECORD_LAYOUT
/begin RECORD_LAYOUT TKW_VV_VV_UB FNC_VALUES 1 UBYTE COLUMN_DIR DIRECT /end RECORD_LAYOUT
/begin RECORD_LAYOUT TKW_VV_VV_UW FNC_VALUES 1 UWORD COLUMN_DIR DIRECT /end RECORD_LAYOUT
/begin RECORD_LAYOUT TKW_VV_VV_SW FNC_VALUES 1 SWORD COLUMN_DIR DIRECT /end RECORD_LAYOUT
/begin RECORD_LAYOUT TKW_VV_VV_UB FNC_VALUES 1 UBYTE COLUMN_DIR DIRECT /end RECORD_LAYOUT
/begin RECORD_LAYOUT TKW_VV_VV_SW FNC_VALUES 1 SWORD COLUMN_DIR DIRECT /end RECORD_LAYOUT
/begin RECORD_LAYOUT TKW_VV_VV_UB FNC_VALUES 1 UBYTE COLUMN_DIR DIRECT /end RECORD_LAYOUT
/begin RECORD_LAYOUT TKW_VV_VV_UW FNC_VALUES 1 UWORD COLUMN_DIR DIRECT /end RECORD_LAYOUT
/begin RECORD_LAYOUT TKW_VV_VV_SW FNC_VALUES 1 SWORD COLUMN_DIR DIRECT /end RECORD_LAYOUT
/begin RECORD_LAYOUT TKL_UB_VV_SW NO_AXIS_PTS_X 1 UBYTE RESERVED 2 BYTE AXIS_PTS_X 3 UBYTE INDEX_INCR DIRECT FNC_VALUES 4 SWORD COLUMN_DIR DIRECT /end RECORD_LAYOUT
/begin RECORD_LAYOUT TKF_SW_SW_SW NO_AXIS_PTS_X 1 UBYTE NO_AXIS_PTS_Y 2 UBYTE AXIS_PTS_X 3 SWORD INDEX_INCR DIRECT AXIS_PTS_Y 4 SWORD INDEX_INCR DIRECT FNC_VALUES 5 SWORD COLUMN_DIR DIRECT /end RECORD_LAYOUT
/begin RECORD_LAYOUT TKW_VV_VV_UB FNC_VALUES 1 UBYTE COLUMN_DIR DIRECT /end RECORD_LAYOUT
/begin RECORD_LAYOUT TKW_VV_VV_SW FNC_VALUES 1 SWORD COLUMN_DIR DIRECT /end RECORD_LAYOUT
/begin RECORD_LAYOUT TKW_VV_VV_UB FNC_VALUES 1 UBYTE COLUMN_DIR DIRECT /end RECORD_LAYOUT
/begin RECORD_LAYOUT TKW_VV_VV_UW FNC_VALUES 1 UWORD COLUMN_DIR DIRECT /end RECORD_LAYOUT
/begin RECORD_LAYOUT TKW_VV_VV_UB FNC_VALUES 1 UBYTE COLUMN_DIR DIRECT /end RECORD_LAYOUT
/begin RECORD_LAYOUT TKW_VV_VV_UW FNC_VALUES 1 UWORD COLUMN_DIR DIRECT /end RECORD_LAYOUT
/begin RECORD_LAYOUT TKW_VV_VV_UB FNC_VALUES 1 UBYTE COLUMN_DIR DIRECT /end RECORD_LAYOUT
/begin RECORD_LAYOUT TKW_VV_VV_SW FNC_VALUES 1 SWORD COLUMN_DIR DIRECT /end RECORD_LAYOUT
/begin RECORD_LAYOUT TKW_VV_VV_UB FNC_VALUES 1 UBYTE COLUMN_DIR DIRECT /end RECORD_LAYOUT
/begin RECORD_LAYOUT TKW_VV_VV_SW FNC_VALUES 1 SWORD COLUMN_DIR DIRECT /end RECORD_LAYOUT
/begin RECORD_LAYOUT TKW_VV_VV_UB FNC_VALUES 1 UBYTE COLUMN_DIR DIRECT /end RECORD_LAYOUT
/begin RECORD_LAYOUT TKW_VV_VV_UW FNC_VALUES 1 UWORD COLUMN_DIR DIRECT /end RECORD_LAYOUT
/begin RECORD_LAYOUT TKW_VV_VV_SW FNC_VALUES 1 SWORD COLUMN_DIR DIRECT /end RECORD_LAYOUT
/begin RECORD_LAYOUT TKW_VV_VV_UL FNC_VALUES 1 ULONG COLUMN_DIR DIRECT /end RECORD_LAYOUT
/begin RECORD_LAYOUT TKL_UW_VV_UW NO_AXIS_PTS_X 1 UBYTE RESERVED 2 BYTE AXIS_PTS_X 3 UWORD INDEX_INCR DIRECT FNC_VALUES 4 UWORD COLUMN_DIR DIRECT /end RECORD_LAYOUT
/begin RECORD_LAYOUT TKF_UW_UW_UW NO_AXIS_PTS_X 1 UBYTE NO_AXIS_PTS_Y 2 UBYTE AXIS_PTS_X 3 UWORD INDEX_INCR DIRECT AXIS_PTS_Y 4 UWORD INDEX_INCR DIRECT FNC_VALUES 5 UWORD COLUMN_DIR DIRECT /end RECORD_LAYOUT
/begin RECORD_LAYOUT TKW_VV_VV_UW FNC_VALUES 1 UWORD COLUMN_DIR DIRECT /end RECORD_LAYOUT
/begin RECORD_LAYOUT TKW_VV_VV_SW FNC_VALUES 1 SWORD COLUMN_DIR DIRECT /end RECORD_LAYOUT
/begin RECORD_LAYOUT TKW_VV_VV_UL FNC_VALUES 1 ULONG COLUMN_DIR DIRECT /end RECORD_LAYOUT
/begin RECORD_LAYOUT TKL_SW_VV_UW NO_AXIS_PTS_X 1 UBYTE RESERVED 2 BYTE AXIS_PTS_X 3 SWORD INDEX_INCR DIRECT FNC_VALUES 4 UWORD COLUMN_DIR DIRECT /end RECORD_LAYOUT
/begin RECORD_LAYOUT TKF_SW_SW_SW NO_AXIS_PTS_X 1 UBYTE NO_AXIS_PTS_Y 2 UBYTE AXIS_PTS_X 3 SWORD INDEX_INCR DIRECT AXIS_PTS_Y 4 SWORD INDEX_INCR DIRECT FNC_VALUES 5 SWORD COLUMN_DIR DIRECT /end RECORD_LAYOUT
/begin RECORD_LAYOUT TKW_VV_VV_UB FNC_VALUES 1 UBYTE COLUMN_DIR DIRECT /end RECORD_LAYOUT
/begin RECORD_LAYOUT TKW_VV_VV_UW FNC_VALUES 1 UWORD COLUMN_DIR DIRECT /end RECORD_LAYOUT
/begin RECORD_LAYOUT TKW_VV_VV_UB FNC_VALUES 1 UBYTE COLUMN_DIR DIRECT /end RECORD_LAYOUT
/begin RECORD_LAYOUT TKW_VV_VV_UW FNC_VALUES 1 UWORD COLUMN_DIR DIRECT /end RECORD_LAYOUT
/begin RECORD_LAYOUT TKL_UW_VV_UW NO_AXIS_PTS_X 1 UBYTE RESERVED 2 BYTE AXIS_PTS_X 3 UWORD INDEX_INCR DIRECT FNC_VALUES 4 UWORD COLUMN_DIR DIRECT /end RECORD_LAYOUT
/begin RECORD_LAYOUT TKL_UW_VV_SW NO_AXIS_PTS_X 1 UBYTE RESERVED 2 BYTE AXIS_PTS_X 3 UWORD INDEX_INCR DIRECT FNC_VALUES 4 SWORD COLUMN_DIR DIRECT /end RECORD_LAYOUT
/begin RECORD_LAYOUT TKW_VV_VV_UB FNC_VALUES 1 UBYTE COLUMN_DIR DIRECT /end RECORD_LAYOUT
/begin RECORD_LAYOUT TKW_VV_VV_UW FNC_VALUES 1 UWORD COLUMN_DIR DIRECT /end RECORD_LAYOUT
/begin RECORD_LAYOUT TKW_VV_VV_SW FNC_VALUES 1 SWORD COLUMN_DIR DIRECT /end RECORD_LAYOUT
/begin RECORD_LAYOUT TKL_UW_VV_SW NO_AXIS_PTS_X 1 UBYTE RESERVED 2 BYTE AXIS_PTS_X 3 UWORD INDEX_INCR DIRECT FNC_VALUES 4 SWORD COLUMN_DIR DIRECT /end RECORD_LAYOUT
/begin RECORD_LAYOUT TKF_UW_UW_UW NO_AXIS_PTS_X 1 UBYTE NO_AXIS_PTS_Y 2 UBYTE AXIS_PTS_X 3 UWORD INDEX_INCR DIRECT AXIS_PTS_Y 4 UWORD INDEX_INCR DIRECT FNC_VALUES 5 UWORD COLUMN_DIR DIRECT /end RECORD_LAYOUT
/begin RECORD_LAYOUT TKF_UW_SW_SW NO_AXIS_PTS_X 1 UBYTE NO_AXIS_PTS_Y 2 UBYTE AXIS_PTS_X 3 SWORD INDEX_INCR DIRECT AXIS_PTS_Y 4 UWORD INDEX_INCR DIRECT FNC_VALUES 5 SWORD COLUMN_DIR DIRECT /end RECORD_LAYOUT
/begin RECORD_LAYOUT TKW_VV_VV_UB FNC_VALUES 1 UBYTE COLUMN_DIR DIRECT /end RECORD_LAYOUT
/begin RECORD_LAYOUT TKW_VV_VV_UW FNC_VALUES 1 UWORD COLUMN_DIR DIRECT /end RECORD_LAYOUT
/begin RECORD_LAYOUT TKW_VV_VV_SW FNC_VALUES 1 SWORD COLUMN_DIR DIRECT /end RECORD_LAYOUT
/begin RECORD_LAYOUT TKW_VV_VV_UB FNC_VALUES 1 UBYTE COLUMN_DIR DIRECT /end RECORD_LAYOUT
/begin RECORD_LAYOUT TKW_VV_VV_UW FNC_VALUES 1 UWORD COLUMN_DIR DIRECT /end RECORD_LAYOUT
/begin RECORD_LAYOUT TKW_VV_VV_SW FNC_VALUES 1 SWORD COLUMN_DIR DIRECT /end RECORD_LAYOUT
/begin RECORD_LAYOUT TKL_UW_VV_UW NO_AXIS_PTS_X 1 UBYTE RESERVED 2 BYTE AXIS_PTS_X 3 UWORD INDEX_INCR DIRECT FNC_VALUES 4 UWORD COLUMN_DIR DIRECT /end RECORD_LAYOUT
/begin RECORD_LAYOUT TKW_VV_VV_UW FNC_VALUES 1 UWORD COLUMN_DIR DIRECT /end RECORD_LAYOUT
/begin RECORD_LAYOUT TKF_SW_SW_SW NO_AXIS_PTS_X 1 UBYTE NO_AXIS_PTS_Y 2 UBYTE AXIS_PTS_X 3 SWORD INDEX_INCR DIRECT AXIS_PTS_Y 4 SWORD INDEX_INCR DIRECT FNC_VALUES 5 SWORD COLUMN_DIR DIRECT /end RECORD_LAYOUT
/begin RECORD_LAYOUT TKW_VV_VV_UB FNC_VALUES 1 UBYTE COLUMN_DIR DIRECT /end RECORD_LAYOUT
/begin RECORD_LAYOUT TKW_VV_VV_UW FNC_VALUES 1 UWORD COLUMN_DIR DIRECT /end RECORD_LAYOUT
/begin RECORD_LAYOUT TKW_VV_VV_SW FNC_VALUES 1 SWORD COLUMN_DIR DIRECT /end RECORD_LAYOUT
/begin RECORD_LAYOUT TKW_VV_VV_UB FNC_VALUES 1 UBYTE COLUMN_DIR DIRECT /end RECORD_LAYOUT
/begin RECORD_LAYOUT TKW_VV_VV_UW FNC_VALUES 1 UWORD COLUMN_DIR DIRECT /end RECORD_LAYOUT
/begin RECORD_LAYOUT TKW_VV_VV_SW FNC_VALUES 1 SWORD COLUMN_DIR DIRECT /end RECORD_LAYOUT
/begin RECORD_LAYOUT TKL_UB_VV_SW NO_AXIS_PTS_X 1 UBYTE RESERVED 2 BYTE AXIS_PTS_X 3 UBYTE INDEX_INCR DIRECT FNC_VALUES 4 SWORD COLUMN_DIR DIRECT /end RECORD_LAYOUT
/begin RECORD_LAYOUT TKF_SW_SW_SW NO_AXIS_PTS_X 1 UBYTE NO_AXIS_PTS_Y 2 UBYTE AXIS_PTS_X 3 SWORD INDEX_INCR DIRECT AXIS_PTS_Y 4 SWORD INDEX_INCR DIRECT FNC_VALUES 5 SWORD COLUMN_DIR DIRECT /end RECORD_LAYOUT
/begin RECORD_LAYOUT TKW_VV_VV_UB FNC_VALUES 1 UBYTE COLUMN_DIR DIRECT /end RECORD_LAYOUT
/begin RECORD_LAYOUT TKW_VV_VV_UW FNC_VALUES 1 UWORD COLUMN_DIR DIRECT /end RECORD_LAYOUT
/begin RECORD_LAYOUT TKW_VV_VV_SW FNC_VALUES 1 SWORD COLUMN_DIR DIRECT /end RECORD_LAYOUT
/begin RECORD_LAYOUT TKL_UW_VV_UW NO_AXIS_PTS_X 1 UBYTE RESERVED 2 BYTE AXIS_PTS_X 3 UWORD INDEX_INCR DIRECT FNC_VALUES 4 UWORD COLUMN_DIR DIRECT /end RECORD_LAYOUT
/begin RECORD_LAYOUT TKF_UW_SW_UW NO_AXIS_PTS_X 1 UBYTE NO_AXIS_PTS_Y 2 UBYTE AXIS_PTS_X 3 SWORD INDEX_INCR DIRECT AXIS_PTS_Y 4 UWORD INDEX_INCR DIRECT FNC_VALUES 5 UWORD COLUMN_DIR DIRECT /end RECORD_LAYOUT
/begin RECORD_LAYOUT TKW_VV_VV_UB FNC_VALUES 1 UBYTE COLUMN_DIR DIRECT /end RECORD_LAYOUT
/begin RECORD_LAYOUT TKW_VV_VV_UW FNC_VALUES 1 UWORD COLUMN_DIR DIRECT /end RECORD_LAYOUT
/begin RECORD_LAYOUT TKW_VV_VV_UB FNC_VALUES 1 UBYTE COLUMN_DIR DIRECT /end RECORD_LAYOUT
/begin RECORD_LAYOUT TKW_VV_VV_UW FNC_VALUES 1 UWORD COLUMN_DIR DIRECT /end RECORD_LAYOUT
/begin RECORD_LAYOUT TKW_VV_VV_SW FNC_VALUES 1 SWORD COLUMN_DIR DIRECT /end RECORD_LAYOUT
/begin RECORD_LAYOUT TKW_VV_VV_UB FNC_VALUES 1 UBYTE COLUMN_DIR DIRECT /end RECORD_LAYOUT
/begin RECORD_LAYOUT TKW_VV_VV_UW FNC_VALUES 1 UWORD COLUMN_DIR DIRECT /end RECORD_LAYOUT
/begin RECORD_LAYOUT TKW_VV_VV_SW FNC_VALUES 1 SWORD COLUMN_DIR DIRECT /end RECORD_LAYOUT
/begin RECORD_LAYOUT TKL_UW_VV_UW NO_AXIS_PTS_X 1 UBYTE RESERVED 2 BYTE AXIS_PTS_X 3 UWORD INDEX_INCR DIRECT FNC_VALUES 4 UWORD COLUMN_DIR DIRECT /end RECORD_LAYOUT
/begin RECORD_LAYOUT TKW_VV_VV_UB FNC_VALUES 1 UBYTE COLUMN_DIR DIRECT /end RECORD_LAYOUT
/begin RECORD_LAYOUT TKW_VV_VV_UW FNC_VALUES 1 UWORD COLUMN_DIR DIRECT /end RECORD_LAYOUT
/begin RECORD_LAYOUT TKW_VV_VV_SW FNC_VALUES 1 SWORD COLUMN_DIR DIRECT /end RECORD_LAYOUT
/begin RECORD_LAYOUT TKL_SW_VV_UW NO_AXIS_PTS_X 1 UBYTE RESERVED 2 BYTE AXIS_PTS_X 3 SWORD INDEX_INCR DIRECT FNC_VALUES 4 UWORD COLUMN_DIR DIRECT /end RECORD_LAYOUT
/begin RECORD_LAYOUT TKW_VV_VV_UB FNC_VALUES 1 UBYTE COLUMN_DIR DIRECT /end RECORD_LAYOUT
/begin RECORD_LAYOUT TKW_VV_VV_UW FNC_VALUES 1 UWORD COLUMN_DIR DIRECT /end RECORD_LAYOUT
/begin RECORD_LAYOUT TKW_VV_VV_UB FNC_VALUES 1 UBYTE COLUMN_DIR DIRECT /end RECORD_LAYOUT
/begin RECORD_LAYOUT TKW_VV_VV_UW FNC_VALUES 1 UWORD COLUMN_DIR DIRECT /end RECORD_LAYOUT
/begin RECORD_LAYOUT TKW_VV_VV_SW FNC_VALUES 1 SWORD COLUMN_DIR DIRECT /end RECORD_LAYOUT
/begin RECORD_LAYOUT TKL_UB_VV_SW NO_AXIS_PTS_X 1 UBYTE RESERVED 2 BYTE AXIS_PTS_X 3 UBYTE INDEX_INCR DIRECT FNC_VALUES 4 SWORD COLUMN_DIR DIRECT /end RECORD_LAYOUT
/begin RECORD_LAYOUT TKL_UW_VV_SW NO_AXIS_PTS_X 1 UBYTE RESERVED 2 BYTE AXIS_PTS_X 3 UWORD INDEX_INCR DIRECT FNC_VALUES 4 SWORD COLUMN_DIR DIRECT /end RECORD_LAYOUT
/begin RECORD_LAYOUT TKL_SW_VV_UW NO_AXIS_PTS_X 1 UBYTE RESERVED 2 BYTE AXIS_PTS_X 3 SWORD INDEX_INCR DIRECT FNC_VALUES 4 UWORD COLUMN_DIR DIRECT /end RECORD_LAYOUT
/begin RECORD_LAYOUT TKW_VV_VV_UB FNC_VALUES 1 UBYTE COLUMN_DIR DIRECT /end RECORD_LAYOUT
/begin RECORD_LAYOUT TKW_VV_VV_UW FNC_VALUES 1 UWORD COLUMN_DIR DIRECT /end RECORD_LAYOUT
/begin RECORD_LAYOUT TKF_SW_UW_UW NO_AXIS_PTS_X 1 UBYTE NO_AXIS_PTS_Y 2 UBYTE AXIS_PTS_X 3 UWORD INDEX_INCR DIRECT AXIS_PTS_Y 4 SWORD INDEX_INCR DIRECT FNC_VALUES 5 UWORD COLUMN_DIR DIRECT /end RECORD_LAYOUT
/begin RECORD_LAYOUT TKW_VV_VV_UB FNC_VALUES 1 UBYTE COLUMN_DIR DIRECT /end RECORD_LAYOUT
/begin RECORD_LAYOUT TKW_VV_VV_UW FNC_VALUES 1 UWORD COLUMN_DIR DIRECT /end RECORD_LAYOUT
/begin RECORD_LAYOUT TKL_UW_VV_UW NO_AXIS_PTS_X 1 UBYTE RESERVED 2 BYTE AXIS_PTS_X 3 UWORD INDEX_INCR DIRECT FNC_VALUES 4 UWORD COLUMN_DIR DIRECT /end RECORD_LAYOUT
/begin RECORD_LAYOUT TKW_VV_VV_UB FNC_VALUES 1 UBYTE COLUMN_DIR DIRECT /end RECORD_LAYOUT
/begin RECORD_LAYOUT TKW_VV_VV_UW FNC_VALUES 1 UWORD COLUMN_DIR DIRECT /end RECORD_LAYOUT
/begin RECORD_LAYOUT TKW_VV_VV_SW FNC_VALUES 1 SWORD COLUMN_DIR DIRECT /end RECORD_LAYOUT
/begin RECORD_LAYOUT TKL_SW_VV_UW NO_AXIS_PTS_X 1 UBYTE RESERVED 2 BYTE AXIS_PTS_X 3 SWORD INDEX_INCR DIRECT FNC_VALUES 4 UWORD COLUMN_DIR DIRECT /end RECORD_LAYOUT
/begin RECORD_LAYOUT TKW_VV_VV_UB FNC_VALUES 1 UBYTE COLUMN_DIR DIRECT /end RECORD_LAYOUT
/begin RECORD_LAYOUT TKW_VV_VV_UW FNC_VALUES 1 UWORD COLUMN_DIR DIRECT /end RECORD_LAYOUT
/begin RECORD_LAYOUT TKL_SW_VV_UW NO_AXIS_PTS_X 1 UBYTE RESERVED 2 BYTE AXIS_PTS_X 3 SWORD INDEX_INCR DIRECT FNC_VALUES 4 UWORD COLUMN_DIR DIRECT /end RECORD_LAYOUT
/begin RECORD_LAYOUT TKW_VV_VV_UB FNC_VALUES 1 UBYTE COLUMN_DIR DIRECT /end RECORD_LAYOUT
/begin RECORD_LAYOUT TKW_VV_VV_UW FNC_VALUES 1 UWORD COLUMN_DIR DIRECT /end RECORD_LAYOUT
/begin RECORD_LAYOUT TKW_VV_VV_UB FNC_VALUES 1 UBYTE COLUMN_DIR DIRECT /end RECORD_LAYOUT
/begin RECORD_LAYOUT TKW_VV_VV_UW FNC_VALUES 1 UWORD COLUMN_DIR DIRECT /end RECORD_LAYOUT
/begin RECORD_LAYOUT TKW_VV_VV_UW FNC_VALUES 1 UWORD COLUMN_DIR DIRECT /end RECORD_LAYOUT
/begin RECORD_LAYOUT TKW_VV_VV_UB FNC_VALUES 1 UBYTE COLUMN_DIR DIRECT /end RECORD_LAYOUT
/begin RECORD_LAYOUT TKW_VV_VV_UB FNC_VALUES 1 UBYTE COLUMN_DIR DIRECT /end RECORD_LAYOUT
/begin RECORD_LAYOUT TKW_VV_VV_UW FNC_VALUES 1 UWORD COLUMN_DIR DIRECT /end RECORD_LAYOUT
/begin RECORD_LAYOUT TKW_VV_VV_SW FNC_VALUES 1 SWORD COLUMN_DIR DIRECT /end RECORD_LAYOUT
/end MODULE
/end PROJECT
