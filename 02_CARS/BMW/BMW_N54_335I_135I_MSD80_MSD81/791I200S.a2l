ASAP2_VERSION 1 41
/begin PROJECT MSD85 "Spray Guided DI-System with Piezo Injectors for 8-Cylinder"
/begin HEADER "_default_HeaderComment" PROJECT_NO _91 /end HEADER
/begin MODULE _default_ModuleName "_default_ModuleLongIdentifier"
/begin MOD_COMMON "_default_ModCommonComment" DEPOSIT ABSOLUTE BYTE_ORDER MSB_LAST ALIGNMENT_BYTE 1 ALIGNMENT_WORD 2 ALIGNMENT_LONG 2 ALIGNMENT_FLOAT32_IEEE 2 ALIGNMENT_FLOAT64_IEEE 4 /end MOD_COMMON
/begin MEASUREMENT cdn_diag_rly_accout "Diagnosis conditions for ACC Relay" UBYTE _CNV_A_R_LINEAR_____0_CM 1 100. 0. 255. DISPLAY_IDENTIFIER CDN_DIAG_RLY_ACCOUT ECU_ADDRESS 0xd0000354 FORMAT "%3.0" /end MEASUREMENT
/begin MEASUREMENT lv_err_rly_accout "Status air condition compressor relay diagnosis" UBYTE _CNV_S_2_RANGE__0___1_CM 1 100. 0. 1. DISPLAY_IDENTIFIER LV_ERR_RLY_ACCOUT ECU_ADDRESS 0xd0007f68 BIT_MASK 0x1 /end MEASUREMENT
/begin MEASUREMENT lv_inh_diag_rly_accout "Diagnosis inhibition RLY_ACCOUT_diagnosis" UBYTE _CNV_S_2_RANGE__0___1_CM 1 100. 0. 1. DISPLAY_IDENTIFIER LV_INH_DIAG_RLY_ACCOUT ECU_ADDRESS 0xd0008dfc BIT_MASK 0x1 /end MEASUREMENT
/begin MEASUREMENT cdn_diag_ef "Diagnosis conditions for Exhaust Flap" UBYTE _CNV_A_R_LINEAR_____0_CM 1 100. 0. 255. DISPLAY_IDENTIFIER CDN_DIAG_EF ECU_ADDRESS 0xd0000b48 FORMAT "%3.0" /end MEASUREMENT
/begin MEASUREMENT lv_err_ef "Logical value for exhaust flap power stage error" UBYTE _CNV_S_2_RANGE__0___1_CM 1 100. 0. 1. DISPLAY_IDENTIFIER LV_ERR_EF ECU_ADDRESS 0xd0007f7a BIT_MASK 0x1 /end MEASUREMENT
/begin MEASUREMENT lv_inh_diag_ef "Exhaust Flap diagnosis: application incidence to inhibit the diagnosis" UBYTE _CNV_S_2_RANGE__0___1_CM 1 100. 0. 1. DISPLAY_IDENTIFIER LV_INH_DIAG_EF ECU_ADDRESS 0xd0008de4 BIT_MASK 0x1 /end MEASUREMENT
/begin MEASUREMENT er_mmv_is_diag[0] "Filtered engine roughness value cylinder individual" SWORD _CNV_A_R_LINEAR_____12_CM 1 100. -8. 7.99975586 DISPLAY_IDENTIFIER ER_MMV_IS_DIAG[0] ECU_ADDRESS 0xd000a78c FORMAT "%7.4" /end MEASUREMENT
/begin MEASUREMENT er_mmv_is_diag[1] "Filtered engine roughness value cylinder individual" SWORD _CNV_A_R_LINEAR_____12_CM 1 100. -8. 7.99975586 DISPLAY_IDENTIFIER ER_MMV_IS_DIAG[1] ECU_ADDRESS 0xd000a78e FORMAT "%7.4" /end MEASUREMENT
/begin MEASUREMENT er_mmv_is_diag[2] "Filtered engine roughness value cylinder individual" SWORD _CNV_A_R_LINEAR_____12_CM 1 100. -8. 7.99975586 DISPLAY_IDENTIFIER ER_MMV_IS_DIAG[2] ECU_ADDRESS 0xd000a790 FORMAT "%7.4" /end MEASUREMENT
/begin MEASUREMENT er_mmv_is_diag[3] "Filtered engine roughness value cylinder individual" SWORD _CNV_A_R_LINEAR_____12_CM 1 100. -8. 7.99975586 DISPLAY_IDENTIFIER ER_MMV_IS_DIAG[3] ECU_ADDRESS 0xd000a792 FORMAT "%7.4" /end MEASUREMENT
/begin MEASUREMENT er_mmv_is_diag[4] "Filtered engine roughness value cylinder individual" SWORD _CNV_A_R_LINEAR_____12_CM 1 100. -8. 7.99975586 DISPLAY_IDENTIFIER ER_MMV_IS_DIAG[4] ECU_ADDRESS 0xd000a794 FORMAT "%7.4" /end MEASUREMENT
/begin MEASUREMENT er_mmv_is_diag[5] "Filtered engine roughness value cylinder individual" SWORD _CNV_A_R_LINEAR_____12_CM 1 100. -8. 7.99975586 DISPLAY_IDENTIFIER ER_MMV_IS_DIAG[5] ECU_ADDRESS 0xd000a796 FORMAT "%7.4" /end MEASUREMENT
/begin MEASUREMENT er_mmv_is_diag[6] "Filtered engine roughness value cylinder individual" SWORD _CNV_A_R_LINEAR_____12_CM 1 100. -8. 7.99975586 DISPLAY_IDENTIFIER ER_MMV_IS_DIAG[6] ECU_ADDRESS 0xd000a798 FORMAT "%7.4" /end MEASUREMENT
/begin MEASUREMENT er_mmv_is_diag[7] "Filtered engine roughness value cylinder individual" SWORD _CNV_A_R_LINEAR_____12_CM 1 100. -8. 7.99975586 DISPLAY_IDENTIFIER ER_MMV_IS_DIAG[7] ECU_ADDRESS 0xd000a79a FORMAT "%7.4" /end MEASUREMENT
/begin CHARACTERISTIC ip_thd_is_er_diag__n__maf "ER reference value for ER diagnosis" MAP 0xa080b564 _REC_MAP_20_u2_u2_u1 -32766. _CNV_A_R_LINEAR_____13_CM -1. -32767. DISPLAY_IDENTIFIER IP_THD_IS_ER_DIAG__N__MAF FORMAT "%7.0"
 /begin AXIS_DESCR COM_AXIS n _CNV_A_R_LINEAR_____14_CM 4 0. 8160. FORMAT "%4.0" AXIS_PTS_REF ldp_n__thd_is_er_diag /end AXIS_DESCR
 /begin AXIS_DESCR COM_AXIS maf _CNV_A_R_LINEAR_____15_CM 4 0. 1389. FORMAT "%4.0" AXIS_PTS_REF ldp_maf__thd_is_er_diag /end AXIS_DESCR
/end CHARACTERISTIC
/begin CHARACTERISTIC ip_fac_thd_is_er_diag__tco "TCO-dependent reference value correction" CURVE 0xa080a588 _REC_CUR_20_u1_u1 0.9922 _CNV_A_R_LINEAR_____16_CM 1. 1.9922 DISPLAY_IDENTIFIER IP_FAC_THD_IS_ER_DIAG__TCO FORMAT "%5.3"
 /begin AXIS_DESCR COM_AXIS tco _CNV_A_R_LINEAR_____17_CM 8 -48. 142.5 FORMAT "%5.1" AXIS_PTS_REF ldp_tco__fac_thd_is_er_diag /end AXIS_DESCR
/end CHARACTERISTIC
/begin CHARACTERISTIC c_crlc_is_er_diag "Correlation constant for calculating the ER diagnostic values" VALUE 0xa080baed _REC_VAL_20_u1 0.99610001 _CNV_A_R_LINEAR_____18_CM 0. 0.99610001 DISPLAY_IDENTIFIER C_CRLC_IS_ER_DIAG FORMAT "%5.3" /end CHARACTERISTIC
/begin AXIS_PTS ldp_maf__thd_is_er_diag "" 0xa080882a maf _REC_AXS_20_u1 1389. _CNV_A_R_LINEAR_____15_CM 4 0. 1389. FORMAT "%4.0" /end AXIS_PTS
/begin AXIS_PTS ldp_n__thd_is_er_diag "" 0xa0808ad0 n _REC_AXS_20_u2 816. _CNV_A_R_LINEAR_____14_CM 4 0. 8160. FORMAT "%4.0" /end AXIS_PTS
/begin AXIS_PTS ldp_tco__fac_thd_is_er_diag "" 0xa0808dd0 tco _REC_AXS_20_u1 190.5 _CNV_A_R_LINEAR_____17_CM 8 -48. 142.5 FORMAT "%5.1" /end AXIS_PTS
/begin MEASUREMENT state_imob_client "State machine client " UBYTE _CNV_A_R_LINEAR_____0_CM 1 100. 0. 255. DISPLAY_IDENTIFIER STATE_IMOB_CLIENT ECU_ADDRESS 0xd0000de0 FORMAT "%3.0" /end MEASUREMENT
/begin MEASUREMENT lv_imob_act "State machine client active" UBYTE _CNV_S_2_RANGE__0___1_CM 1 100. 0. 1. DISPLAY_IDENTIFIER LV_IMOB_ACT ECU_ADDRESS 0xd0007806 BIT_MASK 0x1 /end MEASUREMENT
/begin MEASUREMENT ctr_imob_tout "5ms timer for timeout client state machine" UWORD _CNV_A_R_LINEAR_____19_CM 1 100. 0. 32767.5 DISPLAY_IDENTIFIER CTR_IMOB_TOUT ECU_ADDRESS 0xd0000dcc FORMAT "%6.1" /end MEASUREMENT
/begin MEASUREMENT ctr_imob_tout_fail "Counter for timeout state \"wait response\"" UBYTE _CNV_A_R_LINEAR_____0_CM 1 100. 0. 255. DISPLAY_IDENTIFIER CTR_IMOB_TOUT_FAIL ECU_ADDRESS 0xd0000de1 FORMAT "%3.0" /end MEASUREMENT
/begin MEASUREMENT inh_iv_imob "Request for lock of injection by immobilizer" UBYTE _CNV_A_R_LINEAR_____0_CM 1 100. 0. 255. DISPLAY_IDENTIFIER INH_IV_IMOB ECU_ADDRESS 0xd0007804 FORMAT "%3.0" /end MEASUREMENT
/begin MEASUREMENT ctr_imob_auth "5ms timer for timeout client state machine" UBYTE _CNV_A_R_LINEAR_____4_CM 1 100. 0.1 25.5 DISPLAY_IDENTIFIER CTR_IMOB_AUTH ECU_ADDRESS 0xd0000de2 FORMAT "%3.1" /end MEASUREMENT
/begin MEASUREMENT imob_md5_result[0] "MD5 ecu calculated value" UBYTE _CNV_A_R_LINEAR_____0_CM 1 100. 0. 255. DISPLAY_IDENTIFIER IMOB_MD5_RESULT[0] ECU_ADDRESS 0xd0000dd0 FORMAT "%3.0" /end MEASUREMENT
/begin MEASUREMENT imob_md5_result[1] "MD5 ecu calculated value" UBYTE _CNV_A_R_LINEAR_____0_CM 1 100. 0. 255. DISPLAY_IDENTIFIER IMOB_MD5_RESULT[1] ECU_ADDRESS 0xd0000dd1 FORMAT "%3.0" /end MEASUREMENT
/begin MEASUREMENT imob_md5_result[2] "MD5 ecu calculated value" UBYTE _CNV_A_R_LINEAR_____0_CM 1 100. 0. 255. DISPLAY_IDENTIFIER IMOB_MD5_RESULT[2] ECU_ADDRESS 0xd0000dd2 FORMAT "%3.0" /end MEASUREMENT
/begin MEASUREMENT imob_md5_result[3] "MD5 ecu calculated value" UBYTE _CNV_A_R_LINEAR_____0_CM 1 100. 0. 255. DISPLAY_IDENTIFIER IMOB_MD5_RESULT[3] ECU_ADDRESS 0xd0000dd3 FORMAT "%3.0" /end MEASUREMENT
/begin MEASUREMENT imob_md5_result[4] "MD5 ecu calculated value" UBYTE _CNV_A_R_LINEAR_____0_CM 1 100. 0. 255. DISPLAY_IDENTIFIER IMOB_MD5_RESULT[4] ECU_ADDRESS 0xd0000dd4 FORMAT "%3.0" /end MEASUREMENT
/begin MEASUREMENT imob_md5_result[5] "MD5 ecu calculated value" UBYTE _CNV_A_R_LINEAR_____0_CM 1 100. 0. 255. DISPLAY_IDENTIFIER IMOB_MD5_RESULT[5] ECU_ADDRESS 0xd0000dd5 FORMAT "%3.0" /end MEASUREMENT
/begin MEASUREMENT imob_md5_result[6] "MD5 ecu calculated value" UBYTE _CNV_A_R_LINEAR_____0_CM 1 100. 0. 255. DISPLAY_IDENTIFIER IMOB_MD5_RESULT[6] ECU_ADDRESS 0xd0000dd6 FORMAT "%3.0" /end MEASUREMENT
/begin MEASUREMENT imob_md5_result[7] "MD5 ecu calculated value" UBYTE _CNV_A_R_LINEAR_____0_CM 1 100. 0. 255. DISPLAY_IDENTIFIER IMOB_MD5_RESULT[7] ECU_ADDRESS 0xd0000dd7 FORMAT "%3.0" /end MEASUREMENT
/begin MEASUREMENT imob_md5_result[8] "MD5 ecu calculated value" UBYTE _CNV_A_R_LINEAR_____0_CM 1 100. 0. 255. DISPLAY_IDENTIFIER IMOB_MD5_RESULT[8] ECU_ADDRESS 0xd0000dd8 FORMAT "%3.0" /end MEASUREMENT
/begin MEASUREMENT imob_md5_result[9] "MD5 ecu calculated value" UBYTE _CNV_A_R_LINEAR_____0_CM 1 100. 0. 255. DISPLAY_IDENTIFIER IMOB_MD5_RESULT[9] ECU_ADDRESS 0xd0000dd9 FORMAT "%3.0" /end MEASUREMENT
/begin MEASUREMENT imob_md5_result[10] "MD5 ecu calculated value" UBYTE _CNV_A_R_LINEAR_____0_CM 1 100. 0. 255. DISPLAY_IDENTIFIER IMOB_MD5_RESULT[10] ECU_ADDRESS 0xd0000dda FORMAT "%3.0" /end MEASUREMENT
/begin MEASUREMENT imob_md5_result[11] "MD5 ecu calculated value" UBYTE _CNV_A_R_LINEAR_____0_CM 1 100. 0. 255. DISPLAY_IDENTIFIER IMOB_MD5_RESULT[11] ECU_ADDRESS 0xd0000ddb FORMAT "%3.0" /end MEASUREMENT
/begin MEASUREMENT imob_md5_result[12] "MD5 ecu calculated value" UBYTE _CNV_A_R_LINEAR_____0_CM 1 100. 0. 255. DISPLAY_IDENTIFIER IMOB_MD5_RESULT[12] ECU_ADDRESS 0xd0000ddc FORMAT "%3.0" /end MEASUREMENT
/begin MEASUREMENT imob_md5_result[13] "MD5 ecu calculated value" UBYTE _CNV_A_R_LINEAR_____0_CM 1 100. 0. 255. DISPLAY_IDENTIFIER IMOB_MD5_RESULT[13] ECU_ADDRESS 0xd0000ddd FORMAT "%3.0" /end MEASUREMENT
/begin MEASUREMENT imob_md5_result[14] "MD5 ecu calculated value" UBYTE _CNV_A_R_LINEAR_____0_CM 1 100. 0. 255. DISPLAY_IDENTIFIER IMOB_MD5_RESULT[14] ECU_ADDRESS 0xd0000dde FORMAT "%3.0" /end MEASUREMENT
/begin MEASUREMENT imob_md5_result[15] "MD5 ecu calculated value" UBYTE _CNV_A_R_LINEAR_____0_CM 1 100. 0. 255. DISPLAY_IDENTIFIER IMOB_MD5_RESULT[15] ECU_ADDRESS 0xd0000ddf FORMAT "%3.0" /end MEASUREMENT
/begin MEASUREMENT lv_lock_imob "Indicator for lock of ignition and injection by immobilizer" UBYTE _CNV_S_2_RANGE__0___1_CM 1 100. 0. 1. DISPLAY_IDENTIFIER LV_LOCK_IMOB ECU_ADDRESS 0xd0007805 BIT_MASK 0x1 /end MEASUREMENT
/begin MEASUREMENT imob_config_ews4[0] "config_ews" UBYTE _CNV_A_R_LINEAR_____0_CM 1 100. 0. 255. DISPLAY_IDENTIFIER IMOB_CONFIG_EWS4[0] ECU_ADDRESS 0xd00090d8 FORMAT "%3.0" BIT_MASK 0x1 /end MEASUREMENT
/begin MEASUREMENT imob_config_ews4[1] "config_ews" UBYTE _CNV_A_R_LINEAR_____0_CM 1 100. 0. 255. DISPLAY_IDENTIFIER IMOB_CONFIG_EWS4[1] ECU_ADDRESS 0xd00090d9 FORMAT "%3.0" BIT_MASK 0x1 /end MEASUREMENT
/begin MEASUREMENT imob_config_ews4[2] "config_ews" UBYTE _CNV_A_R_LINEAR_____0_CM 1 100. 0. 255. DISPLAY_IDENTIFIER IMOB_CONFIG_EWS4[2] ECU_ADDRESS 0xd00090da FORMAT "%3.0" BIT_MASK 0x1 /end MEASUREMENT
/begin MEASUREMENT imob_config_ews4[3] "config_ews" UBYTE _CNV_A_R_LINEAR_____0_CM 1 100. 0. 255. DISPLAY_IDENTIFIER IMOB_CONFIG_EWS4[3] ECU_ADDRESS 0xd00090db FORMAT "%3.0" BIT_MASK 0x1 /end MEASUREMENT
/begin MEASUREMENT imob_nr_vld_k_ews4 "valid k_ews [0-7]" UBYTE _CNV_A_R_LINEAR_____0_CM 1 100. 0. 255. DISPLAY_IDENTIFIER IMOB_NR_VLD_K_EWS4 ECU_ADDRESS 0xd00090e0 FORMAT "%3.0" BIT_MASK 0x1 /end MEASUREMENT
/begin MEASUREMENT lv_err_imob_0 "Present failure manipulation" UBYTE _CNV_S_2_RANGE__0___1_CM 1 100. 0. 1. DISPLAY_IDENTIFIER LV_ERR_IMOB_0 ECU_ADDRESS 0xd0007ef5 BIT_MASK 0x1 /end MEASUREMENT
/begin MEASUREMENT lv_err_imob_1 "Present failure for CAS BUS" UBYTE _CNV_S_2_RANGE__0___1_CM 1 100. 0. 1. DISPLAY_IDENTIFIER LV_ERR_IMOB_1 ECU_ADDRESS 0xd0007ef6 BIT_MASK 0x1 /end MEASUREMENT
/begin MEASUREMENT lv_err_imob_2 "Present failure for data storage" UBYTE _CNV_S_2_RANGE__0___1_CM 1 100. 0. 1. DISPLAY_IDENTIFIER LV_ERR_IMOB_2 ECU_ADDRESS 0xd0007ef7 BIT_MASK 0x1 /end MEASUREMENT
/begin MEASUREMENT lv_err_imob_3 "Present failure for CAN Bus" UBYTE _CNV_S_2_RANGE__0___1_CM 1 100. 0. 1. DISPLAY_IDENTIFIER LV_ERR_IMOB_3 ECU_ADDRESS 0xd0007ef8 BIT_MASK 0x1 /end MEASUREMENT
/begin MEASUREMENT cdn_diag_imob_1 "Condition bit coded for each sym" UBYTE _CNV_A_R_LINEAR_____0_CM 1 100. 0. 255. DISPLAY_IDENTIFIER CDN_DIAG_IMOB_1 ECU_ADDRESS 0xd0000de8 FORMAT "%3.0" /end MEASUREMENT
/begin MEASUREMENT cdn_diag_imob_3 "Condition bit coded for each sym" UBYTE _CNV_A_R_LINEAR_____0_CM 1 100. 0. 255. DISPLAY_IDENTIFIER CDN_DIAG_IMOB_3 ECU_ADDRESS 0xd0000de9 FORMAT "%3.0" /end MEASUREMENT
/begin CHARACTERISTIC c_vb_min_msw_diag "Min. battery voltage for MSW diagnosis" VALUE 0xa080c42e _REC_VAL_20_u1 25.8984 _CNV_A_R_LINEAR_____22_CM 0. 25.8984 DISPLAY_IDENTIFIER C_VB_MIN_MSW_DIAG FORMAT "%3.1" /end CHARACTERISTIC
/begin CHARACTERISTIC c_amp_ref "reference value of the ambient pressure" VALUE 0xa080ba8e _REC_VAL_20_u2 5434. _CNV_A_R_LINEAR_____27_CM 0. 5434. DISPLAY_IDENTIFIER C_AMP_REF FORMAT "%7.2" /end CHARACTERISTIC
/begin CHARACTERISTIC c_v_amp_max_diag "maximum diagnostic value for the ambient pressure value" VALUE 0xa080c3ba _REC_VAL_20_u2 4.9951171875 _CNV_A_R_LINEAR_____2_CM 0. 4.9951171875 DISPLAY_IDENTIFIER C_V_AMP_MAX_DIAG FORMAT "%5.3" /end CHARACTERISTIC
/begin CHARACTERISTIC c_v_amp_min_diag "minimum diagnostic value for the ambient pressure value" VALUE 0xa080c3bc _REC_VAL_20_u2 4.9951171875 _CNV_A_R_LINEAR_____2_CM 0. 4.9951171875 DISPLAY_IDENTIFIER C_V_AMP_MIN_DIAG FORMAT "%5.3" /end CHARACTERISTIC
/begin MEASUREMENT lv_brake_det "LV_IM_BLS or _BTS detected" UBYTE _CNV_S_2_RANGE__0___1_CM 1 100. 0. 1. DISPLAY_IDENTIFIER LV_BRAKE_DET ECU_ADDRESS 0xd00089ed BIT_MASK 0x1 /end MEASUREMENT
/begin CHARACTERISTIC c_t_bts_plaus_max "Maximum value of the time counter for debounce  " VALUE 0xa080c13e _REC_VAL_20_u2 6553.5 _CNV_A_R_LINEAR_____4_CM 0. 6553.5 DISPLAY_IDENTIFIER C_T_BTS_PLAUS_MAX FORMAT "%6.1" /end CHARACTERISTIC
/begin MEASUREMENT lv_err_bls_plaus "BLS plausibility error flag" UBYTE _CNV_S_2_RANGE__0___1_CM 1 100. 0. 1. DISPLAY_IDENTIFIER LV_ERR_BLS_PLAUS ECU_ADDRESS 0xd00089ec BIT_MASK 0x1 /end MEASUREMENT
/begin MEASUREMENT lv_err_im_bls_plaus "BLS plausibility error flag" UBYTE _CNV_S_2_RANGE__0___1_CM 1 100. 0. 1. DISPLAY_IDENTIFIER LV_ERR_IM_BLS_PLAUS ECU_ADDRESS 0xd0007f6b BIT_MASK 0x1 /end MEASUREMENT
/begin MEASUREMENT lv_err_im_bts_plaus "BTS plausibility error flag" UBYTE _CNV_S_2_RANGE__0___1_CM 1 100. 0. 1. DISPLAY_IDENTIFIER LV_ERR_IM_BTS_PLAUS ECU_ADDRESS 0xd0007f6c BIT_MASK 0x1 /end MEASUREMENT
/begin MEASUREMENT lv_bts_edge "rising or falling edge of lv_im_bts" UBYTE _CNV_S_2_RANGE__0___1_CM 1 100. 0. 1. DISPLAY_IDENTIFIER LV_BTS_EDGE ECU_ADDRESS 0xd0000392 BIT_MASK 0x1 /end MEASUREMENT
/begin MEASUREMENT lv_bls_edge "rising or falling edge of lv_im_bls" UBYTE _CNV_S_2_RANGE__0___1_CM 1 100. 0. 1. DISPLAY_IDENTIFIER LV_BLS_EDGE ECU_ADDRESS 0xd0000391 BIT_MASK 0x1 /end MEASUREMENT
/begin MEASUREMENT t_bts_plaus "timer for debounce by error managment" UWORD _CNV_A_R_LINEAR_____4_CM 1 100. 0. 6553.5 DISPLAY_IDENTIFIER T_BTS_PLAUS ECU_ADDRESS 0xd0000388 FORMAT "%6.1" /end MEASUREMENT
/begin MEASUREMENT lv_im_bls "brake light switch" UBYTE _CNV_S_2_RANGE__0___1_CM 1 100. 0. 1. DISPLAY_IDENTIFIER LV_IM_BLS ECU_ADDRESS 0xd00089ee BIT_MASK 0x1 /end MEASUREMENT
/begin MEASUREMENT lv_im_bts "brake test switch" UBYTE _CNV_S_2_RANGE__0___1_CM 1 100. 0. 1. DISPLAY_IDENTIFIER LV_IM_BTS ECU_ADDRESS 0xd00089ef BIT_MASK 0x1 /end MEASUREMENT
/begin MEASUREMENT lv_err_can_boff "logical variable CAN bus off in bus off mode" UBYTE _CNV_S_2_RANGE__0___1_CM 1 100. 0. 1. DISPLAY_IDENTIFIER LV_ERR_CAN_BOFF ECU_ADDRESS 0xd0007f65 BIT_MASK 0x1 /end MEASUREMENT
/begin MEASUREMENT lv_err_locan_boff "logical variable LOCAN bus off in bus off mode" UBYTE _CNV_S_2_RANGE__0___1_CM 1 100. 0. 1. DISPLAY_IDENTIFIER LV_ERR_LOCAN_BOFF ECU_ADDRESS 0xd0007fb9 BIT_MASK 0x1 /end MEASUREMENT
/begin MEASUREMENT lv_inh_diag_isc "Flag for inhibitation of the idle speed control diagnosis" UBYTE _CNV_S_2_RANGE__0___1_CM 1 100. 0. 1. DISPLAY_IDENTIFIER LV_INH_DIAG_ISC ECU_ADDRESS 0xd0008cf3 BIT_MASK 0x1 /end MEASUREMENT
/begin MEASUREMENT lv_inh_diag_rbm_isc "Flag for inhibitation of the Idle Speed Control Diagnosis if there is a OBD failure" UBYTE _CNV_S_2_RANGE__0___1_CM 1 100. 0. 1. DISPLAY_IDENTIFIER LV_INH_DIAG_RBM_ISC ECU_ADDRESS 0xd0008cf4 BIT_MASK 0x1 /end MEASUREMENT
/begin MEASUREMENT state_rbm_isc "Interface of ISC monitor with the Rate-Based Monitoring statistics" UBYTE _CNV_A_R_LINEAR_____0_CM 1 100. 0. 7. DISPLAY_IDENTIFIER STATE_RBM_ISC ECU_ADDRESS 0xd0008cf0 FORMAT "%1.0" /end MEASUREMENT
/begin MEASUREMENT maf_sp_tqi_mmv_diag_isc "Moving mean value of MAF_SP_TQI (RAM cell) - functional check ISC" UWORD _CNV_A_R_LINEAR_____111_CM 1 100. 0. 1389. DISPLAY_IDENTIFIER MAF_SP_TQI_MMV_DIAG_ISC ECU_ADDRESS 0xd000a904 FORMAT "%7.2" /end MEASUREMENT
/begin MEASUREMENT lv_maf_sp_tqi_dyw_diag_isc "Indication for limited dynamic condition - functional check ISC" UBYTE _CNV_S_2_RANGE__0___1_CM 1 100. 0. 1. DISPLAY_IDENTIFIER LV_MAF_SP_TQI_DYW_DIAG_ISC ECU_ADDRESS 0xd0008cf5 BIT_MASK 0x1 /end MEASUREMENT
/begin CHARACTERISTIC c_crlc_maf_sp_tqi_diag_isc "Correlation constant for calculation of MAF_SP_TQI_MMV_DIAG_ISC" VALUE 0xa080baf8 _REC_VAL_20_u2 0.9999847 _CNV_A_R_LINEAR_____126_CM 0. 0.9999847 DISPLAY_IDENTIFIER C_CRLC_MAF_SP_TQI_DIAG_ISC FORMAT "%7.5" /end CHARACTERISTIC
/begin CHARACTERISTIC c_maf_sp_tqi_dyw_diag_isc "Dynamic window around MAF_SP_TQI_MMV_DIAG_ISC" VALUE 0xa080be4e _REC_VAL_20_u2 1389. _CNV_A_R_LINEAR_____111_CM 0. 1389. DISPLAY_IDENTIFIER C_MAF_SP_TQI_DYW_DIAG_ISC FORMAT "%7.2" /end CHARACTERISTIC
/begin MEASUREMENT t_dly_maf_sp_tqi_diag_isc "Actual deactivation time after drop of limited dynamic condition " UBYTE _CNV_A_R_LINEAR_____4_CM 1 100. 0. 25.5 DISPLAY_IDENTIFIER T_DLY_MAF_SP_TQI_DIAG_ISC ECU_ADDRESS 0xd0008cf2 FORMAT "%4.1" /end MEASUREMENT
/begin CHARACTERISTIC c_t_dly_maf_sp_tqi_diag_isc "Deactivation time after drop of limited dynamic" VALUE 0xa080c180 _REC_VAL_20_u1 25.5 _CNV_A_R_LINEAR_____4_CM 0. 25.5 DISPLAY_IDENTIFIER C_T_DLY_MAF_SP_TQI_DIAG_ISC FORMAT "%4.1" /end CHARACTERISTIC
/begin MEASUREMENT state_rbm_isc_cst "Interface of ISC_CST monitor with the Rate-Based Monitoring statistics." UBYTE _CNV_A_R_LINEAR_____0_CM 1 100. 0. 7. DISPLAY_IDENTIFIER STATE_RBM_ISC_CST ECU_ADDRESS 0xd0008cf1 FORMAT "%1.0" /end MEASUREMENT
/begin CHARACTERISTIC c_maf_sp_tqi_dyw_diag_isc_cst "Dynamic window around MAF_SP_TQI_MMV_DIAG_ISC at coldstart" VALUE 0xa080be50 _REC_VAL_20_u2 1389. _CNV_A_R_LINEAR_____111_CM 0. 1389. DISPLAY_IDENTIFIER C_MAF_SP_TQI_DYW_DIAG_ISC_CST FORMAT "%7.2" /end CHARACTERISTIC
/begin CHARACTERISTIC c_crlc_maf_sp_tqi_diag_isc_cst "Correlation constant of MAF_SP_TQI_MMV_DIAG_ISC during coldstart monitoring" VALUE 0xa080bafa _REC_VAL_20_u2 0.9999847 _CNV_A_R_LINEAR_____126_CM 0. 0.9999847 DISPLAY_IDENTIFIER C_CRLC_MAF_SP_TQI_DIAG_ISC_CST FORMAT "%7.5" /end CHARACTERISTIC
/begin MEASUREMENT dyw_knks_diag[0] "Bandweite Klopfsensor i" UWORD _CNV_A_R_LINEAR_____2_CM 1 100. 0. 4.9951171875 DISPLAY_IDENTIFIER DYW_KNKS_DIAG[0] ECU_ADDRESS 0xd0001200 FORMAT "%5.3" /end MEASUREMENT
/begin MEASUREMENT dyw_knks_diag[1] "Bandweite Klopfsensor i" UWORD _CNV_A_R_LINEAR_____2_CM 1 100. 0. 4.9951171875 DISPLAY_IDENTIFIER DYW_KNKS_DIAG[1] ECU_ADDRESS 0xd0001202 FORMAT "%5.3" /end MEASUREMENT
/begin MEASUREMENT dyw_knks_diag[2] "Bandweite Klopfsensor i" UWORD _CNV_A_R_LINEAR_____2_CM 1 100. 0. 4.9951171875 DISPLAY_IDENTIFIER DYW_KNKS_DIAG[2] ECU_ADDRESS 0xd0001204 FORMAT "%5.3" /end MEASUREMENT
/begin MEASUREMENT dyw_knks_diag[3] "Bandweite Klopfsensor i" UWORD _CNV_A_R_LINEAR_____2_CM 1 100. 0. 4.9951171875 DISPLAY_IDENTIFIER DYW_KNKS_DIAG[3] ECU_ADDRESS 0xd0001206 FORMAT "%5.3" /end MEASUREMENT
/begin MEASUREMENT cycnr_dyw_knks_diag[0] "Zyklenzaehler 'Master'-Algorithmus fuer Sensor i" UBYTE _CNV_A_R_LINEAR_____160_CM 1 100. 0. 255. DISPLAY_IDENTIFIER CYCNR_DYW_KNKS_DIAG[0] ECU_ADDRESS 0xd0001214 FORMAT "%3.0" /end MEASUREMENT
/begin MEASUREMENT cycnr_dyw_knks_diag[1] "Zyklenzaehler 'Master'-Algorithmus fuer Sensor i" UBYTE _CNV_A_R_LINEAR_____160_CM 1 100. 0. 255. DISPLAY_IDENTIFIER CYCNR_DYW_KNKS_DIAG[1] ECU_ADDRESS 0xd0001215 FORMAT "%3.0" /end MEASUREMENT
/begin MEASUREMENT cycnr_dyw_knks_diag[2] "Zyklenzaehler 'Master'-Algorithmus fuer Sensor i" UBYTE _CNV_A_R_LINEAR_____160_CM 1 100. 0. 255. DISPLAY_IDENTIFIER CYCNR_DYW_KNKS_DIAG[2] ECU_ADDRESS 0xd0001216 FORMAT "%3.0" /end MEASUREMENT
/begin MEASUREMENT cycnr_dyw_knks_diag[3] "Zyklenzaehler 'Master'-Algorithmus fuer Sensor i" UBYTE _CNV_A_R_LINEAR_____160_CM 1 100. 0. 255. DISPLAY_IDENTIFIER CYCNR_DYW_KNKS_DIAG[3] ECU_ADDRESS 0xd0001217 FORMAT "%3.0" /end MEASUREMENT
/begin MEASUREMENT v_int_knks_diag[0] "Integralwert der Sensorausgangsspannung des Sensors i" UWORD _CNV_A_R_EGCP_LINEA_206_CM 1 100. 0. 319.995117 DISPLAY_IDENTIFIER V_INT_KNKS_DIAG[0] ECU_ADDRESS 0xd0001208 FORMAT "%7.3" /end MEASUREMENT
/begin MEASUREMENT v_int_knks_diag[1] "Integralwert der Sensorausgangsspannung des Sensors i" UWORD _CNV_A_R_EGCP_LINEA_206_CM 1 100. 0. 319.995117 DISPLAY_IDENTIFIER V_INT_KNKS_DIAG[1] ECU_ADDRESS 0xd000120a FORMAT "%7.3" /end MEASUREMENT
/begin MEASUREMENT v_int_knks_diag[2] "Integralwert der Sensorausgangsspannung des Sensors i" UWORD _CNV_A_R_EGCP_LINEA_206_CM 1 100. 0. 319.995117 DISPLAY_IDENTIFIER V_INT_KNKS_DIAG[2] ECU_ADDRESS 0xd000120c FORMAT "%7.3" /end MEASUREMENT
/begin MEASUREMENT v_int_knks_diag[3] "Integralwert der Sensorausgangsspannung des Sensors i" UWORD _CNV_A_R_EGCP_LINEA_206_CM 1 100. 0. 319.995117 DISPLAY_IDENTIFIER V_INT_KNKS_DIAG[3] ECU_ADDRESS 0xd000120e FORMAT "%7.3" /end MEASUREMENT
/begin MEASUREMENT cycnr_int_knks_diag[0] "Zyklenzaehler 'Slave'-Algorithmus fuer Sensor i" UBYTE _CNV_A_R_LINEAR_____160_CM 1 100. 0. 255. DISPLAY_IDENTIFIER CYCNR_INT_KNKS_DIAG[0] ECU_ADDRESS 0xd0001210 FORMAT "%3.0" /end MEASUREMENT
/begin MEASUREMENT cycnr_int_knks_diag[1] "Zyklenzaehler 'Slave'-Algorithmus fuer Sensor i" UBYTE _CNV_A_R_LINEAR_____160_CM 1 100. 0. 255. DISPLAY_IDENTIFIER CYCNR_INT_KNKS_DIAG[1] ECU_ADDRESS 0xd0001211 FORMAT "%3.0" /end MEASUREMENT
/begin MEASUREMENT cycnr_int_knks_diag[2] "Zyklenzaehler 'Slave'-Algorithmus fuer Sensor i" UBYTE _CNV_A_R_LINEAR_____160_CM 1 100. 0. 255. DISPLAY_IDENTIFIER CYCNR_INT_KNKS_DIAG[2] ECU_ADDRESS 0xd0001212 FORMAT "%3.0" /end MEASUREMENT
/begin MEASUREMENT cycnr_int_knks_diag[3] "Zyklenzaehler 'Slave'-Algorithmus fuer Sensor i" UBYTE _CNV_A_R_LINEAR_____160_CM 1 100. 0. 255. DISPLAY_IDENTIFIER CYCNR_INT_KNKS_DIAG[3] ECU_ADDRESS 0xd0001213 FORMAT "%3.0" /end MEASUREMENT
/begin MEASUREMENT lv_err_knks_1 "Fehler Klopfsensor 1 entprellt" UBYTE _CNV_S_2_RANGE__0___1_CM 1 100. 0. 1. DISPLAY_IDENTIFIER LV_ERR_KNKS_1 ECU_ADDRESS 0xd0007f16 BIT_MASK 0x1 /end MEASUREMENT
/begin MEASUREMENT lv_err_knks_2 "Fehler Klopfsensor 2 entprellt" UBYTE _CNV_S_2_RANGE__0___1_CM 1 100. 0. 1. DISPLAY_IDENTIFIER LV_ERR_KNKS_2 ECU_ADDRESS 0xd0007f17 BIT_MASK 0x1 /end MEASUREMENT
/begin MEASUREMENT lv_err_knks_3 "Fehler Klopfsensor 3 entprellt" UBYTE _CNV_S_2_RANGE__0___1_CM 1 100. 0. 1. DISPLAY_IDENTIFIER LV_ERR_KNKS_3 ECU_ADDRESS 0xd0007f18 BIT_MASK 0x1 /end MEASUREMENT
/begin MEASUREMENT lv_err_knks_4 "Fehler Klopfsensor 4 entprellt" UBYTE _CNV_S_2_RANGE__0___1_CM 1 100. 0. 1. DISPLAY_IDENTIFIER LV_ERR_KNKS_4 ECU_ADDRESS 0xd0007f19 BIT_MASK 0x1 /end MEASUREMENT
/begin CHARACTERISTIC c_nl_min_diag "minimale Geraeuschwertschwelle fuer 'Range Check'" VALUE 0xa080bfe9 _REC_VAL_20_u1 4.98046875 _CNV_A_R_LINEAR_____207_CM 0. 4.98046875 DISPLAY_IDENTIFIER C_NL_MIN_DIAG FORMAT "%4.2" /end CHARACTERISTIC
/begin CHARACTERISTIC c_dyw_min_knks_diag "Bandweiten-Schwellwert fuer Fehlererkennung durch 'Master Algorithm'" VALUE 0xa080bc52 _REC_VAL_20_u2 4.9951171875 _CNV_A_R_LINEAR_____2_CM 0. 4.9951171875 DISPLAY_IDENTIFIER C_DYW_MIN_KNKS_DIAG FORMAT "%5.3" /end CHARACTERISTIC
/begin CHARACTERISTIC c_v_int_knks_diag "Spannungs-Schwellwert fuer Fehlererkennung durch 'Slave Algorithm'" VALUE 0xa080c3ce _REC_VAL_20_u2 319.995117 _CNV_A_R_EGCP_LINEA_206_CM 0. 319.995117 DISPLAY_IDENTIFIER C_V_INT_KNKS_DIAG FORMAT "%7.3" /end CHARACTERISTIC
/begin CHARACTERISTIC c_cycnr_knks_diag "Anzahl der Diagnosezyklen" VALUE 0xa080bc29 _REC_VAL_20_u1 255. _CNV_A_R_LINEAR_____160_CM 0. 255. DISPLAY_IDENTIFIER C_CYCNR_KNKS_DIAG FORMAT "%3.0" /end CHARACTERISTIC
/begin CHARACTERISTIC c_nl_max_diag "maximale Geraeuschwertschwelle fuer 'Range Check'" VALUE 0xa080bfe7 _REC_VAL_20_u1 4.98046875 _CNV_A_R_LINEAR_____207_CM 0. 4.98046875 DISPLAY_IDENTIFIER C_NL_MAX_DIAG FORMAT "%4.2" /end CHARACTERISTIC
/begin CHARACTERISTIC c_maf_min_knks_diag "MAF-Schwelle zur Aktivierung der Klopfsensor-Diagnose" VALUE 0xa080be40 _REC_VAL_20_u2 1389. _CNV_A_R_LINEAR_____111_CM 0. 1389. DISPLAY_IDENTIFIER C_MAF_MIN_KNKS_DIAG FORMAT "%7.2" /end CHARACTERISTIC
/begin CHARACTERISTIC c_mff_min_knks_diag "Lower engine load threshold for knock sensor diagnosis" VALUE 0xa080be90 _REC_VAL_20_u2 1389. _CNV_A_R_LINEAR_____111_CM 0. 1389. DISPLAY_IDENTIFIER C_MFF_MIN_KNKS_DIAG FORMAT "%7.2" /end CHARACTERISTIC
/begin CHARACTERISTIC c_n_min_knks_diag "Drehzahl-Schwelle zur Aktivierung der Klopfsensor-Diagnose" VALUE 0xa080bf9b _REC_VAL_20_u1 8140. _CNV_A_R_LINEAR_____10_CM 20. 8160. DISPLAY_IDENTIFIER C_N_MIN_KNKS_DIAG FORMAT "%4.0" /end CHARACTERISTIC
/begin CHARACTERISTIC c_abc_max_knks "Maximalwert Entprellzaehler" VALUE 0xa080ba1b _REC_VAL_20_u1 254. _CNV_A_R_LINEAR_____0_CM 1. 255. DISPLAY_IDENTIFIER C_ABC_MAX_KNKS FORMAT "%3.0" /end CHARACTERISTIC
/begin CHARACTERISTIC c_abc_inc_knks "Inkrement Entprellzaehler" VALUE 0xa080b953 _REC_VAL_20_u1 255. _CNV_A_R_LINEAR_____0_CM 0. 255. DISPLAY_IDENTIFIER C_ABC_INC_KNKS FORMAT "%3.0" /end CHARACTERISTIC
/begin MEASUREMENT ctr_tcc_t_per_maf_frq_el[0] "TCC counter for diagnostic instance MAF_FRQ_EL[NC_MAF_NR]" UBYTE _CNV_A_R_LINEAR_____0_CM 1 100. 0. 255. DISPLAY_IDENTIFIER CTR_TCC_T_PER_MAF_FRQ_EL[0] ECU_ADDRESS 0xd00088d8 FORMAT "%3.0" /end MEASUREMENT
/begin MEASUREMENT ctr_tcc_t_per_maf_frq_el[1] "TCC counter for diagnostic instance MAF_FRQ_EL[NC_MAF_NR]" UBYTE _CNV_A_R_LINEAR_____0_CM 1 100. 0. 255. DISPLAY_IDENTIFIER CTR_TCC_T_PER_MAF_FRQ_EL[1] ECU_ADDRESS 0xd00088d9 FORMAT "%3.0" /end MEASUREMENT
/begin CHARACTERISTIC c_ratio_t_per_maf_frq_grd_diag "maximum acceptable percentage of out of range T_PER_MAF_FRQ_GRD[NC_MAF_NR] per ms" VALUE 0xa080c0a4 _REC_VAL_20_u2 99.9969482421875 _CNV_A_R_LINEAR_____212_CM 0. 99.9969482421875 DISPLAY_IDENTIFIER C_RATIO_T_PER_MAF_FRQ_GRD_DIAG FORMAT "%7.3" /end CHARACTERISTIC
/begin CHARACTERISTIC c_ratio_t_per_maf_frq_rng_diag "maximum acceptable percentage of out of range T_PER_MAF_FRQ_RNG[NC_MAF_NR] per ms" VALUE 0xa080c0a6 _REC_VAL_20_u2 99.9969482421875 _CNV_A_R_LINEAR_____212_CM 0. 99.9969482421875 DISPLAY_IDENTIFIER C_RATIO_T_PER_MAF_FRQ_RNG_DIAG FORMAT "%7.3" /end CHARACTERISTIC
/begin CHARACTERISTIC c_n_thd_maf_frq_rng_min "minimum N threshold for enable the MAF_FRQ_RNG diagnosis" VALUE 0xa080bfd8 _REC_VAL_20_u2 8160. _CNV_A_R_LINEAR_____14_CM 0. 8160. DISPLAY_IDENTIFIER C_N_THD_MAF_FRQ_RNG_MIN FORMAT "%4.0" /end CHARACTERISTIC
/begin CHARACTERISTIC c_fac_maf_rel_thd_maf_rng_min "minimum realtive cylinder filling for enable the MAF_FRQ_RNG diagnosis" VALUE 0xa080bcdc _REC_VAL_20_u2 300. _CNV_A_R_LINEAR_____226_CM 0. 300. DISPLAY_IDENTIFIER C_FAC_MAF_REL_THD_MAF_RNG_MIN FORMAT "%5.1" /end CHARACTERISTIC
/begin CHARACTERISTIC c_ctr_tcc_t_per_maf_frq_el "threshold for TCC counter for diagnostic instance MAF_FRQ_EL[NC_MAF_NR]" VALUE 0xa080bbdd _REC_VAL_20_u1 255. _CNV_A_R_LINEAR_____0_CM 0. 255. DISPLAY_IDENTIFIER C_CTR_TCC_T_PER_MAF_FRQ_EL FORMAT "%3.0" /end CHARACTERISTIC
/begin MEASUREMENT lv_err_maf_frq_el_0 "Error Flag for MAF electrical diagnosis" UBYTE _CNV_S_2_RANGE__0___1_CM 1 100. 0. 1. DISPLAY_IDENTIFIER LV_ERR_MAF_FRQ_EL_0 ECU_ADDRESS 0xd000804f BIT_MASK 0x1 /end MEASUREMENT
/begin MEASUREMENT lv_err_maf_frq_el_1 "Error Flag for MAF electrical diagnosis" UBYTE _CNV_S_2_RANGE__0___1_CM 1 100. 0. 1. DISPLAY_IDENTIFIER LV_ERR_MAF_FRQ_EL_1 ECU_ADDRESS 0xd0008052 BIT_MASK 0x1 /end MEASUREMENT
/begin MEASUREMENT lv_err_maf_frq_grd_0 "Error Flag for MAF gradient diagnosis" UBYTE _CNV_S_2_RANGE__0___1_CM 1 100. 0. 1. DISPLAY_IDENTIFIER LV_ERR_MAF_FRQ_GRD_0 ECU_ADDRESS 0xd000804e BIT_MASK 0x1 /end MEASUREMENT
/begin MEASUREMENT lv_err_maf_frq_grd_1 "Error Flag for MAF gradient diagnosis" UBYTE _CNV_S_2_RANGE__0___1_CM 1 100. 0. 1. DISPLAY_IDENTIFIER LV_ERR_MAF_FRQ_GRD_1 ECU_ADDRESS 0xd0008051 BIT_MASK 0x1 /end MEASUREMENT
/begin MEASUREMENT lv_err_maf_frq_rng_0 "Error Flag for MAF range diagnosis" UBYTE _CNV_S_2_RANGE__0___1_CM 1 100. 0. 1. DISPLAY_IDENTIFIER LV_ERR_MAF_FRQ_RNG_0 ECU_ADDRESS 0xd000804d BIT_MASK 0x1 /end MEASUREMENT
/begin MEASUREMENT lv_err_maf_frq_rng_1 "Error Flag for MAF range diagnosis" UBYTE _CNV_S_2_RANGE__0___1_CM 1 100. 0. 1. DISPLAY_IDENTIFIER LV_ERR_MAF_FRQ_RNG_1 ECU_ADDRESS 0xd0008050 BIT_MASK 0x1 /end MEASUREMENT
/begin MEASUREMENT lv_err_maf "MAF error detected" UBYTE _CNV_S_2_RANGE__0___1_CM 1 100. 0. 1. DISPLAY_IDENTIFIER LV_ERR_MAF ECU_ADDRESS 0xd0007f0e BIT_MASK 0x1 /end MEASUREMENT
/begin CHARACTERISTIC c_v_pvs_min_diag_2 "lower diagnosis-threshold channel 2" VALUE 0xa080c3f8 _REC_VAL_20_u2 4.9951171875 _CNV_A_R_LINEAR_____2_CM 0. 4.9951171875 DISPLAY_IDENTIFIER C_V_PVS_MIN_DIAG_2 FORMAT "%5.3" /end CHARACTERISTIC
/begin CHARACTERISTIC c_t_is_pvs_err "Minimum idle dwell time in error cases" VALUE 0xa080c1d6 _REC_VAL_20_u1 2.55 _CNV_A_R_LINEAR_____3_CM 0. 2.55 DISPLAY_IDENTIFIER C_T_IS_PVS_ERR FORMAT "%4.2" /end CHARACTERISTIC
/begin CHARACTERISTIC ip_pvs_ratio_hys "permissible variance of the PVS-values" CURVE 0xa080b3ae _REC_CUR_20_u2_u2 4.9951171875 _CNV_A_R_LINEAR_____2_CM 0. 4.9951171875 DISPLAY_IDENTIFIER IP_PVS_RATIO_HYS FORMAT "%5.3"
 /begin AXIS_DESCR COM_AXIS online_dummy _CNV_A_R_LINEAR_____2_CM 2 0. 4.9951171875 FORMAT "%5.3" AXIS_PTS_REF ldp_v_pvs_min /end AXIS_DESCR
/end CHARACTERISTIC
/begin MEASUREMENT lv_err_pvs_1 "Logical value (set, if PVS - Channel 1 has debounced a range error)" UBYTE _CNV_S_2_RANGE__0___1_CM 1 100. 0. 1. DISPLAY_IDENTIFIER LV_ERR_PVS_1 ECU_ADDRESS 0xd0007f3b BIT_MASK 0x1 /end MEASUREMENT
/begin MEASUREMENT lv_dyn_lim_1_act "Limited dynamic 1 is  active / passive" UBYTE _CNV_S_2_RANGE__0___1_CM 1 100. 0. 1. DISPLAY_IDENTIFIER LV_DYN_LIM_1_ACT ECU_ADDRESS 0xd00089e5 BIT_MASK 0x1 /end MEASUREMENT
/begin MEASUREMENT lv_dyn_lim_2_act "Limited dynamic 2 is  active / passive" UBYTE _CNV_S_2_RANGE__0___1_CM 1 100. 0. 1. DISPLAY_IDENTIFIER LV_DYN_LIM_2_ACT ECU_ADDRESS 0xd00089e6 BIT_MASK 0x1 /end MEASUREMENT
/begin MEASUREMENT state_pvs_diag "Status of PVS-diagnosis" UBYTE _CNV_S_9_RANGE_STAT_250_CM 1 100. 0. 128. DISPLAY_IDENTIFIER STATE_PVS_DIAG ECU_ADDRESS 0xd00089e0 /end MEASUREMENT
/begin MEASUREMENT lv_n_sp_is_lih_act "LIH idle speed setpoint" UBYTE _CNV_S_2_RANGE__0___1_CM 1 100. 0. 1. DISPLAY_IDENTIFIER LV_N_SP_IS_LIH_ACT ECU_ADDRESS 0xd00089e8 BIT_MASK 0x1 /end MEASUREMENT
/begin MEASUREMENT lv_err_pvs "Logical value (set, if a PVS -error is debounced)" UBYTE _CNV_S_2_RANGE__0___1_CM 1 100. 0. 1. DISPLAY_IDENTIFIER LV_ERR_PVS ECU_ADDRESS 0xd00089e2 BIT_MASK 0x1 /end MEASUREMENT
/begin MEASUREMENT lv_det_not_plaus_act "PV_AV / Brake signal current not plausible" UBYTE _CNV_S_2_RANGE__0___1_CM 1 100. 0. 1. DISPLAY_IDENTIFIER LV_DET_NOT_PLAUS_ACT ECU_ADDRESS 0xd00089e4 BIT_MASK 0x1 /end MEASUREMENT
/begin MEASUREMENT lv_pvs_bls_not_plaus_act "Plausibility error PVS recognized without error entry" UBYTE _CNV_S_2_RANGE__0___1_CM 1 100. 0. 1. DISPLAY_IDENTIFIER LV_PVS_BLS_NOT_PLAUS_ACT ECU_ADDRESS 0xd00089e3 BIT_MASK 0x1 /end MEASUREMENT
/begin MEASUREMENT ctr_pvs_bls_not_plaus_act "Counter plausibility error PVS recognized without error entry" UBYTE _CNV_A_R_LINEAR_____0_CM 1 100. 0. 255. DISPLAY_IDENTIFIER CTR_PVS_BLS_NOT_PLAUS_ACT ECU_ADDRESS 0xd00015f8 FORMAT "%3.0" /end MEASUREMENT
/begin CHARACTERISTIC c_pvs_bls_bts_plaus_conf "Enable bit for plausibility check" VALUE 0xa080c095 _REC_VAL_20_u1 2. _CNV_A_R_LINEAR_____0_CM 0. 2. DISPLAY_IDENTIFIER C_PVS_BLS_BTS_PLAUS_CONF FORMAT "%2.0" /end CHARACTERISTIC
/begin AXIS_PTS ldp_v_pvs_min "" 0xa08090d4 online_dummy _REC_AXS_20_u2 4.9951171875 _CNV_A_R_LINEAR_____2_CM 2 0. 4.9951171875 FORMAT "%5.3" /end AXIS_PTS
/begin MEASUREMENT lv_err_v_ref_2 "Logical value (set, if supply voltage PVS- Channel 2 debounced)" UBYTE _CNV_S_2_RANGE__0___1_CM 1 100. 0. 1. DISPLAY_IDENTIFIER LV_ERR_V_REF_2 ECU_ADDRESS 0xd0007f3a BIT_MASK 0x1 /end MEASUREMENT
/begin MEASUREMENT lv_err_pvs_double "Logical value (set, if a PVS double error is present)" UBYTE _CNV_S_2_RANGE__0___1_CM 1 100. 0. 1. DISPLAY_IDENTIFIER LV_ERR_PVS_DOUBLE ECU_ADDRESS 0xd0007f3e BIT_MASK 0x1 /end MEASUREMENT
/begin MEASUREMENT lv_err_v_ref_1 "Logical value (set, if supply voltage PVS- Channel 1  debounced)" UBYTE _CNV_S_2_RANGE__0___1_CM 1 100. 0. 1. DISPLAY_IDENTIFIER LV_ERR_V_REF_1 ECU_ADDRESS 0xd0007f39 BIT_MASK 0x1 /end MEASUREMENT
/begin MEASUREMENT lv_err_pvs_bls_not_plaus "Plausibility error PVS / Brake recognized" UBYTE _CNV_S_2_RANGE__0___1_CM 1 100. 0. 1. DISPLAY_IDENTIFIER LV_ERR_PVS_BLS_NOT_PLAUS ECU_ADDRESS 0xd0007f3f BIT_MASK 0x1 /end MEASUREMENT
/begin MEASUREMENT lv_det_err_pvs "Logical value (set, if a PVS-error is present)" UBYTE _CNV_S_2_RANGE__0___1_CM 1 100. 0. 1. DISPLAY_IDENTIFIER LV_DET_ERR_PVS ECU_ADDRESS 0xd00015fb BIT_MASK 0x1 /end MEASUREMENT
/begin CHARACTERISTIC c_vcc_dif_pvs "max. permissible variance of the supply voltage of 10V" VALUE 0xa080c434 _REC_VAL_20_u2 9.9902 _CNV_A_R_LINEAR_____251_CM 0. 9.9902 DISPLAY_IDENTIFIER C_VCC_DIF_PVS FORMAT "%5.3" /end CHARACTERISTIC
/begin CHARACTERISTIC c_v_pvs_min_diag_1 "lower diagnosis-threshold channel 1" VALUE 0xa080c3f6 _REC_VAL_20_u2 4.9951171875 _CNV_A_R_LINEAR_____2_CM 0. 4.9951171875 DISPLAY_IDENTIFIER C_V_PVS_MIN_DIAG_1 FORMAT "%5.3" /end CHARACTERISTIC
/begin CHARACTERISTIC c_v_pvs_min_diag_min_1 "Upper diagnosis threshold for switching from faulty channel to error-free" VALUE 0xa080c3fa _REC_VAL_20_u2 4.9951171875 _CNV_A_R_LINEAR_____2_CM 0. 4.9951171875 DISPLAY_IDENTIFIER C_V_PVS_MIN_DIAG_MIN_1 FORMAT "%5.3" /end CHARACTERISTIC
/begin CHARACTERISTIC c_v_pvs_min_diag_min_2 "Upper diagnosis threshold for switching from faulty channel to error-free" VALUE 0xa080c3fc _REC_VAL_20_u2 4.9951171875 _CNV_A_R_LINEAR_____2_CM 0. 4.9951171875 DISPLAY_IDENTIFIER C_V_PVS_MIN_DIAG_MIN_2 FORMAT "%5.3" /end CHARACTERISTIC
/begin CHARACTERISTIC c_v_pvs_max_diag_1 "Upper diagnosis threshold channel 1" VALUE 0xa080c3f2 _REC_VAL_20_u2 4.9951171875 _CNV_A_R_LINEAR_____2_CM 0. 4.9951171875 DISPLAY_IDENTIFIER C_V_PVS_MAX_DIAG_1 FORMAT "%5.3" /end CHARACTERISTIC
/begin CHARACTERISTIC c_v_pvs_max_diag_2 "Upper diagnosis threshold channel 2" VALUE 0xa080c3f4 _REC_VAL_20_u2 4.9951171875 _CNV_A_R_LINEAR_____2_CM 0. 4.9951171875 DISPLAY_IDENTIFIER C_V_PVS_MAX_DIAG_2 FORMAT "%5.3" /end CHARACTERISTIC
/begin AXIS_PTS ldp_vs_ip_pv_av_max_brake "" 0xa08092fc vs _REC_AXS_20_u1 255. _CNV_A_R_LINEAR_____6_CM 5 0. 255. FORMAT "%3.0" /end AXIS_PTS
/begin AXIS_PTS ldp_brake_prs_ip_pv_av_max "" 0xa080850a brake_prs _REC_AXS_20_u1 255. _CNV_A_R_LINEAR_____73_CM 5 0. 255. FORMAT "%3.0" /end AXIS_PTS
/begin CHARACTERISTIC ip_pv_av_max_brake_vs "PV_AV limit for VS" CURVE 0xa080b3a2 _REC_CUR_20_u1_u1 99.609375 _CNV_A_R_LINEAR_____5_CM 0. 99.609375 DISPLAY_IDENTIFIER IP_PV_AV_MAX_BRAKE_VS FORMAT "%9.6"
 /begin AXIS_DESCR COM_AXIS vs _CNV_A_R_LINEAR_____6_CM 5 0. 255. FORMAT "%3.0" AXIS_PTS_REF ldp_vs_ip_pv_av_max_brake /end AXIS_DESCR
/end CHARACTERISTIC
/begin CHARACTERISTIC ip_pv_av_max_brake_prs "PV_AV limit for brake pressure" CURVE 0xa080b39c _REC_CUR_20_u1_u1 99.609375 _CNV_A_R_LINEAR_____5_CM 0. 99.609375 DISPLAY_IDENTIFIER IP_PV_AV_MAX_BRAKE_PRS FORMAT "%9.6"
 /begin AXIS_DESCR COM_AXIS brake_prs _CNV_A_R_LINEAR_____73_CM 5 0. 255. FORMAT "%3.0" AXIS_PTS_REF ldp_brake_prs_ip_pv_av_max /end AXIS_DESCR
/end CHARACTERISTIC
/begin CHARACTERISTIC lc_brake_prs "Switch to enable brake pressure monitoring for plausibility check" VALUE 0xa080c53a _REC_VAL_20_u1 1. _CNV_S_2_RANGE__0___1_CM 0. 1. DISPLAY_IDENTIFIER LC_BRAKE_PRS /end CHARACTERISTIC
/begin MEASUREMENT ctr_c_t_vs_brake_max "Delay timer for vehicle speed in PVS_BLS_BTS_PLAUS" UBYTE _CNV_A_R_LINEAR_____3_CM 1 100. 0. 2.55 DISPLAY_IDENTIFIER CTR_C_T_VS_BRAKE_MAX ECU_ADDRESS 0xd00015f9 FORMAT "%4.2" /end MEASUREMENT
/begin CHARACTERISTIC c_t_thd_vs_brake_max "Delay timer threshold for vehicle speed in PVS_BLS_BTS_PLAUS" VALUE 0xa080c281 _REC_VAL_20_u1 2.55 _CNV_A_R_LINEAR_____3_CM 0. 2.55 DISPLAY_IDENTIFIER C_T_THD_VS_BRAKE_MAX FORMAT "%4.2" /end CHARACTERISTIC
/begin MEASUREMENT pv_av_max_brake_det "PV_AV_MAX_BRAKE_DET" UBYTE _CNV_A_R_LINEAR_____5_CM 1 100. 0. 99.609375 DISPLAY_IDENTIFIER PV_AV_MAX_BRAKE_DET ECU_ADDRESS 0xd00089e1 FORMAT "%9.6" /end MEASUREMENT
/begin CHARACTERISTIC c_pv_av_brake_max "Maximum PV_AV threshold for PVS_BLS_BTS_PLAUS" VALUE 0xa080c08e _REC_VAL_20_u1 99.609375 _CNV_A_R_LINEAR_____5_CM 0. 99.609375 DISPLAY_IDENTIFIER C_PV_AV_BRAKE_MAX FORMAT "%9.6" /end CHARACTERISTIC
/begin CHARACTERISTIC c_pv_av_brake_min "Minimum PV_AV threshold for PVS_BLS_BTS_PLAUS" VALUE 0xa080c08f _REC_VAL_20_u1 99.609375 _CNV_A_R_LINEAR_____5_CM 0. 99.609375 DISPLAY_IDENTIFIER C_PV_AV_BRAKE_MIN FORMAT "%9.6" /end CHARACTERISTIC
/begin CHARACTERISTIC c_vs_brake_max "Maximum VS threshold for PVS_BLS_BTS_PLAUS" VALUE 0xa080c48a _REC_VAL_20_u1 255. _CNV_A_R_LINEAR_____6_CM 0. 255. DISPLAY_IDENTIFIER C_VS_BRAKE_MAX FORMAT "%3.0" /end CHARACTERISTIC
/begin CHARACTERISTIC c_vs_brake_min "Minimum VS threshold for PVS_BLS_BTS_PLAUS" VALUE 0xa080c48b _REC_VAL_20_u1 255. _CNV_A_R_LINEAR_____6_CM 0. 255. DISPLAY_IDENTIFIER C_VS_BRAKE_MIN FORMAT "%3.0" /end CHARACTERISTIC
/begin CHARACTERISTIC c_vs_max_brake "Maximum VS threshold for PVS_BLS_BTS_PLAUS" VALUE 0xa080c4ca _REC_VAL_20_u1 255. _CNV_A_R_LINEAR_____6_CM 0. 255. DISPLAY_IDENTIFIER C_VS_MAX_BRAKE FORMAT "%3.0" /end CHARACTERISTIC
/begin CHARACTERISTIC c_n_max_brake "Engine speed threshold for ABC in PVS_BLS_BTS_PLAUS" VALUE 0xa080bf60 _REC_VAL_20_u2 8160. _CNV_A_R_LINEAR_____14_CM 0. 8160. DISPLAY_IDENTIFIER C_N_MAX_BRAKE FORMAT "%4.0" /end CHARACTERISTIC
/begin MEASUREMENT lv_pv_av_lim_act "Logical value for PV_AV over threshold for PVS_BLS_BTS_PLAUS" UBYTE _CNV_S_2_RANGE__0___1_CM 1 100. 0. 1. DISPLAY_IDENTIFIER LV_PV_AV_LIM_ACT ECU_ADDRESS 0xd00089e9 BIT_MASK 0x1 /end MEASUREMENT
/begin MEASUREMENT lv_cdn_vs_vld_1 "Logical value for VS condition for PVS_BLS_BTS_PLAUS" UBYTE _CNV_S_2_RANGE__0___1_CM 1 100. 0. 1. DISPLAY_IDENTIFIER LV_CDN_VS_VLD_1 ECU_ADDRESS 0xd00015fc BIT_MASK 0x1 /end MEASUREMENT
/begin MEASUREMENT lv_cdn_vs_vld_2 "Logical value for brake pressure condition for PVS_BLS_BTS_PLAUS" UBYTE _CNV_S_2_RANGE__0___1_CM 1 100. 0. 1. DISPLAY_IDENTIFIER LV_CDN_VS_VLD_2 ECU_ADDRESS 0xd00015fd BIT_MASK 0x1 /end MEASUREMENT
/begin MEASUREMENT lv_err_pvs_2 "Logical value (set, if PVS - Channel 2 has debounced a range error)" UBYTE _CNV_S_2_RANGE__0___1_CM 1 100. 0. 1. DISPLAY_IDENTIFIER LV_ERR_PVS_2 ECU_ADDRESS 0xd0007f3c BIT_MASK 0x1 /end MEASUREMENT
/begin MEASUREMENT lv_err_pvs_ratio "Present error PVS_RATIO" UBYTE _CNV_S_2_RANGE__0___1_CM 1 100. 0. 1. DISPLAY_IDENTIFIER LV_ERR_PVS_RATIO ECU_ADDRESS 0xd0007f3d BIT_MASK 0x1 /end MEASUREMENT
/begin MEASUREMENT v_pvs_1 "Voltage of pedal value sensor 1" UWORD _CNV_A_R_LINEAR_____2_CM 1 100. 0. 4.9951171875 DISPLAY_IDENTIFIER V_PVS_1 ECU_ADDRESS 0xd000a63c FORMAT "%5.3" /end MEASUREMENT
/begin MEASUREMENT v_pvs_2 "Voltage of pedal value sensor 2" UWORD _CNV_A_R_LINEAR_____2_CM 1 100. 0. 4.9951171875 DISPLAY_IDENTIFIER V_PVS_2 ECU_ADDRESS 0xd000a63e FORMAT "%5.3" /end MEASUREMENT
/begin MEASUREMENT vcc_pvs_1 "Voltage supply for pedal value sensor 1 (and TPS) raw acquisition" UWORD _CNV_A_R_LINEAR_____251_CM 1 100. 0. 9.9902 DISPLAY_IDENTIFIER VCC_PVS_1 ECU_ADDRESS 0xd000a640 FORMAT "%5.3" /end MEASUREMENT
/begin MEASUREMENT vcc_pvs_2 "Voltage supply for pedal value sensor 2 raw acquisition" UWORD _CNV_A_R_LINEAR_____251_CM 1 100. 0. 9.9902 DISPLAY_IDENTIFIER VCC_PVS_2 ECU_ADDRESS 0xd000a642 FORMAT "%5.3" /end MEASUREMENT
/begin CHARACTERISTIC c_tia_dif_diag "minimum temperature difference to detect a non-stucking tia signal" VALUE 0xa080c324 _REC_VAL_20_u1 190.5 _CNV_A_R_LINEAR_____25_CM 0. 190.5 DISPLAY_IDENTIFIER C_TIA_DIF_DIAG FORMAT "%5.1" /end CHARACTERISTIC
/begin CHARACTERISTIC c_tia_plaus_dif_err "tia - offset to max/min range to detect a error" VALUE 0xa080c32c _REC_VAL_20_u1 190.5 _CNV_A_R_LINEAR_____25_CM 0. 190.5 DISPLAY_IDENTIFIER C_TIA_PLAUS_DIF_ERR FORMAT "%5.1" /end CHARACTERISTIC
/begin CHARACTERISTIC c_t_vs_min_tia_plaus_diag "minimum time period with a certain vehicle speed to expect a moving tia signal" VALUE 0xa080c2a0 _REC_VAL_20_u2 32767.5 _CNV_A_R_LINEAR_____19_CM 0. 32767.5 DISPLAY_IDENTIFIER C_T_VS_MIN_TIA_PLAUS_DIAG FORMAT "%6.1" /end CHARACTERISTIC
/begin CHARACTERISTIC c_vs_min_tia_plaus_diag "minimum temperature difference to detect a non-stucking tia signal" VALUE 0xa080c4ee _REC_VAL_20_u1 255. _CNV_A_R_LINEAR_____6_CM 0. 255. DISPLAY_IDENTIFIER C_VS_MIN_TIA_PLAUS_DIAG FORMAT "%3.0" /end CHARACTERISTIC
/begin CHARACTERISTIC c_tam_min_tia_plaus_diag "minimum ambient temperture to activate the diagnosis condition" VALUE 0xa080c2b8 _REC_VAL_20_u1 190.5 _CNV_A_R_LINEAR_____17_CM -48. 142.5 DISPLAY_IDENTIFIER C_TAM_MIN_TIA_PLAUS_DIAG FORMAT "%5.1" /end CHARACTERISTIC
/begin MEASUREMENT lv_err_tia_plaus "Temperature air sensor plausibility error" UBYTE _CNV_S_2_RANGE__0___1_CM 1 100. 0. 1. DISPLAY_IDENTIFIER LV_ERR_TIA_PLAUS ECU_ADDRESS 0xd0007fdf BIT_MASK 0x1 /end MEASUREMENT
/begin MEASUREMENT tia_plaus_min_diag "minimum expected tia" UBYTE _CNV_A_R_LINEAR_____17_CM 1 100. -48. 142.5 DISPLAY_IDENTIFIER TIA_PLAUS_MIN_DIAG ECU_ADDRESS 0xd0001739 FORMAT "%5.1" /end MEASUREMENT
/begin MEASUREMENT tia_dif_diag "difference between tia and tia_st" UBYTE _CNV_A_R_LINEAR_____25_CM 1 100. 0. 190.5 DISPLAY_IDENTIFIER TIA_DIF_DIAG ECU_ADDRESS 0xd000173c FORMAT "%5.1" /end MEASUREMENT
/begin MEASUREMENT t_vs_tia_plaus_diag "time period - vehicle is driven with certain speed" UWORD _CNV_A_R_LINEAR_____19_CM 1 100. 0. 32767.5 DISPLAY_IDENTIFIER T_VS_TIA_PLAUS_DIAG ECU_ADDRESS 0xd0001730 FORMAT "%6.1" /end MEASUREMENT
/begin MEASUREMENT t_is_tia_plaus_diag "time period - vehicle is driven in idle" UWORD _CNV_A_R_LINEAR_____19_CM 1 100. 0. 32767.5 DISPLAY_IDENTIFIER T_IS_TIA_PLAUS_DIAG ECU_ADDRESS 0xd0001732 FORMAT "%6.1" /end MEASUREMENT
/begin MEASUREMENT lv_dif_cdn_tia_plaus_diag "flag indicating that tia signal was moving" UBYTE _CNV_S_2_RANGE__0___1_CM 1 100. 0. 1. DISPLAY_IDENTIFIER LV_DIF_CDN_TIA_PLAUS_DIAG ECU_ADDRESS 0xd000173e BIT_MASK 0x1 /end MEASUREMENT
/begin MEASUREMENT lv_vs_cdn_tia_plaus_diag "flag indicating that vehicle speed condition is reached" UBYTE _CNV_S_2_RANGE__0___1_CM 1 100. 0. 1. DISPLAY_IDENTIFIER LV_VS_CDN_TIA_PLAUS_DIAG ECU_ADDRESS 0xd000173f BIT_MASK 0x1 /end MEASUREMENT
/begin MEASUREMENT lv_is_cdn_tia_plaus_diag "Flag indicating that vehicle idle condition is reached" UBYTE _CNV_S_2_RANGE__0___1_CM 1 100. 0. 1. DISPLAY_IDENTIFIER LV_IS_CDN_TIA_PLAUS_DIAG ECU_ADDRESS 0xd0001740 BIT_MASK 0x1 /end MEASUREMENT
/begin MEASUREMENT tia_plaus_max_diag "maximum expected tia" UBYTE _CNV_A_R_LINEAR_____17_CM 1 100. -48. 142.5 DISPLAY_IDENTIFIER TIA_PLAUS_MAX_DIAG ECU_ADDRESS 0xd0001738 FORMAT "%5.1" /end MEASUREMENT
/begin MEASUREMENT tia_dif_max_diag "Maximum reached TIA" UBYTE _CNV_A_R_LINEAR_____17_CM 1 100. -48. 142.5 DISPLAY_IDENTIFIER TIA_DIF_MAX_DIAG ECU_ADDRESS 0xd000173a FORMAT "%5.1" /end MEASUREMENT
/begin MEASUREMENT tia_dif_min_diag "Minimum reached TIA" UBYTE _CNV_A_R_LINEAR_____17_CM 1 100. -48. 142.5 DISPLAY_IDENTIFIER TIA_DIF_MIN_DIAG ECU_ADDRESS 0xd000173b FORMAT "%5.1" /end MEASUREMENT
/begin CHARACTERISTIC c_tco_min_is_cdn_tia_plaus "" VALUE 0xa080c2d6 _REC_VAL_20_u1 190.5 _CNV_A_R_LINEAR_____17_CM -48. 142.5 DISPLAY_IDENTIFIER C_TCO_MIN_IS_CDN_TIA_PLAUS FORMAT "%6.2" /end CHARACTERISTIC
/begin CHARACTERISTIC id_t_is_min_tia_plaus_diag "" CURVE 0xa0809e44 _REC_CUR_20_u2_u1 32767.5 _CNV_A_R_LINEAR_____19_CM 0. 32767.5 DISPLAY_IDENTIFIER ID_T_IS_MIN_TIA_PLAUS_DIAG FORMAT "%6.1"
 /begin AXIS_DESCR COM_AXIS tam _CNV_A_R_LINEAR_____17_CM 4 -48. 142.5 FORMAT "%5.1" AXIS_PTS_REF ldp_tam_tia_plaus_diag /end AXIS_DESCR
/end CHARACTERISTIC
/begin AXIS_PTS ldp_tam_tia_plaus_diag "" 0xa0808dca tam _REC_AXS_20_u1 190.5 _CNV_A_R_LINEAR_____17_CM 4 -48. 142.5 FORMAT "%5.1" /end AXIS_PTS
/begin MEASUREMENT ctr_is_cdn_tia_plaus "Cyle counter for T_IS condition" UBYTE _CNV_A_R_LINEAR_____0_CM 1 100. 0. 255. DISPLAY_IDENTIFIER CTR_IS_CDN_TIA_PLAUS ECU_ADDRESS 0xd000173d FORMAT "%3.0" /end MEASUREMENT
/begin CHARACTERISTIC c_vs_max_is_cdn_tia_plaus "Maximum VS for valid IS condition" VALUE 0xa080c4cf _REC_VAL_20_u1 255. _CNV_A_R_LINEAR_____6_CM 0. 255. DISPLAY_IDENTIFIER C_VS_MAX_IS_CDN_TIA_PLAUS FORMAT "%3.0" /end CHARACTERISTIC
/begin CHARACTERISTIC c_ctr_is_cdn_tia_plaus "Number of valide IS condition cycles" VALUE 0xa080bb9d _REC_VAL_20_u1 255. _CNV_A_R_LINEAR_____0_CM 0. 255. DISPLAY_IDENTIFIER C_CTR_IS_CDN_TIA_PLAUS FORMAT "%3.0" /end CHARACTERISTIC
/begin CHARACTERISTIC c_maf_min_int_cdn_tia_plaus "Threshold MAF to enable MAF_CYL integral" VALUE 0xa080be3e _REC_VAL_20_u2 1389. _CNV_A_R_LINEAR_____111_CM 0. 1389. DISPLAY_IDENTIFIER C_MAF_MIN_INT_CDN_TIA_PLAUS FORMAT "%7.2" /end CHARACTERISTIC
/begin MEASUREMENT t_load_is_cdn_tia_plaus "Time period - vehicle is driven with high load" UWORD _CNV_A_R_LINEAR_____19_CM 1 100. 0. 32767.5 DISPLAY_IDENTIFIER T_LOAD_IS_CDN_TIA_PLAUS ECU_ADDRESS 0xd0001734 FORMAT "%6.1" /end MEASUREMENT
/begin MEASUREMENT lv_load_is_cdn_tia_plaus "Flag indicating that vehicle was driven with high load to enter in idle condition" UBYTE _CNV_S_2_RANGE__0___1_CM 1 100. 0. 1. DISPLAY_IDENTIFIER LV_LOAD_IS_CDN_TIA_PLAUS ECU_ADDRESS 0xd0001741 BIT_MASK 0x1 /end MEASUREMENT
/begin CHARACTERISTIC c_tam_max_tia_plaus_diag "Maximum ambient temperture to activate the diagnosis condition" VALUE 0xa080c2b4 _REC_VAL_20_u1 190.5 _CNV_A_R_LINEAR_____17_CM -48. 142.5 DISPLAY_IDENTIFIER C_TAM_MAX_TIA_PLAUS_DIAG FORMAT "%5.1" /end CHARACTERISTIC
/begin CHARACTERISTIC c_t_load_is_cdn_tia_plaus "Threshold for load timer to enter IS condition" VALUE 0xa080c1da _REC_VAL_20_u2 32767.5 _CNV_A_R_LINEAR_____19_CM 0. 32767.5 DISPLAY_IDENTIFIER C_T_LOAD_IS_CDN_TIA_PLAUS FORMAT "%6.1" /end CHARACTERISTIC
/begin CHARACTERISTIC c_toil_chk_ctl_1 "warning threshold 1 for TOIL overtemperature (appl. suggestion: 156°C)" VALUE 0xa080c348 _REC_VAL_20_u1 255. _CNV_A_R_LINEAR_____26_CM -40. 215. DISPLAY_IDENTIFIER C_TOIL_CHK_CTL_1 FORMAT "%3.0" /end CHARACTERISTIC
/begin CHARACTERISTIC c_toil_chk_ctl_2 "warning threshold 2 for TOIL overtemperature (appl. suggestion: 159°C)" VALUE 0xa080c349 _REC_VAL_20_u1 255. _CNV_A_R_LINEAR_____26_CM -40. 215. DISPLAY_IDENTIFIER C_TOIL_CHK_CTL_2 FORMAT "%3.0" /end CHARACTERISTIC
/begin CHARACTERISTIC c_maf_vs_min_diag_mt "MAF condition - vehicle speed diagnosis, MT vehicle" VALUE 0xa080be55 _REC_VAL_20_u1 1389. _CNV_A_R_LINEAR_____15_CM 0. 1389. DISPLAY_IDENTIFIER C_MAF_VS_MIN_DIAG_MT FORMAT "%4.0" /end CHARACTERISTIC
/begin CHARACTERISTIC c_maf_vs_min_diag_at "MAF condition - vehicle speed diagnosis, AT vehicle" VALUE 0xa080be54 _REC_VAL_20_u1 1389. _CNV_A_R_LINEAR_____15_CM 0. 1389. DISPLAY_IDENTIFIER C_MAF_VS_MIN_DIAG_AT FORMAT "%4.0" /end CHARACTERISTIC
/begin CHARACTERISTIC c_n_vs_min_diag_mt "Engine speed condition - vehicle speed diagnosis, MT vehicle" VALUE 0xa080bfe2 _REC_VAL_20_u2 8160. _CNV_A_R_LINEAR_____14_CM 0. 8160. DISPLAY_IDENTIFIER C_N_VS_MIN_DIAG_MT FORMAT "%4.0" /end CHARACTERISTIC
/begin CHARACTERISTIC c_n_vs_min_diag_at "Engine speed condition - vehicle speed diagnosis, AT vehicle" VALUE 0xa080bfe0 _REC_VAL_20_u2 8160. _CNV_A_R_LINEAR_____14_CM 0. 8160. DISPLAY_IDENTIFIER C_N_VS_MIN_DIAG_AT FORMAT "%4.0" /end CHARACTERISTIC
/begin CHARACTERISTIC c_t_vs_min_diag "Time condition - vehicle speed diagnosis" VALUE 0xa080c29e _REC_VAL_20_u2 6553.5 _CNV_A_R_LINEAR_____4_CM 0. 6553.5 DISPLAY_IDENTIFIER C_T_VS_MIN_DIAG FORMAT "%6.1" /end CHARACTERISTIC
/begin MEASUREMENT t_vs_diag "Time counter for error detection" UWORD _CNV_A_R_LINEAR_____4_CM 1 100. 0. 6553.5 DISPLAY_IDENTIFIER T_VS_DIAG ECU_ADDRESS 0xd0001860 FORMAT "%6.1" /end MEASUREMENT
/begin MEASUREMENT t_vs_end_diag "Time counter for end of diagnosis" UWORD _CNV_A_R_LINEAR_____4_CM 1 100. 0. 6553.5 DISPLAY_IDENTIFIER T_VS_END_DIAG ECU_ADDRESS 0xd0001862 FORMAT "%6.1" /end MEASUREMENT
/begin MEASUREMENT lv_err_vs_plaus "VS plaus sensor error bit" UBYTE _CNV_S_2_RANGE__0___1_CM 1 100. 0. 1. DISPLAY_IDENTIFIER LV_ERR_VS_PLAUS ECU_ADDRESS 0xd0007fdb BIT_MASK 0x1 /end MEASUREMENT
/begin MEASUREMENT lv_err_vs "VS sensor error bit" UBYTE _CNV_S_2_RANGE__0___1_CM 1 100. 0. 1. DISPLAY_IDENTIFIER LV_ERR_VS ECU_ADDRESS 0xd0007f15 BIT_MASK 0x1 /end MEASUREMENT
/begin CHARACTERISTIC c_tq_av_vs_min_diag_mt "TQ_AV condition - vehicle speed diagnosis, MT vehicle" VALUE 0xa080c36d _REC_VAL_20_u1 510. _CNV_A_R_LINEAR_____262_CM 0. 510. DISPLAY_IDENTIFIER C_TQ_AV_VS_MIN_DIAG_MT FORMAT "%4.0" /end CHARACTERISTIC
/begin CHARACTERISTIC c_tq_av_vs_min_diag_at "TQ_AV condition - vehicle speed diagnosis, AT vehicle" VALUE 0xa080c36c _REC_VAL_20_u1 510. _CNV_A_R_LINEAR_____262_CM 0. 510. DISPLAY_IDENTIFIER C_TQ_AV_VS_MIN_DIAG_AT FORMAT "%4.0" /end CHARACTERISTIC
/begin MEASUREMENT lv_err_mec_ivvt_in_1 "Error flag for functional error on the inlet CAM adjustment" UBYTE _CNV_S_2_RANGE__0___1_CM 1 100. 0. 1. DISPLAY_IDENTIFIER LV_ERR_MEC_IVVT_IN_1 ECU_ADDRESS 0xd0007fc9 BIT_MASK 0x1 /end MEASUREMENT
/begin MEASUREMENT lv_err_mec_ivvt_in_2 "Error flag for functional error on the inlet CAM adjustment" UBYTE _CNV_S_2_RANGE__0___1_CM 1 100. 0. 1. DISPLAY_IDENTIFIER LV_ERR_MEC_IVVT_IN_2 ECU_ADDRESS 0xd0007fca BIT_MASK 0x1 /end MEASUREMENT
/begin MEASUREMENT lv_err_mec_ivvt_ex "Error flag for functional error on the exhaust CAM adjustment" UBYTE _CNV_S_2_RANGE__0___1_CM 1 100. 0. 1. DISPLAY_IDENTIFIER LV_ERR_MEC_IVVT_EX ECU_ADDRESS 0xd0007fcb BIT_MASK 0x1 /end MEASUREMENT
/begin MEASUREMENT lv_err_gen "Boolean for error currently present on Generator" UBYTE _CNV_S_2_RANGE__0___1_CM 1 100. 0. 1. DISPLAY_IDENTIFIER LV_ERR_GEN ECU_ADDRESS 0xd0007f41 BIT_MASK 0x1 /end MEASUREMENT
/begin MEASUREMENT lv_err_ivvt "Global error flag IVVT" UBYTE _CNV_S_2_RANGE__0___1_CM 1 100. 0. 1. DISPLAY_IDENTIFIER LV_ERR_IVVT ECU_ADDRESS 0xd000869e BIT_MASK 0x1 /end MEASUREMENT
/begin CHARACTERISTIC c_t_ast_gen_diag_off "End of genertaor diagnosis T_AST" VALUE 0xa080c12a _REC_VAL_20_u2 51.2 _CNV_A_R_LINEAR_____4_CM 0. 51.2 DISPLAY_IDENTIFIER C_T_AST_GEN_DIAG_OFF FORMAT "%4.1" /end CHARACTERISTIC
/begin CHARACTERISTIC c_t_ast_gen_diag_on "Begin of genertaor diagnosis T_AST" VALUE 0xa080c12c _REC_VAL_20_u2 51.2 _CNV_A_R_LINEAR_____4_CM 0. 51.2 DISPLAY_IDENTIFIER C_T_AST_GEN_DIAG_ON FORMAT "%4.1" /end CHARACTERISTIC
/begin CHARACTERISTIC c_vb_mes_gen_diag_thd "battery voltage threshold for diagnosis" VALUE 0xa080c422 _REC_VAL_20_u2 28.7055 _CNV_A_R_LINEAR_____473_CM 0. 28.7055 DISPLAY_IDENTIFIER C_VB_MES_GEN_DIAG_THD FORMAT "%5.2" /end CHARACTERISTIC
/begin CHARACTERISTIC c_vb_mes_gen_diag_thd_max "Max.battery voltage threshold for diagnosis" VALUE 0xa080c424 _REC_VAL_20_u2 28.7055 _CNV_A_R_LINEAR_____473_CM 0. 28.7055 DISPLAY_IDENTIFIER C_VB_MES_GEN_DIAG_THD_MAX FORMAT "%5.2" /end CHARACTERISTIC
/begin CHARACTERISTIC c_dffgen_thd_max "Max.DF diagnosis threshold for Generator diagnosis" VALUE 0xa080bc42 _REC_VAL_20_u1 99.609375 _CNV_A_R_LINEAR_____5_CM 0. 99.609375 DISPLAY_IDENTIFIER C_DFFGEN_THD_MAX /end CHARACTERISTIC
/begin CHARACTERISTIC c_dffgen_thd_min "Min.DF diagnosis threshold for Generator diagnosis" VALUE 0xa080bc43 _REC_VAL_20_u1 99.609375 _CNV_A_R_LINEAR_____5_CM 0. 99.609375 DISPLAY_IDENTIFIER C_DFFGEN_THD_MIN /end CHARACTERISTIC
/begin CHARACTERISTIC c_perc_gen_diag_vb_max "Percentage of battery voltage values within diagnosis range" VALUE 0xa080c076 _REC_VAL_20_u2 99.99847412109381 _CNV_A_R_LINEAR_____8_CM 0. 99.99847412109381 DISPLAY_IDENTIFIER C_PERC_GEN_DIAG_VB_MAX /end CHARACTERISTIC
/begin MEASUREMENT ctr_diag_gen_diag "Diagnosis counter for fulfilled diagnosis values" UWORD _CNV_A_R_LINEAR_____50_CM 1 100. 0. 512. DISPLAY_IDENTIFIER CTR_DIAG_GEN_DIAG ECU_ADDRESS 0xd0003772 FORMAT "%4.0" /end MEASUREMENT
/begin MEASUREMENT ctr_ref_gen_diag "Reference counter for diagnosis result" UWORD _CNV_A_R_LINEAR_____50_CM 1 100. 0. 512. DISPLAY_IDENTIFIER CTR_REF_GEN_DIAG ECU_ADDRESS 0xd0003770 FORMAT "%4.0" /end MEASUREMENT
/begin MEASUREMENT lv_err_gen_diag "Error Generator diagnosis" UBYTE _CNV_S_2_RANGE__0___1_CM 1 100. 0. 1. DISPLAY_IDENTIFIER LV_ERR_GEN_DIAG ECU_ADDRESS 0xd0007f42 BIT_MASK 0x1 /end MEASUREMENT
/begin MEASUREMENT lv_inh_diag_tia_plaus "Inhibition of TIA plaus diagnosis due to present error" UBYTE _CNV_S_2_RANGE__0___1_CM 1 100. 0. 1. DISPLAY_IDENTIFIER LV_INH_DIAG_TIA_PLAUS ECU_ADDRESS 0xd00089fd BIT_MASK 0x1 /end MEASUREMENT
/begin MEASUREMENT state_rbm_tia_plaus "Interface of TIA_PLAUS monitor with the Rate-Based Monitoring statistics" UBYTE _CNV_A_R_LINEAR_____0_CM 1 100. 0. 7. DISPLAY_IDENTIFIER STATE_RBM_TIA_PLAUS ECU_ADDRESS 0xd00089fc FORMAT "%1.0" /end MEASUREMENT
/begin MEASUREMENT lv_inh_diag_maf "Inhibition of MAF diagnosis" UBYTE _CNV_S_2_RANGE__0___1_CM 1 100. 0. 1. DISPLAY_IDENTIFIER LV_INH_DIAG_MAF ECU_ADDRESS 0xd00088dd BIT_MASK 0x1 /end MEASUREMENT
/begin MEASUREMENT lv_maf_bls_diag "MAF error and brake is active" UBYTE _CNV_S_2_RANGE__0___1_CM 1 100. 0. 1. DISPLAY_IDENTIFIER LV_MAF_BLS_DIAG ECU_ADDRESS 0xd00088de BIT_MASK 0x1 /end MEASUREMENT
/begin MEASUREMENT state_rbm_maf "Interface of MAF monitor with the Rate-Based Monitoring statistics" UBYTE _CNV_A_R_LINEAR_____0_CM 1 100. 0. 7. DISPLAY_IDENTIFIER STATE_RBM_MAF ECU_ADDRESS 0xd00088dc FORMAT "%1.0" /end MEASUREMENT
/begin MEASUREMENT t_rly_main_diag "Time window to perform the main relay diagnosis" UBYTE _CNV_A_R_LINEAR_____20_CM 1 100. 0. 2550. DISPLAY_IDENTIFIER T_RLY_MAIN_DIAG ECU_ADDRESS 0xd0001614 FORMAT "%4.0" /end MEASUREMENT
/begin MEASUREMENT t_dly_rly_main_diag "Delay timer for the diagnosis to allow switching of the relay" UBYTE _CNV_A_R_LINEAR_____20_CM 1 100. 0. 2550. DISPLAY_IDENTIFIER T_DLY_RLY_MAIN_DIAG ECU_ADDRESS 0xd0008e34 FORMAT "%4.0" /end MEASUREMENT
/begin CHARACTERISTIC c_t_rly_main_diag "Time window to perform the main relay diagnosis" VALUE 0xa080c270 _REC_VAL_20_u1 2550. _CNV_A_R_LINEAR_____20_CM 0. 2550. DISPLAY_IDENTIFIER C_T_RLY_MAIN_DIAG FORMAT "%4.0" /end CHARACTERISTIC
/begin CHARACTERISTIC c_v_igk_rly_main_diag "Voltage threshold for detection of main relay on" VALUE 0xa080c3cc _REC_VAL_20_u1 25.8984 _CNV_A_R_LINEAR_____22_CM 0. 25.8984 DISPLAY_IDENTIFIER C_V_IGK_RLY_MAIN_DIAG FORMAT "%3.1" /end CHARACTERISTIC
/begin CHARACTERISTIC c_t_dly_rly_main_diag "Delay time for the diagnosis to allow switching of the relay" VALUE 0xa080c187 _REC_VAL_20_u1 2550. _CNV_A_R_LINEAR_____20_CM 0. 2550. DISPLAY_IDENTIFIER C_T_DLY_RLY_MAIN_DIAG FORMAT "%4.0" /end CHARACTERISTIC
/begin CHARACTERISTIC c_t_predrive_dly_max "Maximum predrive check delay" VALUE 0xa080c258 _REC_VAL_20_u1 2550. _CNV_A_R_LINEAR_____20_CM 0. 2550. DISPLAY_IDENTIFIER C_T_PREDRIVE_DLY_MAX FORMAT "%4.0" /end CHARACTERISTIC
/begin MEASUREMENT lv_err_bn_veh_mod "Present error BN2000" UBYTE _CNV_S_2_RANGE__0___1_CM 1 100. 0. 1. DISPLAY_IDENTIFIER LV_ERR_BN_VEH_MOD ECU_ADDRESS 0xd0007fa5 BIT_MASK 0x1 /end MEASUREMENT
/begin MEASUREMENT lv_err_rly_main_dly "Present error BN2000" UBYTE _CNV_S_2_RANGE__0___1_CM 1 100. 0. 1. DISPLAY_IDENTIFIER LV_ERR_RLY_MAIN_DLY ECU_ADDRESS 0xd0007f67 BIT_MASK 0x1 /end MEASUREMENT
/begin MEASUREMENT lv_err_rly_main "Boolean for error detected at the main relay" UBYTE _CNV_S_2_RANGE__0___1_CM 1 100. 0. 1. DISPLAY_IDENTIFIER LV_ERR_RLY_MAIN ECU_ADDRESS 0xd0007f66 BIT_MASK 0x1 /end MEASUREMENT
/begin MEASUREMENT lv_rly_main_dly_err "Boolean for error detected at the main relay" UBYTE _CNV_S_2_RANGE__0___1_CM 1 100. 0. 1. DISPLAY_IDENTIFIER LV_ERR_RLY_MAIN ECU_ADDRESS 0xd0008e35 BIT_MASK 0x1 /end MEASUREMENT
/begin MEASUREMENT lv_diag_end_rly_main_dly "Boolean for error detected at the main relay" UBYTE _CNV_S_2_RANGE__0___1_CM 1 100. 0. 1. DISPLAY_IDENTIFIER LV_ERR_RLY_MAIN ECU_ADDRESS 0xd0008e36 BIT_MASK 0x1 /end MEASUREMENT
/begin CHARACTERISTIC c_vb_rly_main_diag "Voltage threshold for detection of battery voltage present" VALUE 0xa080c431 _REC_VAL_20_u1 25.8984 _CNV_A_R_LINEAR_____22_CM 0. 25.8984 DISPLAY_IDENTIFIER C_VB_RLY_MAIN_DIAG FORMAT "%3.1" /end CHARACTERISTIC
/begin CHARACTERISTIC c_vb_rly_main_dly_diag "Voltage threshold for detection of battery voltage present" VALUE 0xa080c432 _REC_VAL_20_u1 25.8984 _CNV_A_R_LINEAR_____22_CM 0. 25.8984 DISPLAY_IDENTIFIER C_VB_RLY_MAIN_DIAG FORMAT "%3.1" /end CHARACTERISTIC
/begin MEASUREMENT ctr_diag_rly_main_dly "Counter plausibility error PVS recognized without error entry" UBYTE _CNV_A_R_LINEAR_____0_CM 1 100. 0. 255. DISPLAY_IDENTIFIER CTR_DIAG_RLY_MAIN_DLY ECU_ADDRESS 0xd0001615 FORMAT "%3.0" /end MEASUREMENT
/begin MEASUREMENT ctr_end_diag_rly_main_dly "Counter plausibility error PVS recognized without error entry" UBYTE _CNV_A_R_LINEAR_____0_CM 1 100. 0. 255. DISPLAY_IDENTIFIER CTR_END_DIAG_RLY_MAIN_DLY ECU_ADDRESS 0xd0001616 FORMAT "%3.0" /end MEASUREMENT
/begin MEASUREMENT state_rbm_vs_plaus "Interface of VS_PLAUS monitor with the Rate-Based Monitoring statistics" UBYTE _CNV_A_R_LINEAR_____0_CM 1 100. 0. 7. DISPLAY_IDENTIFIER STATE_RBM_VS_PLAUS ECU_ADDRESS 0xd0008bf0 FORMAT "%1.0" /end MEASUREMENT
/begin MEASUREMENT lv_inh_diag_knks "Inhibitflag for KNKS-diagnosis" UBYTE _CNV_S_2_RANGE__0___1_CM 1 100. 0. 1. DISPLAY_IDENTIFIER LV_INH_DIAG_KNKS ECU_ADDRESS 0xd0008c80 BIT_MASK 0x1 /end MEASUREMENT
/begin CHARACTERISTIC c_t_dly_tia_diag "Delay time for diagnosis activation" VALUE 0xa080c18c _REC_VAL_20_u2 32767.5 _CNV_A_R_LINEAR_____19_CM 0. 32767.5 DISPLAY_IDENTIFIER C_T_DLY_TIA_DIAG FORMAT "%6.1" /end CHARACTERISTIC
/begin CHARACTERISTIC c_t_dly_tia_thr_diag "Delay time for diagnosis activation" VALUE 0xa080c18e _REC_VAL_20_u2 32767.5 _CNV_A_R_LINEAR_____19_CM 0. 32767.5 DISPLAY_IDENTIFIER C_T_DLY_TIA_THR_DIAG FORMAT "%6.1" /end CHARACTERISTIC
/begin MEASUREMENT lv_err_tia_thr_el_2 "Electrical TIA_THR error" UBYTE _CNV_S_2_RANGE__0___1_CM 1 100. 0. 1. DISPLAY_IDENTIFIER LV_ERR_TIA_THR_EL_2 ECU_ADDRESS 0xd0007f0b BIT_MASK 0x1 /end MEASUREMENT
/begin MEASUREMENT lv_err_tia_thr_el_1 "Electrical TIA_THR error" UBYTE _CNV_S_2_RANGE__0___1_CM 1 100. 0. 1. DISPLAY_IDENTIFIER LV_ERR_TIA_THR_EL_1 ECU_ADDRESS 0xd0007f0a BIT_MASK 0x1 /end MEASUREMENT
/begin MEASUREMENT lv_err_tia_el_1 "Electrical TIA error" UBYTE _CNV_S_2_RANGE__0___1_CM 1 100. 0. 1. DISPLAY_IDENTIFIER LV_ERR_TIA_EL_1 ECU_ADDRESS 0xd0007f08 BIT_MASK 0x1 /end MEASUREMENT
/begin MEASUREMENT lv_err_tia_el_2 "Electrical TIA error" UBYTE _CNV_S_2_RANGE__0___1_CM 1 100. 0. 1. DISPLAY_IDENTIFIER LV_ERR_TIA_EL_2 ECU_ADDRESS 0xd0007f09 BIT_MASK 0x1 /end MEASUREMENT
/begin MEASUREMENT lv_err_tia_thr "TIA_THR error present" UBYTE _CNV_S_2_RANGE__0___1_CM 1 100. 0. 1. DISPLAY_IDENTIFIER LV_ERR_TIA_THR ECU_ADDRESS 0xd0008a00 BIT_MASK 0x1 /end MEASUREMENT
/begin MEASUREMENT lv_err_tia "TIA error present" UBYTE _CNV_S_2_RANGE__0___1_CM 1 100. 0. 1. DISPLAY_IDENTIFIER LV_ERR_TIA ECU_ADDRESS 0xd0008a01 BIT_MASK 0x1 /end MEASUREMENT
/begin CHARACTERISTIC c_vp_tia_max_diag "TIA threshold for short to ground - TIA diagnosis" VALUE 0xa080c480 _REC_VAL_20_u2 4.999847 _CNV_A_R_LINEAR_____172_CM 0. 4.999847 DISPLAY_IDENTIFIER C_VP_TIA_MAX_DIAG FORMAT "%7.5" /end CHARACTERISTIC
/begin CHARACTERISTIC c_vp_tia_min_diag "TIA threshold for short to VB or line break - TIA diagnosis" VALUE 0xa080c482 _REC_VAL_20_u2 4.999847 _CNV_A_R_LINEAR_____172_CM 0. 4.999847 DISPLAY_IDENTIFIER C_VP_TIA_MIN_DIAG FORMAT "%7.5" /end CHARACTERISTIC
/begin CHARACTERISTIC c_vp_tia_thr_max_diag "TIA_THR threshold for short to ground - TIA_THR diagnosis" VALUE 0xa080c484 _REC_VAL_20_u2 4.999847 _CNV_A_R_LINEAR_____172_CM 0. 4.999847 DISPLAY_IDENTIFIER C_VP_TIA_THR_MAX_DIAG FORMAT "%7.5" /end CHARACTERISTIC
/begin CHARACTERISTIC c_vp_tia_thr_min_diag "TIA_THR threshold for short to VB or line break - TIA_THR diagnosis" VALUE 0xa080c486 _REC_VAL_20_u2 4.999847 _CNV_A_R_LINEAR_____172_CM 0. 4.999847 DISPLAY_IDENTIFIER C_VP_TIA_THR_MIN_DIAG FORMAT "%7.5" /end CHARACTERISTIC
/begin AXIS_PTS ldp_t_per_maf_frq_ofs "" 0xa0813928 online_dummy _REC_AXS_20_u2 65535. _CNV_A_R_LINEAR_____410_CM 256 0. 65535. FORMAT "%5.0" /end AXIS_PTS
/begin MEASUREMENT lv_ctr_t_per_maf_frq_rng[0] "failure (range) of the mean period time for frequency MAF-sensor" UBYTE _CNV_S_2_RANGE__0___1_CM 1 100. 0. 1. DISPLAY_IDENTIFIER LV_CTR_T_PER_MAF_FRQ_RNG[0] ECU_ADDRESS 0xd00088e8 BIT_MASK 0x1 /end MEASUREMENT
/begin MEASUREMENT lv_ctr_t_per_maf_frq_rng[1] "failure (range) of the mean period time for frequency MAF-sensor" UBYTE _CNV_S_2_RANGE__0___1_CM 1 100. 0. 1. DISPLAY_IDENTIFIER LV_CTR_T_PER_MAF_FRQ_RNG[1] ECU_ADDRESS 0xd00088e9 BIT_MASK 0x1 /end MEASUREMENT
/begin MEASUREMENT lv_ctr_t_per_maf_frq_el[0] "failure (electrical) of the mean period time for frequency MAF sensor " UBYTE _CNV_S_2_RANGE__0___1_CM 1 100. 0. 1. DISPLAY_IDENTIFIER LV_CTR_T_PER_MAF_FRQ_EL[0] ECU_ADDRESS 0xd00088ec BIT_MASK 0x1 /end MEASUREMENT
/begin MEASUREMENT lv_ctr_t_per_maf_frq_el[1] "failure (electrical) of the mean period time for frequency MAF sensor " UBYTE _CNV_S_2_RANGE__0___1_CM 1 100. 0. 1. DISPLAY_IDENTIFIER LV_CTR_T_PER_MAF_FRQ_EL[1] ECU_ADDRESS 0xd00088ed BIT_MASK 0x1 /end MEASUREMENT
/begin MEASUREMENT lv_ctr_t_per_maf_frq_sens[0] "failure (sensor) of the mean period time for frequency MAF sensor" UBYTE _CNV_S_2_RANGE__0___1_CM 1 100. 0. 1. DISPLAY_IDENTIFIER LV_CTR_T_PER_MAF_FRQ_SENS[0] ECU_ADDRESS 0xd00088ee BIT_MASK 0x1 /end MEASUREMENT
/begin MEASUREMENT lv_ctr_t_per_maf_frq_sens[1] "failure (sensor) of the mean period time for frequency MAF sensor" UBYTE _CNV_S_2_RANGE__0___1_CM 1 100. 0. 1. DISPLAY_IDENTIFIER LV_CTR_T_PER_MAF_FRQ_SENS[1] ECU_ADDRESS 0xd00088ef BIT_MASK 0x1 /end MEASUREMENT
/begin CHARACTERISTIC c_t_per_max_frq_ofs "offset of the period time for conversion table" VALUE 0xa080c250 _REC_VAL_20_u2 65535. _CNV_A_R_LINEAR_____410_CM 0. 65535. DISPLAY_IDENTIFIER C_T_PER_MAX_FRQ_OFS FORMAT "%5.0" /end CHARACTERISTIC
/begin CHARACTERISTIC c_t_per_maf_frq_max_diag "maximum threshold for range check of  t_per_maf_frq_sum_j" VALUE 0xa080c24a _REC_VAL_20_u2 65535. _CNV_A_R_LINEAR_____410_CM 0. 65535. DISPLAY_IDENTIFIER C_T_PER_MAF_FRQ_MAX_DIAG FORMAT "%5.0" /end CHARACTERISTIC
/begin CHARACTERISTIC c_t_per_maf_frq_min_diag "minimum threshold for range check of  t_per_maf_frq_sum_j" VALUE 0xa080c24c _REC_VAL_20_u2 65535. _CNV_A_R_LINEAR_____410_CM 0. 65535. DISPLAY_IDENTIFIER C_T_PER_MAF_FRQ_MIN_DIAG FORMAT "%5.0" /end CHARACTERISTIC
/begin CHARACTERISTIC c_t_per_maf_frq_grd_diag "maximum threshold for gradient check of  t_per_maf_frq_sum" VALUE 0xa080c248 _REC_VAL_20_u2 65535. _CNV_A_R_LINEAR_____410_CM 0. 65535. DISPLAY_IDENTIFIER C_T_PER_MAF_FRQ_GRD_DIAG FORMAT "%5.0" /end CHARACTERISTIC
/begin CHARACTERISTIC c_t_per_maf_frq_el "maximum threshold for range check of  t_per_maf_frq_el" VALUE 0xa080c246 _REC_VAL_20_u2 65535. _CNV_A_R_LINEAR_____410_CM 0. 65535. DISPLAY_IDENTIFIER C_T_PER_MAF_FRQ_EL FORMAT "%5.0" /end CHARACTERISTIC
/begin CHARACTERISTIC c_t_per_maf_frq_sens "minimum threshold for range check of  t_per_maf_frq_sens" VALUE 0xa080c24e _REC_VAL_20_u2 65535. _CNV_A_R_LINEAR_____410_CM 0. 65535. DISPLAY_IDENTIFIER C_T_PER_MAF_FRQ_SENS FORMAT "%5.0" /end CHARACTERISTIC
/begin MEASUREMENT ctr_maf_frq_kgh_sum_0[0] "number of accumulated mass air flows during one segment" UWORD _CNV_A_R_LINEAR_____0_CM 1 100. 0. 65535. DISPLAY_IDENTIFIER CTR_MAF_FRQ_KGH_SUM_0[0] ECU_ADDRESS 0xd0001354 FORMAT "%5.0" /end MEASUREMENT
/begin MEASUREMENT ctr_maf_frq_kgh_sum_0[1] "number of accumulated mass air flows during one segment" UWORD _CNV_A_R_LINEAR_____0_CM 1 100. 0. 65535. DISPLAY_IDENTIFIER CTR_MAF_FRQ_KGH_SUM_0[1] ECU_ADDRESS 0xd0001356 FORMAT "%5.0" /end MEASUREMENT
/begin MEASUREMENT ctr_maf_frq_kgh_sum_1[0] "number of accumulated mass air flows during one segment" UWORD _CNV_A_R_LINEAR_____0_CM 1 100. 0. 65535. DISPLAY_IDENTIFIER CTR_MAF_FRQ_KGH_SUM_1[0] ECU_ADDRESS 0xd0001358 FORMAT "%5.0" /end MEASUREMENT
/begin MEASUREMENT ctr_maf_frq_kgh_sum_1[1] "number of accumulated mass air flows during one segment" UWORD _CNV_A_R_LINEAR_____0_CM 1 100. 0. 65535. DISPLAY_IDENTIFIER CTR_MAF_FRQ_KGH_SUM_1[1] ECU_ADDRESS 0xd000135a FORMAT "%5.0" /end MEASUREMENT
/begin MEASUREMENT ctr_maf_frq_kgh_sum[0] "number of valid accumulated mass air flows during one segment" UWORD _CNV_A_R_LINEAR_____0_CM 1 100. 0. 65535. DISPLAY_IDENTIFIER CTR_MAF_FRQ_KGH_SUM[0] ECU_ADDRESS 0xd000a4a8 FORMAT "%5.0" /end MEASUREMENT
/begin MEASUREMENT ctr_maf_frq_kgh_sum[1] "number of valid accumulated mass air flows during one segment" UWORD _CNV_A_R_LINEAR_____0_CM 1 100. 0. 65535. DISPLAY_IDENTIFIER CTR_MAF_FRQ_KGH_SUM[1] ECU_ADDRESS 0xd000a4aa FORMAT "%5.0" /end MEASUREMENT
/begin MEASUREMENT ctr_t_per_maf_frq_rng_1[0] "number of accumulated range failures during one segment for buffer 1" UWORD _CNV_A_R_LINEAR_____0_CM 1 100. 0. 65535. DISPLAY_IDENTIFIER CTR_T_PER_MAF_FRQ_RNG_1[0] ECU_ADDRESS 0xd0001360 FORMAT "%5.0" /end MEASUREMENT
/begin MEASUREMENT ctr_t_per_maf_frq_rng_1[1] "number of accumulated range failures during one segment for buffer 1" UWORD _CNV_A_R_LINEAR_____0_CM 1 100. 0. 65535. DISPLAY_IDENTIFIER CTR_T_PER_MAF_FRQ_RNG_1[1] ECU_ADDRESS 0xd0001362 FORMAT "%5.0" /end MEASUREMENT
/begin MEASUREMENT ctr_t_per_maf_frq_rng_0[0] "number of accumulated range failures during one segment for buffer 0" UWORD _CNV_A_R_LINEAR_____0_CM 1 100. 0. 65535. DISPLAY_IDENTIFIER CTR_T_PER_MAF_FRQ_RNG_0[0] ECU_ADDRESS 0xd000135c FORMAT "%5.0" /end MEASUREMENT
/begin MEASUREMENT ctr_t_per_maf_frq_rng_0[1] "number of accumulated range failures during one segment for buffer 0" UWORD _CNV_A_R_LINEAR_____0_CM 1 100. 0. 65535. DISPLAY_IDENTIFIER CTR_T_PER_MAF_FRQ_RNG_0[1] ECU_ADDRESS 0xd000135e FORMAT "%5.0" /end MEASUREMENT
/begin MEASUREMENT ctr_t_per_maf_frq_rng[0] "number of accumulated range failures during one segment" UWORD _CNV_A_R_LINEAR_____0_CM 1 100. 0. 65535. DISPLAY_IDENTIFIER CTR_T_PER_MAF_FRQ_RNG[0] ECU_ADDRESS 0xd000a4ac FORMAT "%5.0" /end MEASUREMENT
/begin MEASUREMENT ctr_t_per_maf_frq_rng[1] "number of accumulated range failures during one segment" UWORD _CNV_A_R_LINEAR_____0_CM 1 100. 0. 65535. DISPLAY_IDENTIFIER CTR_T_PER_MAF_FRQ_RNG[1] ECU_ADDRESS 0xd000a4ae FORMAT "%5.0" /end MEASUREMENT
/begin MEASUREMENT ctr_t_per_maf_frq_grd[0] "number of accumulated gradient failures during one segment" UWORD _CNV_A_R_LINEAR_____0_CM 1 100. 0. 65535. DISPLAY_IDENTIFIER CTR_T_PER_MAF_FRQ_GRD[0] ECU_ADDRESS 0xd000a4b0 FORMAT "%5.0" /end MEASUREMENT
/begin MEASUREMENT ctr_t_per_maf_frq_grd[1] "number of accumulated gradient failures during one segment" UWORD _CNV_A_R_LINEAR_____0_CM 1 100. 0. 65535. DISPLAY_IDENTIFIER CTR_T_PER_MAF_FRQ_GRD[1] ECU_ADDRESS 0xd000a4b2 FORMAT "%5.0" /end MEASUREMENT
/begin MEASUREMENT ctr_t_per_maf_frq_grd_1[0] "number of accumulated gradient failures during one segment for buffer 1" UWORD _CNV_A_R_LINEAR_____0_CM 1 100. 0. 65535. DISPLAY_IDENTIFIER CTR_T_PER_MAF_FRQ_GRD_1[0] ECU_ADDRESS 0xd0001368 FORMAT "%5.0" /end MEASUREMENT
/begin MEASUREMENT ctr_t_per_maf_frq_grd_1[1] "number of accumulated gradient failures during one segment for buffer 1" UWORD _CNV_A_R_LINEAR_____0_CM 1 100. 0. 65535. DISPLAY_IDENTIFIER CTR_T_PER_MAF_FRQ_GRD_1[1] ECU_ADDRESS 0xd000136a FORMAT "%5.0" /end MEASUREMENT
/begin MEASUREMENT ctr_t_per_maf_frq_grd_0[0] "number of accumulated gradient failures during one segment for buffer 0" UWORD _CNV_A_R_LINEAR_____0_CM 1 100. 0. 65535. DISPLAY_IDENTIFIER CTR_T_PER_MAF_FRQ_GRD_0[0] ECU_ADDRESS 0xd0001364 FORMAT "%5.0" /end MEASUREMENT
/begin MEASUREMENT ctr_t_per_maf_frq_grd_0[1] "number of accumulated gradient failures during one segment for buffer 0" UWORD _CNV_A_R_LINEAR_____0_CM 1 100. 0. 65535. DISPLAY_IDENTIFIER CTR_T_PER_MAF_FRQ_GRD_0[1] ECU_ADDRESS 0xd0001366 FORMAT "%5.0" /end MEASUREMENT
/begin MEASUREMENT maf_frq_kgh_sum_0[0] "accumulated mass air flow measured every sampling pulse time for buffer 0" ULONG _CNV_A_R_LINEAR_____887_CM 1 100. 0. 67108863.98437 DISPLAY_IDENTIFIER MAF_FRQ_KGH_SUM_0[0] ECU_ADDRESS 0xd00013d4 FORMAT "%12.3" /end MEASUREMENT
/begin MEASUREMENT maf_frq_kgh_sum_0[1] "accumulated mass air flow measured every sampling pulse time for buffer 0" ULONG _CNV_A_R_LINEAR_____887_CM 1 100. 0. 67108863.98437 DISPLAY_IDENTIFIER MAF_FRQ_KGH_SUM_0[1] ECU_ADDRESS 0xd00013d8 FORMAT "%12.3" /end MEASUREMENT
/begin MEASUREMENT maf_frq_kgh_sum_1[0] "accumulated mass air flow measured every sampling pulse time for buffer 1" ULONG _CNV_A_R_LINEAR_____887_CM 1 100. 0. 67108863.98437 DISPLAY_IDENTIFIER MAF_FRQ_KGH_SUM_1[0] ECU_ADDRESS 0xd00013dc FORMAT "%12.3" /end MEASUREMENT
/begin MEASUREMENT maf_frq_kgh_sum_1[1] "accumulated mass air flow measured every sampling pulse time for buffer 1" ULONG _CNV_A_R_LINEAR_____887_CM 1 100. 0. 67108863.98437 DISPLAY_IDENTIFIER MAF_FRQ_KGH_SUM_1[1] ECU_ADDRESS 0xd00013e0 FORMAT "%12.3" /end MEASUREMENT
/begin MEASUREMENT maf_frq_kgh_sum[0] "accumulated mass air flow measured every sampling pulse time" ULONG _CNV_A_R_LINEAR_____887_CM 1 100. 0. 67108863.98437 DISPLAY_IDENTIFIER MAF_FRQ_KGH_SUM[0] ECU_ADDRESS 0xd00013e4 FORMAT "%12.3" /end MEASUREMENT
/begin MEASUREMENT maf_frq_kgh_sum[1] "accumulated mass air flow measured every sampling pulse time" ULONG _CNV_A_R_LINEAR_____887_CM 1 100. 0. 67108863.98437 DISPLAY_IDENTIFIER MAF_FRQ_KGH_SUM[1] ECU_ADDRESS 0xd00013e8 FORMAT "%12.3" /end MEASUREMENT
/begin MEASUREMENT t_per_maf_frq[0] "arithmetric average of the  period time" UWORD _CNV_A_R_LINEAR_____410_CM 1 100. 0. 65535. DISPLAY_IDENTIFIER T_PER_MAF_FRQ[0] ECU_ADDRESS 0xd000a4a0 FORMAT "%5.0" /end MEASUREMENT
/begin MEASUREMENT t_per_maf_frq[1] "arithmetric average of the  period time" UWORD _CNV_A_R_LINEAR_____410_CM 1 100. 0. 65535. DISPLAY_IDENTIFIER T_PER_MAF_FRQ[1] ECU_ADDRESS 0xd000a4a2 FORMAT "%5.0" /end MEASUREMENT
/begin MEASUREMENT t_per_maf_frq_bas[0] "basic arithmetric average of the  period time" UWORD _CNV_A_R_LINEAR_____410_CM 1 100. 0. 65535. DISPLAY_IDENTIFIER T_PER_MAF_FRQ_BAS[0] ECU_ADDRESS 0xd000136c FORMAT "%5.0" /end MEASUREMENT
/begin MEASUREMENT t_per_maf_frq_bas[1] "basic arithmetric average of the  period time" UWORD _CNV_A_R_LINEAR_____410_CM 1 100. 0. 65535. DISPLAY_IDENTIFIER T_PER_MAF_FRQ_BAS[1] ECU_ADDRESS 0xd000136e FORMAT "%5.0" /end MEASUREMENT
/begin MEASUREMENT maf_frq_kgh_bas[0] "basic value of the air mass flow (freq. MAF) " UWORD _CNV_A_R_LINEAR_____215_CM 1 100. 0. 2047.96875 DISPLAY_IDENTIFIER MAF_FRQ_KGH_BAS[0] ECU_ADDRESS 0xd0001350 FORMAT "%10.5" /end MEASUREMENT
/begin MEASUREMENT maf_frq_kgh_bas[1] "basic value of the air mass flow (freq. MAF) " UWORD _CNV_A_R_LINEAR_____215_CM 1 100. 0. 2047.96875 DISPLAY_IDENTIFIER MAF_FRQ_KGH_BAS[1] ECU_ADDRESS 0xd0001352 FORMAT "%10.5" /end MEASUREMENT
/begin MEASUREMENT maf_frq_kgh_mes[0] "measured mass air flow" UWORD _CNV_A_R_LINEAR_____215_CM 1 100. 0. 2047.96875 DISPLAY_IDENTIFIER MAF_FRQ_KGH_MES[0] ECU_ADDRESS 0xd000a4a4 FORMAT "%10.5" /end MEASUREMENT
/begin MEASUREMENT maf_frq_kgh_mes[1] "measured mass air flow" UWORD _CNV_A_R_LINEAR_____215_CM 1 100. 0. 2047.96875 DISPLAY_IDENTIFIER MAF_FRQ_KGH_MES[1] ECU_ADDRESS 0xd000a4a6 FORMAT "%10.5" /end MEASUREMENT
/begin MEASUREMENT lv_ctr_t_per_maf_frq_grd[0] "failure (gradient) of the mean period time for frequency MAF sensor" UBYTE _CNV_S_2_RANGE__0___1_CM 1 100. 0. 1. DISPLAY_IDENTIFIER LV_CTR_T_PER_MAF_FRQ_GRD[0] ECU_ADDRESS 0xd00088ea BIT_MASK 0x1 /end MEASUREMENT
/begin MEASUREMENT lv_ctr_t_per_maf_frq_grd[1] "failure (gradient) of the mean period time for frequency MAF sensor" UBYTE _CNV_S_2_RANGE__0___1_CM 1 100. 0. 1. DISPLAY_IDENTIFIER LV_CTR_T_PER_MAF_FRQ_GRD[1] ECU_ADDRESS 0xd00088eb BIT_MASK 0x1 /end MEASUREMENT
/begin MEASUREMENT lv_maf_frq_seg[0] "indicates if segment number is even or odd to choose the right buffer" UBYTE _CNV_S_2_RANGE__0___1_CM 1 100. 0. 1. DISPLAY_IDENTIFIER LV_MAF_FRQ_SEG[0] ECU_ADDRESS 0xd00013ec BIT_MASK 0x1 /end MEASUREMENT
/begin MEASUREMENT lv_maf_frq_seg[1] "indicates if segment number is even or odd to choose the right buffer" UBYTE _CNV_S_2_RANGE__0___1_CM 1 100. 0. 1. DISPLAY_IDENTIFIER LV_MAF_FRQ_SEG[1] ECU_ADDRESS 0xd00013ed BIT_MASK 0x1 /end MEASUREMENT
/begin MEASUREMENT fac_cor_maf[0] "temperature dependant correction factor for measured MAF frequency signal" UWORD _CNV_A_R_LINEAR_____9_CM 1 100. 0. 1.99996948242188 DISPLAY_IDENTIFIER FAC_COR_MAF[0] ECU_ADDRESS 0xd0001370 FORMAT "%7.5" /end MEASUREMENT
/begin MEASUREMENT fac_cor_maf[1] "temperature dependant correction factor for measured MAF frequency signal" UWORD _CNV_A_R_LINEAR_____9_CM 1 100. 0. 1.99996948242188 DISPLAY_IDENTIFIER FAC_COR_MAF[1] ECU_ADDRESS 0xd0001372 FORMAT "%7.5" /end MEASUREMENT
/begin CHARACTERISTIC c_t_per_tia_pwm_nom "nominal period time of the tia sensor" VALUE 0xa080c252 _REC_VAL_20_u2 65535. _CNV_A_R_LINEAR_____410_CM 0. 65535. DISPLAY_IDENTIFIER C_T_PER_TIA_PWM_NOM FORMAT "%5.0" /end CHARACTERISTIC
/begin CHARACTERISTIC lc_inh_fac_cor_maf "inhibition switch for calculation of correction factor" VALUE 0xa080c581 _REC_VAL_20_u1 1. _CNV_A_R_LINEAR_____0_CM 0. 1. DISPLAY_IDENTIFIER LC_INH_FAC_COR_MAF FORMAT "%1.0" /end CHARACTERISTIC
/begin CHARACTERISTIC id_maf_frq_tab "conversion table for the frequency MAF sensor" CURVE 0xa08140e4 _REC_CUR_20_u2_u2 2047.96875 _CNV_A_R_LINEAR_____215_CM 0. 2047.96875 DISPLAY_IDENTIFIER ID_MAF_FRQ_TAB FORMAT "%10.5"
 /begin AXIS_DESCR COM_AXIS online_dummy _CNV_A_R_LINEAR_____410_CM 256 0. 65535. FORMAT "%5.0" AXIS_PTS_REF ldp_t_per_maf_frq_ofs /end AXIS_DESCR
/end CHARACTERISTIC
/begin MEASUREMENT t_per_maf_frq_sum[0] "arithmetic average of the period time 0" ULONG _CNV_A_R_LINEAR_____410_CM 1 100. 0. 4294967295. DISPLAY_IDENTIFIER T_PER_MAF_FRQ_SUM[0] ECU_ADDRESS 0xd000138c FORMAT "%10.0" /end MEASUREMENT
/begin MEASUREMENT t_per_maf_frq_sum[1] "arithmetic average of the period time 1" ULONG _CNV_A_R_LINEAR_____410_CM 1 100. 0. 4294967295. DISPLAY_IDENTIFIER T_PER_MAF_FRQ_SUM[1] ECU_ADDRESS 0xd0001390 FORMAT "%10.0" /end MEASUREMENT
/begin MEASUREMENT t_per_maf_frq_av[0] "arithmetic average of the period time 0" ULONG _CNV_A_R_LINEAR_____410_CM 1 100. 0. 4294967295. DISPLAY_IDENTIFIER T_PER_MAF_FRQ_AV[0] ECU_ADDRESS 0xd000139c FORMAT "%10.0" /end MEASUREMENT
/begin MEASUREMENT t_per_maf_frq_av[1] "arithmetic average of the period time 1" ULONG _CNV_A_R_LINEAR_____410_CM 1 100. 0. 4294967295. DISPLAY_IDENTIFIER T_PER_MAF_FRQ_AV[1] ECU_ADDRESS 0xd00013a0 FORMAT "%10.0" /end MEASUREMENT
/begin MEASUREMENT t_per_maf_frq_av_old[0] "arithmetic average of the period time 0" ULONG _CNV_A_R_LINEAR_____410_CM 1 100. 0. 4294967295. DISPLAY_IDENTIFIER T_PER_MAF_FRQ_AV_OLD[0] ECU_ADDRESS 0xd00013c4 FORMAT "%10.0" /end MEASUREMENT
/begin MEASUREMENT t_per_maf_frq_av_old[1] "arithmetic average of the period time 1" ULONG _CNV_A_R_LINEAR_____410_CM 1 100. 0. 4294967295. DISPLAY_IDENTIFIER T_PER_MAF_FRQ_AV_OLD[1] ECU_ADDRESS 0xd00013c8 FORMAT "%10.0" /end MEASUREMENT
/begin MEASUREMENT t_per_maf_frq_av_max[0] "arithmetic average of the period time 0" ULONG _CNV_A_R_LINEAR_____410_CM 1 100. 0. 4294967295. DISPLAY_IDENTIFIER T_PER_MAF_FRQ_AV_MAX[0] ECU_ADDRESS 0xd00013a4 FORMAT "%10.0" /end MEASUREMENT
/begin MEASUREMENT t_per_maf_frq_av_max[1] "arithmetic average of the period time 1" ULONG _CNV_A_R_LINEAR_____410_CM 1 100. 0. 4294967295. DISPLAY_IDENTIFIER T_PER_MAF_FRQ_AV_MAX[1] ECU_ADDRESS 0xd00013a8 FORMAT "%10.0" /end MEASUREMENT
/begin MEASUREMENT t_per_tia_pwm[0] "period duration of the temperature signal from HFM6 0" ULONG _CNV_A_R_LINEAR_____410_CM 1 100. 0. 4294967295. DISPLAY_IDENTIFIER T_PER_TIA_PWM[0] ECU_ADDRESS 0xd0001394 FORMAT "%10.0" /end MEASUREMENT
/begin MEASUREMENT t_per_tia_pwm[1] "period duration of the temperature signal from HFM6 1" ULONG _CNV_A_R_LINEAR_____410_CM 1 100. 0. 4294967295. DISPLAY_IDENTIFIER T_PER_TIA_PWM[1] ECU_ADDRESS 0xd0001398 FORMAT "%10.0" /end MEASUREMENT
/begin MEASUREMENT ctr_t_per_tia_pwm_sum[0] "counter value of the HFM6 temperature signal period duration 0" UWORD _CNV_A_R_LINEAR_____0_CM 1 100. 0. 65535. DISPLAY_IDENTIFIER CTR_T_PER_TIA_PWM_SUM[0] ECU_ADDRESS 0xd000a4b8 FORMAT "%5.0" /end MEASUREMENT
/begin MEASUREMENT ctr_t_per_tia_pwm_sum[1] "counter value of the HFM6 temperature signal period duration 1" UWORD _CNV_A_R_LINEAR_____0_CM 1 100. 0. 65535. DISPLAY_IDENTIFIER CTR_T_PER_TIA_PWM_SUM[1] ECU_ADDRESS 0xd000a4ba FORMAT "%5.0" /end MEASUREMENT
/begin MEASUREMENT ctr_t_per_maf_frq_sum[0] "number of periods during one sampling pulse time 0" UWORD _CNV_A_R_LINEAR_____0_CM 1 100. 0. 65535. DISPLAY_IDENTIFIER CTR_T_PER_MAF_FRQ_SUM[0] ECU_ADDRESS 0xd000a4b4 FORMAT "%5.0" /end MEASUREMENT
/begin MEASUREMENT ctr_t_per_maf_frq_sum[1] "number of periods during one sampling pulse time 1" UWORD _CNV_A_R_LINEAR_____0_CM 1 100. 0. 65535. DISPLAY_IDENTIFIER CTR_T_PER_MAF_FRQ_SUM[1] ECU_ADDRESS 0xd000a4b6 FORMAT "%5.0" /end MEASUREMENT
/begin MEASUREMENT v_fup_sum[0] "Accumulated mainfold air pressure measurements for segment number (2n-1), n=1,2,3,..." ULONG _CNV_A_R_LINEAR_____904_CM 1 100. 0. 20971519.99511 DISPLAY_IDENTIFIER V_FUP_SUM[0] ECU_ADDRESS 0xd000b9ec FORMAT "%12.3" /end MEASUREMENT
/begin MEASUREMENT v_fup_sum[1] "Accumulated mainfold air pressure measurements for segment number (2n-1), n=1,2,3,..." ULONG _CNV_A_R_LINEAR_____904_CM 1 100. 0. 20971519.99511 DISPLAY_IDENTIFIER V_FUP_SUM[1] ECU_ADDRESS 0xd000b9f0 FORMAT "%12.3" /end MEASUREMENT
/begin MEASUREMENT v_fup_sum_1[0] "Accumulated mainfold air pressure measurements for segment number (2n), n=1,2,3,..." ULONG _CNV_A_R_LINEAR_____904_CM 1 100. 0. 20971519.99511 DISPLAY_IDENTIFIER V_FUP_SUM_1[0] ECU_ADDRESS 0xd000b9f4 FORMAT "%12.3" /end MEASUREMENT
/begin MEASUREMENT v_fup_sum_1[1] "Accumulated mainfold air pressure measurements for segment number (2n), n=1,2,3,..." ULONG _CNV_A_R_LINEAR_____904_CM 1 100. 0. 20971519.99511 DISPLAY_IDENTIFIER V_FUP_SUM_1[1] ECU_ADDRESS 0xd000b9f8 FORMAT "%12.3" /end MEASUREMENT
/begin MEASUREMENT ctr_v_fup "Number of samples in buffer V_FUP_SUM" UWORD _CNV_A_R_LINEAR_____0_CM 1 100. 0. 65535. DISPLAY_IDENTIFIER CTR_V_FUP ECU_ADDRESS 0xd000a6dc FORMAT "%5.0" /end MEASUREMENT
/begin MEASUREMENT ctr_v_fup_1 "Number of samples in buffer V_FUP_SUM_1" UWORD _CNV_A_R_LINEAR_____0_CM 1 100. 0. 65535. DISPLAY_IDENTIFIER CTR_V_FUP_1 ECU_ADDRESS 0xd000a6de FORMAT "%5.0" /end MEASUREMENT
/begin MEASUREMENT v_fup[0] "LPG pressure in the fuel rail, voltage raw value (10 bits)" UWORD _CNV_A_R_LINEAR_____172_CM 1 100. 0. 4.999847 DISPLAY_IDENTIFIER V_FUP[0] ECU_ADDRESS 0xd000a6e0 FORMAT "%6.4" /end MEASUREMENT
/begin MEASUREMENT v_fup[1] "LPG pressure in the fuel rail, voltage raw value (10 bits)" UWORD _CNV_A_R_LINEAR_____172_CM 1 100. 0. 4.999847 DISPLAY_IDENTIFIER V_FUP[1] ECU_ADDRESS 0xd000a6e2 FORMAT "%6.4" /end MEASUREMENT
/begin COMPU_METHOD _CNV_A_R_LINEAR_____0_CM "" RAT_FUNC "%6.3" "-" COEFFS 0 1. 0. 0 0 1 /end COMPU_METHOD
/begin COMPU_METHOD _CNV_S_2_RANGE__0___1_CM "" TAB_VERB "%6.3" "-" COMPU_TAB_REF _CNV_S_2_RANGE__0___1 /end COMPU_METHOD
/begin COMPU_VTAB _CNV_S_2_RANGE__0___1 "" TAB_VERB 2 0 "0" 1 "1" /end COMPU_VTAB
/begin COMPU_METHOD _CNV_A_R_LINEAR_____2_CM "" RAT_FUNC "%6.3" "V" COEFFS 0 204.8 0. 0 0 1 /end COMPU_METHOD
/begin COMPU_METHOD _CNV_A_R_LINEAR_____3_CM "" RAT_FUNC "%6.3" "s" COEFFS 0 100. 0. 0 0 1 /end COMPU_METHOD
/begin COMPU_METHOD _CNV_A_R_LINEAR_____4_CM "" RAT_FUNC "%6.3" "s" COEFFS 0 10. 0. 0 0 1 /end COMPU_METHOD
/begin COMPU_METHOD _CNV_A_R_LINEAR_____5_CM "" RAT_FUNC "%6.3" "%" COEFFS 0 2.56 0. 0 0 1 /end COMPU_METHOD
/begin COMPU_METHOD _CNV_A_R_LINEAR_____6_CM "" RAT_FUNC "%6.3" "km/h" COEFFS 0 1. 0. 0 0 1 /end COMPU_METHOD
/begin COMPU_METHOD _CNV_A_R_LINEAR_____8_CM "" RAT_FUNC "%6.3" "%" COEFFS 0 655.3599999999997 0. 0 0 1 /end COMPU_METHOD
/begin COMPU_METHOD _CNV_A_R_LINEAR_____9_CM "" RAT_FUNC "%6.3" "-" COEFFS 0 32767.99999999992 0. 0 0 1 /end COMPU_METHOD
/begin COMPU_METHOD _CNV_A_R_LINEAR_____10_CM "" RAT_FUNC "%6.3" "rpm" COEFFS 0 3.125e-002 0. 0 0 1 /end COMPU_METHOD
/begin COMPU_METHOD _CNV_A_R_LINEAR_____12_CM "" RAT_FUNC "%6.3" "-" COEFFS 0 4095.999999839998 -1.280019205296412e-006 0 0 1 /end COMPU_METHOD
/begin COMPU_METHOD _CNV_A_R_LINEAR_____13_CM "" RAT_FUNC "%6.3" "µs" COEFFS 0 -1. 0. 0 0 1 /end COMPU_METHOD
/begin COMPU_METHOD _CNV_A_R_LINEAR_____14_CM "" RAT_FUNC "%6.3" "rpm" COEFFS 0 1. 0. 0 0 1 /end COMPU_METHOD
/begin COMPU_METHOD _CNV_A_R_LINEAR_____15_CM "" RAT_FUNC "%6.3" "mg/stk" COEFFS 0 0.183585313174946 0. 0 0 1 /end COMPU_METHOD
/begin COMPU_METHOD _CNV_A_R_LINEAR_____16_CM "" RAT_FUNC "%6.3" "-" COEFFS 0 127.9983874218908 1.612578109245533e-003 0 0 1 /end COMPU_METHOD
/begin COMPU_METHOD _CNV_A_R_LINEAR_____17_CM "" RAT_FUNC "%6.3" "°C" COEFFS 0 1.333333333333333 64. 0 0 1 /end COMPU_METHOD
/begin COMPU_METHOD _CNV_A_R_LINEAR_____18_CM "" RAT_FUNC "%6.3" "-" COEFFS 0 255.9983911655618 0. 0 0 1 /end COMPU_METHOD
/begin COMPU_METHOD _CNV_A_R_LINEAR_____19_CM "" RAT_FUNC "%6.3" "s" COEFFS 0 2. 0. 0 0 1 /end COMPU_METHOD
/begin COMPU_METHOD _CNV_A_R_LINEAR_____20_CM "" RAT_FUNC "%6.3" "ms" COEFFS 0 0.1 0. 0 0 1 /end COMPU_METHOD
/begin COMPU_METHOD _CNV_A_R_LINEAR_____22_CM "" RAT_FUNC "%6.3" "V" COEFFS 0 9.846168103048838 0. 0 0 1 /end COMPU_METHOD
/begin COMPU_METHOD _CNV_A_R_LINEAR_____25_CM "" RAT_FUNC "%6.3" "°C" COEFFS 0 1.333333333333333 0. 0 0 1 /end COMPU_METHOD
/begin COMPU_METHOD _CNV_A_R_LINEAR_____26_CM "" RAT_FUNC "%6.3" "°C" COEFFS 0 1. 40. 0 0 1 /end COMPU_METHOD
/begin COMPU_METHOD _CNV_A_R_LINEAR_____27_CM "" RAT_FUNC "%6.3" "hPa" COEFFS 0 12.06017666543982 0. 0 0 1 /end COMPU_METHOD
/begin COMPU_METHOD _CNV_A_R_LINEAR_____50_CM "" RAT_FUNC "%6.3" "" COEFFS 0 1. 0. 0 0 1 /end COMPU_METHOD
/begin COMPU_METHOD _CNV_A_R_LINEAR_____73_CM "" RAT_FUNC "%6.3" "bar" COEFFS 0 1. 0. 0 0 1 /end COMPU_METHOD
/begin COMPU_METHOD _CNV_A_R_LINEAR_____111_CM "" RAT_FUNC "%6.3" "mg/stk" COEFFS 0 47.18142548596112 0. 0 0 1 /end COMPU_METHOD
/begin COMPU_METHOD _CNV_A_R_LINEAR_____126_CM "" RAT_FUNC "%6.3" "-" COEFFS 0 65536.00270084133 0. 0 0 1 /end COMPU_METHOD
/begin COMPU_METHOD _CNV_A_R_LINEAR_____160_CM "" RAT_FUNC "%6.3" "Seg" COEFFS 0 1. 0. 0 0 1 /end COMPU_METHOD
/begin COMPU_METHOD _CNV_A_R_LINEAR_____172_CM "" RAT_FUNC "%6.3" "V" COEFFS 0 6553.60054017653 0. 0 0 1 /end COMPU_METHOD
/begin COMPU_METHOD _CNV_A_R_EGCP_LINEA_206_CM "" RAT_FUNC "%6.3" "V" COEFFS 0 204.8000001200018 0. 0 0 1 /end COMPU_METHOD
/begin COMPU_METHOD _CNV_A_R_LINEAR_____207_CM "" RAT_FUNC "%6.3" "V" COEFFS 0 51.2 0. 0 0 1 /end COMPU_METHOD
/begin COMPU_METHOD _CNV_A_R_LINEAR_____212_CM "" RAT_FUNC "%6.3" "%" COEFFS 0 327.68 0. 0 0 1 /end COMPU_METHOD
/begin COMPU_METHOD _CNV_A_R_LINEAR_____215_CM "" RAT_FUNC "%6.3" "kg/h" COEFFS 0 32. 0. 0 0 1 /end COMPU_METHOD
/begin COMPU_METHOD _CNV_A_R_LINEAR_____226_CM "" RAT_FUNC "%6.3" "%" COEFFS 0 10. 0. 0 0 1 /end COMPU_METHOD
/begin COMPU_METHOD _CNV_S_9_RANGE_STAT_250_CM "" TAB_VERB "%6.3" "-" COMPU_TAB_REF _CNV_S_9_RANGE_STAT_250 /end COMPU_METHOD
/begin COMPU_VTAB _CNV_S_9_RANGE_STAT_250 "" TAB_VERB 9 0 "PVS_NO_ERROR" 1 "PVS_LIH_PRED" 2 "PVS_LIH_1" 4 "PVS_LIH_2" 8 "PVS_LIH_MIN" 16 "PVS_DBL_ERROR" 32 "PVS_LIH_BLS" 64 "PVS_LIH_1_PRED" 128 "PVS_LIH_2_PRED" /end COMPU_VTAB
/begin COMPU_METHOD _CNV_A_R_LINEAR_____251_CM "" RAT_FUNC "%6.3" "V" COEFFS 0 102.4003523452984 0. 0 0 1 /end COMPU_METHOD
/begin COMPU_METHOD _CNV_A_R_LINEAR_____262_CM "" RAT_FUNC "%6.3" "Nm" COEFFS 0 0.5 0. 0 0 1 /end COMPU_METHOD
/begin COMPU_METHOD _CNV_A_R_LINEAR_____410_CM "" RAT_FUNC "%6.3" "µs" COEFFS 0 1. 0. 0 0 1 /end COMPU_METHOD
/begin COMPU_METHOD _CNV_A_R_LINEAR_____473_CM "" RAT_FUNC "%6.3" "V" COEFFS 0 35.63776976537597 0. 0 0 1 /end COMPU_METHOD
/begin COMPU_METHOD _CNV_A_R_LINEAR_____887_CM "" RAT_FUNC "%6.3" "kg/h" COEFFS 0 64.00000000000478 0. 0 0 1 /end COMPU_METHOD
/begin COMPU_METHOD _CNV_A_R_LINEAR_____904_CM "" RAT_FUNC "%6.3" "V" COEFFS 0 204.8000000000702 0. 0 0 1 /end COMPU_METHOD
/begin RECORD_LAYOUT _REC_VAL_20_u1 FNC_VALUES 1 UBYTE COLUMN_DIR DIRECT /end RECORD_LAYOUT
/begin RECORD_LAYOUT _REC_VAL_20_u2 FNC_VALUES 1 UWORD COLUMN_DIR DIRECT /end RECORD_LAYOUT
/begin RECORD_LAYOUT _REC_AXS_20_u1 NO_AXIS_PTS_X 1 UBYTE AXIS_PTS_X 2 UBYTE INDEX_INCR DIRECT /end RECORD_LAYOUT
/begin RECORD_LAYOUT _REC_CUR_20_u1_u1 FNC_VALUES 1 UBYTE COLUMN_DIR DIRECT /end RECORD_LAYOUT
/begin RECORD_LAYOUT _REC_MAP_20_u2_u2_u1 FNC_VALUES 1 UWORD COLUMN_DIR DIRECT /end RECORD_LAYOUT
/begin RECORD_LAYOUT _REC_AXS_20_u2 NO_AXIS_PTS_X 1 UWORD AXIS_PTS_X 2 UWORD INDEX_INCR DIRECT /end RECORD_LAYOUT
/begin RECORD_LAYOUT _REC_CUR_20_u2_u1 FNC_VALUES 1 UWORD COLUMN_DIR DIRECT /end RECORD_LAYOUT
/begin RECORD_LAYOUT _REC_CUR_20_u2_u2 FNC_VALUES 1 UWORD COLUMN_DIR DIRECT /end RECORD_LAYOUT
/begin FUNCTION BIO_Acquisition_of_mass_air_flow "_Acquisition of mass air flow"
 /begin DEF_CHARACTERISTIC c_t_per_max_frq_ofs c_t_per_maf_frq_max_diag c_t_per_maf_frq_min_diag c_t_per_maf_frq_grd_diag c_t_per_maf_frq_el c_t_per_maf_frq_sens c_t_per_tia_pwm_nom lc_inh_fac_cor_maf id_maf_frq_tab /end DEF_CHARACTERISTIC
 /begin OUT_MEASUREMENT lv_ctr_t_per_maf_frq_rng[0] lv_ctr_t_per_maf_frq_rng[1] lv_ctr_t_per_maf_frq_el[0] lv_ctr_t_per_maf_frq_el[1] lv_ctr_t_per_maf_frq_sens[0] lv_ctr_t_per_maf_frq_sens[1] ctr_maf_frq_kgh_sum_0[0] ctr_maf_frq_kgh_sum_0[1] ctr_maf_frq_kgh_sum_1[0] ctr_maf_frq_kgh_sum_1[1] ctr_maf_frq_kgh_sum[0] ctr_maf_frq_kgh_sum[1] ctr_t_per_maf_frq_rng_1[0] ctr_t_per_maf_frq_rng_1[1] ctr_t_per_maf_frq_rng_0[0] ctr_t_per_maf_frq_rng_0[1] ctr_t_per_maf_frq_rng[0] ctr_t_per_maf_frq_rng[1] ctr_t_per_maf_frq_grd[0] ctr_t_per_maf_frq_grd[1] ctr_t_per_maf_frq_grd_1[0] ctr_t_per_maf_frq_grd_1[1] ctr_t_per_maf_frq_grd_0[0] ctr_t_per_maf_frq_grd_0[1] maf_frq_kgh_sum_0[0] maf_frq_kgh_sum_0[1] maf_frq_kgh_sum_1[0] maf_frq_kgh_sum_1[1] maf_frq_kgh_sum[0] maf_frq_kgh_sum[1] t_per_maf_frq[0] t_per_maf_frq[1] t_per_maf_frq_bas[0] t_per_maf_frq_bas[1] maf_frq_kgh_bas[0] maf_frq_kgh_bas[1] maf_frq_kgh_mes[0] maf_frq_kgh_mes[1] lv_ctr_t_per_maf_frq_grd[0] lv_ctr_t_per_maf_frq_grd[1] lv_maf_frq_seg[0] lv_maf_frq_seg[1] fac_cor_maf[0] fac_cor_maf[1] t_per_maf_frq_sum[0] t_per_maf_frq_sum[1] t_per_maf_frq_av[0] t_per_maf_frq_av[1] t_per_maf_frq_av_old[0] t_per_maf_frq_av_old[1] t_per_maf_frq_av_max[0] t_per_maf_frq_av_max[1] t_per_tia_pwm[0] t_per_tia_pwm[1] ctr_t_per_tia_pwm_sum[0] ctr_t_per_tia_pwm_sum[1] ctr_t_per_maf_frq_sum[0] ctr_t_per_maf_frq_sum[1] /end OUT_MEASUREMENT
/end FUNCTION
/begin FUNCTION BIO_Acquisition_of_fuel_pressure "Acquisition of fuel pressure"
 /begin OUT_MEASUREMENT v_fup_sum[0] v_fup_sum[1] v_fup_sum_1[0] v_fup_sum_1[1] ctr_v_fup ctr_v_fup_1 v_fup[0] v_fup[1] /end OUT_MEASUREMENT
/end FUNCTION
/begin FUNCTION C_A_DIA ""
 /begin SUB_FUNCTION DIA_Mass_air_flow_meter DIA_Intake_air_temperature_sensor DIA_IVVT_diagnosis DIA_Fuel_pump_relay_RLY_EFP DIA_Ambient_pressure_sensor DIA_Oil_temperature_sensor_TOIL DIA_Knock_sensor_diagnosis DIA_Vehicle_speed_signal_diagnosis DIA_Ignition_system_diagnosis DIA_Throttle_position_sensor_diagnosis DIA_ETC_driver_diagnosis DIA_Generator_diagnosis DIA_Air_Condition_Compressor_Control_Relay_Diagnosis__RLY_ACCOUT_ DIA_Main_Relay_Diagnosis__RLY_MAIN_ DIA_Idle_Speed_Control_Diagnosis DIA_CAN_diagnosis DIA_Multifunctional_steering_wheel__MSW_ DIA_Pedal_value_sensor_diagnosis DIA_Brake_light_switch_diagnosis__BLS_BTS_ DIA_Idle_Speed_Actuator_Diagnosis DIA_Engine_roughness_idle_diagnosis DIA_Immobilizer_signal_diagnosis DIA_Exhaust_flap_diagnosis DIA_Anti_bounce_algorithm DIA_Torque_Request_for_Safety_Diagnosis DIA_E_box_cooling_fan_diagnosis DIA_ECU_temperature_sensor_diagnosis DIA_Tank_leakage_pump_diagnosis DIA_SOF_diagnosis DIA_TPS___ETC_Limp_Home_Manager DIA_Diagnosis_Oil_temperature_and_level_sensor___DTOENS_ DIA_BSD_Diagnosis DIA_Starter_Output_Diagnosis DIA_Oil_pressure_switch_diagnosis DIA_CAN_diagnosis_for_EFP_control DIA_ETC_Actuator_diagnosis_and_Adaptation DIA_Electric_solenoid_valve_diagnosis DIA_AMT_intervention_plausibility DIA_GS_intervention_plausibility_Diagnosis DIA_Distance_cruise_control_diagnosis DIA_Electronically_controlled_radiator_shutter_diagnosis DIA_Upstream_oxygen_sensor_signal_monitoring DIA_CAN_diagnosis_for_NOX_control DIA_NOx_Sensor_Diagnosis___OBD_I DIA_Clutch_switch_diagnosis DIA_ECU_selftest DIA_SPI_Bus_diagnosis DIA_Automatic_gear_shift_signal_diagnosis DIA_Diagnosis_Electrical_Controlled_Waterpump DIA_IS_Control_Diag DIA_IS_Control_Diag__AI DIA_Fuel_reserve_diagnosis DIA_Vima_actuator_feedback_diagnosis DIA_Ambient_temperature_sensor DIA_Engine_Off_Duration_diagnosis DIA_LDM_diagnosis__LV_ERR_LDM_ DIA_Fuel_Pressure_Actuator_Diag DIA_Fuel_Pressure_Sensor_Diag DIA_Fuel_Pressure_Actuator_Diag_AI DIA_Fuel_Pressure_Sensor_Diag_AI DIA_FUP_EFP_Sensor_Diag__AI DIA_FUP_EFP_Sensor_Diag Energy_spare_mode_diag DIA_Electric_recirculation_flap_diagnosis DIA_Electric_waste_gate_diagnosis DIA_PUT_sensor_diagnosis DIA_PUT_Charge_Air_Pressure_Sensor_Diagnosis DIA_Oil_pressure_sensor_diagnosis DIA_Electrical_diagnosis_of_oil_pressure_actuator DIA_TEG_sensor_diagnosis /end SUB_FUNCTION
/end FUNCTION
/begin FUNCTION DIA_Mass_air_flow_meter "_Mass air flow meter"
 /begin DEF_CHARACTERISTIC c_ratio_t_per_maf_frq_grd_diag c_ratio_t_per_maf_frq_rng_diag c_n_thd_maf_frq_rng_min c_fac_maf_rel_thd_maf_rng_min c_ctr_tcc_t_per_maf_frq_el /end DEF_CHARACTERISTIC
 /begin OUT_MEASUREMENT ctr_tcc_t_per_maf_frq_el[0] ctr_tcc_t_per_maf_frq_el[1] lv_err_maf_frq_el_0 lv_err_maf_frq_el_1 lv_err_maf_frq_grd_0 lv_err_maf_frq_grd_1 lv_err_maf_frq_rng_0 lv_err_maf_frq_rng_1 lv_err_maf lv_inh_diag_maf lv_maf_bls_diag state_rbm_maf /end OUT_MEASUREMENT
/end FUNCTION
/begin FUNCTION DIA_Intake_air_temperature_sensor "_Intake air temperature sensor"
 /begin DEF_CHARACTERISTIC c_tia_dif_diag c_tia_plaus_dif_err c_t_vs_min_tia_plaus_diag c_vs_min_tia_plaus_diag c_tam_min_tia_plaus_diag c_tco_min_is_cdn_tia_plaus id_t_is_min_tia_plaus_diag ldp_tam_tia_plaus_diag c_vs_max_is_cdn_tia_plaus c_ctr_is_cdn_tia_plaus c_maf_min_int_cdn_tia_plaus c_tam_max_tia_plaus_diag c_t_load_is_cdn_tia_plaus c_t_dly_tia_diag c_t_dly_tia_thr_diag c_vp_tia_max_diag c_vp_tia_min_diag c_vp_tia_thr_max_diag c_vp_tia_thr_min_diag /end DEF_CHARACTERISTIC
 /begin OUT_MEASUREMENT lv_err_tia_plaus tia_plaus_min_diag tia_dif_diag t_vs_tia_plaus_diag t_is_tia_plaus_diag lv_dif_cdn_tia_plaus_diag lv_vs_cdn_tia_plaus_diag lv_is_cdn_tia_plaus_diag tia_plaus_max_diag tia_dif_max_diag tia_dif_min_diag ctr_is_cdn_tia_plaus t_load_is_cdn_tia_plaus lv_load_is_cdn_tia_plaus lv_inh_diag_tia_plaus state_rbm_tia_plaus lv_err_tia_thr_el_2 lv_err_tia_thr_el_1 lv_err_tia_el_1 lv_err_tia_el_2 lv_err_tia_thr lv_err_tia /end OUT_MEASUREMENT
/end FUNCTION
/begin FUNCTION DIA_IVVT_diagnosis "_IVVT diagnosis"
 /begin OUT_MEASUREMENT lv_err_mec_ivvt_in_1 lv_err_mec_ivvt_in_2 lv_err_mec_ivvt_ex lv_err_ivvt /end OUT_MEASUREMENT
/end FUNCTION
/begin FUNCTION DIA_Fuel_pump_relay_RLY_EFP "_Fuel pump relay RLY_EFP" /end FUNCTION
/begin FUNCTION DIA_Ambient_pressure_sensor "_Ambient pressure sensor" /begin DEF_CHARACTERISTIC c_amp_ref c_v_amp_max_diag c_v_amp_min_diag /end DEF_CHARACTERISTIC /end FUNCTION
/begin FUNCTION DIA_Oil_temperature_sensor_TOIL "_Oil temperature sensor TOIL" /begin DEF_CHARACTERISTIC c_toil_chk_ctl_1 c_toil_chk_ctl_2 /end DEF_CHARACTERISTIC /end FUNCTION
/begin FUNCTION DIA_Knock_sensor_diagnosis "_Knock sensor diagnosis"
 /begin DEF_CHARACTERISTIC c_nl_min_diag c_dyw_min_knks_diag c_v_int_knks_diag c_cycnr_knks_diag c_nl_max_diag c_maf_min_knks_diag c_mff_min_knks_diag c_n_min_knks_diag c_abc_max_knks c_abc_inc_knks /end DEF_CHARACTERISTIC
 /begin OUT_MEASUREMENT dyw_knks_diag[0] dyw_knks_diag[1] dyw_knks_diag[2] dyw_knks_diag[3] cycnr_dyw_knks_diag[0] cycnr_dyw_knks_diag[1] cycnr_dyw_knks_diag[2] cycnr_dyw_knks_diag[3] v_int_knks_diag[0] v_int_knks_diag[1] v_int_knks_diag[2] v_int_knks_diag[3] cycnr_int_knks_diag[0] cycnr_int_knks_diag[1] cycnr_int_knks_diag[2] cycnr_int_knks_diag[3] lv_err_knks_1 lv_err_knks_2 lv_err_knks_3 lv_err_knks_4 lv_inh_diag_knks /end OUT_MEASUREMENT
/end FUNCTION
/begin FUNCTION DIA_Vehicle_speed_signal_diagnosis "_Vehicle speed signal diagnosis"
 /begin DEF_CHARACTERISTIC c_maf_vs_min_diag_mt c_maf_vs_min_diag_at c_n_vs_min_diag_mt c_n_vs_min_diag_at c_t_vs_min_diag c_tq_av_vs_min_diag_mt c_tq_av_vs_min_diag_at /end DEF_CHARACTERISTIC
 /begin OUT_MEASUREMENT t_vs_diag t_vs_end_diag lv_err_vs_plaus lv_err_vs state_rbm_vs_plaus /end OUT_MEASUREMENT
/end FUNCTION
/begin FUNCTION DIA_Ignition_system_diagnosis "_Ignition system diagnosis" /end FUNCTION
/begin FUNCTION DIA_Throttle_position_sensor_diagnosis "_Throttle position sensor diagnosis" /end FUNCTION
/begin FUNCTION DIA_ETC_driver_diagnosis "_ETC driver diagnosis" /end FUNCTION
/begin FUNCTION DIA_Generator_diagnosis "_Generator diagnosis"
 /begin DEF_CHARACTERISTIC c_t_ast_gen_diag_off c_t_ast_gen_diag_on c_vb_mes_gen_diag_thd c_vb_mes_gen_diag_thd_max c_dffgen_thd_max c_dffgen_thd_min c_perc_gen_diag_vb_max /end DEF_CHARACTERISTIC
 /begin OUT_MEASUREMENT lv_err_gen ctr_diag_gen_diag ctr_ref_gen_diag lv_err_gen_diag /end OUT_MEASUREMENT
/end FUNCTION
/begin FUNCTION DIA_Air_Condition_Compressor_Control_Relay_Diagnosis__RLY_ACCOUT_ "_Air Condition Compressor Control Relay Diagnosis (RLY_ACCOUT)"
 /begin OUT_MEASUREMENT cdn_diag_rly_accout lv_err_rly_accout lv_inh_diag_rly_accout /end OUT_MEASUREMENT
/end FUNCTION
/begin FUNCTION DIA_Main_Relay_Diagnosis__RLY_MAIN_ "_Main Relay Diagnosis (RLY_MAIN)"
 /begin DEF_CHARACTERISTIC c_t_rly_main_diag c_v_igk_rly_main_diag c_t_dly_rly_main_diag c_t_predrive_dly_max c_vb_rly_main_diag c_vb_rly_main_dly_diag /end DEF_CHARACTERISTIC
 /begin OUT_MEASUREMENT t_rly_main_diag t_dly_rly_main_diag lv_err_bn_veh_mod lv_err_rly_main_dly lv_err_rly_main lv_rly_main_dly_err lv_diag_end_rly_main_dly /end OUT_MEASUREMENT
/end FUNCTION
/begin FUNCTION DIA_Idle_Speed_Control_Diagnosis "_Idle Speed Control Diagnosis"
 /begin DEF_CHARACTERISTIC c_crlc_maf_sp_tqi_diag_isc c_maf_sp_tqi_dyw_diag_isc c_t_dly_maf_sp_tqi_diag_isc c_maf_sp_tqi_dyw_diag_isc_cst c_crlc_maf_sp_tqi_diag_isc_cst /end DEF_CHARACTERISTIC
 /begin OUT_MEASUREMENT lv_inh_diag_isc lv_inh_diag_rbm_isc state_rbm_isc maf_sp_tqi_mmv_diag_isc lv_maf_sp_tqi_dyw_diag_isc t_dly_maf_sp_tqi_diag_isc state_rbm_isc_cst /end OUT_MEASUREMENT
/end FUNCTION
/begin FUNCTION DIA_CAN_diagnosis "_CAN diagnosis" /begin OUT_MEASUREMENT lv_err_can_boff lv_err_locan_boff /end OUT_MEASUREMENT /end FUNCTION
/begin FUNCTION DIA_Multifunctional_steering_wheel__MSW_ "_Multifunctional steering wheel (MSW)" /begin DEF_CHARACTERISTIC c_vb_min_msw_diag /end DEF_CHARACTERISTIC /end FUNCTION
/begin FUNCTION DIA_Pedal_value_sensor_diagnosis "_Pedal value sensor diagnosis"
 /begin DEF_CHARACTERISTIC c_v_pvs_min_diag_2 c_t_is_pvs_err ip_pvs_ratio_hys c_pvs_bls_bts_plaus_conf c_vcc_dif_pvs c_v_pvs_min_diag_1 c_v_pvs_min_diag_min_1 c_v_pvs_min_diag_min_2 c_v_pvs_max_diag_1 c_v_pvs_max_diag_2 ldp_vs_ip_pv_av_max_brake ldp_brake_prs_ip_pv_av_max ip_pv_av_max_brake_vs ip_pv_av_max_brake_prs lc_brake_prs c_t_thd_vs_brake_max c_pv_av_brake_max c_pv_av_brake_min c_vs_brake_max c_vs_brake_min c_vs_max_brake c_n_max_brake /end DEF_CHARACTERISTIC
 /begin OUT_MEASUREMENT lv_err_pvs_1 lv_dyn_lim_1_act lv_dyn_lim_2_act state_pvs_diag lv_n_sp_is_lih_act lv_err_pvs lv_det_not_plaus_act lv_pvs_bls_not_plaus_act ctr_pvs_bls_not_plaus_act lv_err_v_ref_2 lv_err_pvs_double lv_err_v_ref_1 lv_err_pvs_bls_not_plaus lv_det_err_pvs ctr_c_t_vs_brake_max pv_av_max_brake_det lv_pv_av_lim_act lv_cdn_vs_vld_1 lv_cdn_vs_vld_2 lv_err_pvs_2 lv_err_pvs_ratio v_pvs_1 v_pvs_2 vcc_pvs_1 vcc_pvs_2 ctr_diag_rly_main_dly ctr_end_diag_rly_main_dly /end OUT_MEASUREMENT
/end FUNCTION
/begin FUNCTION DIA_Brake_light_switch_diagnosis__BLS_BTS_ "_Brake light switch diagnosis (BLS/BTS)" /begin DEF_CHARACTERISTIC c_t_bts_plaus_max /end DEF_CHARACTERISTIC
 /begin OUT_MEASUREMENT lv_brake_det lv_err_bls_plaus lv_err_im_bls_plaus lv_err_im_bts_plaus lv_bts_edge lv_bls_edge t_bts_plaus lv_im_bls lv_im_bts /end OUT_MEASUREMENT
/end FUNCTION
/begin FUNCTION DIA_Idle_Speed_Actuator_Diagnosis "_Idle Speed Actuator Diagnosis" /end FUNCTION
/begin FUNCTION DIA_Engine_roughness_idle_diagnosis "_Engine roughness idle diagnosis"
 /begin DEF_CHARACTERISTIC ip_thd_is_er_diag__n__maf ip_fac_thd_is_er_diag__tco c_crlc_is_er_diag /end DEF_CHARACTERISTIC
 /begin OUT_MEASUREMENT er_mmv_is_diag[0] er_mmv_is_diag[1] er_mmv_is_diag[2] er_mmv_is_diag[3] er_mmv_is_diag[4] er_mmv_is_diag[5] er_mmv_is_diag[6] er_mmv_is_diag[7] /end OUT_MEASUREMENT
/end FUNCTION
/begin FUNCTION DIA_Immobilizer_signal_diagnosis "_Immobilizer signal diagnosis"
 /begin OUT_MEASUREMENT state_imob_client lv_imob_act ctr_imob_tout ctr_imob_tout_fail inh_iv_imob ctr_imob_auth imob_md5_result[0] imob_md5_result[1] imob_md5_result[2] imob_md5_result[3] imob_md5_result[4] imob_md5_result[5] imob_md5_result[6] imob_md5_result[7] imob_md5_result[8] imob_md5_result[9] imob_md5_result[10] imob_md5_result[11] imob_md5_result[12] imob_md5_result[13] imob_md5_result[14] imob_md5_result[15] lv_lock_imob imob_config_ews4[0] imob_config_ews4[1] imob_config_ews4[2] imob_config_ews4[3] imob_nr_vld_k_ews4 lv_err_imob_0 lv_err_imob_1 lv_err_imob_2 lv_err_imob_3 cdn_diag_imob_1 cdn_diag_imob_3 /end OUT_MEASUREMENT
/end FUNCTION
/begin FUNCTION DIA_Exhaust_flap_diagnosis "_Exhaust flap diagnosis" /begin OUT_MEASUREMENT cdn_diag_ef lv_err_ef lv_inh_diag_ef /end OUT_MEASUREMENT /end FUNCTION
/end MODULE
/end PROJECT
