ASAP2_VERSION 1 41
/begin PROJECT MSD85 "Spray Guided DI-System with Piezo Injectors for 8-Cylinder"
/begin HEADER "_default_HeaderComment" PROJECT_NO _91 /end HEADER
/begin MODULE _default_ModuleName "_default_ModuleLongIdentifier"
/begin MOD_COMMON "_default_ModCommonComment" DEPOSIT ABSOLUTE BYTE_ORDER MSB_LAST ALIGNMENT_BYTE 1 ALIGNMENT_WORD 2 ALIGNMENT_LONG 2 ALIGNMENT_FLOAT32_IEEE 2 ALIGNMENT_FLOAT64_IEEE 4 /end MOD_COMMON
/begin MEASUREMENT A_quer_abs "Absolutwert Querbeschleunigung" SWORD _CNV_R_R_Def_a_sw_b_549_CM 1 100. -64. 63.998 DISPLAY_IDENTIFIER A_QUER_ABS ECU_ADDRESS 0xd000e1f4 FORMAT "%7.2" /end MEASUREMENT
/begin MEASUREMENT Cnt_ar_aus "" UBYTE _CNV_R_R_Def_dez_sl_551_CM 1 100. 0. 255. DISPLAY_IDENTIFIER CNT_AR_AUS ECU_ADDRESS 0xd000e271 FORMAT "%3.0" /end MEASUREMENT
/begin MEASUREMENT Dm_jmot "Deltamoment aus Motormassenträgheitsmoment für Automatikgetriebe" SWORD _CNV_R_R_Def_m_sw_q_554_CM 1 100. -3276.8 3276.7 DISPLAY_IDENTIFIER DM_JMOT ECU_ADDRESS 0xd000e1fe FORMAT "%7.2" /end MEASUREMENT
/begin MEASUREMENT Dmdk "Deltamoment zur Aufregelung nach Anschlussdrehzahlregelung" SWORD _CNV_R_R_Def_m_sw_q_554_CM 1 100. -3276.8 3276.7 DISPLAY_IDENTIFIER DMDK ECU_ADDRESS 0xd000e2be FORMAT "%7.2" /end MEASUREMENT
/begin MEASUREMENT Dmdk_wunsch "Delta zwischen Mdk_wunsch und Moment zur Anschlussdrehzahlregelung" SWORD _CNV_R_R_Def_m_sw_q_554_CM 1 100. -3276.8 3276.7 DISPLAY_IDENTIFIER DMDK_WUNSCH ECU_ADDRESS 0xd000e2b8 FORMAT "%7.2" /end MEASUREMENT
/begin MEASUREMENT Dmdk_wunsch_l "Delta Mdk_wunsch_l-Mdk_wunsch" SWORD _CNV_R_R_Def_m_sw_q_554_CM 1 100. -3276.8 3276.7 DISPLAY_IDENTIFIER DMDK_WUNSCH_L ECU_ADDRESS 0xd000e200 FORMAT "%7.2" /end MEASUREMENT
/begin MEASUREMENT Dmdk_wunsch_min "Delta Mdk_wunsch_l-Mdk_min" SWORD _CNV_R_R_Def_m_sw_q_554_CM 1 100. -3276.8 3276.7 DISPLAY_IDENTIFIER DMDK_WUNSCH_MIN ECU_ADDRESS 0xd000e202 FORMAT "%7.2" /end MEASUREMENT
/begin MEASUREMENT Dmdkdp "wirksamer Dashpotmomentengradient" SWORD _CNV_R_R_Def_m_sw_q_554_CM 1 100. -3276.8 3276.7 DISPLAY_IDENTIFIER DMDKDP ECU_ADDRESS 0xd000e204 FORMAT "%7.2" /end MEASUREMENT
/begin MEASUREMENT Dmdklsd "wirksamer Lastschlagdämpfungsmomentengradient" SWORD _CNV_R_R_Def_m_sw_q_554_CM 1 100. -3276.8 3276.7 DISPLAY_IDENTIFIER DMDKLSD ECU_ADDRESS 0xd000e206 FORMAT "%7.2" /end MEASUREMENT
/begin MEASUREMENT Dmdp1 "Dashpotmomentengradient Bereich 1" SWORD _CNV_R_R_Def_m_sw_q_554_CM 1 100. -3276.8 3276.7 DISPLAY_IDENTIFIER DMDP1 ECU_ADDRESS 0xd000e208 FORMAT "%7.2" /end MEASUREMENT
/begin MEASUREMENT Dmdp2 "Dashpotmomentengradient Bereich 2" SWORD _CNV_R_R_Def_m_sw_q_554_CM 1 100. -3276.8 3276.7 DISPLAY_IDENTIFIER DMDP2 ECU_ADDRESS 0xd000e20a FORMAT "%7.2" /end MEASUREMENT
/begin MEASUREMENT Dmdp3 "Dashpotmomentengradient Bereich 3" SWORD _CNV_R_R_Def_m_sw_q_554_CM 1 100. -3276.8 3276.7 DISPLAY_IDENTIFIER DMDP3 ECU_ADDRESS 0xd000e20c FORMAT "%7.2" /end MEASUREMENT
/begin MEASUREMENT Dmdpoff "Deltamoment Dashpotende" SWORD _CNV_R_R_Def_m_sw_q_554_CM 1 100. -3276.8 3276.7 DISPLAY_IDENTIFIER DMDPOFF ECU_ADDRESS 0xd000e20e FORMAT "%7.2" /end MEASUREMENT
/begin MEASUREMENT Dmdpon "Deltamoment Dashpotauslösung" SWORD _CNV_R_R_Def_m_sw_q_554_CM 1 100. -3276.8 3276.7 DISPLAY_IDENTIFIER DMDPON ECU_ADDRESS 0xd000e210 FORMAT "%7.2" /end MEASUREMENT
/begin MEASUREMENT Dmls1 "Lastschlagdämpfungsmomentengradient Bereich 1" SWORD _CNV_R_R_Def_m_sw_q_554_CM 1 100. -3276.8 3276.7 DISPLAY_IDENTIFIER DMLS1 ECU_ADDRESS 0xd000e212 FORMAT "%7.2" /end MEASUREMENT
/begin MEASUREMENT Dmls2 "Lastschlagdämpfungsmomentengradient Bereich 2" SWORD _CNV_R_R_Def_m_sw_q_554_CM 1 100. -3276.8 3276.7 DISPLAY_IDENTIFIER DMLS2 ECU_ADDRESS 0xd000e214 FORMAT "%7.2" /end MEASUREMENT
/begin MEASUREMENT Dmls3 "Lastschlagdämpfungsmomentengradient Bereich 3" SWORD _CNV_R_R_Def_m_sw_q_554_CM 1 100. -3276.8 3276.7 DISPLAY_IDENTIFIER DMLS3 ECU_ADDRESS 0xd000e216 FORMAT "%7.2" /end MEASUREMENT
/begin MEASUREMENT Dmls3f "Lastschlagdämpfungsmomentengradient Bereich 3 vor min-Auswahl" SWORD _CNV_R_R_Def_m_sw_q_554_CM 1 100. -3276.8 3276.7 DISPLAY_IDENTIFIER DMLS3F ECU_ADDRESS 0xd000e218 FORMAT "%7.2" /end MEASUREMENT
/begin MEASUREMENT Dmlsdoff "Deltamoment Lastschlagdämpfungsende" SWORD _CNV_R_R_Def_m_sw_q_554_CM 1 100. -3276.8 3276.7 DISPLAY_IDENTIFIER DMLSDOFF ECU_ADDRESS 0xd000e21a FORMAT "%7.2" /end MEASUREMENT
/begin MEASUREMENT Dmlsdon "Deltamoment Lastschlagdämpfungsauslösung" SWORD _CNV_R_R_Def_m_sw_q_554_CM 1 100. -3276.8 3276.7 DISPLAY_IDENTIFIER DMLSDON ECU_ADDRESS 0xd000e21c FORMAT "%7.2" /end MEASUREMENT
/begin MEASUREMENT Dn_gang "Delta Anschlussdrehzahl" SWORD _CNV_R_R_Def_n_sw_q_595_CM 1 100. -32768. 32767. DISPLAY_IDENTIFIER DN_GANG ECU_ADDRESS 0xd000e2c8 FORMAT "%5.0" /end MEASUREMENT
/begin MEASUREMENT Dnkw_reg "Regelabweichung Anschlussdrehzahlregler" SWORD _CNV_R_R_Def_n_sw_q_595_CM 1 100. -32768. 32767. DISPLAY_IDENTIFIER DNKW_REG ECU_ADDRESS 0xd000e2c4 FORMAT "%5.0" /end MEASUREMENT
/begin MEASUREMENT Dpsfaktd "Faktor Deltasaugrohrdruck UGD-TD-GD" UBYTE _CNV_R_R_Def_f_ub_b_553_CM 1 100. 0. 0.996 DISPLAY_IDENTIFIER DPSFAKTD ECU_ADDRESS 0xd000e252 /end MEASUREMENT
/begin MEASUREMENT Dzw_krkorll "Deltazündwinkel Klopfregelung LL" SWORD _CNV_R_R_Def_zw_sw__604_CM 1 100. -50. 60. DISPLAY_IDENTIFIER DZW_KRKORLL ECU_ADDRESS 0xd000e09e FORMAT "%6.1" /end MEASUREMENT
/begin MEASUREMENT Dzw_krkorlls "Deltazündwinkel Klopfregelung LL spät" SWORD _CNV_R_R_Def_zw_sw__607_CM 1 100. -64. 63.998 DISPLAY_IDENTIFIER DZW_KRKORLLS ECU_ADDRESS 0xd000e0a2 FORMAT "%8.3" /end MEASUREMENT
/begin MEASUREMENT Dzw_ldkr "Spätstellung d. Klopfregelung im Turbobetrieb" SWORD _CNV_R_R_Def_zw_sw__604_CM 1 100. -3276.8 3276.7 DISPLAY_IDENTIFIER DZW_LDKR ECU_ADDRESS 0xc0000de4 FORMAT "%6.1" /end MEASUREMENT
/begin MEASUREMENT Dzw_ldkrstat "Spätstellung d. Klopfregelung im Turbobetrieb - stat. Anteil" SWORD _CNV_R_R_Def_zw_sw__604_CM 1 100. -3276.8 3276.7 DISPLAY_IDENTIFIER DZW_LDKRSTAT ECU_ADDRESS 0xc00047ac FORMAT "%6.1" /end MEASUREMENT
/begin MEASUREMENT Eta_res "Wirkungsgrad angeforderte Momentenreserve" SWORD _CNV_R_R_Def_eta_sw_606_CM 1 100. 0. 100. DISPLAY_IDENTIFIER ETA_RES ECU_ADDRESS 0xd000dd72 FORMAT "%8.3" /end MEASUREMENT
/begin MEASUREMENT Eta_zw_minres "min Wirkungsgrad der Momentenreserve" SWORD _CNV_R_R_Def_eta_sw_606_CM 1 100. 0. 100. DISPLAY_IDENTIFIER ETA_ZW_MINRES ECU_ADDRESS 0xd000dd5e FORMAT "%8.3" /end MEASUREMENT
/begin MEASUREMENT F_etawan "Wirkungsgrad Wandler" UWORD _CNV_R_R_Def_f_uw_b_590_CM 1 100. 0. 1.9999 DISPLAY_IDENTIFIER F_ETAWAN ECU_ADDRESS 0xd000e246 FORMAT "%14.5" /end MEASUREMENT
/begin MEASUREMENT F_filtbp "Momenteneingriff der AR rausrampen" UBYTE _CNV_R_R_Def_f_ub_b_619_CM 1 100. 0. 1. DISPLAY_IDENTIFIER F_FILTBP ECU_ADDRESS 0xd000e273 /end MEASUREMENT
/begin MEASUREMENT F_lamx_fp "Verhältnis idealer zu realer Luftaufwand" UWORD _CNV_R_R_Def_f_uw_b_590_CM 1 100. 0. 1.9999 DISPLAY_IDENTIFIER F_LAMX_FP ECU_ADDRESS 0xd000dc30 FORMAT "%14.5" /end MEASUREMENT
/begin MEASUREMENT F_md_fhot "Korrekturfaktor für Moment/Füllung aus Höhe und Temperatur" UWORD _CNV_R_R_Def_f_uw_b_590_CM 1 100. 0. 1.9999 DISPLAY_IDENTIFIER F_MD_FHOT ECU_ADDRESS 0xd000dc2a FORMAT "%14.5" /end MEASUREMENT
/begin MEASUREMENT F_mdivl "Korrektur Md über La bei VL" SWORD _CNV_R_R_Def_f_sw_b_592_CM 1 100. -8. 7.9997 DISPLAY_IDENTIFIER F_MDIVL ECU_ADDRESS 0xd000dc4e FORMAT "%9.4" /end MEASUREMENT
/begin MEASUREMENT F_rfmx "Faktor Rf-Eingriff" UWORD _CNV_R_R_Def_f_uw_b_590_CM 1 100. 0. 1.9999 DISPLAY_IDENTIFIER F_RFMX ECU_ADDRESS 0xd000dc50 FORMAT "%14.5" /end MEASUREMENT
/begin MEASUREMENT F_rfv_lamx "Faktor: Rf/Rfv_vl_max" UWORD _CNV_R_R_Def_f_uw_b_621_CM 1 100. 0. 255.996 DISPLAY_IDENTIFIER F_RFV_LAMX ECU_ADDRESS 0xd000dc38 FORMAT "%8.3" /end MEASUREMENT
/begin MEASUREMENT F_rfvkor_dash "Faktor um Vanos-Sollwerte auf Rf_min (1) überzublenden" UBYTE _CNV_R_R_Def_f_ub_b_553_CM 1 100. 0. 0.996 DISPLAY_IDENTIFIER F_RFVKOR_DASH ECU_ADDRESS 0xd000e1fc /end MEASUREMENT
/begin MEASUREMENT F_vl_aus "Lastfaktor für Volllastabschaltung" UWORD _CNV_R_R_Def_f_sw_b_616_CM 1 100. 0. 3.9999 DISPLAY_IDENTIFIER F_VL_AUS ECU_ADDRESS 0xd000dc32 FORMAT "%14.5" /end MEASUREMENT
/begin MEASUREMENT Fdmfbt "Faktor dynamische Überblendung UGD-TD-GD" UBYTE _CNV_R_R_Def_f_ub_b_553_CM 1 100. 0. 0.996 DISPLAY_IDENTIFIER FDMFBT ECU_ADDRESS 0xd000e253 /end MEASUREMENT
/begin MEASUREMENT Flsdpwgl "Faktor Fahrpedaleinfluß auf Füllung bei Lastschlagdämpfung" UWORD _CNV_R_R_Def_f_uw_b_621_CM 1 100. 0. 255.996 DISPLAY_IDENTIFIER FLSDPWGL ECU_ADDRESS 0xd000e248 FORMAT "%8.3" /end MEASUREMENT
/begin MEASUREMENT Frfmxkrld "Faktor f. Rfmax-Reduzierung" UWORD _CNV_R_R_Def_f_uw_b_590_CM 1 100. 0. 1.9999 DISPLAY_IDENTIFIER FRFMXKRLD ECU_ADDRESS 0xc0000dea FORMAT "%14.5" /end MEASUREMENT
/begin MEASUREMENT Frfmxtald "Faktor max. Fuellung" UWORD _CNV_R_R_Def_f_uw_b_590_CM 1 100. 0. 1.9999 DISPLAY_IDENTIFIER FRFMXTALD ECU_ADDRESS 0xc0000dec FORMAT "%14.5" /end MEASUREMENT
/begin MEASUREMENT Frfmxtmld "Faktor max Fuellung" UWORD _CNV_R_R_Def_f_uw_b_590_CM 1 100. 0. 1.9999 DISPLAY_IDENTIFIER FRFMXTMLD ECU_ADDRESS 0xc0000dee FORMAT "%14.5" /end MEASUREMENT
/begin MEASUREMENT Ftrq_wfl_dp "Faktor Verhältnis Moment Füllung zu Zündung bei Dashpot" UWORD _CNV_R_R_Def_f_uw_b_621_CM 1 100. 0. 255.996 DISPLAY_IDENTIFIER FTRQ_WFL_DP ECU_ADDRESS 0xd000e24a FORMAT "%8.3" /end MEASUREMENT
/begin MEASUREMENT Fupsrfatl_k "Faktor Saugrohrdruck in Fuellung (Nichlin.-Bereich) - Turbo - Betrieb" UWORD _CNV_R_R_Def_f_uw_b_629_CM 1 100. 0. 0.299995422363281 DISPLAY_IDENTIFIER FUPSRFATL_K ECU_ADDRESS 0xc0000df0 FORMAT "%14.6" /end MEASUREMENT
/begin MEASUREMENT Gang_soll "Soll-Gang" UBYTE _CNV_R_R_Def_dez_sl_551_CM 1 100. 0. 255. DISPLAY_IDENTIFIER GANG_SOLL ECU_ADDRESS 0xd000e2a5 FORMAT "%3.0" /end MEASUREMENT
/begin MEASUREMENT Kl_kuppenable_aus "Ausgang aus KL_KUPP_ENABLE" UBYTE _CNV_R_R_Def_dez_sl_551_CM 1 100. 0. 255. DISPLAY_IDENTIFIER KL_KUPPENABLE_AUS ECU_ADDRESS 0xd000e254 FORMAT "%3.0" /end MEASUREMENT
/begin MEASUREMENT Kl_tasche_aus "Nkw-offset zur Korrektur Tans-Einfluss auf Schallgeschwindigkeit" SWORD _CNV_R_R_Def_n_sw_q_595_CM 1 100. -32768. 32767. DISPLAY_IDENTIFIER KL_TASCHE_AUS ECU_ADDRESS 0xd000dc4c FORMAT "%5.0" /end MEASUREMENT
/begin MEASUREMENT Kl_tmze_aus "Faktor Einfluss Zylindertemp auf max Füllung" SWORD _CNV_R_R_Def_f_sw_b_592_CM 1 100. -8. 7.9997 DISPLAY_IDENTIFIER KL_TMZE_AUS ECU_ADDRESS 0xd000dc4a FORMAT "%9.4" /end MEASUREMENT
/begin MEASUREMENT Md_ab_max "max Abtriebsmoment" SLONG _CNV_R_R_Def_m_sw_q_554_CM 1 100. -214748364.8 214748364.7 DISPLAY_IDENTIFIER MD_AB_MAX ECU_ADDRESS 0xd000e2e4 FORMAT "%9.2" /end MEASUREMENT
/begin MEASUREMENT Md_ab_min "min Abtriebsmoment" SLONG _CNV_R_R_Def_m_sw_q_554_CM 1 100. -214748364.8 214748364.7 DISPLAY_IDENTIFIER MD_AB_MIN ECU_ADDRESS 0xd000e2e0 FORMAT "%9.2" /end MEASUREMENT
/begin MEASUREMENT Md_ab_wunsch "Abtriebswunschmoment des Fahrers" SLONG _CNV_R_R_Def_m_sw_q_554_CM 1 100. -214748364.8 214748364.7 DISPLAY_IDENTIFIER MD_AB_WUNSCH ECU_ADDRESS 0xd000e2dc FORMAT "%9.2" /end MEASUREMENT
/begin MEASUREMENT Md_asr_sor "Begrenzungsmoment ASR schneller Pfad vor Gradientenlimitierung" SWORD _CNV_R_R_Def_m_sw_q_554_CM 1 100. -3276.8 3276.7 DISPLAY_IDENTIFIER MD_ASR_SOR ECU_ADDRESS 0xd000e306 FORMAT "%7.2" /end MEASUREMENT
/begin MEASUREMENT Md_na "delta Moment Nebenaggregate" SWORD _CNV_R_R_Def_m_sw_q_554_CM 1 100. -3276.8 3276.7 DISPLAY_IDENTIFIER MD_NA ECU_ADDRESS 0xd000e096 FORMAT "%7.2" /end MEASUREMENT
/begin MEASUREMENT Md_na_ges "delta Moment Nebenaggregate" SWORD _CNV_R_R_Def_m_sw_q_554_CM 1 100. -3276.8 3276.7 DISPLAY_IDENTIFIER MD_NA_GES ECU_ADDRESS 0xd000e098 FORMAT "%7.2" /end MEASUREMENT
/begin MEASUREMENT Md_na_sum "Summe der Momente aller Nebenaggregate" SWORD _CNV_R_R_Def_m_sw_q_554_CM 1 100. -3276.8 3276.7 DISPLAY_IDENTIFIER MD_NA_SUM ECU_ADDRESS 0xd000e09a FORMAT "%7.2" /end MEASUREMENT
/begin MEASUREMENT Md_rad_ksoll "Sollmoment am Rad koordiniert" SLONG _CNV_R_R_Def_m_sw_q_554_CM 1 100. -214748364.8 214748364.7 DISPLAY_IDENTIFIER MD_RAD_KSOLL ECU_ADDRESS 0xd000e30c FORMAT "%9.2" /end MEASUREMENT
/begin MEASUREMENT Md_rad_wunsch "Fahrerwunschmoment am Rad" SLONG _CNV_R_R_Def_m_sw_q_554_CM 1 100. -214748364.8 214748364.7 DISPLAY_IDENTIFIER MD_RAD_WUNSCH ECU_ADDRESS 0xd000e2d8 FORMAT "%9.2" /end MEASUREMENT
/begin MEASUREMENT Md_reib_add "Reibungsmoment" SWORD _CNV_R_R_Def_m_sw_q_554_CM 1 100. -3276.8 3276.7 DISPLAY_IDENTIFIER MD_REIB_ADD ECU_ADDRESS 0xd000e318 FORMAT "%7.2" /end MEASUREMENT
/begin MEASUREMENT Md_reib_sa "einfuegen" SWORD _CNV_R_R_Def_m_sw_q_554_CM 1 100. -3276.8 3276.7 DISPLAY_IDENTIFIER MD_REIB_SA ECU_ADDRESS 0xd000e314 FORMAT "%7.2" /end MEASUREMENT
/begin MEASUREMENT Md_reib_st "Reibungsmoment" SWORD _CNV_R_R_Def_m_sw_q_554_CM 1 100. -3276.8 3276.7 DISPLAY_IDENTIFIER MD_REIB_ST ECU_ADDRESS 0xd000e31c FORMAT "%7.2" /end MEASUREMENT
/begin MEASUREMENT Md_reib_stini "Reibungsmoment" SWORD _CNV_R_R_Def_m_sw_q_554_CM 1 100. -3276.8 3276.7 DISPLAY_IDENTIFIER MD_REIB_STINI ECU_ADDRESS 0xd000e31a FORMAT "%7.2" /end MEASUREMENT
/begin MEASUREMENT Md_reib_vl "einfuegen" SWORD _CNV_R_R_Def_m_sw_q_554_CM 1 100. -3276.8 3276.7 DISPLAY_IDENTIFIER MD_REIB_VL ECU_ADDRESS 0xd000e310 FORMAT "%7.2" /end MEASUREMENT
/begin MEASUREMENT Md_res "Momentenreserve" SWORD _CNV_R_R_Def_m_sw_q_554_CM 1 100. -3276.8 3276.7 DISPLAY_IDENTIFIER MD_RES ECU_ADDRESS 0xd000dd62 FORMAT "%7.2" /end MEASUREMENT
/begin MEASUREMENT Md_res_anf "angeforderte Momentenreserve" SWORD _CNV_R_R_Def_m_sw_q_554_CM 1 100. -3276.8 3276.7 DISPLAY_IDENTIFIER MD_RES_ANF ECU_ADDRESS 0xd000dd74 FORMAT "%7.2" /end MEASUREMENT
/begin MEASUREMENT Md_res_anf1 "angeforderte Momentenreserve Rohwert" SWORD _CNV_R_R_Def_m_sw_q_554_CM 1 100. -3276.8 3276.7 DISPLAY_IDENTIFIER MD_RES_ANF1 ECU_ADDRESS 0xd000dd80 FORMAT "%7.2" /end MEASUREMENT
/begin MEASUREMENT Md_res_anfmx "angeforderte Momentenreserve Max-Wert" SWORD _CNV_R_R_Def_m_sw_q_554_CM 1 100. -3276.8 3276.7 DISPLAY_IDENTIFIER MD_RES_ANFMX ECU_ADDRESS 0xd000dd78 FORMAT "%7.2" /end MEASUREMENT
/begin MEASUREMENT Md_res_glll "Momentenreserve für CILC am Bandende" SWORD _CNV_R_R_Def_m_sw_q_554_CM 1 100. -3276.8 3276.7 DISPLAY_IDENTIFIER MD_RES_GLLL ECU_ADDRESS 0xd000dd84 FORMAT "%7.2" /end MEASUREMENT
/begin MEASUREMENT Md_res_katreg "Momentenreserve Katregeneration" SWORD _CNV_R_R_Def_m_sw_q_554_CM 1 100. -3276.8 3276.7 DISPLAY_IDENTIFIER MD_RES_KATREG ECU_ADDRESS 0xd000dd7e FORMAT "%7.2" /end MEASUREMENT
/begin MEASUREMENT Md_res_krll "Momentenreserve Klopfregelung LL" SWORD _CNV_R_R_Def_m_sw_q_554_CM 1 100. -3276.8 3276.7 DISPLAY_IDENTIFIER MD_RES_KRLL ECU_ADDRESS 0xd000e09c FORMAT "%7.2" /end MEASUREMENT
/begin MEASUREMENT Md_res_max "max mögliche Momentenreserve" SWORD _CNV_R_R_Def_m_sw_q_554_CM 1 100. -3276.8 3276.7 DISPLAY_IDENTIFIER MD_RES_MAX ECU_ADDRESS 0xd000dd64 FORMAT "%7.2" /end MEASUREMENT
/begin MEASUREMENT Md_res_schalt "Momentenreserve Anschlussdrehzahlregler" SWORD _CNV_R_R_Def_m_sw_q_554_CM 1 100. -3276.8 3276.7 DISPLAY_IDENTIFIER MD_RES_SCHALT ECU_ADDRESS 0xd000e2c2 FORMAT "%7.2" /end MEASUREMENT
/begin MEASUREMENT Md_schalt_i "I-Anteil Anschlussdrehzahlregler" UWORD _CNV_R_R_Def_m_sw_q_554_CM 1 100. 0. 6553.5 DISPLAY_IDENTIFIER MD_SCHALT_I ECU_ADDRESS 0xd000e2b6 FORMAT "%7.2" /end MEASUREMENT
/begin MEASUREMENT Md_schalt_p "P-Anteil Anschlussdrehzahlregler" UWORD _CNV_R_R_Def_m_sw_q_554_CM 1 100. 0. 6553.5 DISPLAY_IDENTIFIER MD_SCHALT_P ECU_ADDRESS 0xd000e2b4 FORMAT "%7.2" /end MEASUREMENT
/begin MEASUREMENT Md_schalt_pi "Ausgang PI-Regler Anschlussdrehzahl" SWORD _CNV_R_R_Def_m_sw_q_554_CM 1 100. -3276.8 3276.7 DISPLAY_IDENTIFIER MD_SCHALT_PI ECU_ADDRESS 0xd000e2ae FORMAT "%7.2" /end MEASUREMENT
/begin MEASUREMENT Md_schalt_pz "P-Anteil Anschlussdrehzahlregler Zündpfad" SWORD _CNV_R_R_Def_m_sw_q_554_CM 1 100. -3276.8 3276.7 DISPLAY_IDENTIFIER MD_SCHALT_PZ ECU_ADDRESS 0xd000e2c0 FORMAT "%7.2" /end MEASUREMENT
/begin MEASUREMENT Md_schalt_st "Status Anschlussdrehzahlregler" UBYTE _CNV_R_R_Def_dez_sl_551_CM 1 100. 0. 255. DISPLAY_IDENTIFIER MD_SCHALT_ST ECU_ADDRESS 0xd000e2ab FORMAT "%3.0" /end MEASUREMENT
/begin MEASUREMENT Md_schalti_aus "Ausgang I-Anteil Anschlussdrehzahl" SWORD _CNV_R_R_Def_m_sw_q_554_CM 1 100. -3276.8 3276.7 DISPLAY_IDENTIFIER MD_SCHALTI_AUS ECU_ADDRESS 0xd000e2b2 FORMAT "%7.2" /end MEASUREMENT
/begin MEASUREMENT Md_schaltp_aus "Ausgang P-Anteil Anschlussdrehzahl" SWORD _CNV_R_R_Def_m_sw_q_554_CM 1 100. -3276.8 3276.7 DISPLAY_IDENTIFIER MD_SCHALTP_AUS ECU_ADDRESS 0xd000e2b0 FORMAT "%7.2" /end MEASUREMENT
/begin MEASUREMENT Md_st "Startmoment zur Beeinflussung der Füllung nach Start" SWORD _CNV_R_R_Def_m_sw_q_554_CM 1 100. -3276.8 3276.7 DISPLAY_IDENTIFIER MD_ST ECU_ADDRESS 0xd000e326 FORMAT "%7.2" /end MEASUREMENT
/begin MEASUREMENT Md_st_vf "Startmoment vor Filter" SWORD _CNV_R_R_Def_m_sw_q_554_CM 1 100. -3276.8 3276.7 DISPLAY_IDENTIFIER MD_ST_VF ECU_ADDRESS 0xd000e328 FORMAT "%7.2" /end MEASUREMENT
/begin MEASUREMENT Mdi_ar_f "" SWORD _CNV_R_R_Def_m_sw_q_554_CM 1 100. -3276.8 3276.7 DISPLAY_IDENTIFIER MDI_AR_F ECU_ADDRESS 0xd000e264 FORMAT "%7.2" /end MEASUREMENT
/begin MEASUREMENT Mdi_dash_ini "Initialisierungswert für DASH" SWORD _CNV_R_R_Def_m_sw_q_554_CM 1 100. -3276.8 3276.7 DISPLAY_IDENTIFIER MDI_DASH_INI ECU_ADDRESS 0xd000e21e FORMAT "%7.2" /end MEASUREMENT
/begin MEASUREMENT Mdi_fzdyn "inneres Moment nach Fahrdynamikfilterung" SWORD _CNV_R_R_Def_m_sw_q_554_CM 1 100. -3276.8 3276.7 DISPLAY_IDENTIFIER MDI_FZDYN ECU_ADDRESS 0xd000e262 FORMAT "%7.2" /end MEASUREMENT
/begin MEASUREMENT Mdi_fzdyn_korr "" SWORD _CNV_R_R_Def_m_sw_q_554_CM 1 100. -3276.8 3276.7 DISPLAY_IDENTIFIER MDI_FZDYN_KORR ECU_ADDRESS 0xd000dd7a FORMAT "%7.2" /end MEASUREMENT
/begin MEASUREMENT Mdi_fzdyn_korr1 "" SWORD _CNV_R_R_Def_m_sw_q_554_CM 1 100. -3276.8 3276.7 DISPLAY_IDENTIFIER MDI_FZDYN_KORR1 ECU_ADDRESS 0xd000dd7c FORMAT "%7.2" /end MEASUREMENT
/begin MEASUREMENT Mdi_lsd_ini "Initialisierungswert für LSD" SWORD _CNV_R_R_Def_m_sw_q_554_CM 1 100. -3276.8 3276.7 DISPLAY_IDENTIFIER MDI_LSD_INI ECU_ADDRESS 0xd000e220 FORMAT "%7.2" /end MEASUREMENT
/begin MEASUREMENT Mdi_max "maximales inneres Moment" SWORD _CNV_R_R_Def_m_sw_q_554_CM 1 100. -3276.8 3276.7 DISPLAY_IDENTIFIER MDI_MAX ECU_ADDRESS 0xd000dc34 FORMAT "%7.2" /end MEASUREMENT
/begin MEASUREMENT Mdi_max_l1 "maximales inneres Moment bei Lambda 1" SWORD _CNV_R_R_Def_m_sw_q_554_CM 1 100. -3276.8 3276.7 DISPLAY_IDENTIFIER MDI_MAX_L1 ECU_ADDRESS 0xd000dc40 FORMAT "%7.2" /end MEASUREMENT
/begin MEASUREMENT Mdi_reib "Motorschleppmoment im aktuellen Betriebspunkt" SWORD _CNV_R_R_Def_m_sw_q_554_CM 1 100. -3276.8 3276.7 DISPLAY_IDENTIFIER MDI_REIB ECU_ADDRESS 0xc0000e24 FORMAT "%7.2" /end MEASUREMENT
/begin MEASUREMENT Mdi_reib1 "Schleppmoment" SWORD _CNV_R_R_Def_m_sw_q_554_CM 1 100. -3276.8 3276.7 DISPLAY_IDENTIFIER MDI_REIB1 ECU_ADDRESS 0xd000e31e FORMAT "%7.2" /end MEASUREMENT
/begin MEASUREMENT Mdi_reib2 "Schleppmoment Betriebsart2" SWORD _CNV_R_R_Def_m_sw_q_554_CM 1 100. -3276.8 3276.7 DISPLAY_IDENTIFIER MDI_REIB2 ECU_ADDRESS 0xd000e320 FORMAT "%7.2" /end MEASUREMENT
/begin MEASUREMENT Mdi_reib3 "Schleppmoment Betriebsart3" SWORD _CNV_R_R_Def_m_sw_q_554_CM 1 100. -3276.8 3276.7 DISPLAY_IDENTIFIER MDI_REIB3 ECU_ADDRESS 0xd000e322 FORMAT "%7.2" /end MEASUREMENT
/begin MEASUREMENT Mdi_reib_kf "einfuegen" SWORD _CNV_R_R_Def_m_sw_q_554_CM 1 100. -3276.8 3276.7 DISPLAY_IDENTIFIER MDI_REIB_KF ECU_ADDRESS 0xd000e324 FORMAT "%7.2" /end MEASUREMENT
/begin MEASUREMENT Mdi_res "Inneres Moment nach Dynamikfilterung incl. Momentenreserve" SWORD _CNV_R_R_Def_m_sw_q_554_CM 1 100. -3276.8 3276.7 DISPLAY_IDENTIFIER MDI_RES ECU_ADDRESS 0xd000dd70 FORMAT "%7.2" /end MEASUREMENT
/begin MEASUREMENT Mdi_res_anf "inneres Moment incl. Momentenreserve" SWORD _CNV_R_R_Def_m_sw_q_554_CM 1 100. -3276.8 3276.7 DISPLAY_IDENTIFIER MDI_RES_ANF ECU_ADDRESS 0xd000dd76 FORMAT "%7.2" /end MEASUREMENT
/begin MEASUREMENT Mdi_res_anfkh "inneres Moment incl. Momentenreserve für Katheizen" SWORD _CNV_R_R_Def_m_sw_q_554_CM 1 100. -3276.8 3276.7 DISPLAY_IDENTIFIER MDI_RES_ANFKH ECU_ADDRESS 0xd000dd82 FORMAT "%7.2" /end MEASUREMENT
/begin MEASUREMENT Mdi_res_anfmx "" SWORD _CNV_R_R_Def_m_sw_q_554_CM 1 100. -3276.8 3276.7 DISPLAY_IDENTIFIER MDI_RES_ANFMX ECU_ADDRESS 0xd000dd60 FORMAT "%7.2" /end MEASUREMENT
/begin MEASUREMENT Mdi_res_dashini "Initialisierungswert für vorrauseilendes Luftmoment" SWORD _CNV_R_R_Def_m_sw_q_554_CM 1 100. -3276.8 3276.7 DISPLAY_IDENTIFIER MDI_RES_DASHINI ECU_ADDRESS 0xd000e222 FORMAT "%7.2" /end MEASUREMENT
/begin MEASUREMENT Mdi_res_lsini "Initialisierungswert für vorrauseilendes Luftmoment" SWORD _CNV_R_R_Def_m_sw_q_554_CM 1 100. -3276.8 3276.7 DISPLAY_IDENTIFIER MDI_RES_LSINI ECU_ADDRESS 0xd000e224 FORMAT "%7.2" /end MEASUREMENT
/begin MEASUREMENT Mdi_res_max "inneres Moment incl. max mögliche Momentenreserve ohne Einfluss LL" SWORD _CNV_R_R_Def_m_sw_q_554_CM 1 100. -3276.8 3276.7 DISPLAY_IDENTIFIER MDI_RES_MAX ECU_ADDRESS 0xd000dd6c FORMAT "%7.2" /end MEASUREMENT
/begin MEASUREMENT Mdi_res_maxll "inneres Moment incl. max mögliche Momentenreserve mit Einfluss LL" SWORD _CNV_R_R_Def_m_sw_q_554_CM 1 100. -3276.8 3276.7 DISPLAY_IDENTIFIER MDI_RES_MAXLL ECU_ADDRESS 0xd000dd6e FORMAT "%7.2" /end MEASUREMENT
/begin MEASUREMENT Mdi_res_mdar "dyn. Momentenreserve" SWORD _CNV_R_R_Def_m_sw_q_554_CM 1 100. -3276.8 3276.7 DISPLAY_IDENTIFIER MDI_RES_MDAR ECU_ADDRESS 0xd000e1f6 FORMAT "%7.2" /end MEASUREMENT
/begin MEASUREMENT Mdk_anschl_reg "Ausgangsmoment aus Anschlussdrehzahlregler" SWORD _CNV_R_R_Def_m_sw_q_554_CM 1 100. -3276.8 3276.7 DISPLAY_IDENTIFIER MDK_ANSCHL_REG ECU_ADDRESS 0xd000e2a8 FORMAT "%7.2" /end MEASUREMENT
/begin MEASUREMENT Mdk_asr_l "Begrenzungsmoment ASR langsamer Pfad" SWORD _CNV_R_R_Def_m_sw_q_554_CM 1 100. -3276.8 3276.7 DISPLAY_IDENTIFIER MDK_ASR_L ECU_ADDRESS 0xd000e302 FORMAT "%7.2" /end MEASUREMENT
/begin MEASUREMENT Mdk_asr_s "Begrenzungsmoment ASR schneller Pfad" SWORD _CNV_R_R_Def_m_sw_q_554_CM 1 100. -3276.8 3276.7 DISPLAY_IDENTIFIER MDK_ASR_S ECU_ADDRESS 0xd000e304 FORMAT "%7.2" /end MEASUREMENT
/begin MEASUREMENT Mdk_dash "Kurbelwellenmoment Dashpot" SWORD _CNV_R_R_Def_m_sw_q_554_CM 1 100. -3276.8 3276.7 DISPLAY_IDENTIFIER MDK_DASH ECU_ADDRESS 0xd000e226 FORMAT "%7.2" /end MEASUREMENT
/begin MEASUREMENT Mdk_dp_o "Schwelle Dashpotmoment > Bereich 2" SWORD _CNV_R_R_Def_m_sw_q_554_CM 1 100. -3276.8 3276.7 DISPLAY_IDENTIFIER MDK_DP_O ECU_ADDRESS 0xd000e228 FORMAT "%7.2" /end MEASUREMENT
/begin MEASUREMENT Mdk_dp_u "Schwelle Dashpotmoment <= Bereich 1" SWORD _CNV_R_R_Def_m_sw_q_554_CM 1 100. -3276.8 3276.7 DISPLAY_IDENTIFIER MDK_DP_U ECU_ADDRESS 0xd000e22a FORMAT "%7.2" /end MEASUREMENT
/begin MEASUREMENT Mdk_fzdyn "Wunschkupplungsmoment vor Fahrdynamikfilterung" SWORD _CNV_R_R_Def_m_sw_q_554_CM 1 100. -3276.8 3276.7 DISPLAY_IDENTIFIER MDK_FZDYN ECU_ADDRESS 0xd000e266 FORMAT "%7.2" /end MEASUREMENT
/begin MEASUREMENT Mdk_fzdyn_vb "Wunschkupplungsmoment vor Begrenzung" SWORD _CNV_R_R_Def_m_sw_q_554_CM 1 100. -3276.8 3276.7 DISPLAY_IDENTIFIER MDK_FZDYN_VB ECU_ADDRESS 0xd000e2a6 FORMAT "%7.2" /end MEASUREMENT
/begin MEASUREMENT Mdk_iwfdp "Initialisierungswert Dashpotfilter" SWORD _CNV_R_R_Def_m_sw_q_554_CM 1 100. -3276.8 3276.7 DISPLAY_IDENTIFIER MDK_IWFDP ECU_ADDRESS 0xd000e22c FORMAT "%7.2" /end MEASUREMENT
/begin MEASUREMENT Mdk_iwflsd "Initialisierungswert Lastschlagdämpfungsfilter" SWORD _CNV_R_R_Def_m_sw_q_554_CM 1 100. -3276.8 3276.7 DISPLAY_IDENTIFIER MDK_IWFLSD ECU_ADDRESS 0xd000e22e FORMAT "%7.2" /end MEASUREMENT
/begin MEASUREMENT Mdk_lsd "Kurbelwellenmoment Lastschlagdämpfung" SWORD _CNV_R_R_Def_m_sw_q_554_CM 1 100. -3276.8 3276.7 DISPLAY_IDENTIFIER MDK_LSD ECU_ADDRESS 0xd000e230 FORMAT "%7.2" /end MEASUREMENT
/begin MEASUREMENT Mdk_lsd_ag "Kurbelwellenmoment Lastschlagdämpfung Automatikgetriebe" SWORD _CNV_R_R_Def_m_sw_q_554_CM 1 100. -3276.8 3276.7 DISPLAY_IDENTIFIER MDK_LSD_AG ECU_ADDRESS 0xd000e232 FORMAT "%7.2" /end MEASUREMENT
/begin MEASUREMENT Mdk_lsd_o "Schwelle Lastschlagdämpfungsmoment >= Bereich 2" SWORD _CNV_R_R_Def_m_sw_q_554_CM 1 100. -3276.8 3276.7 DISPLAY_IDENTIFIER MDK_LSD_O ECU_ADDRESS 0xd000e234 FORMAT "%7.2" /end MEASUREMENT
/begin MEASUREMENT Mdk_lsd_u "Schwelle Lastschlagdämpfungsbereich < Bereich 1" SWORD _CNV_R_R_Def_m_sw_q_554_CM 1 100. -3276.8 3276.7 DISPLAY_IDENTIFIER MDK_LSD_U ECU_ADDRESS 0xd000e236 FORMAT "%7.2" /end MEASUREMENT
/begin MEASUREMENT Mdk_lsd_wakor "Mdk_lsd mit Wandlerkompensation" SWORD _CNV_R_R_Def_m_sw_q_554_CM 1 100. -3276.8 3276.7 DISPLAY_IDENTIFIER MDK_LSD_WAKOR ECU_ADDRESS 0xd000e238 FORMAT "%7.2" /end MEASUREMENT
/begin MEASUREMENT Mdk_max "maximales Kupplungsmoment" SWORD _CNV_R_R_Def_m_sw_q_554_CM 1 100. -3276.8 3276.7 DISPLAY_IDENTIFIER MDK_MAX ECU_ADDRESS 0xd000dc42 FORMAT "%7.2" /end MEASUREMENT
/begin MEASUREMENT Mdk_max_real "maximales Kupplungsmoment aus realem Luftaufwand" SWORD _CNV_R_R_Def_m_sw_q_554_CM 1 100. -3276.8 3276.7 DISPLAY_IDENTIFIER MDK_MAX_REAL ECU_ADDRESS 0xd000dc2c FORMAT "%7.2" /end MEASUREMENT
/begin MEASUREMENT Mdk_min "Minimales Drehmoment an der Kupplung (TQ_MIN_CLU)" SWORD _CNV_R_R_Def_m_sw_q_554_CM 1 100. -3276.8 3276.7 DISPLAY_IDENTIFIER MDK_MIN ECU_ADDRESS 0xd000e312 FORMAT "%7.2" /end MEASUREMENT
/begin MEASUREMENT Mdk_min_reib "Minimales Kupplungsmoment aus Reibungen (standard)" SWORD _CNV_R_R_Def_m_sw_q_554_CM 1 100. -3276.8 3276.7 DISPLAY_IDENTIFIER MDK_MIN_REIB ECU_ADDRESS 0xd000e32a FORMAT "%7.2" /end MEASUREMENT
/begin MEASUREMENT Mdk_min_sa "Minimales Kupplungsmoment bei Schubabschaltung" SWORD _CNV_R_R_Def_m_sw_q_554_CM 1 100. -3276.8 3276.7 DISPLAY_IDENTIFIER MDK_MIN_SA ECU_ADDRESS 0xd000e32c FORMAT "%7.2" /end MEASUREMENT
/begin MEASUREMENT Mdk_msr_l "Begrenzungsmoment aus Motorschleppmomentenregelung langsamer Pfad" SWORD _CNV_R_R_Def_m_sw_q_554_CM 1 100. -3276.8 3276.7 DISPLAY_IDENTIFIER MDK_MSR_L ECU_ADDRESS 0xd000e300 FORMAT "%7.2" /end MEASUREMENT
/begin MEASUREMENT Mdk_msr_s "Begrenzungsmoment aus Motorschleppmomentenregelung schneller Pfad" SWORD _CNV_R_R_Def_m_sw_q_554_CM 1 100. -3276.8 3276.7 DISPLAY_IDENTIFIER MDK_MSR_S ECU_ADDRESS 0xd000e2fe FORMAT "%7.2" /end MEASUREMENT
/begin MEASUREMENT Mdk_res "Kupplungsmoment nach Dynamikfilterung incl. Momentenreserve" SWORD _CNV_R_R_Def_m_sw_q_554_CM 1 100. -3276.8 3276.7 DISPLAY_IDENTIFIER MDK_RES ECU_ADDRESS 0xd000dd66 FORMAT "%7.2" /end MEASUREMENT
/begin MEASUREMENT Mdk_w_f "Wunschkurbelwellenmoment nach Fahrdynamikfilterung ohne Wandlerverlustkompensation" SWORD _CNV_R_R_Def_m_sw_q_554_CM 1 100. -3276.8 3276.7 DISPLAY_IDENTIFIER MDK_W_F ECU_ADDRESS 0xd000e23a FORMAT "%7.2" /end MEASUREMENT
/begin MEASUREMENT Mdk_wu_lramp "Rampe Mdk_wunsch" SWORD _CNV_R_R_Def_m_sw_q_554_CM 1 100. -3276.8 3276.7 DISPLAY_IDENTIFIER MDK_WU_LRAMP ECU_ADDRESS 0xd000e23c FORMAT "%7.2" /end MEASUREMENT
/begin MEASUREMENT Mdk_wunsch_anf "Wunschkupplungsmoment mit Anfahrhilfe" SWORD _CNV_R_R_Def_m_sw_q_554_CM 1 100. -3276.8 3276.7 DISPLAY_IDENTIFIER MDK_WUNSCH_ANF ECU_ADDRESS 0xd000e2ce FORMAT "%7.2" /end MEASUREMENT
/begin MEASUREMENT Mdk_wunsch_cnt "Schaltwahrscheinlichkeit" UBYTE _CNV_R_R_Def_dez_sl_551_CM 1 100. 0. 255. DISPLAY_IDENTIFIER MDK_WUNSCH_CNT ECU_ADDRESS 0xd000e2a4 FORMAT "%3.0" /end MEASUREMENT
/begin MEASUREMENT Mdk_wunsch_d "Fahrerwunsch nach Dashpot und LSD für schnellen Pfad (Zündung)" SWORD _CNV_R_R_Def_m_sw_q_554_CM 1 100. -3276.8 3276.7 DISPLAY_IDENTIFIER MDK_WUNSCH_D ECU_ADDRESS 0xd000e1f8 FORMAT "%7.2" /end MEASUREMENT
/begin MEASUREMENT Mdk_wunsch_filt "Kupplungsmoment nach Fahrdynamikfilterung" SWORD _CNV_R_R_Def_m_sw_q_554_CM 1 100. -3276.8 3276.7 DISPLAY_IDENTIFIER MDK_WUNSCH_FILT ECU_ADDRESS 0xd000e260 FORMAT "%7.2" /end MEASUREMENT
/begin MEASUREMENT Mdk_wunsch_gradmx "maximaler Gradient (negative Werte) während B_dash" SWORD _CNV_R_R_Def_m_sw_q_554_CM 1 100. -3276.8 3276.7 DISPLAY_IDENTIFIER MDK_WUNSCH_GRADMX ECU_ADDRESS 0xd000e23e FORMAT "%7.2" /end MEASUREMENT
/begin MEASUREMENT Mdk_wunsch_ipm "Sollmoment an der Kupplung" SWORD _CNV_R_R_Def_m_sw_q_554_CM 1 100. -3276.8 3276.7 DISPLAY_IDENTIFIER MDK_WUNSCH_IPM ECU_ADDRESS 0xd000e2fc FORMAT "%7.2" /end MEASUREMENT
/begin MEASUREMENT Mdk_wunsch_l "Fahrerwunsch nach Dashpot und LSD für langsamen Pfad (Luft)" SWORD _CNV_R_R_Def_m_sw_q_554_CM 1 100. -3276.8 3276.7 DISPLAY_IDENTIFIER MDK_WUNSCH_L ECU_ADDRESS 0xd000e1fa FORMAT "%7.2" /end MEASUREMENT
/begin MEASUREMENT Mdk_wunsch_proz "rel Momentenwunsch" SWORD _CNV_R_R_Def_f_uw_b_590_CM 1 100. -1. 0.9999 DISPLAY_IDENTIFIER MDK_WUNSCH_PROZ ECU_ADDRESS 0xd000e2ca FORMAT "%14.5" /end MEASUREMENT
/begin MEASUREMENT Mdk_wunsch_rad "Sollmoment an der Kupplung" SWORD _CNV_R_R_Def_m_sw_q_554_CM 1 100. -3276.8 3276.7 DISPLAY_IDENTIFIER MDK_WUNSCH_RAD ECU_ADDRESS 0xd000e2fa FORMAT "%7.2" /end MEASUREMENT
/begin MEASUREMENT Mdk_wunsch_ref_hsa "Schwelle Momentengradient zur Ausgangswunschmomentbestimmung" SWORD _CNV_R_R_Def_m_sw_q_554_CM 1 100. -3276.8 3276.7 DISPLAY_IDENTIFIER MDK_WUNSCH_REF_HSA ECU_ADDRESS 0xd000e240 FORMAT "%7.2" /end MEASUREMENT
/begin MEASUREMENT Mdk_wunsch_ref_sa "Mdk_wunsch gefiltert (Ausgangswunschmoment)" SWORD _CNV_R_R_Def_m_sw_q_554_CM 1 100. -3276.8 3276.7 DISPLAY_IDENTIFIER MDK_WUNSCH_REF_SA ECU_ADDRESS 0xd000e242 FORMAT "%7.2" /end MEASUREMENT
/begin MEASUREMENT Mdk_wunsch_t "Luftmoment zur Reduzierung der 2-stufigen Beschleunigung" SWORD _CNV_R_R_Def_m_sw_q_554_CM 1 100. -3276.8 3276.7 DISPLAY_IDENTIFIER MDK_WUNSCH_T ECU_ADDRESS 0xd000e244 FORMAT "%7.2" /end MEASUREMENT
/begin MEASUREMENT Mdr_ab_max "max aus Mdr_ab_virt und Mdr_ab_wunsch" SWORD _CNV_R_R_Def_md_rel_651_CM 1 100. 0. 100. DISPLAY_IDENTIFIER MDR_AB_MAX ECU_ADDRESS 0xd000e2e8 FORMAT "%6.1" /end MEASUREMENT
/begin MEASUREMENT Mdr_ab_virt "aus Md_rad_soll zurückgerechnetes relatives Fahrerwunschabtriebsmoment" SWORD _CNV_R_R_Def_md_rel_651_CM 1 100. 0. 100. DISPLAY_IDENTIFIER MDR_AB_VIRT ECU_ADDRESS 0xd000e2d6 FORMAT "%6.1" /end MEASUREMENT
/begin MEASUREMENT Mdr_ab_wunsch "relatives Fahrerwunschabtriebsmoment" SWORD _CNV_R_R_Def_md_rel_651_CM 1 100. 0. 100. DISPLAY_IDENTIFIER MDR_AB_WUNSCH ECU_ADDRESS 0xd000e2d4 FORMAT "%6.1" /end MEASUREMENT
/begin MEASUREMENT Mdr_pedal "relatives Fahrerwunschmoment" SWORD _CNV_R_R_Def_md_rel_651_CM 1 100. 0. 100. DISPLAY_IDENTIFIER MDR_PEDAL ECU_ADDRESS 0xd000e2ee FORMAT "%6.1" /end MEASUREMENT
/begin MEASUREMENT Mdr_pedal_max "max mögliches relatives Fahrerwunschmoment" SWORD _CNV_R_R_Def_md_rel_651_CM 1 100. 0. 100. DISPLAY_IDENTIFIER MDR_PEDAL_MAX ECU_ADDRESS 0xd000e2f0 FORMAT "%6.1" /end MEASUREMENT
/begin MEASUREMENT Mdr_wunsch "relatives Fahrerwunschmoment" SWORD _CNV_R_R_Def_md_rel_651_CM 1 100. 0. 100. DISPLAY_IDENTIFIER MDR_WUNSCH ECU_ADDRESS 0xd000e2ec FORMAT "%6.1" /end MEASUREMENT
/begin MEASUREMENT Ms_res_max "max Luftmassenstrom der durch Momentenreserve angefordert werden kann" UWORD _CNV_R_R_Def_ms_uw__594_CM 1 100. 0. 2047.9687 DISPLAY_IDENTIFIER MS_RES_MAX ECU_ADDRESS 0xd000dd6a FORMAT "%8.3" /end MEASUREMENT
/begin MEASUREMENT N_filt "" SWORD _CNV_R_R_Def_n_sw_q_595_CM 1 100. -32768. 32767. DISPLAY_IDENTIFIER N_FILT ECU_ADDRESS 0xd000e27e FORMAT "%5.0" /end MEASUREMENT
/begin MEASUREMENT N_filt_abs "" SWORD _CNV_R_R_Def_n_sw_q_595_CM 1 100. -32768. 32767. DISPLAY_IDENTIFIER N_FILT_ABS ECU_ADDRESS 0xd000e27a FORMAT "%5.0" /end MEASUREMENT
/begin MEASUREMENT N_filt_alt "" SWORD _CNV_R_R_Def_n_sw_q_595_CM 1 100. -32768. 32767. DISPLAY_IDENTIFIER N_FILT_ALT ECU_ADDRESS 0xd000e27c FORMAT "%5.0" /end MEASUREMENT
/begin MEASUREMENT N_filt_bp "" SWORD _CNV_R_R_Def_n_sw_q_595_CM 1 100. -32768. 32767. DISPLAY_IDENTIFIER N_FILT_BP ECU_ADDRESS 0xd000e280 FORMAT "%5.0" /end MEASUREMENT
/begin MEASUREMENT N_filt_tp "" SWORD _CNV_R_R_Def_n_sw_q_595_CM 1 100. -32768. 32767. DISPLAY_IDENTIFIER N_FILT_TP ECU_ADDRESS 0xd000e282 FORMAT "%5.0" ARRAY_SIZE 2 MATRIX_DIM 2 1 1 /end MEASUREMENT
/begin MEASUREMENT N_gang_neu "Motordrehzahl nach Schaltung" SWORD _CNV_R_R_Def_n_sw_q_595_CM 1 100. -32768. 32767. DISPLAY_IDENTIFIER N_GANG_NEU ECU_ADDRESS 0xd000e2c6 FORMAT "%5.0" /end MEASUREMENT
/begin MEASUREMENT Na_bnanteil "Anteil Motordynamik für Generator" UBYTE _CNV_R_R_Def_f_ub_b_613_CM 1 100. 0. 1.9921 DISPLAY_IDENTIFIER NA_BNANTEIL ECU_ADDRESS 0xd000e095 /end MEASUREMENT
/begin MEASUREMENT Nkw_dif_stmx "Differenz  zur Startdrehzahl" SWORD _CNV_R_R_Def_n_sw_q_595_CM 1 100. -32768. 32767. DISPLAY_IDENTIFIER NKW_DIF_STMX ECU_ADDRESS 0xd000e332 FORMAT "%5.0" /end MEASUREMENT
/begin MEASUREMENT Nkw_soll_dif "Differenzdrehzahl zu Nkw_soll" SWORD _CNV_R_R_Def_n_sw_q_595_CM 1 100. -32768. 32767. DISPLAY_IDENTIFIER NKW_SOLL_DIF ECU_ADDRESS 0xd000e32e FORMAT "%5.0" /end MEASUREMENT
/begin MEASUREMENT Nkw_st_mx "Startdrehzahl zur Beeinflussung der Füllung nach Start" SWORD _CNV_R_R_Def_n_sw_q_595_CM 1 100. -32768. 32767. DISPLAY_IDENTIFIER NKW_ST_MX ECU_ADDRESS 0xd000e330 FORMAT "%5.0" /end MEASUREMENT
/begin MEASUREMENT Ntnkw "Quotient Wandlerturbinendrehzahl/Motordrehzahl" UBYTE _CNV_R_R_Def_f_ub_b_632_CM 1 100. 0. 3.9843 DISPLAY_IDENTIFIER NTNKW ECU_ADDRESS 0xd000e255 FORMAT "%5.2" /end MEASUREMENT
/begin MEASUREMENT P_ar "" UBYTE _CNV_R_R_Def_f_ub_b_632_CM 1 100. 0. 3.9843 DISPLAY_IDENTIFIER P_AR ECU_ADDRESS 0xd000e272 FORMAT "%5.2" /end MEASUREMENT
/begin MEASUREMENT Pirgatl_k "Pirg im Turbobetrieb" UWORD _CNV_R_R_Def_p_sw_q_576_CM 1 100. 0. 2559.9609 DISPLAY_IDENTIFIER PIRGATL_K ECU_ADDRESS 0xc0000df2 FORMAT "%7.2" /end MEASUREMENT
/begin MEASUREMENT Psmxatl "Maximaler Saugrohrdruck" UWORD _CNV_R_R_Def_p_sw_q_576_CM 1 100. 0. 2559.9609 DISPLAY_IDENTIFIER PSMXATL ECU_ADDRESS 0xc0000de2 FORMAT "%7.2" /end MEASUREMENT
/begin MEASUREMENT Pwg_fvv_fak "rel Momentenwunsch" UWORD _CNV_R_R_Def_f_uw_b_571_CM 1 100. 0. 0.9999 DISPLAY_IDENTIFIER PWG_FVV_FAK ECU_ADDRESS 0xd000e2cc FORMAT "%14.5" /end MEASUREMENT
/begin MEASUREMENT Pwg_grad "Delta Pedalwertgeber im 10ms_Raster gerechnet" SWORD _CNV_R_R_Def_pwggrd_682_CM 1 100. -20000. 19999.3896 DISPLAY_IDENTIFIER PWG_GRAD ECU_ADDRESS 0xd000e25e FORMAT "%8.3" /end MEASUREMENT
/begin MEASUREMENT Pwg_ist_kor "Pedalwert korrigiert" SWORD _CNV_R_R_Def_wdk_sw_683_CM 1 100. -800. 799.9755 DISPLAY_IDENTIFIER PWG_IST_KOR ECU_ADDRESS 0xd000e2f4 FORMAT "%7.2" /end MEASUREMENT
/begin MEASUREMENT Pwg_max "max(Pwg_virt,Pwg_ist)" SWORD _CNV_R_R_Def_wdk_sw_683_CM 1 100. -800. 799.9755 DISPLAY_IDENTIFIER PWG_MAX ECU_ADDRESS 0xd000e2f2 FORMAT "%7.2" /end MEASUREMENT
/begin MEASUREMENT Pwg_virt "Rückgerechneter Pedalwert aus FGR" SWORD _CNV_R_R_Def_wdk_sw_683_CM 1 100. -800. 799.9755 DISPLAY_IDENTIFIER PWG_VIRT ECU_ADDRESS 0xd000e2f6 FORMAT "%7.2" /end MEASUREMENT
/begin MEASUREMENT Rf_dvvt_max "" SWORD _CNV_R_R_Def_rf_sw__598_CM 1 100. -327.68 327.67 DISPLAY_IDENTIFIER RF_DVVT_MAX ECU_ADDRESS 0xd000dc3e FORMAT "%9.4" /end MEASUREMENT
/begin MEASUREMENT Rf_res_max "Maximale rel. Füllung aus MD-Reserve für Katheizen" SWORD _CNV_R_R_Def_rf_sw__598_CM 1 100. -327.68 327.67 DISPLAY_IDENTIFIER RF_RES_MAX ECU_ADDRESS 0xd000dd68 FORMAT "%9.4" /end MEASUREMENT
/begin MEASUREMENT Rf_tim_mx "begrenztes max Rf" SWORD _CNV_R_R_Def_rf_sw__598_CM 1 100. -327.68 327.67 DISPLAY_IDENTIFIER RF_TIM_MX ECU_ADDRESS 0xd000dc44 FORMAT "%9.4" /end MEASUREMENT
/begin MEASUREMENT Rf_umax "rel Fuellung bei Vollast unter Normbed vor Begrenzung" SWORD _CNV_R_R_Def_rf_sw__598_CM 1 100. -327.68 327.67 DISPLAY_IDENTIFIER RF_UMAX ECU_ADDRESS 0xd000dc2e FORMAT "%9.4" /end MEASUREMENT
/begin MEASUREMENT Rf_vl "rel Fuellung bei Vollast unter Normbed" SWORD _CNV_R_R_Def_rf_sw__598_CM 1 100. -327.68 327.67 DISPLAY_IDENTIFIER RF_VL ECU_ADDRESS 0xd000dc3c FORMAT "%9.4" /end MEASUREMENT
/begin MEASUREMENT Rf_vl_max "rel Fuellung bei Vollast unter Normbed mit Korrektur über Zylindertemperatur" SWORD _CNV_R_R_Def_rf_sw__598_CM 1 100. -327.68 327.67 DISPLAY_IDENTIFIER RF_VL_MAX ECU_ADDRESS 0xd000dc3a FORMAT "%9.4" /end MEASUREMENT
/begin MEASUREMENT Rf_vl_ob "rel Fuellung bei Vollast vor Begrenzung" SWORD _CNV_R_R_Def_rf_sw__598_CM 1 100. -327.68 327.67 DISPLAY_IDENTIFIER RF_VL_OB ECU_ADDRESS 0xd000dc48 FORMAT "%9.4" /end MEASUREMENT
/begin MEASUREMENT Rf_vl_obatl "rel  Fuellung bei Vollast unter Normbed vor Begrenzung" SWORD _CNV_R_R_Def_rf_sw__598_CM 1 100. -327.68 327.67 DISPLAY_IDENTIFIER RF_VL_OBATL ECU_ADDRESS 0xd000dc56 FORMAT "%9.4" /end MEASUREMENT
/begin MEASUREMENT Rfmxatl "Max. Fuellung im Turbo-Betrieb" SWORD _CNV_R_R_Def_rf_sw__598_CM 1 100. -327.68 327.67 DISPLAY_IDENTIFIER RFMXATL ECU_ADDRESS 0xc0000de0 FORMAT "%9.4" /end MEASUREMENT
/begin MEASUREMENT Rfmxkorr "Max. Turbo-Luftaufwand korrigiert" SWORD _CNV_R_R_Def_rf_sw__598_CM 1 100. -327.68 327.67 DISPLAY_IDENTIFIER RFMXKORR ECU_ADDRESS 0xc0000de6 FORMAT "%9.4" /end MEASUREMENT
/begin MEASUREMENT Rfmxldts "Max. Fuellung" SWORD _CNV_R_R_Def_rf_sw__598_CM 1 100. -327.68 327.67 DISPLAY_IDENTIFIER RFMXLDTS ECU_ADDRESS 0xc0000de8 FORMAT "%9.4" /end MEASUREMENT
/begin MEASUREMENT Rfv_vl_max "rel Fuellung bei Vollast unter Normbed mit Korrektur über Zylindertemperatur" SWORD _CNV_R_R_Def_rf_sw__598_CM 1 100. -327.68 327.67 DISPLAY_IDENTIFIER RFV_VL_MAX ECU_ADDRESS 0xd000dc46 FORMAT "%9.4" /end MEASUREMENT
/begin MEASUREMENT Rfv_vl_roh "rel Fuellung bei Vollast unter Normbed" SWORD _CNV_R_R_Def_rf_sw__598_CM 1 100. -327.68 327.67 DISPLAY_IDENTIFIER RFV_VL_ROH ECU_ADDRESS 0xd000dc36 FORMAT "%9.4" /end MEASUREMENT
/begin MEASUREMENT Schalt_ws "Schaltwahrscheinlichkeit" SBYTE _CNV_R_R_Def_f_sb_b_703_CM 1 100. -1. 0.9921 DISPLAY_IDENTIFIER SCHALT_WS ECU_ADDRESS 0xd000e2ac /end MEASUREMENT
/begin MEASUREMENT St_ar1 "Statuswort" UBYTE _CNV_R_R_Def_dez_sl_551_CM 1 100. 0. 255. DISPLAY_IDENTIFIER ST_AR1 ECU_ADDRESS 0xd000e25c FORMAT "%3.0" /end MEASUREMENT
/begin MEASUREMENT St_ar1.B_ar_akt "Statuswort" UBYTE _CNV_S_2_Def_bit_ub_563_CM 1 100. 0. 1. DISPLAY_IDENTIFIER B_AR_AKT ECU_ADDRESS 0xd000e25c BIT_MASK 0x1 /end MEASUREMENT
/begin MEASUREMENT St_ar1.B_ar_ber "Statuswort" UBYTE _CNV_S_2_Def_bit_ub_563_CM 1 100. 0. 1. DISPLAY_IDENTIFIER B_AR_BER ECU_ADDRESS 0xd000e25c BIT_MASK 0x10 /end MEASUREMENT
/begin MEASUREMENT St_ar1.B_filtbp_ngrd "Negativer gradient an N_filt_bp erkannt" UBYTE _CNV_S_2_Def_bit_ub_563_CM 1 100. 0. 1. DISPLAY_IDENTIFIER B_FILTBP_NGRD ECU_ADDRESS 0xd000e25c BIT_MASK 0x80 /end MEASUREMENT
/begin MEASUREMENT St_ar1.B_kein_ar "Statuswort" UBYTE _CNV_S_2_Def_bit_ub_563_CM 1 100. 0. 1. DISPLAY_IDENTIFIER B_KEIN_AR ECU_ADDRESS 0xd000e25c BIT_MASK 0x40 /end MEASUREMENT
/begin MEASUREMENT St_ar1.B_td_kupp "Statuswort" UBYTE _CNV_S_2_Def_bit_ub_563_CM 1 100. 0. 1. DISPLAY_IDENTIFIER B_TD_KUPP ECU_ADDRESS 0xd000e25c BIT_MASK 0x8 /end MEASUREMENT
/begin MEASUREMENT St_ar1.B_zr_ar "Statuswort" UBYTE _CNV_S_2_Def_bit_ub_563_CM 1 100. 0. 1. DISPLAY_IDENTIFIER B_ZR_AR ECU_ADDRESS 0xd000e25c BIT_MASK 0x2 /end MEASUREMENT
/begin MEASUREMENT St_dp_ber "Status Momentenbereich Dashpot" UBYTE _CNV_R_R_Def_dez_sl_551_CM 1 100. 0. 255. DISPLAY_IDENTIFIER ST_DP_BER ECU_ADDRESS 0xd000e256 FORMAT "%3.0" /end MEASUREMENT
/begin MEASUREMENT St_fgr "Status FGR" UBYTE _CNV_R_R_Def_dez_sl_551_CM 1 100. 0. 255. DISPLAY_IDENTIFIER ST_FGR ECU_ADDRESS 0xd000e2ea FORMAT "%3.0" /end MEASUREMENT
/begin MEASUREMENT St_fgr.B_fgr_akt "Bedingung FGR aktiv" UBYTE _CNV_S_2_Def_bit_ub_563_CM 1 100. 0. 1. DISPLAY_IDENTIFIER B_FGR_AKT ECU_ADDRESS 0xd000e2ea BIT_MASK 0x1 /end MEASUREMENT
/begin MEASUREMENT St_fgr.B_sport_aktiv "Bedingung Sportschalter in Funktion aktiv" UBYTE _CNV_S_2_Def_bit_ub_563_CM 1 100. 0. 1. DISPLAY_IDENTIFIER B_SPORT_AKTIV ECU_ADDRESS 0xd000e2ea BIT_MASK 0x2 /end MEASUREMENT
/begin MEASUREMENT St_llr "Statusword Leerlaufregler" UWORD _CNV_R_R_Def_dez_sl_551_CM 1 100. 0. 65535. DISPLAY_IDENTIFIER ST_LLR ECU_ADDRESS 0xc0000e26 FORMAT "%5.0" /end MEASUREMENT
/begin MEASUREMENT St_llr.B_llrein "wird beim ersten LL-Regler ein gesetzt und nicht mehr geändert" UWORD _CNV_S_2_Def_bit_ub_563_CM 1 100. 0. 1. DISPLAY_IDENTIFIER B_LLREIN ECU_ADDRESS 0xc0000e26 BIT_MASK 0x1 /end MEASUREMENT
/begin MEASUREMENT St_ls_ber "Status Momentenbereich Lastschlagdämpfung" UBYTE _CNV_R_R_Def_dez_sl_551_CM 1 100. 0. 255. DISPLAY_IDENTIFIER ST_LS_BER ECU_ADDRESS 0xd000e257 FORMAT "%3.0" /end MEASUREMENT
/begin MEASUREMENT St_mdar0 "Statuswort" UBYTE _CNV_R_R_Def_dez_sl_551_CM 1 100. 0. 255. DISPLAY_IDENTIFIER ST_MDAR0 ECU_ADDRESS 0xd000e1f0 FORMAT "%3.0" /end MEASUREMENT
/begin MEASUREMENT St_mdar0.B_dmdp "Bedingung Dashpotauslöseschwelle überschritten" UBYTE _CNV_S_2_Def_bit_ub_563_CM 1 100. 0. 1. DISPLAY_IDENTIFIER B_DMDP ECU_ADDRESS 0xd000e1f0 BIT_MASK 0x80 /end MEASUREMENT
/begin MEASUREMENT St_mdar0.B_dmls "Bedingung Lastschlagdämpfungauslöseschwelle überschritten" UBYTE _CNV_S_2_Def_bit_ub_563_CM 1 100. 0. 1. DISPLAY_IDENTIFIER B_DMLS ECU_ADDRESS 0xd000e1f0 BIT_MASK 0x8 /end MEASUREMENT
/begin MEASUREMENT St_mdar0.B_dp "Bedingung Dashpot" UBYTE _CNV_S_2_Def_bit_ub_563_CM 1 100. 0. 1. DISPLAY_IDENTIFIER B_DP ECU_ADDRESS 0xd000e1f0 BIT_MASK 0x1 /end MEASUREMENT
/begin MEASUREMENT St_mdar0.B_edp "Bedingung enable Dashpot" UBYTE _CNV_S_2_Def_bit_ub_563_CM 1 100. 0. 1. DISPLAY_IDENTIFIER B_EDP ECU_ADDRESS 0xd000e1f0 BIT_MASK 0x4 /end MEASUREMENT
/begin MEASUREMENT St_mdar0.B_elsd "Bedingung enable Lastschlagdämpfung" UBYTE _CNV_S_2_Def_bit_ub_563_CM 1 100. 0. 1. DISPLAY_IDENTIFIER B_ELSD ECU_ADDRESS 0xd000e1f0 BIT_MASK 0x2 /end MEASUREMENT
/begin MEASUREMENT St_mdar0.B_ifdp "Bedingung Initialisierung Dashpotfilter" UBYTE _CNV_S_2_Def_bit_ub_563_CM 1 100. 0. 1. DISPLAY_IDENTIFIER B_IFDP ECU_ADDRESS 0xd000e1f0 BIT_MASK 0x20 /end MEASUREMENT
/begin MEASUREMENT St_mdar0.B_ls "Bedingung Lastschlagdämpfung" UBYTE _CNV_S_2_Def_bit_ub_563_CM 1 100. 0. 1. DISPLAY_IDENTIFIER B_LS ECU_ADDRESS 0xd000e1f0 BIT_MASK 0x10 /end MEASUREMENT
/begin MEASUREMENT St_mdar0.B_lsd "Bedingung Lastschlagdämpfungsänderungsbegrenzung aktiv" UBYTE _CNV_S_2_Def_bit_ub_563_CM 1 100. 0. 1. DISPLAY_IDENTIFIER B_LSD ECU_ADDRESS 0xd000e1f0 BIT_MASK 0x40 /end MEASUREMENT
/begin MEASUREMENT St_mdar1 "Statuswort" UBYTE _CNV_R_R_Def_dez_sl_551_CM 1 100. 0. 255. DISPLAY_IDENTIFIER ST_MDAR1 ECU_ADDRESS 0xd000e1f1 FORMAT "%3.0" /end MEASUREMENT
/begin MEASUREMENT St_mdar1.B_dash "Bedingung Dashpotänderungsbegrenzung aktiv" UBYTE _CNV_S_2_Def_bit_ub_563_CM 1 100. 0. 1. DISPLAY_IDENTIFIER B_DASH ECU_ADDRESS 0xd000e1f1 BIT_MASK 0x1 /end MEASUREMENT
/begin MEASUREMENT St_mdar1.B_iflsd "Bedingung Initialisierung Lastschlagdämpfungsfilter" UBYTE _CNV_S_2_Def_bit_ub_563_CM 1 100. 0. 1. DISPLAY_IDENTIFIER B_IFLSD ECU_ADDRESS 0xd000e1f1 BIT_MASK 0x2 /end MEASUREMENT
/begin MEASUREMENT St_mdar1.B_kf_at "Bedingung Automatikkennfelder nehmen" UBYTE _CNV_S_2_Def_bit_ub_563_CM 1 100. 0. 1. DISPLAY_IDENTIFIER B_KF_AT ECU_ADDRESS 0xd000e1f1 BIT_MASK 0x10 /end MEASUREMENT
/begin MEASUREMENT St_mdar1.B_ll_md "Bedingung Leerlauf aus Momentensicht" UBYTE _CNV_S_2_Def_bit_ub_563_CM 1 100. 0. 1. DISPLAY_IDENTIFIER B_LL_MD ECU_ADDRESS 0xd000e1f1 BIT_MASK 0x4 /end MEASUREMENT
/begin MEASUREMENT St_mdar1.B_tl_md "Bedingung Teillast aus Momentensicht" UBYTE _CNV_S_2_Def_bit_ub_563_CM 1 100. 0. 1. DISPLAY_IDENTIFIER B_TL_MD ECU_ADDRESS 0xd000e1f1 BIT_MASK 0x8 /end MEASUREMENT
/begin MEASUREMENT St_mdar1.B_vlschalt_verz "Bedingung Dashpot" UBYTE _CNV_S_2_Def_bit_ub_563_CM 1 100. 0. 1. DISPLAY_IDENTIFIER B_VLSCHALT_VERZ ECU_ADDRESS 0xd000e1f1 BIT_MASK 0x40 /end MEASUREMENT
/begin MEASUREMENT St_mdar2 "Statuswort" UBYTE _CNV_R_R_Def_dez_sl_551_CM 1 100. 0. 255. DISPLAY_IDENTIFIER ST_MDAR2 ECU_ADDRESS 0xd000e1f2 FORMAT "%3.0" /end MEASUREMENT
/begin MEASUREMENT St_mdar2.B_lsd4 "Bedingung Teillast aus Momentensicht" UBYTE _CNV_S_2_Def_bit_ub_563_CM 1 100. 0. 1. DISPLAY_IDENTIFIER B_LSD4 ECU_ADDRESS 0xd000e1f2 BIT_MASK 0x1 /end MEASUREMENT
/begin MEASUREMENT St_mdna "" UBYTE _CNV_R_R_Def_dez_sl_551_CM 1 100. 0. 255. DISPLAY_IDENTIFIER ST_MDNA ECU_ADDRESS 0xd000e094 FORMAT "%3.0" /end MEASUREMENT
/begin MEASUREMENT St_mdna.B_lastab "Bedingung Anforderung Lastabwurf" UBYTE _CNV_S_2_Def_bit_ub_563_CM 1 100. 0. 1. DISPLAY_IDENTIFIER B_LASTAB ECU_ADDRESS 0xd000e094 BIT_MASK 0x1 /end MEASUREMENT
/begin MEASUREMENT St_mdr2mdk "Statuswort mdr2mdk" UBYTE _CNV_R_R_Def_dez_sl_551_CM 1 100. 0. 255. DISPLAY_IDENTIFIER ST_MDR2MDK ECU_ADDRESS 0xd000e2f8 FORMAT "%3.0" /end MEASUREMENT
/begin MEASUREMENT St_mdr2mdk.B_md_asr_grdl "Bed. Gradientenlimitierung Mdk_asr_s" UBYTE _CNV_S_2_Def_bit_ub_563_CM 1 100. 0. 1. DISPLAY_IDENTIFIER B_MD_ASR_GRDL ECU_ADDRESS 0xd000e2f8 BIT_MASK 0x1 /end MEASUREMENT
/begin MEASUREMENT St_mdreib "Status Reibungsmoment" UBYTE _CNV_R_R_Def_dez_sl_551_CM 1 100. 0. 255. DISPLAY_IDENTIFIER ST_MDREIB ECU_ADDRESS 0xd000e316 FORMAT "%3.0" /end MEASUREMENT
/begin MEASUREMENT St_mdreib.B_mdst_ba "Betriebsartwahl Startmoment" UBYTE _CNV_S_2_Def_bit_ub_563_CM 1 100. 0. 1. DISPLAY_IDENTIFIER B_MDST_BA ECU_ADDRESS 0xd000e316 BIT_MASK 0x2 /end MEASUREMENT
/begin MEASUREMENT St_mdreib.B_reib_addba2 "Bedingung Hoehenreibungsmoment Umschaltung" UBYTE _CNV_S_2_Def_bit_ub_563_CM 1 100. 0. 1. DISPLAY_IDENTIFIER B_REIB_ADDBA2 ECU_ADDRESS 0xd000e316 BIT_MASK 0x1 /end MEASUREMENT
/begin MEASUREMENT St_mdres "Status Momentenreserve" UBYTE _CNV_R_R_Def_dez_sl_551_CM 1 100. 0. 255. DISPLAY_IDENTIFIER ST_MDRES ECU_ADDRESS 0xd000dd5c FORMAT "%3.0" /end MEASUREMENT
/begin MEASUREMENT St_mdres.B_md_res "Bedingung Momentenreserve aktiv" UBYTE _CNV_S_2_Def_bit_ub_563_CM 1 100. 0. 1. DISPLAY_IDENTIFIER B_MD_RES ECU_ADDRESS 0xd000dd5c BIT_MASK 0x1 /end MEASUREMENT
/begin MEASUREMENT St_mdres.B_mdres_akt "Status Momentenreserve" UBYTE _CNV_S_2_Def_bit_ub_563_CM 1 100. 0. 1. DISPLAY_IDENTIFIER B_MDRES_AKT ECU_ADDRESS 0xd000dd5c BIT_MASK 0x2 /end MEASUREMENT
/begin MEASUREMENT St_mdreskrll "Statuswort MDRESKRLL" UBYTE _CNV_R_R_Def_dez_sl_551_CM 1 100. 0. 255. DISPLAY_IDENTIFIER ST_MDRESKRLL ECU_ADDRESS 0xd000e0a0 FORMAT "%3.0" /end MEASUREMENT
/begin MEASUREMENT St_mdreskrll.B_llk_verz "Bedingung B_llk verzögert" UBYTE _CNV_S_2_Def_bit_ub_563_CM 1 100. 0. 1. DISPLAY_IDENTIFIER B_LLK_VERZ ECU_ADDRESS 0xd000e0a0 BIT_MASK 0x4 /end MEASUREMENT
/begin MEASUREMENT St_mdreskrll.B_mdres_krll "Bedingung Momentenreserve der KR im LL" UBYTE _CNV_S_2_Def_bit_ub_563_CM 1 100. 0. 1. DISPLAY_IDENTIFIER B_MDRES_KRLL ECU_ADDRESS 0xd000e0a0 BIT_MASK 0x2 /end MEASUREMENT
/begin MEASUREMENT St_mdreskrll.B_zwe_krll "Bedingung Zündwinkeleingriff der KR im LL" UBYTE _CNV_S_2_Def_bit_ub_563_CM 1 100. 0. 1. DISPLAY_IDENTIFIER B_ZWE_KRLL ECU_ADDRESS 0xd000e0a0 BIT_MASK 0x1 /end MEASUREMENT
/begin MEASUREMENT St_mini "Statuswort" UBYTE _CNV_R_R_Def_dez_sl_551_CM 1 100. 0. 255. DISPLAY_IDENTIFIER ST_MINI ECU_ADDRESS 0xd000e1f3 FORMAT "%3.0" /end MEASUREMENT
/begin MEASUREMENT St_mini.B_mdimin_sa "Bedingung Schubaschaltung" UBYTE _CNV_S_2_Def_bit_ub_563_CM 1 100. 0. 1. DISPLAY_IDENTIFIER B_MDIMIN_SA ECU_ADDRESS 0xd000e1f3 BIT_MASK 0x1 /end MEASUREMENT
/begin MEASUREMENT St_mini.B_zwmin_ext "Bedingung Zw_min" UBYTE _CNV_S_2_Def_bit_ub_563_CM 1 100. 0. 1. DISPLAY_IDENTIFIER B_ZWMIN_EXT ECU_ADDRESS 0xd000e1f3 BIT_MASK 0x2 /end MEASUREMENT
/begin MEASUREMENT St_nschalt "Statuswort" UBYTE _CNV_R_R_Def_dez_sl_551_CM 1 100. 0. 255. DISPLAY_IDENTIFIER ST_NSCHALT ECU_ADDRESS 0xd000e2aa FORMAT "%3.0" /end MEASUREMENT
/begin MEASUREMENT St_nschalt.B_aufregelung "Statusbyte" UBYTE _CNV_S_2_Def_bit_ub_563_CM 1 100. 0. 1. DISPLAY_IDENTIFIER B_AUFREGELUNG ECU_ADDRESS 0xd000e2aa BIT_MASK 0x1 /end MEASUREMENT
/begin MEASUREMENT St_nschalt.B_schalt_dkgalt "Altwert B_schalt" UBYTE _CNV_S_2_Def_bit_ub_563_CM 1 100. 0. 1. DISPLAY_IDENTIFIER B_SCHALT_DKGALT ECU_ADDRESS 0xd000e2aa BIT_MASK 0x2 /end MEASUREMENT
/begin MEASUREMENT St_ti_b "" UBYTE _CNV_R_R_Def_dez_sl_551_CM 1 100. 0. 255. DISPLAY_IDENTIFIER ST_TI_B ECU_ADDRESS 0xd000dc28 FORMAT "%3.0" /end MEASUREMENT
/begin MEASUREMENT St_ti_b.B_temxon "Rf-Begrenzung aktiv" UBYTE _CNV_S_2_Def_bit_ub_563_CM 1 100. 0. 1. DISPLAY_IDENTIFIER B_TEMXON ECU_ADDRESS 0xd000dc28 BIT_MASK 0x1 /end MEASUREMENT
/begin MEASUREMENT T_ar_aus "Aktiv-Zeit Ar" UWORD _CNV_R_R_Def_td_uw__673_CM 1 100. 0. 655.35 DISPLAY_IDENTIFIER T_AR_AUS ECU_ADDRESS 0xd000e274 FORMAT "%7.2" /end MEASUREMENT
/begin MEASUREMENT T_dash "Zeit Dashpot aktiv" UWORD _CNV_R_R_Def_td_uw__673_CM 1 100. 0. 655.35 DISPLAY_IDENTIFIER T_DASH ECU_ADDRESS 0xd000e24c FORMAT "%7.2" /end MEASUREMENT
/begin MEASUREMENT T_lsd "Zeit LSD aktiv" UWORD _CNV_R_R_Def_td_uw__673_CM 1 100. 0. 655.35 DISPLAY_IDENTIFIER T_LSD ECU_ADDRESS 0xd000e24e FORMAT "%7.2" /end MEASUREMENT
/begin MEASUREMENT T_lsd4 "Zeit LSD aktiv" UWORD _CNV_R_R_Def_td_uw__673_CM 1 100. 0. 655.35 DISPLAY_IDENTIFIER T_LSD4 ECU_ADDRESS 0xd000e250 FORMAT "%7.2" /end MEASUREMENT
/begin MEASUREMENT T_p_ar "" UWORD _CNV_R_R_Def_dez_sl_551_CM 1 100. 0. 65535. DISPLAY_IDENTIFIER T_P_AR ECU_ADDRESS 0xd000e278 FORMAT "%5.0" /end MEASUREMENT
/begin MEASUREMENT T_umdreh_wt "Umdrehungszeit gewichtet" UWORD _CNV_R_R_Def_ti_uw__714_CM 1 100. 0. 838.848 DISPLAY_IDENTIFIER T_UMDREH_WT ECU_ADDRESS 0xd000dc54 FORMAT "%8.3" /end MEASUREMENT
/begin MEASUREMENT Td_ar_an "Verzögerungszeit" UBYTE _CNV_R_R_Def_td_uw__673_CM 1 100. 0. 2.55 DISPLAY_IDENTIFIER TD_AR_AN ECU_ADDRESS 0xd000e268 FORMAT "%5.2" /end MEASUREMENT
/begin MEASUREMENT Td_ar_ber "Verzögerungszeit" UWORD _CNV_R_R_Def_td_uw__673_CM 1 100. 0. 655.35 DISPLAY_IDENTIFIER TD_AR_BER ECU_ADDRESS 0xd000e26a FORMAT "%7.2" /end MEASUREMENT
/begin MEASUREMENT Td_bllk "Rechenschritte Verzögerung B_llk" UBYTE _CNV_R_R_Def_dez_sl_551_CM 1 100. 0. 255. DISPLAY_IDENTIFIER TD_BLLK ECU_ADDRESS 0xd000e0a1 FORMAT "%3.0" /end MEASUREMENT
/begin MEASUREMENT Td_kupp "Verzögerungszeit" UWORD _CNV_R_R_Def_td_uw__673_CM 1 100. 0. 655.35 DISPLAY_IDENTIFIER TD_KUPP ECU_ADDRESS 0xd000e26c FORMAT "%7.2" /end MEASUREMENT
/begin MEASUREMENT Tdnschalt "Verzögerungszeit Anschlussdrehzahlrampe" UWORD _CNV_R_R_Def_td_uw__673_CM 1 100. 0. 655.35 DISPLAY_IDENTIFIER TDNSCHALT ECU_ADDRESS 0xd000e2bc FORMAT "%7.2" /end MEASUREMENT
/begin MEASUREMENT Tdschalt_max "Verzögerungszeit Abschaltung Anschlussdrehzahlregelung" UWORD _CNV_R_R_Def_td_uw__673_CM 1 100. 0. 655.35 DISPLAY_IDENTIFIER TDSCHALT_MAX ECU_ADDRESS 0xd000e2ba FORMAT "%7.2" /end MEASUREMENT
/begin MEASUREMENT Ti_quot "Quotient Tseg/Ti" UWORD _CNV_R_R_Def_f_uw_b_590_CM 1 100. 0. 1.9999 DISPLAY_IDENTIFIER TI_QUOT ECU_ADDRESS 0xd000dc52 FORMAT "%14.5" /end MEASUREMENT
/begin MEASUREMENT Var_at "Variante Automatik-Getriebe" UBYTE _CNV_R_R_Def_dez_sl_551_CM 1 100. 0. 1. DISPLAY_IDENTIFIER VAR_AT ECU_ADDRESS 0xd000e1fd FORMAT "%3.0" /end MEASUREMENT
/begin MEASUREMENT Wandler_mu "Wirkungsgrad/Momentenüberhöhung des Wandlers" UBYTE _CNV_R_R_Def_f_ub_b_737_CM 1 100. 0. 3. DISPLAY_IDENTIFIER WANDLER_MU ECU_ADDRESS 0xd000e258 FORMAT "%5.2" /end MEASUREMENT
/begin MEASUREMENT Zr_entpr_fl "Entprellzähler für Aktivierung Flankendetektor" UBYTE _CNV_R_R_Def_dez_sl_551_CM 1 100. 0. 255. DISPLAY_IDENTIFIER ZR_ENTPR_FL ECU_ADDRESS 0xd000e270 FORMAT "%3.0" /end MEASUREMENT
/begin MEASUREMENT Zr_fl_ar "Zähler für Flankendetektor" UBYTE _CNV_R_R_Def_dez_sl_551_CM 1 100. 0. 255. DISPLAY_IDENTIFIER ZR_FL_AR ECU_ADDRESS 0xd000e26f FORMAT "%3.0" /end MEASUREMENT
/begin MEASUREMENT Zr_schwingung_ar "Zähler Ruckelschwingungen" UBYTE _CNV_R_R_Def_dez_sl_551_CM 1 100. 0. 255. DISPLAY_IDENTIFIER ZR_SCHWINGUNG_AR ECU_ADDRESS 0xd000e26e FORMAT "%3.0" /end MEASUREMENT
/begin MEASUREMENT Zr_vbar "Zähler AR verboten" UWORD _CNV_R_R_Def_td_uw__673_CM 1 100. 0. 655.35 DISPLAY_IDENTIFIER ZR_VBAR ECU_ADDRESS 0xd000e276 FORMAT "%7.2" /end MEASUREMENT
/begin CHARACTERISTIC CW_AR "Freigabe AR bei Ll, B_lsd, B_dash" VALUE 0xa082d8c2 _REC_VAL_20_u1 99.45 _CNV_R_R_Def_dez_sl_551_CM 0. 255. FORMAT "%3.0" /end CHARACTERISTIC
/begin CHARACTERISTIC CW_FMKNUL "Codewort Berechnungsart Bereich" VALUE 0xa082c1ed _REC_VAL_20_u1 99.45 _CNV_R_R_Def_dez_sl_551_CM 0. 255. FORMAT "%3.0" /end CHARACTERISTIC
/begin CHARACTERISTIC CW_MD_TURBO "Codeword MD Berechnung - TURBO Modus" VALUE 0xa0826774 _REC_VAL_20_u1 99.45 _CNV_R_R_Def_dez_sl_551_CM 0. 255. FORMAT "%3.0" /end CHARACTERISTIC
/begin CHARACTERISTIC CW_NA "Codewort Nebenaggregate" VALUE 0xa082b5c8 _REC_VAL_20_u1 99.45 _CNV_R_R_Def_dez_sl_551_CM 0. 255. FORMAT "%3.0" /end CHARACTERISTIC
/begin CHARACTERISTIC CW_S_SPORT "Codewort Wirkung Sportschalter auf Momentengradientenbereich" VALUE 0xa082c1ee _REC_VAL_20_u1 99.45 _CNV_R_R_Def_dez_sl_551_CM 0. 255. FORMAT "%3.0" /end CHARACTERISTIC
/begin CHARACTERISTIC CW_TRQTR1 "Codewort Softwareschalter 1 für Änderungsbegrenzung" VALUE 0xa082c1ef _REC_VAL_20_u1 99.45 _CNV_R_R_Def_dez_sl_551_CM 0. 255. FORMAT "%3.0" /end CHARACTERISTIC
/begin CHARACTERISTIC CW_TRQTR2 "Codewort Softwareschalter 2 für Änderungsbegrenzung" VALUE 0xa082c1f0 _REC_VAL_20_u1 99.45 _CNV_R_R_Def_dez_sl_551_CM 0. 255. FORMAT "%3.0" /end CHARACTERISTIC
/begin CHARACTERISTIC CW_TZKMDMX "Berechnungsart Einlassventiltemperatur" VALUE 0xa0826e44 _REC_VAL_20_u1 99.45 _CNV_R_R_Def_dez_sl_551_CM 0. 255. FORMAT "%3.0" /end CHARACTERISTIC
/begin CHARACTERISTIC CW_VL "" VALUE 0xa0826e43 _REC_VAL_20_u1 99.45 _CNV_R_R_Def_dez_sl_551_CM 0. 255. FORMAT "%3.0" /end CHARACTERISTIC
/begin CHARACTERISTIC KF_DASHMDK3 "Zeitabhängigkeit LSD Gradient Bereich 3" MAP 0xa082cd0c _REC_MAP_52_u1_u1_u2 3. _CNV_R_R_Def_f_ub_b_737_CM 0. 3. FORMAT "%5.2"
 /begin AXIS_DESCR STD_AXIS NO_INPUT_QUANTITY _CNV_R_R_Def_f_ub_b_737_CM 6 0. 3. FORMAT "%5.2" /end AXIS_DESCR
 /begin AXIS_DESCR STD_AXIS T_dash _CNV_R_R_Def_td_uw__673_CM 8 0. 655.35 FORMAT "%5.2" /end AXIS_DESCR
/end CHARACTERISTIC
/begin CHARACTERISTIC KF_DASHMDK3_MN "minimale Monentenwichtung Dashpot Bereich 3" MAP 0xa082d0f8 _REC_MAP_52_u1_s2_s2 3. _CNV_R_R_Def_f_ub_b_737_CM 0. 3. FORMAT "%5.2"
 /begin AXIS_DESCR STD_AXIS Mdk_wunsch _CNV_R_R_Def_m_sw_q_554_CM 8 -3276.8 3276.7 FORMAT "%5.2" /end AXIS_DESCR
 /begin AXIS_DESCR STD_AXIS Mdk_wunsch_grad _CNV_R_R_Def_m_sw_q_554_CM 6 -3276.8 3276.7 FORMAT "%5.2" /end AXIS_DESCR
/end CHARACTERISTIC
/begin CHARACTERISTIC KF_DMDNA_MN "Mindestmomentenrampe bei Aenderung der Nebenaggregatslast" MAP 0xa082d1c0 _REC_MAP_52_UBYTE_s2_u2_s2 131.07 _CNV_R_R_Def_m_sw_q_554_CM -3276.8 3276.7 FORMAT "%5.2"
 /begin AXIS_DESCR STD_AXIS NO_INPUT_QUANTITY _CNV_R_R_Def_v_uw_q_726_CM 6 0. 360. FORMAT "%5.0" /end AXIS_DESCR
 /begin AXIS_DESCR STD_AXIS Md_na_ramp _CNV_R_R_Def_m_sw_q_554_CM 6 -3276.8 3276.7 FORMAT "%5.2" /end AXIS_DESCR
/end CHARACTERISTIC
/begin CHARACTERISTIC KF_DMDP1 "Kennfeld Dashpot Momentengradient Bereich 1" MAP 0xa082c50c _REC_MAP_52_UBYTE_s2_s2_u1 131.07 _CNV_R_R_Def_m_sw_q_554_CM -3276.8 3276.7 FORMAT "%5.2"
 /begin AXIS_DESCR STD_AXIS Nkw _CNV_R_R_Def_n_sw_q_595_CM 6 -32768. 32767. FORMAT "%5.0" /end AXIS_DESCR
 /begin AXIS_DESCR STD_AXIS Gangi _CNV_R_R_Def_dez_sl_551_CM 8 0. 255. FORMAT "%3.0" /end AXIS_DESCR
/end CHARACTERISTIC
/begin CHARACTERISTIC KF_DMDP1A "Dashpot Momentengradient Bereich 1 / Automat" MAP 0xa082d494 _REC_MAP_52_UBYTE_s2_s2_u1 131.07 _CNV_R_R_Def_m_sw_q_554_CM -3276.8 3276.7 FORMAT "%5.2"
 /begin AXIS_DESCR STD_AXIS Nkw _CNV_R_R_Def_n_sw_q_595_CM 6 -32768. 32767. FORMAT "%5.0" /end AXIS_DESCR
 /begin AXIS_DESCR STD_AXIS Gangi _CNV_R_R_Def_dez_sl_551_CM 8 0. 255. FORMAT "%3.0" /end AXIS_DESCR
/end CHARACTERISTIC
/begin CHARACTERISTIC KF_DMDP2 "Kennfeld Dashpot Momentengradient Bereich 2" MAP 0xa082cf18 _REC_MAP_52_UBYTE_s2_s2_u1 131.07 _CNV_R_R_Def_m_sw_q_554_CM -3276.8 3276.7 FORMAT "%5.2"
 /begin AXIS_DESCR STD_AXIS Nkw _CNV_R_R_Def_n_sw_q_595_CM 6 -32768. 32767. FORMAT "%5.0" /end AXIS_DESCR
 /begin AXIS_DESCR STD_AXIS Gangi _CNV_R_R_Def_dez_sl_551_CM 8 0. 255. FORMAT "%3.0" /end AXIS_DESCR
/end CHARACTERISTIC
/begin CHARACTERISTIC KF_DMDP2A "Dashpot Momentengradient Bereich 2 / Automat" MAP 0xa082c97c _REC_MAP_52_UBYTE_s2_s2_u1 131.07 _CNV_R_R_Def_m_sw_q_554_CM -3276.8 3276.7 FORMAT "%5.2"
 /begin AXIS_DESCR STD_AXIS Nkw _CNV_R_R_Def_n_sw_q_595_CM 6 -32768. 32767. FORMAT "%5.0" /end AXIS_DESCR
 /begin AXIS_DESCR STD_AXIS Gangi _CNV_R_R_Def_dez_sl_551_CM 8 0. 255. FORMAT "%3.0" /end AXIS_DESCR
/end CHARACTERISTIC
/begin CHARACTERISTIC KF_DMDP3 "Kennfeld Dashpot Momentengradient Bereich 3" MAP 0xa082c7fc _REC_MAP_52_UBYTE_s2_s2_u1 131.07 _CNV_R_R_Def_m_sw_q_554_CM -3276.8 3276.7 FORMAT "%5.2"
 /begin AXIS_DESCR STD_AXIS Nkw _CNV_R_R_Def_n_sw_q_595_CM 6 -32768. 32767. FORMAT "%5.0" /end AXIS_DESCR
 /begin AXIS_DESCR STD_AXIS Gangi _CNV_R_R_Def_dez_sl_551_CM 8 0. 255. FORMAT "%3.0" /end AXIS_DESCR
/end CHARACTERISTIC
/begin CHARACTERISTIC KF_DMDP3A "Dashpot Momentengradient Bereich 3 / Automat" MAP 0xa082d758 _REC_MAP_52_UBYTE_s2_s2_u1 131.07 _CNV_R_R_Def_m_sw_q_554_CM -3276.8 3276.7 FORMAT "%5.2"
 /begin AXIS_DESCR STD_AXIS Nkw _CNV_R_R_Def_n_sw_q_595_CM 6 -32768. 32767. FORMAT "%5.0" /end AXIS_DESCR
 /begin AXIS_DESCR STD_AXIS Gangi _CNV_R_R_Def_dez_sl_551_CM 8 0. 255. FORMAT "%3.0" /end AXIS_DESCR
/end CHARACTERISTIC
/begin CHARACTERISTIC KF_DMDPON "Kennfeld Deltamoment Dashpotauslösung" MAP 0xa082cd54 _REC_MAP_52_UBYTE_s2_s2_u1 131.07 _CNV_R_R_Def_m_sw_q_554_CM -3276.8 3276.7 FORMAT "%5.2"
 /begin AXIS_DESCR STD_AXIS Mdk_wunsch _CNV_R_R_Def_m_sw_q_554_CM 6 -3276.8 3276.7 FORMAT "%5.2" /end AXIS_DESCR
 /begin AXIS_DESCR STD_AXIS Gangi _CNV_R_R_Def_dez_sl_551_CM 8 0. 255. FORMAT "%3.0" /end AXIS_DESCR
/end CHARACTERISTIC
/begin CHARACTERISTIC KF_DMLS1GD "Kennfeld Lastschlagdämpfung Momentengradient Bereich 1 GD" MAP 0xa082cea0 _REC_MAP_52_UBYTE_s2_s2_u1 131.07 _CNV_R_R_Def_m_sw_q_554_CM -3276.8 3276.7 FORMAT "%5.2"
 /begin AXIS_DESCR STD_AXIS Nkw _CNV_R_R_Def_n_sw_q_595_CM 6 -32768. 32767. FORMAT "%5.0" /end AXIS_DESCR
 /begin AXIS_DESCR STD_AXIS Gangi _CNV_R_R_Def_dez_sl_551_CM 8 0. 255. FORMAT "%3.0" /end AXIS_DESCR
/end CHARACTERISTIC
/begin CHARACTERISTIC KF_DMLS1GDA "Kennfeld Lastschlagdämpfung Momentengradient Bereich 1 GD" MAP 0xa082d668 _REC_MAP_52_UBYTE_s2_s2_u1 131.07 _CNV_R_R_Def_m_sw_q_554_CM -3276.8 3276.7 FORMAT "%5.2"
 /begin AXIS_DESCR STD_AXIS Nkw _CNV_R_R_Def_n_sw_q_595_CM 6 -32768. 32767. FORMAT "%5.0" /end AXIS_DESCR
 /begin AXIS_DESCR STD_AXIS Gangi _CNV_R_R_Def_dez_sl_551_CM 8 0. 255. FORMAT "%3.0" /end AXIS_DESCR
/end CHARACTERISTIC
/begin CHARACTERISTIC KF_DMLS1UD "Kennfeld Lastschlagdämpfung Momentengradient Bereich 1 UGD" MAP 0xa082d340 _REC_MAP_52_UBYTE_s2_s2_u1 131.07 _CNV_R_R_Def_m_sw_q_554_CM -3276.8 3276.7 FORMAT "%5.2"
 /begin AXIS_DESCR STD_AXIS Nkw _CNV_R_R_Def_n_sw_q_595_CM 6 -32768. 32767. FORMAT "%5.0" /end AXIS_DESCR
 /begin AXIS_DESCR STD_AXIS Gangi _CNV_R_R_Def_dez_sl_551_CM 8 0. 255. FORMAT "%3.0" /end AXIS_DESCR
/end CHARACTERISTIC
/begin CHARACTERISTIC KF_DMLS1UDA "Kennfeld Lastschlagdämpfung Momentengradient Bereich 1 UGD" MAP 0xa082c70c _REC_MAP_52_UBYTE_s2_s2_u1 131.07 _CNV_R_R_Def_m_sw_q_554_CM -3276.8 3276.7 FORMAT "%5.2"
 /begin AXIS_DESCR STD_AXIS Nkw _CNV_R_R_Def_n_sw_q_595_CM 6 -32768. 32767. FORMAT "%5.0" /end AXIS_DESCR
 /begin AXIS_DESCR STD_AXIS Gangi _CNV_R_R_Def_dez_sl_551_CM 8 0. 255. FORMAT "%3.0" /end AXIS_DESCR
/end CHARACTERISTIC
/begin CHARACTERISTIC KF_DMLS2GD "Kennfeld Lastschlagdämpfung Momentengradient Bereich 2 GD" MAP 0xa082cc94 _REC_MAP_52_UBYTE_s2_s2_u1 131.07 _CNV_R_R_Def_m_sw_q_554_CM -3276.8 3276.7 FORMAT "%5.2"
 /begin AXIS_DESCR STD_AXIS Nkw _CNV_R_R_Def_n_sw_q_595_CM 6 -32768. 32767. FORMAT "%5.0" /end AXIS_DESCR
 /begin AXIS_DESCR STD_AXIS Gangi _CNV_R_R_Def_dez_sl_551_CM 8 0. 255. FORMAT "%3.0" /end AXIS_DESCR
/end CHARACTERISTIC
/begin CHARACTERISTIC KF_DMLS2GDA "Kennfeld Lastschlagdämpfung Momentengradient Bereich 2 GD" MAP 0xa082d3f8 _REC_MAP_52_UBYTE_s2_s2_u1 131.07 _CNV_R_R_Def_m_sw_q_554_CM -3276.8 3276.7 FORMAT "%5.2"
 /begin AXIS_DESCR STD_AXIS Nkw _CNV_R_R_Def_n_sw_q_595_CM 6 -32768. 32767. FORMAT "%5.0" /end AXIS_DESCR
 /begin AXIS_DESCR STD_AXIS Gangi _CNV_R_R_Def_dez_sl_551_CM 8 0. 255. FORMAT "%3.0" /end AXIS_DESCR
/end CHARACTERISTIC
/begin CHARACTERISTIC KF_DMLS2UD "Kennfeld Lastschlagdämpfung Momentengradient Bereich 2 UGD" MAP 0xa082cf90 _REC_MAP_52_UBYTE_s2_s2_u1 131.07 _CNV_R_R_Def_m_sw_q_554_CM -3276.8 3276.7 FORMAT "%5.2"
 /begin AXIS_DESCR STD_AXIS Nkw _CNV_R_R_Def_n_sw_q_595_CM 6 -32768. 32767. FORMAT "%5.0" /end AXIS_DESCR
 /begin AXIS_DESCR STD_AXIS Gangi _CNV_R_R_Def_dez_sl_551_CM 8 0. 255. FORMAT "%3.0" /end AXIS_DESCR
/end CHARACTERISTIC
/begin CHARACTERISTIC KF_DMLS2UDA "Kennfeld Lastschlagdämpfung Momentengradient Bereich 2 UGD" MAP 0xa082c3cc _REC_MAP_52_UBYTE_s2_s2_u1 131.07 _CNV_R_R_Def_m_sw_q_554_CM -3276.8 3276.7 FORMAT "%5.2"
 /begin AXIS_DESCR STD_AXIS Nkw _CNV_R_R_Def_n_sw_q_595_CM 6 -32768. 32767. FORMAT "%5.0" /end AXIS_DESCR
 /begin AXIS_DESCR STD_AXIS Gangi _CNV_R_R_Def_dez_sl_551_CM 8 0. 255. FORMAT "%3.0" /end AXIS_DESCR
/end CHARACTERISTIC
/begin CHARACTERISTIC KF_DMLSDON "Kennfeld Deltamoment Lastschlagdämpfungsauslösung" MAP 0xa082d7d0 _REC_MAP_52_UBYTE_s2_s2_u1 131.07 _CNV_R_R_Def_m_sw_q_554_CM -3276.8 3276.7 FORMAT "%5.2"
 /begin AXIS_DESCR STD_AXIS Mdk_w_f _CNV_R_R_Def_m_sw_q_554_CM 6 -3276.8 3276.7 FORMAT "%5.2" /end AXIS_DESCR
 /begin AXIS_DESCR STD_AXIS Gangi _CNV_R_R_Def_dez_sl_551_CM 8 0. 255. FORMAT "%3.0" /end AXIS_DESCR
/end CHARACTERISTIC
/begin CHARACTERISTIC KF_DMXLS3GD "Kennfeld Lastschlagdämpfung Momentengradient Bereich 3 GD" MAP 0xa082c444 _REC_MAP_52_UBYTE_s2_s2_u1 131.07 _CNV_R_R_Def_m_sw_q_554_CM -3276.8 3276.7 FORMAT "%5.2"
 /begin AXIS_DESCR STD_AXIS Nkw _CNV_R_R_Def_n_sw_q_595_CM 6 -32768. 32767. FORMAT "%5.0" /end AXIS_DESCR
 /begin AXIS_DESCR STD_AXIS Gangi _CNV_R_R_Def_dez_sl_551_CM 8 0. 255. FORMAT "%3.0" /end AXIS_DESCR
/end CHARACTERISTIC
/begin CHARACTERISTIC KF_DMXLS3GDA "Kennfeld Lastschlagdämpfung Momentengradient Bereich 3 GD" MAP 0xa082cbe8 _REC_MAP_52_UBYTE_s2_s2_u1 131.07 _CNV_R_R_Def_m_sw_q_554_CM -3276.8 3276.7 FORMAT "%5.2"
 /begin AXIS_DESCR STD_AXIS Nkw _CNV_R_R_Def_n_sw_q_595_CM 6 -32768. 32767. FORMAT "%5.0" /end AXIS_DESCR
 /begin AXIS_DESCR STD_AXIS Gangi _CNV_R_R_Def_dez_sl_551_CM 8 0. 255. FORMAT "%3.0" /end AXIS_DESCR
/end CHARACTERISTIC
/begin CHARACTERISTIC KF_DMXLS3UD "Kennfeld Lastschlagdämpfung Momentengradient Bereich 3 UGD" MAP 0xa082d148 _REC_MAP_52_UBYTE_s2_s2_u1 131.07 _CNV_R_R_Def_m_sw_q_554_CM -3276.8 3276.7 FORMAT "%5.2"
 /begin AXIS_DESCR STD_AXIS Nkw _CNV_R_R_Def_n_sw_q_595_CM 6 -32768. 32767. FORMAT "%5.0" /end AXIS_DESCR
 /begin AXIS_DESCR STD_AXIS Gangi _CNV_R_R_Def_dez_sl_551_CM 8 0. 255. FORMAT "%3.0" /end AXIS_DESCR
/end CHARACTERISTIC
/begin CHARACTERISTIC KF_DMXLS3UDA "Kennfeld Lastschlagdämpfung Momentengradient Bereich 3 UGD" MAP 0xa082d5f0 _REC_MAP_52_UBYTE_s2_s2_u1 131.07 _CNV_R_R_Def_m_sw_q_554_CM -3276.8 3276.7 FORMAT "%5.2"
 /begin AXIS_DESCR STD_AXIS Nkw _CNV_R_R_Def_n_sw_q_595_CM 6 -32768. 32767. FORMAT "%5.0" /end AXIS_DESCR
 /begin AXIS_DESCR STD_AXIS Gangi _CNV_R_R_Def_dez_sl_551_CM 8 0. 255. FORMAT "%3.0" /end AXIS_DESCR
/end CHARACTERISTIC
/begin CHARACTERISTIC KF_DMXLS4 "Kennfeld Lastschlagdämpfung Momentengradient Bereich 3 GD" MAP 0xa082d080 _REC_MAP_52_UBYTE_s2_s2_u1 131.07 _CNV_R_R_Def_m_sw_q_554_CM -3276.8 3276.7 FORMAT "%5.2"
 /begin AXIS_DESCR STD_AXIS Nkw _CNV_R_R_Def_n_sw_q_595_CM 6 -32768. 32767. FORMAT "%5.0" /end AXIS_DESCR
 /begin AXIS_DESCR STD_AXIS Gangi _CNV_R_R_Def_dez_sl_551_CM 8 0. 255. FORMAT "%3.0" /end AXIS_DESCR
/end CHARACTERISTIC
/begin CHARACTERISTIC KF_DPSFTD "Kennfeld Faktor Saugrohrdruck UGD-TD-GD" MAP 0xa082d5b0 _REC_MAP_52_u1_s2_s2 0.996 _CNV_R_R_Def_f_ub_b_553_CM 0. 0.996
 /begin AXIS_DESCR STD_AXIS Dpssolgd _CNV_R_R_Def_p_sw_q_576_CM 6 -1280. 1279.9609 FORMAT "%5.2" /end AXIS_DESCR
 /begin AXIS_DESCR STD_AXIS NO_INPUT_QUANTITY _CNV_R_R_Def_p_sw_q_576_CM 6 -1280. 1279.9609 FORMAT "%5.2" /end AXIS_DESCR
/end CHARACTERISTIC
/begin CHARACTERISTIC KF_D_PAR "" MAP 0xa082da28 _REC_MAP_52_UBYTE_s1_u1_s2 0.498 _CNV_R_R_Def_f_sb_b_742_CM -0.25 0.248
 /begin AXIS_DESCR STD_AXIS Gangi _CNV_R_R_Def_dez_sl_551_CM 8 0. 255. FORMAT "%3.0" /end AXIS_DESCR
 /begin AXIS_DESCR STD_AXIS Nkw _CNV_R_R_Def_n_sw_q_595_CM 4 -32768. 32767. FORMAT "%5.0" /end AXIS_DESCR
/end CHARACTERISTIC
/begin CHARACTERISTIC KF_D_PARA "" MAP 0xa082da5c _REC_MAP_52_UBYTE_s1_u1_s2 0.498 _CNV_R_R_Def_f_sb_b_742_CM -0.25 0.248
 /begin AXIS_DESCR STD_AXIS Gangi _CNV_R_R_Def_dez_sl_551_CM 8 0. 255. FORMAT "%3.0" /end AXIS_DESCR
 /begin AXIS_DESCR STD_AXIS Nkw _CNV_R_R_Def_n_sw_q_595_CM 4 -32768. 32767. FORMAT "%5.0" /end AXIS_DESCR
/end CHARACTERISTIC
/begin CHARACTERISTIC KF_FDASHMDK3 "Pedalwichtung Dashpot Bereich 3" MAP 0xa082c37c _REC_MAP_52_u1_s2_s2 3. _CNV_R_R_Def_f_ub_b_737_CM 0. 3. FORMAT "%5.2"
 /begin AXIS_DESCR STD_AXIS Mdk_wunsch_gradmx _CNV_R_R_Def_m_sw_q_554_CM 6 -3276.8 3276.7 FORMAT "%5.2" /end AXIS_DESCR
 /begin AXIS_DESCR STD_AXIS Mdk_wunsch_ref_sa _CNV_R_R_Def_m_sw_q_554_CM 8 -3276.8 3276.7 FORMAT "%5.2" /end AXIS_DESCR
/end CHARACTERISTIC
/begin CHARACTERISTIC KF_FDASHPWG3 "Pedalwichtung Dashpot Bereich 3" MAP 0xa082c8ec _REC_MAP_52_u1_s2_s2 3. _CNV_R_R_Def_f_ub_b_737_CM 0. 3. FORMAT "%5.2"
 /begin AXIS_DESCR STD_AXIS NO_INPUT_QUANTITY _CNV_R_R_Def_wdk_sw_683_CM 8 -800. 799.9755 FORMAT "%5.2" /end AXIS_DESCR
 /begin AXIS_DESCR STD_AXIS Pwg_grad _CNV_R_R_Def_pwggrd_682_CM 6 -20000. 19999.3896 /end AXIS_DESCR
/end CHARACTERISTIC
/begin CHARACTERISTIC KF_FDASH_TMOT "Temperaturwichtung Dashpot Bereich 3" MAP 0xa082c6d8 _REC_MAP_52_UBYTE_u2_s2_s2 0.9999847412109381 _CNV_R_R_Def_f_uw_b_571_CM 0. 0.9999847412109381 FORMAT "%14.5"
 /begin AXIS_DESCR STD_AXIS Nkw _CNV_R_R_Def_n_sw_q_595_CM 4 -32768. 32767. FORMAT "%5.0" /end AXIS_DESCR
 /begin AXIS_DESCR STD_AXIS Tmot _CNV_R_R_Def_t_sw_q_579_CM 4 -327.68 327.67 FORMAT "%5.2" /end AXIS_DESCR
/end CHARACTERISTIC
/begin CHARACTERISTIC KF_FDASH_TMOTA "Temperaturwichtung Dashpot Bereich 3 / Automat" MAP 0xa082cc60 _REC_MAP_52_UBYTE_u2_s2_s2 0.9999847412109381 _CNV_R_R_Def_f_uw_b_571_CM 0. 0.9999847412109381 FORMAT "%14.5"
 /begin AXIS_DESCR STD_AXIS Nkw _CNV_R_R_Def_n_sw_q_595_CM 4 -32768. 32767. FORMAT "%5.0" /end AXIS_DESCR
 /begin AXIS_DESCR STD_AXIS Tmot _CNV_R_R_Def_t_sw_q_579_CM 4 -327.68 327.67 FORMAT "%5.2" /end AXIS_DESCR
/end CHARACTERISTIC
/begin CHARACTERISTIC KF_FDMDPA12 "Wichtung Dashpot Bereich 1+2 über A_quer und Gang" MAP 0xa082c4bc _REC_MAP_52_u1_s2_s2 0.996 _CNV_R_R_Def_f_ub_b_553_CM 0. 0.996
 /begin AXIS_DESCR STD_AXIS A_quer_abs _CNV_R_R_Def_a_sw_b_549_CM 6 -64. 63.998 FORMAT "%5.2" /end AXIS_DESCR
 /begin AXIS_DESCR STD_AXIS NO_INPUT_QUANTITY _CNV_R_R_Def_dez_sl_551_CM 8 -32768. 32767. FORMAT "%5.0" /end AXIS_DESCR
/end CHARACTERISTIC
/begin CHARACTERISTIC KF_FDMDPA3 "Wichtung Dashpot Bereich 3 über A_quer und Gang" MAP 0xa082cb98 _REC_MAP_52_u1_s2_s2 0.996 _CNV_R_R_Def_f_ub_b_553_CM 0. 0.996
 /begin AXIS_DESCR STD_AXIS A_quer_abs _CNV_R_R_Def_a_sw_b_549_CM 6 -64. 63.998 FORMAT "%5.2" /end AXIS_DESCR
 /begin AXIS_DESCR STD_AXIS NO_INPUT_QUANTITY _CNV_R_R_Def_dez_sl_551_CM 8 -32768. 32767. FORMAT "%5.0" /end AXIS_DESCR
/end CHARACTERISTIC
/begin CHARACTERISTIC KF_FDMFBT "Kennfeld Faktor dyn. Überblendung UGD-TD-GD" MAP 0xa082ca6c _REC_MAP_52_u1_u1_u1 0.996 _CNV_R_R_Def_f_ub_b_553_CM 0. 0.996 /begin AXIS_DESCR STD_AXIS Dpsfaktd _CNV_R_R_Def_f_ub_b_553_CM 6 0. 0.996 /end AXIS_DESCR /begin AXIS_DESCR STD_AXIS Dpsfak _CNV_R_R_Def_f_ub_b_553_CM 2 0. 0.996 /end AXIS_DESCR /end CHARACTERISTIC
/begin CHARACTERISTIC KF_FLSDMDKL "Faktor Einfluß Momentenwunsch auf Füllung bei Lastschlagdämpfung" MAP 0xa082d50c _REC_MAP_52_UBYTE_u2_s2_s2 99.83844000000001 _CNV_R_R_Def_f_uw_b_621_CM 0. 255.996
 /begin AXIS_DESCR STD_AXIS Mdk_wunsch _CNV_R_R_Def_m_sw_q_554_CM 8 -3276.8 3276.7 FORMAT "%5.2" /end AXIS_DESCR
 /begin AXIS_DESCR STD_AXIS Mdk_wunsch_d _CNV_R_R_Def_m_sw_q_554_CM 8 -3276.8 3276.7 FORMAT "%5.2" /end AXIS_DESCR
/end CHARACTERISTIC
/begin CHARACTERISTIC KF_FLSDPWGL "Kennfeld Faktor Einfluß Fahrpedal auf Füllung bei Lastschlagdämpfung" MAP 0xa082d224 _REC_MAP_52_UBYTE_u2_s2_s2 99.83844000000001 _CNV_R_R_Def_f_uw_b_621_CM 0. 255.996
 /begin AXIS_DESCR STD_AXIS NO_INPUT_QUANTITY _CNV_R_R_Def_wdk_sw_683_CM 8 -800. 799.9755 FORMAT "%5.2" /end AXIS_DESCR
 /begin AXIS_DESCR STD_AXIS Mdk_wunsch_d _CNV_R_R_Def_m_sw_q_554_CM 8 -3276.8 3276.7 FORMAT "%5.2" /end AXIS_DESCR
/end CHARACTERISTIC
/begin CHARACTERISTIC KF_FMDKWUGRAD12 "Kennfeld Wichtung Grad Dashpot Bereich12" MAP 0xa082c93c _REC_MAP_52_u1_s2_s2 3.9843 _CNV_R_R_Def_f_ub_b_632_CM 0. 3.9843 FORMAT "%5.2"
 /begin AXIS_DESCR STD_AXIS Mdk_wunsch_gradmx _CNV_R_R_Def_m_sw_q_554_CM 6 -3276.8 3276.7 FORMAT "%5.2" /end AXIS_DESCR
 /begin AXIS_DESCR STD_AXIS Mdk_wunsch_ref_sa _CNV_R_R_Def_m_sw_q_554_CM 6 -3276.8 3276.7 FORMAT "%5.2" /end AXIS_DESCR
/end CHARACTERISTIC
/begin CHARACTERISTIC KF_FMDKWUGRAD3 "Kennfeld Wichtung Grad Dashpot Bereich3" MAP 0xa082d3b8 _REC_MAP_52_u1_s2_s2 3.9843 _CNV_R_R_Def_f_ub_b_632_CM 0. 3.9843 FORMAT "%5.2"
 /begin AXIS_DESCR STD_AXIS Mdk_wunsch_gradmx _CNV_R_R_Def_m_sw_q_554_CM 6 -3276.8 3276.7 FORMAT "%5.2" /end AXIS_DESCR
 /begin AXIS_DESCR STD_AXIS Mdk_wunsch_ref_sa _CNV_R_R_Def_m_sw_q_554_CM 6 -3276.8 3276.7 FORMAT "%5.2" /end AXIS_DESCR
/end CHARACTERISTIC
/begin CHARACTERISTIC KF_FRFMXKR "Faktor RF" MAP 0xa082b840 _REC_MAP_52_UBYTE_u2_s2_s2 1.9999 _CNV_R_R_Def_f_uw_b_590_CM 0. 1.9999 FORMAT "%14.5"
 /begin AXIS_DESCR STD_AXIS Nkw _CNV_R_R_Def_n_sw_q_595_CM 8 -32768. 32767. FORMAT "%5.0" /end AXIS_DESCR
 /begin AXIS_DESCR STD_AXIS Dzw_ldkrstat _CNV_R_R_Def_zw_sw__604_CM 8 -50. 60. FORMAT "%4.1" /end AXIS_DESCR
/end CHARACTERISTIC
/begin CHARACTERISTIC KF_FRFMXTALD "Faktor Max. Fuellung" MAP 0xa082b7dc _REC_MAP_52_UBYTE_u2_s2_s2 1.9999 _CNV_R_R_Def_f_uw_b_590_CM 0. 1.9999 FORMAT "%14.5"
 /begin AXIS_DESCR STD_AXIS Nkw _CNV_R_R_Def_n_sw_q_595_CM 6 -32768. 32767. FORMAT "%5.0" /end AXIS_DESCR
 /begin AXIS_DESCR STD_AXIS Tans _CNV_R_R_Def_t_sw_q_578_CM 6 -3276.8 3276.7 FORMAT "%4.1" /end AXIS_DESCR
/end CHARACTERISTIC
/begin CHARACTERISTIC KF_LSDUEB_T "Überblendung des Momentenwunschs bei LSD4" MAP 0xa082cafc _REC_MAP_52_u1_u2_s2 0.996 _CNV_R_R_Def_f_ub_b_553_CM 0. 0.996
 /begin AXIS_DESCR STD_AXIS T_lsd4 _CNV_R_R_Def_td_uw__673_CM 4 0. 655.35 FORMAT "%5.2" /end AXIS_DESCR
 /begin AXIS_DESCR STD_AXIS NO_INPUT_QUANTITY _CNV_R_R_Def_m_sw_q_554_CM 4 -3276.8 3276.7 FORMAT "%5.2" /end AXIS_DESCR
/end CHARACTERISTIC
/begin CHARACTERISTIC KF_LSSPORT "Wichtung LSD bei B_sport" MAP 0xa082cdcc _REC_MAP_52_u1_u1_s2 15.9375 _CNV_R_R_Def_f_ub_b_743_CM 0. 15.9375 FORMAT "%5.2"
 /begin AXIS_DESCR STD_AXIS Gangi _CNV_R_R_Def_dez_sl_551_CM 8 0. 255. FORMAT "%3.0" /end AXIS_DESCR
 /begin AXIS_DESCR STD_AXIS Nkw _CNV_R_R_Def_n_sw_q_595_CM 8 -32768. 32767. FORMAT "%5.0" /end AXIS_DESCR
/end CHARACTERISTIC
/begin CHARACTERISTIC KF_MDIAR_MX "Maximalmoment Antiruckelfunktion" MAP 0xa082dbd4 _REC_MAP_52_UBYTE_s2_s2_s2 131.07 _CNV_R_R_Def_m_sw_q_554_CM -3276.8 3276.7 FORMAT "%5.2"
 /begin AXIS_DESCR STD_AXIS Mdk_wunsch _CNV_R_R_Def_m_sw_q_554_CM 6 -3276.8 3276.7 FORMAT "%5.2" /end AXIS_DESCR
 /begin AXIS_DESCR STD_AXIS Nkw _CNV_R_R_Def_n_sw_q_595_CM 6 -32768. 32767. FORMAT "%5.0" /end AXIS_DESCR
/end CHARACTERISTIC
/begin CHARACTERISTIC KF_MDIOP_1 "optimales Moment bei LA 1" MAP 0xa0826778 _REC_MAP_52_UBYTE_s2_s2_s2 131.07 _CNV_R_R_Def_m_sw_q_554_CM -3276.8 3276.7 FORMAT "%5.2"
 /begin AXIS_DESCR STD_AXIS Rf _CNV_R_R_Def_rf_sw__598_CM 16 -327.68 327.67 FORMAT "%7.4" /end AXIS_DESCR
 /begin AXIS_DESCR STD_AXIS Nkw _CNV_R_R_Def_n_sw_q_595_CM 16 -32768. 32767. FORMAT "%5.0" /end AXIS_DESCR
/end CHARACTERISTIC
/begin CHARACTERISTIC KF_MDIOP_2 "optimales Moment bei LA 1" MAP 0xa08269bc _REC_MAP_52_UBYTE_s2_s2_s2 131.07 _CNV_R_R_Def_m_sw_q_554_CM -3276.8 3276.7 FORMAT "%5.2"
 /begin AXIS_DESCR STD_AXIS Rf _CNV_R_R_Def_rf_sw__598_CM 16 -327.68 327.67 FORMAT "%7.4" /end AXIS_DESCR
 /begin AXIS_DESCR STD_AXIS Nkw _CNV_R_R_Def_n_sw_q_595_CM 16 -32768. 32767. FORMAT "%5.0" /end AXIS_DESCR
/end CHARACTERISTIC
/begin CHARACTERISTIC KF_MDIOP_3 "optimales Moment bei LA 1" MAP 0xa0826c00 _REC_MAP_52_UBYTE_s2_s2_s2 131.07 _CNV_R_R_Def_m_sw_q_554_CM -3276.8 3276.7 FORMAT "%5.2"
 /begin AXIS_DESCR STD_AXIS Rf _CNV_R_R_Def_rf_sw__598_CM 16 -327.68 327.67 FORMAT "%7.4" /end AXIS_DESCR
 /begin AXIS_DESCR STD_AXIS Nkw _CNV_R_R_Def_n_sw_q_595_CM 16 -32768. 32767. FORMAT "%5.0" /end AXIS_DESCR
/end CHARACTERISTIC
/begin CHARACTERISTIC KF_MDKW_L "Kennfeld Fahrerwunschmoment für Füllungspfad bei Lastschlagdämpfung" MAP 0xa082c784 _REC_MAP_52_UBYTE_s2_s2_u1 131.07 _CNV_R_R_Def_m_sw_q_554_CM -3276.8 3276.7 FORMAT "%5.2"
 /begin AXIS_DESCR STD_AXIS NO_INPUT_QUANTITY _CNV_R_R_Def_m_sw_q_554_CM 6 -3276.8 3276.7 FORMAT "%5.2" /end AXIS_DESCR
 /begin AXIS_DESCR STD_AXIS Gangi _CNV_R_R_Def_dez_sl_551_CM 8 0. 255. FORMAT "%3.0" /end AXIS_DESCR
/end CHARACTERISTIC
/begin CHARACTERISTIC KF_MDKW_LGD "Kennfeld Fahrerwunschmoment für Füllungspfad bei Lastschlagdämpfung GD" MAP 0xa082ca84 _REC_MAP_52_UBYTE_s2_s2_u1 131.07 _CNV_R_R_Def_m_sw_q_554_CM -3276.8 3276.7 FORMAT "%5.2"
 /begin AXIS_DESCR STD_AXIS NO_INPUT_QUANTITY _CNV_R_R_Def_m_sw_q_554_CM 6 -3276.8 3276.7 FORMAT "%5.2" /end AXIS_DESCR
 /begin AXIS_DESCR STD_AXIS Gangi _CNV_R_R_Def_dez_sl_551_CM 8 0. 255. FORMAT "%3.0" /end AXIS_DESCR
/end CHARACTERISTIC
/begin CHARACTERISTIC KF_MDK_DP_O "Kennfeld Schwelle Dashpotmoment > Bereich 2" MAP 0xa082d008 _REC_MAP_52_UBYTE_s2_s2_u1 131.07 _CNV_R_R_Def_m_sw_q_554_CM -3276.8 3276.7 FORMAT "%5.2"
 /begin AXIS_DESCR STD_AXIS Nkw _CNV_R_R_Def_n_sw_q_595_CM 6 -32768. 32767. FORMAT "%5.0" /end AXIS_DESCR
 /begin AXIS_DESCR STD_AXIS Gangi _CNV_R_R_Def_dez_sl_551_CM 8 0. 255. FORMAT "%3.0" /end AXIS_DESCR
/end CHARACTERISTIC
/begin CHARACTERISTIC KF_MDK_DP_U "Kennfeld Schwelle Dashpotmoment <= Bereich 1" MAP 0xa082c874 _REC_MAP_52_UBYTE_s2_s2_u1 131.07 _CNV_R_R_Def_m_sw_q_554_CM -3276.8 3276.7 FORMAT "%5.2"
 /begin AXIS_DESCR STD_AXIS Nkw _CNV_R_R_Def_n_sw_q_595_CM 6 -32768. 32767. FORMAT "%5.0" /end AXIS_DESCR
 /begin AXIS_DESCR STD_AXIS Gangi _CNV_R_R_Def_dez_sl_551_CM 8 0. 255. FORMAT "%3.0" /end AXIS_DESCR
/end CHARACTERISTIC
/begin CHARACTERISTIC KF_MDK_LSD_O "Kennfeld Schwelle Lastschlagdämpfungsmoment >= Bereich 2" MAP 0xa082d2c8 _REC_MAP_52_UBYTE_s2_s2_u1 131.07 _CNV_R_R_Def_m_sw_q_554_CM -3276.8 3276.7 FORMAT "%5.2"
 /begin AXIS_DESCR STD_AXIS Nkw _CNV_R_R_Def_n_sw_q_595_CM 6 -32768. 32767. FORMAT "%5.0" /end AXIS_DESCR
 /begin AXIS_DESCR STD_AXIS Gangi _CNV_R_R_Def_dez_sl_551_CM 8 0. 255. FORMAT "%3.0" /end AXIS_DESCR
/end CHARACTERISTIC
/begin CHARACTERISTIC KF_MDK_LSD_U "Kennfeld Schwelle Lastschlagdämpfungsmoment < Bereich 1" MAP 0xa082c9f4 _REC_MAP_52_UBYTE_s2_s2_u1 131.07 _CNV_R_R_Def_m_sw_q_554_CM -3276.8 3276.7 FORMAT "%5.2"
 /begin AXIS_DESCR STD_AXIS Nkw _CNV_R_R_Def_n_sw_q_595_CM 6 -32768. 32767. FORMAT "%5.0" /end AXIS_DESCR
 /begin AXIS_DESCR STD_AXIS Gangi _CNV_R_R_Def_dez_sl_551_CM 8 0. 255. FORMAT "%3.0" /end AXIS_DESCR
/end CHARACTERISTIC
/begin CHARACTERISTIC KF_MDREIBSA_MN "Minimales Reibmoment während Schubabschaltung" MAP 0xa082e910 _REC_MAP_52_UBYTE_u2_s2_s2 131.07 _CNV_R_R_Def_m_sw_q_554_CM 0. 6553.5 FORMAT "%5.2"
 /begin AXIS_DESCR STD_AXIS Nkw _CNV_R_R_Def_n_sw_q_595_CM 12 -32768. 32767. FORMAT "%5.0" /end AXIS_DESCR
 /begin AXIS_DESCR STD_AXIS Tmot _CNV_R_R_Def_t_sw_q_579_CM 5 -327.68 327.67 FORMAT "%5.2" /end AXIS_DESCR
/end CHARACTERISTIC
/begin CHARACTERISTIC KF_MDREIB_ADDBA1 "zusaetzliche Reibung Motortemperatur" MAP 0xa082e170 _REC_MAP_52_UBYTE_s2_s2_s2 131.07 _CNV_R_R_Def_m_sw_q_554_CM -3276.8 3276.7 FORMAT "%5.2"
 /begin AXIS_DESCR STD_AXIS Tmot _CNV_R_R_Def_t_sw_q_579_CM 8 -327.68 327.67 FORMAT "%5.2" /end AXIS_DESCR
 /begin AXIS_DESCR STD_AXIS Toel _CNV_R_R_Def_t_sw_q_578_CM 8 -3276.8 3276.7 FORMAT "%4.1" /end AXIS_DESCR
/end CHARACTERISTIC
/begin CHARACTERISTIC KF_MDREIB_ADDBA2 "zusaetzliche Reibung Motortemperatur Betriebsart 2" MAP 0xa082e214 _REC_MAP_52_UBYTE_s2_s2_s2 131.07 _CNV_R_R_Def_m_sw_q_554_CM -3276.8 3276.7 FORMAT "%5.2"
 /begin AXIS_DESCR STD_AXIS Tmot _CNV_R_R_Def_t_sw_q_579_CM 8 -327.68 327.67 FORMAT "%5.2" /end AXIS_DESCR
 /begin AXIS_DESCR STD_AXIS Toel _CNV_R_R_Def_t_sw_q_578_CM 8 -3276.8 3276.7 FORMAT "%4.1" /end AXIS_DESCR
/end CHARACTERISTIC
/begin CHARACTERISTIC KF_MDREIB_ADD_KM "zusaetzliche Reibung Motoreinlauf" MAP 0xa082e2b8 _REC_MAP_52_UBYTE_s2_u2_s2 131.07 _CNV_R_R_Def_m_sw_q_554_CM -3276.8 3276.7 FORMAT "%5.2"
 /begin AXIS_DESCR STD_AXIS Km_st _CNV_R_R_Def_km_sw__68_CM 4 0. 655350. FORMAT "%5.0" /end AXIS_DESCR
 /begin AXIS_DESCR STD_AXIS Toel _CNV_R_R_Def_t_sw_q_578_CM 4 -3276.8 3276.7 FORMAT "%4.1" /end AXIS_DESCR
/end CHARACTERISTIC
/begin CHARACTERISTIC KF_MDREIB_BA1 "Schleppmoment Motor" MAP 0xa082e320 _REC_MAP_52_UBYTE_s2_s2_s2 131.07 _CNV_R_R_Def_m_sw_q_554_CM -3276.8 3276.7 FORMAT "%5.2"
 /begin AXIS_DESCR STD_AXIS Nkw _CNV_R_R_Def_n_sw_q_595_CM 12 -32768. 32767. FORMAT "%5.0" /end AXIS_DESCR
 /begin AXIS_DESCR STD_AXIS Rf _CNV_R_R_Def_rf_sw__598_CM 10 -327.68 327.67 FORMAT "%7.4" /end AXIS_DESCR
/end CHARACTERISTIC
/begin CHARACTERISTIC KF_MDREIB_BA2 "Schleppmoment Motor Betriebsart 2" MAP 0xa082e440 _REC_MAP_52_UBYTE_s2_s2_s2 131.07 _CNV_R_R_Def_m_sw_q_554_CM -3276.8 3276.7 FORMAT "%5.2"
 /begin AXIS_DESCR STD_AXIS Nkw _CNV_R_R_Def_n_sw_q_595_CM 12 -32768. 32767. FORMAT "%5.0" /end AXIS_DESCR
 /begin AXIS_DESCR STD_AXIS Rf _CNV_R_R_Def_rf_sw__598_CM 10 -327.68 327.67 FORMAT "%7.4" /end AXIS_DESCR
/end CHARACTERISTIC
/begin CHARACTERISTIC KF_MDREIB_BA3 "Schleppmoment Motor Betriebsart 3" MAP 0xa082e560 _REC_MAP_52_UBYTE_s2_s2_s2 131.07 _CNV_R_R_Def_m_sw_q_554_CM -3276.8 3276.7 FORMAT "%5.2"
 /begin AXIS_DESCR STD_AXIS Nkw _CNV_R_R_Def_n_sw_q_595_CM 12 -32768. 32767. FORMAT "%5.0" /end AXIS_DESCR
 /begin AXIS_DESCR STD_AXIS Rf _CNV_R_R_Def_rf_sw__598_CM 10 -327.68 327.67 FORMAT "%7.4" /end AXIS_DESCR
/end CHARACTERISTIC
/begin CHARACTERISTIC KF_MDREIB_ST_T "Zeitverlauf Startreibung" MAP 0xa082e2ec _REC_MAP_52_UBYTE_u2_u2_s2 1.9999 _CNV_R_R_Def_f_uw_b_590_CM 0. 1.9999 FORMAT "%14.5"
 /begin AXIS_DESCR STD_AXIS Tn_start_10 _CNV_R_R_Def_td_uw__673_CM 4 0. 655.35 FORMAT "%5.2" /end AXIS_DESCR
 /begin AXIS_DESCR STD_AXIS Tmot_start _CNV_R_R_Def_t_sw_q_579_CM 4 -327.68 327.67 FORMAT "%5.2" /end AXIS_DESCR
/end CHARACTERISTIC
/begin CHARACTERISTIC KF_MDR_ABV "rel gewünschtes Moment am Hinterrad" MAP 0xa082deb8 _REC_MAP_52_UBYTE_s2_u2_s2 100. _CNV_R_R_Def_md_rel_651_CM 0. 100. FORMAT "%4.1"
 /begin AXIS_DESCR STD_AXIS V _CNV_R_R_Def_v_uw_q_726_CM 8 0. 360. FORMAT "%5.0" /end AXIS_DESCR
 /begin AXIS_DESCR STD_AXIS Pwg_ist _CNV_R_R_Def_wdk_sw_683_CM 8 -800. 799.9755 FORMAT "%5.2" /end AXIS_DESCR
/end CHARACTERISTIC
/begin CHARACTERISTIC KF_MDSCHALT_I "I-Anteil Anschlussdrehzahlregler" MAP 0xa082dcc4 _REC_MAP_52_UBYTE_u2_s2_u2 131.07 _CNV_R_R_Def_m_sw_q_554_CM 0. 6553.5 FORMAT "%5.2"
 /begin AXIS_DESCR STD_AXIS Dnkw_reg _CNV_R_R_Def_n_sw_q_595_CM 8 -32768. 32767. FORMAT "%5.0" /end AXIS_DESCR
 /begin AXIS_DESCR STD_AXIS Pwg_fvv_fak _CNV_R_R_Def_f_uw_b_571_CM 4 0. 0.9999 FORMAT "%14.5" /end AXIS_DESCR
/end CHARACTERISTIC
/begin CHARACTERISTIC KF_MDSCHALT_P "P-Anteil Anschlussdrehzahlregler" MAP 0xa082dc68 _REC_MAP_52_UBYTE_u2_s2_u2 131.07 _CNV_R_R_Def_m_sw_q_554_CM 0. 6553.5 FORMAT "%5.2"
 /begin AXIS_DESCR STD_AXIS Dnkw_reg _CNV_R_R_Def_n_sw_q_595_CM 8 -32768. 32767. FORMAT "%5.0" /end AXIS_DESCR
 /begin AXIS_DESCR STD_AXIS Pwg_fvv_fak _CNV_R_R_Def_f_uw_b_571_CM 4 0. 0.9999 FORMAT "%14.5" /end AXIS_DESCR
/end CHARACTERISTIC
/begin CHARACTERISTIC KF_MDSCHALT_PZ "P-Anteil Anschlussdrehzahlregler für Zündpfad" MAP 0xa082dd20 _REC_MAP_52_UBYTE_s2_s2_u2 131.07 _CNV_R_R_Def_m_sw_q_554_CM -3276.8 3276.7 FORMAT "%5.2"
 /begin AXIS_DESCR STD_AXIS Dnkw_reg _CNV_R_R_Def_n_sw_q_595_CM 8 -32768. 32767. FORMAT "%5.0" /end AXIS_DESCR
 /begin AXIS_DESCR STD_AXIS Pwg_fvv_fak _CNV_R_R_Def_f_uw_b_571_CM 6 0. 0.9999 FORMAT "%14.5" /end AXIS_DESCR
/end CHARACTERISTIC
/begin CHARACTERISTIC KF_MDSCHALT_RES "Momentenreserve Anschlussdrehzahlregler" MAP 0xa082dda0 _REC_MAP_52_UBYTE_s2_s2_u2 131.07 _CNV_R_R_Def_m_sw_q_554_CM -3276.8 3276.7 FORMAT "%5.2"
 /begin AXIS_DESCR STD_AXIS Dnkw_reg _CNV_R_R_Def_n_sw_q_595_CM 8 -32768. 32767. FORMAT "%5.0" /end AXIS_DESCR
 /begin AXIS_DESCR STD_AXIS Pwg_fvv_fak _CNV_R_R_Def_f_uw_b_571_CM 6 0. 0.9999 FORMAT "%14.5" /end AXIS_DESCR
/end CHARACTERISTIC
/begin CHARACTERISTIC KF_MDST_A1 "Motormoment im Start für Betriebsart 1 und Automatik" MAP 0xa082e680 _REC_MAP_52_UBYTE_s2_s2_s2 131.07 _CNV_R_R_Def_m_sw_q_554_CM -3276.8 3276.7 FORMAT "%5.2"
 /begin AXIS_DESCR STD_AXIS Nkw_soll_dif _CNV_R_R_Def_n_sw_q_595_CM 8 -32768. 32767. FORMAT "%5.0" /end AXIS_DESCR
 /begin AXIS_DESCR STD_AXIS Tmot _CNV_R_R_Def_t_sw_q_579_CM 8 -327.68 327.67 FORMAT "%5.2" /end AXIS_DESCR
/end CHARACTERISTIC
/begin CHARACTERISTIC KF_MDST_A2 "Motormoment im Start für Betriebsart 2 und Automatik" MAP 0xa082e724 _REC_MAP_52_UBYTE_s2_s2_s2 131.07 _CNV_R_R_Def_m_sw_q_554_CM -3276.8 3276.7 FORMAT "%5.2"
 /begin AXIS_DESCR STD_AXIS Nkw_soll_dif _CNV_R_R_Def_n_sw_q_595_CM 8 -32768. 32767. FORMAT "%5.0" /end AXIS_DESCR
 /begin AXIS_DESCR STD_AXIS Tmot _CNV_R_R_Def_t_sw_q_579_CM 8 -327.68 327.67 FORMAT "%5.2" /end AXIS_DESCR
/end CHARACTERISTIC
/begin CHARACTERISTIC KF_MDST_M1 "Motormoment im Start für Betriebsart 1 und Handschalter" MAP 0xa082e7c8 _REC_MAP_52_UBYTE_s2_s2_s2 131.07 _CNV_R_R_Def_m_sw_q_554_CM -3276.8 3276.7 FORMAT "%5.2"
 /begin AXIS_DESCR STD_AXIS Nkw_soll_dif _CNV_R_R_Def_n_sw_q_595_CM 8 -32768. 32767. FORMAT "%5.0" /end AXIS_DESCR
 /begin AXIS_DESCR STD_AXIS Tmot _CNV_R_R_Def_t_sw_q_579_CM 8 -327.68 327.67 FORMAT "%5.2" /end AXIS_DESCR
/end CHARACTERISTIC
/begin CHARACTERISTIC KF_MDST_M2 "Motormoment im Start für Betriebsart 2 und Handschalter" MAP 0xa082e86c _REC_MAP_52_UBYTE_s2_s2_s2 131.07 _CNV_R_R_Def_m_sw_q_554_CM -3276.8 3276.7 FORMAT "%5.2"
 /begin AXIS_DESCR STD_AXIS Nkw_soll_dif _CNV_R_R_Def_n_sw_q_595_CM 8 -32768. 32767. FORMAT "%5.0" /end AXIS_DESCR
 /begin AXIS_DESCR STD_AXIS Tmot _CNV_R_R_Def_t_sw_q_579_CM 8 -327.68 327.67 FORMAT "%5.2" /end AXIS_DESCR
/end CHARACTERISTIC
/begin CHARACTERISTIC KF_PAR_NULL "" MAP 0xa082da90 _REC_MAP_52_u1_u1_s2 3.9843 _CNV_R_R_Def_f_ub_b_632_CM 0. 3.9843 FORMAT "%5.2"
 /begin AXIS_DESCR STD_AXIS Gangi _CNV_R_R_Def_dez_sl_551_CM 8 0. 255. FORMAT "%3.0" /end AXIS_DESCR
 /begin AXIS_DESCR STD_AXIS Nkw _CNV_R_R_Def_n_sw_q_595_CM 4 -32768. 32767. FORMAT "%5.0" /end AXIS_DESCR
/end CHARACTERISTIC
/begin CHARACTERISTIC KF_PAR_NULLA "" MAP 0xa082dac4 _REC_MAP_52_u1_u1_s2 3.9843 _CNV_R_R_Def_f_ub_b_632_CM 0. 3.9843 FORMAT "%5.2"
 /begin AXIS_DESCR STD_AXIS Gangi _CNV_R_R_Def_dez_sl_551_CM 8 0. 255. FORMAT "%3.0" /end AXIS_DESCR
 /begin AXIS_DESCR STD_AXIS Nkw _CNV_R_R_Def_n_sw_q_595_CM 4 -32768. 32767. FORMAT "%5.0" /end AXIS_DESCR
/end CHARACTERISTIC
/begin CHARACTERISTIC KF_PEDAL "Umsetzungskennfeld Pwg_ist auf Md_fw_rel" MAP 0xa082df5c _REC_MAP_52_UBYTE_s2_s2_s2 100. _CNV_R_R_Def_md_rel_651_CM 0. 100. FORMAT "%4.1"
 /begin AXIS_DESCR STD_AXIS Nkw _CNV_R_R_Def_n_sw_q_595_CM 8 -32768. 32767. FORMAT "%5.0" /end AXIS_DESCR
 /begin AXIS_DESCR STD_AXIS Pwg_ist _CNV_R_R_Def_wdk_sw_683_CM 16 -800. 799.9755 FORMAT "%5.2" /end AXIS_DESCR
/end CHARACTERISTIC
/begin CHARACTERISTIC KF_RFVKOR_DASH "Faktor um Vanos-Sollwerte auf Rf_min (1) überzublenden" MAP 0xa082d470 _REC_MAP_52_u1_s2_s2 0.996 _CNV_R_R_Def_f_ub_b_553_CM 0. 0.996
 /begin AXIS_DESCR STD_AXIS Dmdk_wunsch_l _CNV_R_R_Def_m_sw_q_554_CM 4 -3276.8 3276.7 FORMAT "%5.2" /end AXIS_DESCR
 /begin AXIS_DESCR STD_AXIS Dmdk_wunsch_min _CNV_R_R_Def_m_sw_q_554_CM 4 -3276.8 3276.7 FORMAT "%5.2" /end AXIS_DESCR
/end CHARACTERISTIC
/begin CHARACTERISTIC KF_SCHALT_WS "Schaltwahrscheinlichkeit" MAP 0xa082de20 _REC_MAP_52_UBYTE_s1_s2_s2 1.9921 _CNV_R_R_Def_f_sb_b_703_CM -1. 0.9921
 /begin AXIS_DESCR STD_AXIS Mdk_wunsch_proz _CNV_R_R_Def_f_uw_b_590_CM 8 -1. 0.9999 FORMAT "%14.5" /end AXIS_DESCR
 /begin AXIS_DESCR STD_AXIS Nkw _CNV_R_R_Def_n_sw_q_595_CM 8 -32768. 32767. FORMAT "%5.0" /end AXIS_DESCR
/end CHARACTERISTIC
/begin CHARACTERISTIC KF_SNFILT_ARAN "" MAP 0xa082db2c _REC_MAP_52_UBYTE_s2_s2_u1 0. _CNV_R_R_Def_n_sw_q_595_CM -32768. 32767. FORMAT "%5.0"
 /begin AXIS_DESCR STD_AXIS Mdk_wunsch _CNV_R_R_Def_m_sw_q_554_CM 4 -3276.8 3276.7 FORMAT "%5.2" /end AXIS_DESCR
 /begin AXIS_DESCR STD_AXIS Gangi _CNV_R_R_Def_dez_sl_551_CM 8 0. 255. FORMAT "%3.0" /end AXIS_DESCR
/end CHARACTERISTIC
/begin CHARACTERISTIC KF_SNFILT_ARAUS "" MAP 0xa082db80 _REC_MAP_52_UBYTE_s2_s2_u1 0. _CNV_R_R_Def_n_sw_q_595_CM -32768. 32767. FORMAT "%5.0"
 /begin AXIS_DESCR STD_AXIS Mdk_wunsch _CNV_R_R_Def_m_sw_q_554_CM 4 -3276.8 3276.7 FORMAT "%5.2" /end AXIS_DESCR
 /begin AXIS_DESCR STD_AXIS Gangi _CNV_R_R_Def_dez_sl_551_CM 8 0. 255. FORMAT "%3.0" /end AXIS_DESCR
/end CHARACTERISTIC
/begin CHARACTERISTIC KF_TAR_AUS "" MAP 0xa082d970 _REC_MAP_52_UBYTE_u2_s2_u1 98.30250000000001 _CNV_R_R_Def_td_uw__673_CM 0. 655.35 FORMAT "%5.2"
 /begin AXIS_DESCR STD_AXIS Nkw _CNV_R_R_Def_n_sw_q_595_CM 4 -32768. 32767. FORMAT "%5.0" /end AXIS_DESCR
 /begin AXIS_DESCR STD_AXIS Gangi _CNV_R_R_Def_dez_sl_551_CM 8 0. 255. FORMAT "%3.0" /end AXIS_DESCR
/end CHARACTERISTIC
/begin CHARACTERISTIC KF_TDAR "" MAP 0xa082daf8 _REC_MAP_52_u1_u1_s2 2.55 _CNV_R_R_Def_td_uw__673_CM 0. 2.55 FORMAT "%5.2"
 /begin AXIS_DESCR STD_AXIS Gangi _CNV_R_R_Def_dez_sl_551_CM 8 0. 255. FORMAT "%3.0" /end AXIS_DESCR
 /begin AXIS_DESCR STD_AXIS Nkw _CNV_R_R_Def_n_sw_q_595_CM 4 -32768. 32767. FORMAT "%5.0" /end AXIS_DESCR
/end CHARACTERISTIC
/begin CHARACTERISTIC KF_UEB_MD "Überblendung bei Dashpot aktiviert" MAP 0xa082c674 _REC_MAP_52_u1_s2_s2 0.996 _CNV_R_R_Def_f_ub_b_553_CM 0. 0.996
 /begin AXIS_DESCR STD_AXIS Mdk_w_f _CNV_R_R_Def_m_sw_q_554_CM 8 -3276.8 3276.7 FORMAT "%5.2" /end AXIS_DESCR
 /begin AXIS_DESCR STD_AXIS Nkw _CNV_R_R_Def_n_sw_q_595_CM 8 -32768. 32767. FORMAT "%5.0" /end AXIS_DESCR
/end CHARACTERISTIC
/begin CHARACTERISTIC KF_W_ARMD "" MAP 0xa082d9c4 _REC_MAP_52_UBYTE_u2_s2_s2 3.9999 _CNV_R_R_Def_f_sw_b_616_CM 0. 3.9999 FORMAT "%14.5"
 /begin AXIS_DESCR STD_AXIS Rf_soll _CNV_R_R_Def_rf_sw__598_CM 6 -327.68 327.67 FORMAT "%7.4" /end AXIS_DESCR
 /begin AXIS_DESCR STD_AXIS Nkw _CNV_R_R_Def_n_sw_q_595_CM 6 -32768. 32767. FORMAT "%5.0" /end AXIS_DESCR
/end CHARACTERISTIC
/begin CHARACTERISTIC KF_ZKDP3 "Kennfeld Zeitkonstante für Filter Dashpotmomentengradient Bereich 3" MAP 0xa082d6e0 _REC_MAP_52_UBYTE_u2_s2_u1 98.30250000000001 _CNV_R_R_Def_td_uw__673_CM 0. 655.35 FORMAT "%5.2"
 /begin AXIS_DESCR STD_AXIS Nkw _CNV_R_R_Def_n_sw_q_595_CM 6 -32768. 32767. FORMAT "%5.0" /end AXIS_DESCR
 /begin AXIS_DESCR STD_AXIS Gangi _CNV_R_R_Def_dez_sl_551_CM 8 0. 255. FORMAT "%3.0" /end AXIS_DESCR
/end CHARACTERISTIC
/begin CHARACTERISTIC KF_ZKDP3A "Zeitkonstante für Filter Dashpotmomentengradient Bereich 3" MAP 0xa082ce28 _REC_MAP_52_UBYTE_u2_s2_u1 98.30250000000001 _CNV_R_R_Def_td_uw__673_CM 0. 655.35 FORMAT "%5.2"
 /begin AXIS_DESCR STD_AXIS Nkw _CNV_R_R_Def_n_sw_q_595_CM 6 -32768. 32767. FORMAT "%5.0" /end AXIS_DESCR
 /begin AXIS_DESCR STD_AXIS Gangi _CNV_R_R_Def_dez_sl_551_CM 8 0. 255. FORMAT "%3.0" /end AXIS_DESCR
/end CHARACTERISTIC
/begin CHARACTERISTIC KF_ZKLS3GD "Kennfeld Zeitkonstante für Filter Lastschlagdämpfungsmomentengradient Bereich 3 GD" MAP 0xa082c5fc _REC_MAP_52_UBYTE_u2_s2_u1 98.30250000000001 _CNV_R_R_Def_td_uw__673_CM 0. 655.35 FORMAT "%5.2"
 /begin AXIS_DESCR STD_AXIS Nkw _CNV_R_R_Def_n_sw_q_595_CM 6 -32768. 32767. FORMAT "%5.0" /end AXIS_DESCR
 /begin AXIS_DESCR STD_AXIS Gangi _CNV_R_R_Def_dez_sl_551_CM 8 0. 255. FORMAT "%3.0" /end AXIS_DESCR
/end CHARACTERISTIC
/begin CHARACTERISTIC KF_ZKLS3GDA "Kennfeld Zeitkonstante für Filter Lastschlagdämpfungsmomentengradient Bereich 3 GD" MAP 0xa082cb20 _REC_MAP_52_UBYTE_u2_s2_u1 98.30250000000001 _CNV_R_R_Def_td_uw__673_CM 0. 655.35 FORMAT "%5.2"
 /begin AXIS_DESCR STD_AXIS Nkw _CNV_R_R_Def_n_sw_q_595_CM 6 -32768. 32767. FORMAT "%5.0" /end AXIS_DESCR
 /begin AXIS_DESCR STD_AXIS Gangi _CNV_R_R_Def_dez_sl_551_CM 8 0. 255. FORMAT "%3.0" /end AXIS_DESCR
/end CHARACTERISTIC
/begin CHARACTERISTIC KF_ZKLS3UD "Kennfeld Zeitkonstante für Filter Lastschlagdämpfungsmomentengradient Bereich 3 UGD" MAP 0xa082d848 _REC_MAP_52_UBYTE_u2_s2_u1 98.30250000000001 _CNV_R_R_Def_td_uw__673_CM 0. 655.35 FORMAT "%5.2"
 /begin AXIS_DESCR STD_AXIS Nkw _CNV_R_R_Def_n_sw_q_595_CM 6 -32768. 32767. FORMAT "%5.0" /end AXIS_DESCR
 /begin AXIS_DESCR STD_AXIS Gangi _CNV_R_R_Def_dez_sl_551_CM 8 0. 255. FORMAT "%3.0" /end AXIS_DESCR
/end CHARACTERISTIC
/begin CHARACTERISTIC KF_ZKLS3UDA "Kennfeld Zeitkonstante für Filter Lastschlagdämpfungsmomentengradient Bereich 3 UGD" MAP 0xa082c584 _REC_MAP_52_UBYTE_u2_s2_u1 98.30250000000001 _CNV_R_R_Def_td_uw__673_CM 0. 655.35 FORMAT "%5.2"
 /begin AXIS_DESCR STD_AXIS Nkw _CNV_R_R_Def_n_sw_q_595_CM 6 -32768. 32767. FORMAT "%5.0" /end AXIS_DESCR
 /begin AXIS_DESCR STD_AXIS Gangi _CNV_R_R_Def_dez_sl_551_CM 8 0. 255. FORMAT "%3.0" /end AXIS_DESCR
/end CHARACTERISTIC
/begin CHARACTERISTIC KL_DMDPOFF "Kennlinie Deltamoment Dashpotende" CURVE 0xa082c34c _REC_CUR_TKL_UW_VV__s2_u1 131.07 _CNV_R_R_Def_m_sw_q_554_CM -3276.8 3276.7 FORMAT "%5.2"
 /begin AXIS_DESCR STD_AXIS Gangi _CNV_R_R_Def_dez_sl_551_CM 8 0. 255. FORMAT "%3.0" /end AXIS_DESCR
/end CHARACTERISTIC
/begin CHARACTERISTIC KL_DMLSDOFF "Kennlinie Deltamoment Lastschlagdämpfungsende" CURVE 0xa082c2a8 _REC_CUR_TKL_UW_VV__s2_u1 131.07 _CNV_R_R_Def_m_sw_q_554_CM -3276.8 3276.7 FORMAT "%5.2"
 /begin AXIS_DESCR STD_AXIS Gangi _CNV_R_R_Def_dez_sl_551_CM 8 0. 255. FORMAT "%3.0" /end AXIS_DESCR
/end CHARACTERISTIC
/begin CHARACTERISTIC KL_DZW_KRFR "KL Deltazümdwinkel Klopfregelung früh" CURVE 0xa082b5f8 _REC_CUR_TKL_UW_VV__s2_s2 99.83843999999999 _CNV_R_R_Def_zw_sw__607_CM -64. 63.998
 /begin AXIS_DESCR STD_AXIS Nkw _CNV_R_R_Def_n_sw_q_595_CM 8 -32768. 32767. FORMAT "%5.0" /end AXIS_DESCR
/end CHARACTERISTIC
/begin CHARACTERISTIC KL_DZW_KRSP "KL Deltazümdwinkel Klopfregelung spät" CURVE 0xa082b5d4 _REC_CUR_TKL_UW_VV__s2_s2 99.83843999999999 _CNV_R_R_Def_zw_sw__607_CM -64. 63.998
 /begin AXIS_DESCR STD_AXIS Dzw_mm _CNV_R_R_Def_zw_sw__604_CM 8 -50. 60. FORMAT "%4.1" /end AXIS_DESCR
/end CHARACTERISTIC
/begin CHARACTERISTIC KL_FDASH3_NKW "Dashfaktor im Bereich 3 ueber Drehzahl" CURVE 0xa082c2f0 _REC_CUR_TKL_UW_VV__u1_s2 7.9687 _CNV_R_R_Def_f_ub_b_694_CM 0. 7.9687 FORMAT "%5.2"
 /begin AXIS_DESCR STD_AXIS Nkw _CNV_R_R_Def_n_sw_q_595_CM 6 -32768. 32767. FORMAT "%5.0" /end AXIS_DESCR
/end CHARACTERISTIC
/begin CHARACTERISTIC KL_FDASHINI "Faktor zum Abrampen des Luft-Ini-Wertes" CURVE 0xa082c320 _REC_CUR_TKL_UW_VV__u1_u2 3.9843 _CNV_R_R_Def_f_ub_b_632_CM 0. 3.9843 FORMAT "%5.2"
 /begin AXIS_DESCR STD_AXIS T_dash _CNV_R_R_Def_td_uw__673_CM 4 0. 655.35 FORMAT "%5.2" /end AXIS_DESCR
/end CHARACTERISTIC
/begin CHARACTERISTIC KL_FHO_UL "Höheneinfluss gewollte Momentenreduzierung beim UL" CURVE 0xa0826e58 _REC_CUR_TKL_UW_VV__u2_u2 1.9999 _CNV_R_R_Def_f_uw_b_590_CM 0. 1.9999 FORMAT "%14.5"
 /begin AXIS_DESCR STD_AXIS Fho _CNV_R_R_Def_f_uw_b_590_CM 4 0. 1.9999 FORMAT "%14.5" /end AXIS_DESCR
/end CHARACTERISTIC
/begin CHARACTERISTIC KL_FJMOT "Kennlinie Deltamoment aus Motormassenträgheitsmoment für Automatikgetriebe" CURVE 0xa082c284 _REC_CUR_TKL_UW_VV__s2_s1 131.07 _CNV_R_R_Def_m_sw_q_554_CM -3276.8 3276.7 FORMAT "%5.2"
 /begin AXIS_DESCR STD_AXIS Nkw_grad _CNV_R_R_Def_ngrd_s_661_CM 6 -4096. 4064. FORMAT "%5.2" /end AXIS_DESCR
/end CHARACTERISTIC
/begin CHARACTERISTIC KL_FLSDINI "Faktor zum Abrampen des Luft-Ini-Wertes" CURVE 0xa082c298 _REC_CUR_TKL_UW_VV__u1_u2 3.9843 _CNV_R_R_Def_f_ub_b_632_CM 0. 3.9843 FORMAT "%5.2"
 /begin AXIS_DESCR STD_AXIS T_lsd _CNV_R_R_Def_td_uw__673_CM 4 0. 655.35 FORMAT "%5.2" /end AXIS_DESCR
/end CHARACTERISTIC
/begin CHARACTERISTIC KL_FLSDMDK12 "Kennlinie Faktor Fahrpedal zu Lastschlagdämpfungsmomentengradienten Bereich 1 und 2" CURVE 0xa082c330 _REC_CUR_TKL_UW_VV__u1_s2 3. _CNV_R_R_Def_f_ub_b_737_CM 0. 3. FORMAT "%5.2"
 /begin AXIS_DESCR STD_AXIS Mdk_wunsch _CNV_R_R_Def_m_sw_q_554_CM 8 -3276.8 3276.7 FORMAT "%5.2" /end AXIS_DESCR
/end CHARACTERISTIC
/begin CHARACTERISTIC KL_FLSDMDK3 "Kennlinie Faktor Fahrpedal zu Lastschlagdämpfungsmomentengradienten Bereich 3" CURVE 0xa082c214 _REC_CUR_TKL_UW_VV__u1_s2 3. _CNV_R_R_Def_f_ub_b_737_CM 0. 3. FORMAT "%5.2"
 /begin AXIS_DESCR STD_AXIS Mdk_wunsch _CNV_R_R_Def_m_sw_q_554_CM 8 -3276.8 3276.7 FORMAT "%5.2" /end AXIS_DESCR
/end CHARACTERISTIC
/begin CHARACTERISTIC KL_FLSDPWG12 "Kennlinie Faktor Fahrpedal zu Lastschlagdämpfungsmomentengradienten Bereich 1 und 2" CURVE 0xa082c2c4 _REC_CUR_TKL_UW_VV__u1_s2 3. _CNV_R_R_Def_f_ub_b_737_CM 0. 3. FORMAT "%5.2"
 /begin AXIS_DESCR STD_AXIS NO_INPUT_QUANTITY _CNV_R_R_Def_wdk_sw_683_CM 8 -800. 799.9755 FORMAT "%5.2" /end AXIS_DESCR
/end CHARACTERISTIC
/begin CHARACTERISTIC KL_FLSDPWG3 "Kennlinie Faktor Fahrpedal zu Lastschlagdämpfungsmomentengradienten Bereich 3" CURVE 0xa082c230 _REC_CUR_TKL_UW_VV__u1_s2 3. _CNV_R_R_Def_f_ub_b_737_CM 0. 3. FORMAT "%5.2"
 /begin AXIS_DESCR STD_AXIS NO_INPUT_QUANTITY _CNV_R_R_Def_wdk_sw_683_CM 8 -800. 799.9755 FORMAT "%5.2" /end AXIS_DESCR
/end CHARACTERISTIC
/begin CHARACTERISTIC KL_FMDI_VL "-" CURVE 0xa0826f70 _REC_CUR_TKL_UW_VV__s2_s2 15.9997 _CNV_R_R_Def_f_sw_b_592_CM -8. 7.9997 FORMAT "%7.4"
 /begin AXIS_DESCR STD_AXIS Nkw _CNV_R_R_Def_n_sw_q_595_CM 6 -32768. 32767. FORMAT "%5.0" /end AXIS_DESCR
/end CHARACTERISTIC
/begin CHARACTERISTIC KL_FMDST "Filterkonstante Startmoment" CURVE 0xa082e15c _REC_CUR_TKL_UW_VV__u2_s2 0.9999 _CNV_R_R_Def_f_uw_b_571_CM 0. 0.9999 FORMAT "%14.5"
 /begin AXIS_DESCR STD_AXIS Tmot _CNV_R_R_Def_t_sw_q_579_CM 4 -327.68 327.67 FORMAT "%5.2" /end AXIS_DESCR
/end CHARACTERISTIC
/begin CHARACTERISTIC KL_FPLDPUMP "Faktor Lader-Pumpgrenze" CURVE 0xa082b644 _REC_CUR_TKL_UW_VV__u2_u2 3.9999 _CNV_R_R_Def_f_sw_b_616_CM 0. 3.9999 FORMAT "%14.5"
 /begin AXIS_DESCR STD_AXIS Mssolatl_k _CNV_R_R_Def_ms_uw__594_CM 8 0. 2047.9687 /end AXIS_DESCR
/end CHARACTERISTIC
/begin CHARACTERISTIC KL_FPLDSTOPF "Faktor Lader-Stopfgrenze" CURVE 0xa082b744 _REC_CUR_TKL_UW_VV__u2_u2 3.9999 _CNV_R_R_Def_f_sw_b_616_CM 0. 3.9999 FORMAT "%14.5"
 /begin AXIS_DESCR STD_AXIS Mssolatl_k _CNV_R_R_Def_ms_uw__594_CM 8 0. 2047.9687 /end AXIS_DESCR
/end CHARACTERISTIC
/begin CHARACTERISTIC KL_FRFMXTMLD "Faktor Max. Fuellung" CURVE 0xa082b7c0 _REC_CUR_TKL_UW_VV__u2_s2 1.9999 _CNV_R_R_Def_f_uw_b_590_CM 0. 1.9999 FORMAT "%14.5"
 /begin AXIS_DESCR STD_AXIS Tmot _CNV_R_R_Def_t_sw_q_579_CM 6 -327.68 327.67 FORMAT "%5.2" /end AXIS_DESCR
/end CHARACTERISTIC
/begin CHARACTERISTIC KL_FTVDK_MDMAX "Temperaturfaktor fuer Drosselventil Durchfluss" CURVE 0xa0826e80 _REC_CUR_TKL_UW_VV__u2_s2 1.9999 _CNV_R_R_Def_f_uw_b_590_CM 0. 1.9999 FORMAT "%14.5"
 /begin AXIS_DESCR STD_AXIS Tans _CNV_R_R_Def_t_sw_q_578_CM 8 -3276.8 3276.7 FORMAT "%4.1" /end AXIS_DESCR
/end CHARACTERISTIC
/begin CHARACTERISTIC KL_FUPSRF_ATL "Schluckgerade" CURVE 0xa082b6ac _REC_CUR_TKL_UW_VV__u2_s2 0.299995422363281 _CNV_R_R_Def_f_uw_b_629_CM 0. 0.299995422363281 FORMAT "%14.6"
 /begin AXIS_DESCR STD_AXIS Nkw _CNV_R_R_Def_n_sw_q_595_CM 12 -32768. 32767. FORMAT "%5.0" /end AXIS_DESCR
/end CHARACTERISTIC
/begin CHARACTERISTIC KL_F_UEB "Faktor Überblendung bei Dashpot aktiviert" CURVE 0xa082c368 _REC_CUR_TKL_UW_VV__u1_u1 0.996 _CNV_R_R_Def_f_ub_b_553_CM 0. 0.996
 /begin AXIS_DESCR STD_AXIS Gangi _CNV_R_R_Def_dez_sl_551_CM 8 0. 255. FORMAT "%3.0" /end AXIS_DESCR
/end CHARACTERISTIC
/begin CHARACTERISTIC KL_KUPP_ENABLE "Kennlinie zur Deaktivierung (mit 0) der Bedingung B_kuppln für Dashpot" CURVE 0xa082c2e0 _REC_CUR_TKL_UW_VV__u1_s2 99.45 _CNV_R_R_Def_dez_sl_551_CM 0. 255. FORMAT "%3.0"
 /begin AXIS_DESCR STD_AXIS NO_INPUT_QUANTITY _CNV_R_R_Def_n_sw_q_595_CM 4 -32768. 32767. FORMAT "%5.0" /end AXIS_DESCR
/end CHARACTERISTIC
/begin CHARACTERISTIC KL_LAMX "-" CURVE 0xa0826ea4 _REC_CUR_TKL_UW_VV__s2_s2 98.30250000000001 _CNV_R_R_Def_rf_sw__598_CM -327.68 327.67 FORMAT "%7.4"
 /begin AXIS_DESCR STD_AXIS Nkw _CNV_R_R_Def_n_sw_q_595_CM 18 -32768. 32767. FORMAT "%5.0" /end AXIS_DESCR
/end CHARACTERISTIC
/begin CHARACTERISTIC KL_LAMX_ATL "Max. Turbo-Luftaufwand" CURVE 0xa082b668 _REC_CUR_TKL_UW_VV__s2_s2 98.30250000000001 _CNV_R_R_Def_rf_sw__598_CM -327.68 327.67 FORMAT "%7.4"
 /begin AXIS_DESCR STD_AXIS Nkw _CNV_R_R_Def_n_sw_q_595_CM 16 -32768. 32767. FORMAT "%5.0" /end AXIS_DESCR
/end CHARACTERISTIC
/begin CHARACTERISTIC KL_LAMX_ATLAT "Max. Turbo-Luftaufwand im Sport-Modus" CURVE 0xa082b77c _REC_CUR_TKL_UW_VV__s2_s2 98.30250000000001 _CNV_R_R_Def_rf_sw__598_CM -327.68 327.67 FORMAT "%7.4"
 /begin AXIS_DESCR STD_AXIS Nkw _CNV_R_R_Def_n_sw_q_595_CM 16 -32768. 32767. FORMAT "%5.0" /end AXIS_DESCR
/end CHARACTERISTIC
/begin CHARACTERISTIC KL_LAMX_FP "Faktor Überblendung zwischen 1 und F_lamx_fp" CURVE 0xa0826e6c _REC_CUR_TKL_UW_VV__u1_s2 0.996 _CNV_R_R_Def_f_ub_b_553_CM 0. 0.996
 /begin AXIS_DESCR STD_AXIS Mdr_wunsch _CNV_R_R_Def_md_rel_651_CM 6 0. 100. FORMAT "%4.1" /end AXIS_DESCR
/end CHARACTERISTIC
/begin CHARACTERISTIC KL_LAMX_FV "-" CURVE 0xa0826ef0 _REC_CUR_TKL_UW_VV__s2_s2 98.30250000000001 _CNV_R_R_Def_rf_sw__598_CM -327.68 327.67 FORMAT "%7.4"
 /begin AXIS_DESCR STD_AXIS Nkw _CNV_R_R_Def_n_sw_q_595_CM 18 -32768. 32767. FORMAT "%5.0" /end AXIS_DESCR
/end CHARACTERISTIC
/begin CHARACTERISTIC KL_LDRFKRA "RF Schwelle" CURVE 0xa082b6e0 _REC_CUR_TKL_UW_VV__s2_s2 98.30250000000001 _CNV_R_R_Def_rf_sw__598_CM -327.68 327.67 FORMAT "%7.4"
 /begin AXIS_DESCR STD_AXIS Nkw _CNV_R_R_Def_n_sw_q_595_CM 6 -32768. 32767. FORMAT "%5.0" /end AXIS_DESCR
/end CHARACTERISTIC
/begin CHARACTERISTIC KL_MDMAX "Momentenkennlinie" CURVE 0xa082de88 _REC_CUR_TKL_UW_VV__s2_s2 85.536 _CNV_R_R_Def_m_sw_q_554_CM -3276.8 1000. FORMAT "%5.2"
 /begin AXIS_DESCR STD_AXIS Nkw_opt _CNV_R_R_Def_n_sw_q_595_CM 11 -32768. 32767. FORMAT "%5.0" /end AXIS_DESCR
/end CHARACTERISTIC
/begin CHARACTERISTIC KL_MDREIB_ADDBA1 "zusaetzliche Reibung Hoeheneinfluss" CURVE 0xa082e0b4 _REC_CUR_TKL_UW_VV__s2_u2 131.07 _CNV_R_R_Def_m_sw_q_554_CM -3276.8 3276.7 FORMAT "%5.2"
 /begin AXIS_DESCR STD_AXIS Pu _CNV_R_R_Def_p_sw_q_576_CM 6 0. 2559.9609 FORMAT "%5.2" /end AXIS_DESCR
/end CHARACTERISTIC
/begin CHARACTERISTIC KL_MDREIB_ADDBA2 "zusaetzliche Reibung Hoeheneinfluss" CURVE 0xa082e0d0 _REC_CUR_TKL_UW_VV__s2_u2 131.07 _CNV_R_R_Def_m_sw_q_554_CM -3276.8 3276.7 FORMAT "%5.2"
 /begin AXIS_DESCR STD_AXIS Pu _CNV_R_R_Def_p_sw_q_576_CM 6 0. 2559.9609 FORMAT "%5.2" /end AXIS_DESCR
/end CHARACTERISTIC
/begin CHARACTERISTIC KL_MDREIB_STBA1 "zusaetzliche Startreibung" CURVE 0xa082e0ec _REC_CUR_TKL_UW_VV__s2_s2 131.07 _CNV_R_R_Def_m_sw_q_554_CM -3276.8 3276.7 FORMAT "%5.2"
 /begin AXIS_DESCR STD_AXIS Tmot _CNV_R_R_Def_t_sw_q_579_CM 4 -327.68 327.67 FORMAT "%5.2" /end AXIS_DESCR
/end CHARACTERISTIC
/begin CHARACTERISTIC KL_MDREIB_STBA2 "zusaetzliche Startreibung Betriebsart 2" CURVE 0xa082e100 _REC_CUR_TKL_UW_VV__s2_s2 131.07 _CNV_R_R_Def_m_sw_q_554_CM -3276.8 3276.7 FORMAT "%5.2"
 /begin AXIS_DESCR STD_AXIS Tmot _CNV_R_R_Def_t_sw_q_579_CM 4 -327.68 327.67 FORMAT "%5.2" /end AXIS_DESCR
/end CHARACTERISTIC
/begin CHARACTERISTIC KL_MDRESKRLL "KL Momentenreserve Klopfregelung LL" CURVE 0xa082b61c _REC_CUR_TKL_UW_VV__s2_s2 131.07 _CNV_R_R_Def_m_sw_q_554_CM -3276.8 3276.7 FORMAT "%5.2"
 /begin AXIS_DESCR STD_AXIS Dzw_krkorlls _CNV_R_R_Def_zw_sw__607_CM 8 -64. 63.998 /end AXIS_DESCR
/end CHARACTERISTIC
/begin CHARACTERISTIC KL_MU_WAN "Kennlinie Faktor Wirkungsgrad/Momentenüberhöhung Wandler" CURVE 0xa082c204 _REC_CUR_TKL_UW_VV__u1_u1 3. _CNV_R_R_Def_f_ub_b_737_CM 0. 3. FORMAT "%5.2"
 /begin AXIS_DESCR STD_AXIS Ntnkw _CNV_R_R_Def_f_ub_b_632_CM 6 0. 3.9843 FORMAT "%5.2" /end AXIS_DESCR
/end CHARACTERISTIC
/begin CHARACTERISTIC KL_NKWST_MX "Startdrehzahl zur Beinflussung der Füllung nach Start" CURVE 0xa082e138 _REC_CUR_TKL_UW_VV__s2_s2 0. _CNV_R_R_Def_n_sw_q_595_CM -32768. 32767. FORMAT "%5.0"
 /begin AXIS_DESCR STD_AXIS Tmot _CNV_R_R_Def_t_sw_q_579_CM 8 -327.68 327.67 FORMAT "%5.2" /end AXIS_DESCR
/end CHARACTERISTIC
/begin CHARACTERISTIC KL_PIRG_ATL "Restgasdruck" CURVE 0xa082b6fc _REC_CUR_TKL_UW_VV__u2_s2 102.398436 _CNV_R_R_Def_p_sw_q_576_CM 0. 2559.9609 FORMAT "%5.2"
 /begin AXIS_DESCR STD_AXIS Nkw _CNV_R_R_Def_n_sw_q_595_CM 12 -32768. 32767. FORMAT "%5.0" /end AXIS_DESCR
/end CHARACTERISTIC
/begin CHARACTERISTIC KL_RFMXATLNL "-" CURVE 0xa0826fb0 _REC_CUR_TKL_UW_VV__s2_s2 98.30250000000001 _CNV_R_R_Def_rf_sw__598_CM -327.68 327.67 FORMAT "%7.4"
 /begin AXIS_DESCR STD_AXIS Nkw _CNV_R_R_Def_n_sw_q_595_CM 6 -32768. 32767. FORMAT "%5.0" /end AXIS_DESCR
/end CHARACTERISTIC
/begin CHARACTERISTIC KL_SELB_STAB "Selbststabilisierungsfaktor" CURVE 0xa082e114 _REC_CUR_TKL_UW_VV__s2_u2 15.9997 _CNV_R_R_Def_f_sw_b_592_CM -8. 7.9997 FORMAT "%7.4"
 /begin AXIS_DESCR STD_AXIS F_n_nstat _CNV_R_R_Def_f_sw_b_616_CM 8 0. 3.9999 FORMAT "%14.5" /end AXIS_DESCR
/end CHARACTERISTIC
/begin CHARACTERISTIC KL_TAR_KUP "-" CURVE 0xa082d948 _REC_CUR_TKL_UW_VV__u2_s2 98.30250000000001 _CNV_R_R_Def_td_uw__673_CM 0. 655.35 FORMAT "%5.2"
 /begin AXIS_DESCR STD_AXIS Nkw _CNV_R_R_Def_n_sw_q_595_CM 4 -32768. 32767. FORMAT "%5.0" /end AXIS_DESCR
/end CHARACTERISTIC
/begin CHARACTERISTIC KL_TASCHE "-" CURVE 0xa0826f54 _REC_CUR_TKL_UW_VV__s2_s2 0. _CNV_R_R_Def_n_sw_q_595_CM -32768. 6000. FORMAT "%5.0"
 /begin AXIS_DESCR STD_AXIS Tans _CNV_R_R_Def_t_sw_q_578_CM 6 -3276.8 3276.7 FORMAT "%4.1" /end AXIS_DESCR
/end CHARACTERISTIC
/begin CHARACTERISTIC KL_TLKRLDAB "Zeitkonstante f. Spätstellung aus Klopfregelung" CURVE 0xa082b768 _REC_CUR_TKL_UW_VV__u1_s2 12.7 _CNV_R_R_Def_td_ub__609_CM 5.e-002 12.75 FORMAT "%5.2"
 /begin AXIS_DESCR STD_AXIS Nkw _CNV_R_R_Def_n_sw_q_595_CM 6 -32768. 32767. FORMAT "%5.0" /end AXIS_DESCR
/end CHARACTERISTIC
/begin CHARACTERISTIC KL_TLKRLDAUF "Zeitkonstante f. Spätstellung aus Klopfregelung" CURVE 0xa082b730 _REC_CUR_TKL_UW_VV__u1_s2 12.7 _CNV_R_R_Def_td_ub__609_CM 5.e-002 12.75 FORMAT "%5.2"
 /begin AXIS_DESCR STD_AXIS Nkw _CNV_R_R_Def_n_sw_q_595_CM 6 -32768. 32767. FORMAT "%5.0" /end AXIS_DESCR
/end CHARACTERISTIC
/begin CHARACTERISTIC KL_TMOT_ARMD "-" CURVE 0xa082d95c _REC_CUR_TKL_UW_VV__u2_s2 3.9999 _CNV_R_R_Def_f_sw_b_616_CM 0. 3.9999 FORMAT "%14.5"
 /begin AXIS_DESCR STD_AXIS Tmot _CNV_R_R_Def_t_sw_q_579_CM 4 -327.68 327.67 FORMAT "%5.2" /end AXIS_DESCR
/end CHARACTERISTIC
/begin CHARACTERISTIC KL_TMZE "-" CURVE 0xa0826f3c _REC_CUR_TKL_UW_VV__s2_s2 15.9997 _CNV_R_R_Def_f_sw_b_592_CM -8. 7.9997 FORMAT "%7.4"
 /begin AXIS_DESCR STD_AXIS Tmot _CNV_R_R_Def_t_sw_q_579_CM 5 -327.68 327.67 FORMAT "%5.2" /end AXIS_DESCR
/end CHARACTERISTIC
/begin CHARACTERISTIC KL_T_2UMDREH "Zeit eines Arbeitsspiels" CURVE 0xa0826f8c _REC_CUR_TKL_UW_VV__u2_s2 100.66176 _CNV_R_R_Def_ti_uw__714_CM 0. 838.848
 /begin AXIS_DESCR STD_AXIS Nkw _CNV_R_R_Def_n_sw_q_595_CM 4 -32768. 32767. FORMAT "%5.0" /end AXIS_DESCR
/end CHARACTERISTIC
/begin CHARACTERISTIC KL_T_LRAMP "Zeitverzögerung B_vlschalt" CURVE 0xa082c1b4 _REC_CUR_TKL_UW_VV__u2_s2 101.5777 _CNV_R_R_Def_td_uw__673_CM 0. 327.67 FORMAT "%5.2"
 /begin AXIS_DESCR STD_AXIS Nkw _CNV_R_R_Def_n_sw_q_595_CM 6 -32768. 32767. FORMAT "%5.0" /end AXIS_DESCR
/end CHARACTERISTIC
/begin CHARACTERISTIC KL_VL_LRAMP "Rampensteigung bei B_vlschalt" CURVE 0xa082c304 _REC_CUR_TKL_UW_VV__s2_s2 131.07 _CNV_R_R_Def_m_sw_q_554_CM -3276.8 3276.7 FORMAT "%5.2"
 /begin AXIS_DESCR STD_AXIS Nkw _CNV_R_R_Def_n_sw_q_595_CM 6 -32768. 32767. FORMAT "%5.0" /end AXIS_DESCR
/end CHARACTERISTIC
/begin CHARACTERISTIC KL_VL_LRAMPVERZ "Rampensteigung bei B_vlschalt_verz" CURVE 0xa082c24c _REC_CUR_TKL_UW_VV__s2_s2 131.07 _CNV_R_R_Def_m_sw_q_554_CM -3276.8 3276.7 FORMAT "%5.2"
 /begin AXIS_DESCR STD_AXIS Nkw _CNV_R_R_Def_n_sw_q_595_CM 6 -32768. 32767. FORMAT "%5.0" /end AXIS_DESCR
/end CHARACTERISTIC
/begin CHARACTERISTIC KL_WT_UMDREH "Wichtung Zeit eines Arbeitsspiels" CURVE 0xa0826fa0 _REC_CUR_TKL_UW_VV__u1_u2 1.9921 _CNV_R_R_Def_f_ub_b_613_CM 0. 1.9921
 /begin AXIS_DESCR STD_AXIS Rk_1 _CNV_R_R_Def_rk_uw__746_CM 4 0. 31.9995 FORMAT "%7.4" /end AXIS_DESCR
/end CHARACTERISTIC
/begin CHARACTERISTIC KL_ZK_ETAWAN "Kennlinie Zeitkonstante Wandlerwirkungsgrad" CURVE 0xa082c268 _REC_CUR_TKL_UW_VV__u2_s2 0.9999847412109381 _CNV_R_R_Def_f_uw_b_571_CM 0. 0.9999847412109381 FORMAT "%14.5"
 /begin AXIS_DESCR STD_AXIS Tget _CNV_R_R_Def_t_sw_q_579_CM 6 -327.68 327.67 FORMAT "%5.2" /end AXIS_DESCR
/end CHARACTERISTIC
/begin CHARACTERISTIC K_AQMAX_SPS "Querbeschleunigungsschwelle Sportschalter" VALUE 0xa082c1ce _REC_VAL_20_s2 99.83843999999999 _CNV_R_R_Def_a_sw_b_549_CM -64. 63.998 FORMAT "%5.2" /end CHARACTERISTIC
/begin CHARACTERISTIC K_CNTAR_AUS "" VALUE 0xa082d8db _REC_VAL_20_u1 99.45 _CNV_R_R_Def_dez_sl_551_CM 0. 255. FORMAT "%3.0" /end CHARACTERISTIC
/begin CHARACTERISTIC K_DMDKDP_MX "Änderungsbegrenzung Dashpot" VALUE 0xa082c1d0 _REC_VAL_20_s2 131.07 _CNV_R_R_Def_m_sw_q_554_CM -3276.8 3276.7 FORMAT "%5.2" /end CHARACTERISTIC
/begin CHARACTERISTIC K_DMDKLSD_MN "Änderungsbegrenzung LSD" VALUE 0xa082c1d2 _REC_VAL_20_s2 131.07 _CNV_R_R_Def_m_sw_q_554_CM -3276.8 3276.7 FORMAT "%5.2" /end CHARACTERISTIC
/begin CHARACTERISTIC K_DN_SCHALT "Faktor zur Bestimmung Anschlussdrehzahlregelung" VALUE 0xa082dc58 _REC_VAL_20_u2 0.9999 _CNV_R_R_Def_f_uw_b_571_CM 0. 0.9999 FORMAT "%14.5" /end CHARACTERISTIC
/begin CHARACTERISTIC K_DZWKRLLMNS "Deltazündwinkel Klopfregelung LL min." VALUE 0xa082b5d0 _REC_VAL_20_s2 99.83843999999999 _CNV_R_R_Def_zw_sw__607_CM -64. 63.998 /end CHARACTERISTIC
/begin CHARACTERISTIC K_DZWKRLLMX "Deltazündwinkel Klopfregelung LL max." VALUE 0xa082b5d2 _REC_VAL_20_s2 100.1 _CNV_R_R_Def_zw_sw__604_CM -50. 60. FORMAT "%4.1" /end CHARACTERISTIC
/begin CHARACTERISTIC K_DZWKRMN "Deltazündwinkel Klopfregelung min." VALUE 0xa082b5ce _REC_VAL_20_s2 100.1 _CNV_R_R_Def_zw_sw__604_CM -50. 60. FORMAT "%4.1" /end CHARACTERISTIC
/begin CHARACTERISTIC K_D_FVLAUS " Offset Lastfaktor für Volllastabschaltung" VALUE 0xa0826e46 _REC_VAL_20_u2 3.9999 _CNV_R_R_Def_f_sw_b_616_CM 0. 3.9999 FORMAT "%14.5" /end CHARACTERISTIC
/begin CHARACTERISTIC K_ENTPR_FL "Entprellung Aktivierung Flankendektor" VALUE 0xa082d8d9 _REC_VAL_20_u1 99.45 _CNV_R_R_Def_dez_sl_551_CM 0. 255. FORMAT "%3.0" /end CHARACTERISTIC
/begin CHARACTERISTIC K_ENTPR_SCH "Entprellung Flankenzähler" VALUE 0xa082d8d8 _REC_VAL_20_u1 99.45 _CNV_R_R_Def_dez_sl_551_CM 0. 255. FORMAT "%3.0" /end CHARACTERISTIC
/begin CHARACTERISTIC K_ETA_GETR "Getriebewirkungsgrad" VALUE 0xa082de84 _REC_VAL_20_s2 100. _CNV_R_R_Def_eta_sw_606_CM 0. 100. /end CHARACTERISTIC
/begin CHARACTERISTIC K_FGRENZ1_AR "" VAL_BLK 0xa082d900 _REC_VAL_2_u2 0.9999 _CNV_R_R_Def_f_uw_b_571_CM 0. 0.9999 FORMAT "%14.5" NUMBER 8 /end CHARACTERISTIC
/begin CHARACTERISTIC K_FGRENZ1_ARA "" VAL_BLK 0xa082d920 _REC_VAL_2_u2 0.9999 _CNV_R_R_Def_f_uw_b_571_CM 0. 0.9999 FORMAT "%14.5" NUMBER 8 /end CHARACTERISTIC
/begin CHARACTERISTIC K_FGRENZ_AR "" VAL_BLK 0xa082d8f0 _REC_VAL_2_u2 0.9999 _CNV_R_R_Def_f_uw_b_571_CM 0. 0.9999 FORMAT "%14.5" NUMBER 8 /end CHARACTERISTIC
/begin CHARACTERISTIC K_FGRENZ_ARA "" VAL_BLK 0xa082d910 _REC_VAL_2_u2 0.9999 _CNV_R_R_Def_f_uw_b_571_CM 0. 0.9999 FORMAT "%14.5" NUMBER 8 /end CHARACTERISTIC
/begin CHARACTERISTIC K_FILTBP_DEK "Entprellung Flankenzähler" VAL_BLK 0xa082d8d0 _REC_VAL_2_u1 1. _CNV_R_R_Def_f_ub_b_619_CM 0. 1. NUMBER 8 /end CHARACTERISTIC
/begin CHARACTERISTIC K_FKRFMXATL "Verlauf hin zur saugmotorischen Füllung im Fehlerfall" VALUE 0xa082b640 _REC_VAL_20_u1 12.7 _CNV_R_R_Def_td_ub__609_CM 5.e-002 12.75 FORMAT "%5.2" /end CHARACTERISTIC
/begin CHARACTERISTIC K_F_REIBMAX "Betriebsartenwahl für minimales Moment" VALUE 0xa082e0a5 _REC_VAL_20_u1 1. _CNV_R_R_Def_f_ub_b_619_CM 0. 1. /end CHARACTERISTIC
/begin CHARACTERISTIC K_F_REIBMIN "Betriebsartenwahl für minimales Moment" VALUE 0xa082e0a4 _REC_VAL_20_u1 1. _CNV_R_R_Def_f_ub_b_619_CM 0. 1. /end CHARACTERISTIC
/begin CHARACTERISTIC K_F_RFMXFMN "min Faktor Füllungseingriff" VALUE 0xa0826e4c _REC_VAL_20_u2 1.9999 _CNV_R_R_Def_f_uw_b_590_CM 0. 1.9999 FORMAT "%14.5" /end CHARACTERISTIC
/begin CHARACTERISTIC K_F_RFMXLESS "Faktor Füllungseingriff bei Quotient Segzeit zu Ti < 1" VALUE 0xa0826e50 _REC_VAL_20_u2 1.9999 _CNV_R_R_Def_f_uw_b_590_CM 0. 1.9999 FORMAT "%14.5" /end CHARACTERISTIC
/begin CHARACTERISTIC K_F_RFMXPLUS "Faktor Füllungseingriff bei Quotient Segzeit zu Ti >= 1" VALUE 0xa0826e4e _REC_VAL_20_u2 1.9999 _CNV_R_R_Def_f_uw_b_590_CM 0. 1.9999 FORMAT "%14.5" /end CHARACTERISTIC
/begin CHARACTERISTIC K_F_RFMXTEHYST "Hysterese Faktor Rf-Begrenzung" VALUE 0xa0826e54 _REC_VAL_20_u2 1.9999 _CNV_R_R_Def_f_uw_b_590_CM 0. 1.9999 FORMAT "%14.5" /end CHARACTERISTIC
/begin CHARACTERISTIC K_F_SPORT "Faktor Momentengradient bei Sportschalter" VAL_BLK 0xa082c1f8 _REC_VAL_2_u1 1.9921 _CNV_R_R_Def_f_ub_b_613_CM 0. 1.9921 NUMBER 8 /end CHARACTERISTIC
/begin CHARACTERISTIC K_GANG_MAX "max. Gang" VALUE 0xa082dc4e _REC_VAL_20_u1 99.45 _CNV_R_R_Def_dez_sl_551_CM 0. 255. FORMAT "%3.0" /end CHARACTERISTIC
/begin CHARACTERISTIC K_GANG_MINUS "Anzahl Rückschaltungen" VALUE 0xa082dc4b _REC_VAL_20_u1 99.45 _CNV_R_R_Def_dez_sl_551_CM 0. 255. FORMAT "%3.0" /end CHARACTERISTIC
/begin CHARACTERISTIC K_GANG_PLUS "Anzahl Hochschaltungen" VALUE 0xa082dc4c _REC_VAL_20_u1 99.45 _CNV_R_R_Def_dez_sl_551_CM 0. 255. FORMAT "%3.0" /end CHARACTERISTIC
/begin CHARACTERISTIC K_HSCHALT_WS "Schwelle Wahrscheinlichkeit für Hochschaltungen" VALUE 0xa082dc49 _REC_VAL_20_s1 1.9921 _CNV_R_R_Def_f_sb_b_703_CM -1. 0.9921 /end CHARACTERISTIC
/begin CHARACTERISTIC K_I_GANG "Gangübersetzung" VAL_BLK 0xa082dc38 _REC_VAL_2_u2 63.99900000000001 _CNV_R_R_Def_f_uw_b_617_CM 0. 63.999 FORMAT "%7.4" NUMBER 8 /end CHARACTERISTIC
/begin CHARACTERISTIC K_KEINAR_AT "Freigabe Ar in Abhängigkeit der WK" VAL_BLK 0xa082d8cc _REC_VAL_2_u1 99.45 _CNV_R_R_Def_dez_sl_551_CM 0. 255. FORMAT "%3.0" NUMBER 4 /end CHARACTERISTIC
/begin CHARACTERISTIC K_KEINAR_SMG "Freigabe Ar in Abhängigkeit der Kupplung bei SMG" VAL_BLK 0xa082d8c4 _REC_VAL_2_u1 99.45 _CNV_R_R_Def_dez_sl_551_CM 0. 255. FORMAT "%3.0" NUMBER 8 /end CHARACTERISTIC
/begin CHARACTERISTIC K_KFATHS_EIN "1: es werden die AT-KF verwendet" VAL_BLK 0xa082c200 _REC_VAL_2_u1 1. _CNV_R_R_Def_dez_sl_551_CM 0. 1. FORMAT "%3.0" NUMBER 4 /end CHARACTERISTIC
/begin CHARACTERISTIC K_LSD4_PS "Offset zu Umgebungsdruck zur Aktivierung LSD-Bereich 4" VALUE 0xa082c1d4 _REC_VAL_20_s2 102.398436 _CNV_R_R_Def_p_sw_q_576_CM -1280. 1279.9609 FORMAT "%5.2" /end CHARACTERISTIC
/begin CHARACTERISTIC K_LSD4_PSHYS "Hysterese Erkennung Turbobereich auf Pssol" VALUE 0xa082c1d6 _REC_VAL_20_s2 102.398436 _CNV_R_R_Def_p_sw_q_576_CM -1280. 1279.9609 FORMAT "%5.2" /end CHARACTERISTIC
/begin CHARACTERISTIC K_LSD4_PSSOL "Offset zu Umgebungsdruck zur Erkennung Lastsprung im Turbobereich" VALUE 0xa082c1d8 _REC_VAL_20_s2 102.398436 _CNV_R_R_Def_p_sw_q_576_CM -1280. 1279.9609 FORMAT "%5.2" /end CHARACTERISTIC
/begin CHARACTERISTIC K_MAT_MDST "Tabelle Betriebsartenwahl Startmoment" VAL_BLK 0xa082e0a8 _REC_VAL_2_u1 1. _CNV_R_R_Def_dez_sl_551_CM 0. 1. FORMAT "%3.0" NUMBER 8 /end CHARACTERISTIC
/begin CHARACTERISTIC K_MAT_REIB "Tabelle Betriebsartenzuweisung Reibung" VAL_BLK 0xa082e094 _REC_VAL_2_u1 99.45 _CNV_R_R_Def_dez_sl_551_CM 0. 255. FORMAT "%3.0" NUMBER 8 /end CHARACTERISTIC
/begin CHARACTERISTIC K_MAT_REIB_ADD "Tabelle Betriebsartenzuweisung Zusatzreibung" VAL_BLK 0xa082e09c _REC_VAL_2_u1 1. _CNV_R_R_Def_dez_sl_551_CM 0. 1. FORMAT "%3.0" NUMBER 8 /end CHARACTERISTIC
/begin CHARACTERISTIC K_MDASR_RAMP "Gradientenbegrenzung bei Momtentenaufbau schneller Pfad ASR" VALUE 0xa082e090 _REC_VAL_20_s2 131.07 _CNV_R_R_Def_m_sw_q_554_CM -3276.8 3276.7 FORMAT "%5.2" /end CHARACTERISTIC
/begin CHARACTERISTIC K_MDKMINHYS_SA "Hysterese zur Erkennung SA bei erkannter SA" VALUE 0xa082c1da _REC_VAL_20_s2 131.07 _CNV_R_R_Def_m_sw_q_554_CM -3276.8 3276.7 FORMAT "%5.2" /end CHARACTERISTIC
/begin CHARACTERISTIC K_MDKMIN_SA "Hysterese zur Erkennung SA bei nicht erkannter SA" VALUE 0xa082c1dc _REC_VAL_20_s2 131.07 _CNV_R_R_Def_m_sw_q_554_CM -3276.8 3276.7 FORMAT "%5.2" /end CHARACTERISTIC
/begin CHARACTERISTIC K_MDK_WUNSCHHYST "Momentengradientenschwelle zur Berechnung des Referenzwunsches" VALUE 0xa082c1de _REC_VAL_20_s2 131.07 _CNV_R_R_Def_m_sw_q_554_CM -3276.8 3276.7 FORMAT "%5.2" /end CHARACTERISTIC
/begin CHARACTERISTIC K_MDNKWST_1 "Drehzahldiff. zum Ausschalten der Startreibung mit Momentenvergleich" VALUE 0xa082e0b0 _REC_VAL_20_s2 0. _CNV_R_R_Def_n_sw_q_595_CM -32768. 32767. FORMAT "%5.0" /end CHARACTERISTIC
/begin CHARACTERISTIC K_MDNKWST_2 "Drehzahldiff. zum Ausschalten der Startreibung" VALUE 0xa082e0b2 _REC_VAL_20_s2 0. _CNV_R_R_Def_n_sw_q_595_CM -32768. 32767. FORMAT "%5.0" /end CHARACTERISTIC
/begin CHARACTERISTIC K_MDRESMN_FGRHYS "Hysterese min . Reservemoment bei aktivem FGR" VALUE 0xa0827260 _REC_VAL_20_s2 131.07 _CNV_R_R_Def_m_sw_q_554_CM -3276.8 3276.7 FORMAT "%5.2" /end CHARACTERISTIC
/begin CHARACTERISTIC K_MDRESMN_HYS "Hysterese min . Reservemoment" VALUE 0xa0827264 _REC_VAL_20_s2 131.07 _CNV_R_R_Def_m_sw_q_554_CM -3276.8 3276.7 FORMAT "%5.2" /end CHARACTERISTIC
/begin CHARACTERISTIC K_MDRES_DEK "Wert zum abrampen der Momentenreserve" VALUE 0xa082725e _REC_VAL_20_s2 131.07 _CNV_R_R_Def_m_sw_q_554_CM -3276.8 3276.7 FORMAT "%5.2" /end CHARACTERISTIC
/begin CHARACTERISTIC K_MDRES_GLLL "Momentenreserve für CILC am Bandende" VALUE 0xa0827268 _REC_VAL_20_s2 131.07 _CNV_R_R_Def_m_sw_q_554_CM -3276.8 3276.7 FORMAT "%5.2" /end CHARACTERISTIC
/begin CHARACTERISTIC K_MDRES_MN "min . Reservemoment" VALUE 0xa0827266 _REC_VAL_20_s2 131.07 _CNV_R_R_Def_m_sw_q_554_CM -3276.8 3276.7 FORMAT "%5.2" /end CHARACTERISTIC
/begin CHARACTERISTIC K_MDRES_MNFGR "min . Reservemoment bei aktivem FGR" VALUE 0xa0827262 _REC_VAL_20_s2 131.07 _CNV_R_R_Def_m_sw_q_554_CM -3276.8 3276.7 FORMAT "%5.2" /end CHARACTERISTIC
/begin CHARACTERISTIC K_MDSCHALTRIMN "Min Wert I-Anteil PID-Regler-Ausgang Anschlussdrehzahlregelung" VALUE 0xa082dc60 _REC_VAL_20_s2 131.07 _CNV_R_R_Def_m_sw_q_554_CM -3276.8 3276.7 FORMAT "%5.2" /end CHARACTERISTIC
/begin CHARACTERISTIC K_MDSCHALTRIMX "Max Wert I-Anteil PID-Regler-Ausgang Anschlussdrehzahlregelung" VALUE 0xa082dc62 _REC_VAL_20_s2 131.07 _CNV_R_R_Def_m_sw_q_554_CM -3276.8 3276.7 FORMAT "%5.2" /end CHARACTERISTIC
/begin CHARACTERISTIC K_MDSCHALTRMN "Min Wert PID-Regler-Ausgang Anschlussdrehzahlregelung" VALUE 0xa082dc5c _REC_VAL_20_s2 131.07 _CNV_R_R_Def_m_sw_q_554_CM -3276.8 3276.7 FORMAT "%5.2" /end CHARACTERISTIC
/begin CHARACTERISTIC K_MDSCHALTRMX "Max Wert PID-Regler-Ausgang Anschlussdrehzahlregelung" VALUE 0xa082dc5e _REC_VAL_20_s2 131.07 _CNV_R_R_Def_m_sw_q_554_CM -3276.8 3276.7 FORMAT "%5.2" /end CHARACTERISTIC
/begin CHARACTERISTIC K_MDSCHALT_OFF "Offset Moment bei Minimalbegrenzung Mdk_wunsch_vb" VALUE 0xa082dc5a _REC_VAL_20_s2 131.07 _CNV_R_R_Def_m_sw_q_554_CM -3276.8 3276.7 FORMAT "%5.2" /end CHARACTERISTIC
/begin CHARACTERISTIC K_NFILTMN "" VALUE 0xa082d8e2 _REC_VAL_20_s2 100. _CNV_R_R_Def_n_sw_q_595_CM -500. 500. FORMAT "%5.0" /end CHARACTERISTIC
/begin CHARACTERISTIC K_NFILTMX "" VALUE 0xa082d8e4 _REC_VAL_20_s2 100. _CNV_R_R_Def_n_sw_q_595_CM -500. 500. FORMAT "%5.0" /end CHARACTERISTIC
/begin CHARACTERISTIC K_NGANG_APPL "Appl Drehzahlregelung" VALUE 0xa082dc56 _REC_VAL_20_s2 0. _CNV_R_R_Def_n_sw_q_595_CM -32768. 32767. FORMAT "%5.0" /end CHARACTERISTIC
/begin CHARACTERISTIC K_NGFSAWE "Schwelle Drehzahlgradient für Sperre Lastschlagdämpfung bei WE" VALUE 0xa082c1ec _REC_VAL_20_s1 81.60000000000001 _CNV_R_R_Def_ngrd_s_661_CM -4096. 4064. FORMAT "%5.2" /end CHARACTERISTIC
/begin CHARACTERISTIC K_NSTAT_OFF "Offset zur Berechnung der min Anschlussdrehzahl" VALUE 0xa082dc64 _REC_VAL_20_s2 0. _CNV_R_R_Def_n_sw_q_595_CM -32768. 32767. FORMAT "%5.0" /end CHARACTERISTIC
/begin CHARACTERISTIC K_N_TIMDRED "Drehzahlschwelle Füllungsbegrenzung" VALUE 0xa0826e52 _REC_VAL_20_s2 0. _CNV_R_R_Def_n_sw_q_595_CM -32768. 32767. FORMAT "%5.0" /end CHARACTERISTIC
/begin CHARACTERISTIC K_ORDF_AR "" VALUE 0xa082d8dc _REC_VAL_20_u1 2. _CNV_R_R_Def_dez_sl_551_CM 0. 2. FORMAT "%3.0" /end CHARACTERISTIC
/begin CHARACTERISTIC K_PAR_MAX "" VALUE 0xa082d8de _REC_VAL_20_u1 3.9843 _CNV_R_R_Def_f_ub_b_632_CM 0. 3.9843 FORMAT "%5.2" /end CHARACTERISTIC
/begin CHARACTERISTIC K_PAR_MAXA "" VALUE 0xa082d8e0 _REC_VAL_20_u1 3.9843 _CNV_R_R_Def_f_ub_b_632_CM 0. 3.9843 FORMAT "%5.2" /end CHARACTERISTIC
/begin CHARACTERISTIC K_PAR_MIN "" VALUE 0xa082d8df _REC_VAL_20_u1 3.9843 _CNV_R_R_Def_f_ub_b_632_CM 0. 3.9843 FORMAT "%5.2" /end CHARACTERISTIC
/begin CHARACTERISTIC K_PAR_MINA "" VALUE 0xa082d8e1 _REC_VAL_20_u1 3.9843 _CNV_R_R_Def_f_ub_b_632_CM 0. 3.9843 FORMAT "%5.2" /end CHARACTERISTIC
/begin CHARACTERISTIC K_PWGGRAD_AR "" VALUE 0xa082d8ea _REC_VAL_20_s2 0. _CNV_R_R_Def_pwggrd_682_CM -20000. 19999.3896 /end CHARACTERISTIC
/begin CHARACTERISTIC K_PWGGRAD_ARN "" VALUE 0xa082d8e8 _REC_VAL_20_s2 0. _CNV_R_R_Def_pwggrd_682_CM -20000. 19999.3896 /end CHARACTERISTIC
/begin CHARACTERISTIC K_RSCHALT_WS "Schwelle Wahrscheinlichkeit für Rückschaltungen" VALUE 0xa082dc4a _REC_VAL_20_s1 1.9921 _CNV_R_R_Def_f_sb_b_703_CM -1. 0.9921 /end CHARACTERISTIC
/begin CHARACTERISTIC K_SONKW_AR "" VALUE 0xa082d944 _REC_VAL_20_s2 0. _CNV_R_R_Def_n_sw_q_595_CM -32768. 32767. FORMAT "%5.0" /end CHARACTERISTIC
/begin CHARACTERISTIC K_SSCHWINGUNG_AR "Schwelle Anzahl Schwingungen ab der die AR deaktiviert wird" VALUE 0xa082d8dd _REC_VAL_20_u1 99.45 _CNV_R_R_Def_dez_sl_551_CM 0. 255. FORMAT "%3.0" /end CHARACTERISTIC
/begin CHARACTERISTIC K_STMOT_AR "" VALUE 0xa082d932 _REC_VAL_20_s2 98.30250000000001 _CNV_R_R_Def_t_sw_q_579_CM -327.68 327.67 FORMAT "%5.2" /end CHARACTERISTIC
/begin CHARACTERISTIC K_SUNKW_AR "" VAL_BLK 0xa082d934 _REC_VAL_2_s2 0. _CNV_R_R_Def_n_sw_q_595_CM -32768. 32767. FORMAT "%5.0" NUMBER 8 /end CHARACTERISTIC
/begin CHARACTERISTIC K_SV_AR "Fz-Geschwindigkeit" VALUE 0xa082d930 _REC_VAL_20_u2 100.8 _CNV_R_R_Def_v_uw_q_726_CM 0. 360. FORMAT "%5.0" /end CHARACTERISTIC
/begin CHARACTERISTIC K_TAR_AUS "" VALUE 0xa082d8ec _REC_VAL_20_u2 98.30250000000001 _CNV_R_R_Def_td_uw__673_CM 0. 655.35 FORMAT "%5.2" /end CHARACTERISTIC
/begin CHARACTERISTIC K_TAR_EIN "Verzögerungszeit B_kupp" VALUE 0xa082d8e6 _REC_VAL_20_u2 98.30250000000001 _CNV_R_R_Def_td_uw__673_CM 0. 655.35 FORMAT "%5.2" /end CHARACTERISTIC
/begin CHARACTERISTIC K_TDBLLK "Rechenschritte Verzögerung B_llk" VALUE 0xa082b5cd _REC_VAL_20_u1 99.45 _CNV_R_R_Def_dez_sl_551_CM 0. 255. FORMAT "%3.0" /end CHARACTERISTIC
/begin CHARACTERISTIC K_TDNSCHALT "Verzögerungszeit Anschlussdrehzahlrampe" VALUE 0xa082dc52 _REC_VAL_20_u2 98.30250000000001 _CNV_R_R_Def_td_uw__673_CM 0. 655.35 FORMAT "%5.2" /end CHARACTERISTIC
/begin CHARACTERISTIC K_TDSCHALT_MAX "Verzögerungszeit Abschaltung Anschlussdrehzahlregelung" VALUE 0xa082dc50 _REC_VAL_20_u2 98.30250000000001 _CNV_R_R_Def_td_uw__673_CM 0. 655.35 FORMAT "%5.2" /end CHARACTERISTIC
/begin CHARACTERISTIC K_TI1HOM "Initislwert für Ti_1_homext" VALUE 0xa0826e48 _REC_VAL_20_u2 100.66176 _CNV_R_R_Def_ti_uw__714_CM 0. 838.848 /end CHARACTERISTIC
/begin CHARACTERISTIC K_TI2HOM "Initislwert für Ti_2_homext" VALUE 0xa0826e4a _REC_VAL_20_u2 100.66176 _CNV_R_R_Def_ti_uw__714_CM 0. 838.848 /end CHARACTERISTIC
/begin CHARACTERISTIC K_TLMD_AUS "Schwelle Leerlauf/Teillasterkennung aus Momenten" VALUE 0xa082c1e0 _REC_VAL_20_s2 131.07 _CNV_R_R_Def_m_sw_q_554_CM -3276.8 3276.7 FORMAT "%5.2" /end CHARACTERISTIC
/begin CHARACTERISTIC K_TLMD_EIN "Schwelle Leerlauf/Teillasterkennung aus Momenten" VALUE 0xa082c1e2 _REC_VAL_20_s2 131.07 _CNV_R_R_Def_m_sw_q_554_CM -3276.8 3276.7 FORMAT "%5.2" /end CHARACTERISTIC
/begin CHARACTERISTIC K_TVDPSTEND "Verzögerung B_startende für enable Dashpot" VALUE 0xa082c1e4 _REC_VAL_20_u2 98.30250000000001 _CNV_R_R_Def_td_uw__673_CM 0. 655.35 FORMAT "%5.2" /end CHARACTERISTIC
/begin CHARACTERISTIC K_TVFSAWE "Verzögerung B_sa für enable Dashpot" VALUE 0xa082c1e6 _REC_VAL_20_u2 98.30250000000001 _CNV_R_R_Def_td_uw__673_CM 0. 655.35 FORMAT "%5.2" /end CHARACTERISTIC
/begin CHARACTERISTIC K_VNULL "Schwelle für Fzg. steht Erkennung" VALUE 0xa082c1e8 _REC_VAL_20_u2 0. _CNV_R_R_Def_v_uw_q_726_CM 0. 65535. FORMAT "%5.0" /end CHARACTERISTIC
/begin CHARACTERISTIC K_ZKRFMXATL "Zeitkonstante für gef. Max. Fuelling im Notlauf-Modus" VALUE 0xa0826e56 _REC_VAL_20_u2 655.35 _CNV_R_R_Def_zk10ms_715_CM 1.e-002 655.36 FORMAT "%7.4" /end CHARACTERISTIC
/begin CHARACTERISTIC K_ZK_DMDK "Zeitkonstante zur Filterung von Dmdk_wunsch" VALUE 0xa082dc54 _REC_VAL_20_u2 99.9984 _CNV_R_R_Def_f_uw_b_555_CM 0. 99.9984 /end CHARACTERISTIC
/begin CHARACTERISTIC K_ZK_MDKWUNSCH "Zeitkonstante zur Nachführung des Referenzwunsches" VALUE 0xa082c1ea _REC_VAL_20_u2 0.9999847412109381 _CNV_R_R_Def_f_uw_b_571_CM 0. 0.9999847412109381 FORMAT "%14.5" /end CHARACTERISTIC
/begin CHARACTERISTIC S_ARAUS "Freigabe Aktiv-Zeit AR" VALUE 0xa082d8c1 _REC_VAL_20_u1 99.45 _CNV_R_R_Def_dez_sl_551_CM 0. 255. FORMAT "%3.0" /end CHARACTERISTIC
/begin CHARACTERISTIC S_DMLS3_PWG "Codewort Wirkung Sportschalter auf Momentengradientenbereich" VALUE 0xa082c1f1 _REC_VAL_20_u1 1. _CNV_R_R_Def_dez_sl_551_CM 0. 1. FORMAT "%3.0" /end CHARACTERISTIC
/begin CHARACTERISTIC S_FHO_UL "Schalter gewollte Momentenreduzierung beim UL auf Höhe" VALUE 0xa0826e42 _REC_VAL_20_u1 1. _CNV_R_R_Def_dez_sl_551_CM 0. 1. FORMAT "%3.0" /end CHARACTERISTIC
/begin CHARACTERISTIC S_FZDYN_F "true: Fahrerwunschmoment wird gefiltert" VALUE 0xa082d8c0 _REC_VAL_20_u1 99.45 _CNV_R_R_Def_dez_sl_551_CM 0. 255. FORMAT "%3.0" /end CHARACTERISTIC
/begin CHARACTERISTIC S_GANG_MOD "Schalter modellierter Gang" VALUE 0xa082dc4d _REC_VAL_20_u1 99.45 _CNV_R_R_Def_dez_sl_551_CM 0. 255. FORMAT "%3.0" /end CHARACTERISTIC
/begin CHARACTERISTIC S_KHDI "1: Momentenreserve aus Kathheizmanager einrechnen" VALUE 0xa082725c _REC_VAL_20_u1 99.45 _CNV_R_R_Def_dez_sl_551_CM 0. 255. FORMAT "%3.0" /end CHARACTERISTIC
/begin CHARACTERISTIC S_MDRES_KRLL "Schalter Momentenreserve der KR im LL" VALUE 0xa082b5cc _REC_VAL_20_u1 99.45 _CNV_R_R_Def_dez_sl_551_CM 0. 255. FORMAT "%3.0" /end CHARACTERISTIC
/begin CHARACTERISTIC S_MDRES_VLS "" VALUE 0xa082725d _REC_VAL_20_u1 99.45 _CNV_R_R_Def_dez_sl_551_CM 0. 255. FORMAT "%3.0" /end CHARACTERISTIC
/begin CHARACTERISTIC S_NGANG_APPL "Schalter Appl Drehzahlregler akt" VALUE 0xa082dc48 _REC_VAL_20_u1 99.45 _CNV_R_R_Def_dez_sl_551_CM 0. 255. FORMAT "%3.0" /end CHARACTERISTIC
/begin CHARACTERISTIC S_PWG2MDK "Schalter Pwg_ist / Mdk_wunsch" VALUE 0xa082c1f2 _REC_VAL_20_u1 1. _CNV_R_R_Def_dez_sl_551_CM 0. 1. FORMAT "%3.0" /end CHARACTERISTIC
/begin CHARACTERISTIC S_PWGMAX_AKT "Schalter Pwg_ist / Pwg_max" VALUE 0xa082c1f3 _REC_VAL_20_u1 1. _CNV_R_R_Def_dez_sl_551_CM 0. 1. FORMAT "%3.0" /end CHARACTERISTIC
/begin CHARACTERISTIC S_VLSCH_DASH "Freigabe B_vlschalt" VALUE 0xa082c1f4 _REC_VAL_20_u1 1. _CNV_R_R_Def_dez_sl_551_CM 0. 1. FORMAT "%3.0" /end CHARACTERISTIC
/begin CHARACTERISTIC S_WL_AR "Schalter Schwingungszähler aktiv" VALUE 0xa082d8da _REC_VAL_20_u1 99.45 _CNV_R_R_Def_dez_sl_551_CM 0. 255. FORMAT "%3.0" /end CHARACTERISTIC
/begin COMPU_METHOD _CNV_R_R_Def_km_sw__68_CM "Def_km_sw_q10" RAT_FUNC "%6.3" "km" COEFFS 0. 1. 0. 0. 0. 10. /end COMPU_METHOD
/begin COMPU_METHOD _CNV_R_R_Def_a_sw_b_549_CM "Def_a_sw_b64" RAT_FUNC "%6.3" "m/s²" COEFFS 0. 32768. 0. 0. 0. 64. /end COMPU_METHOD
/begin COMPU_METHOD _CNV_R_R_Def_dez_sl_551_CM "Def_dez_sl_q1" RAT_FUNC "%6.3" "-" COEFFS 0. 1. 0. 0. 0. 1. /end COMPU_METHOD
/begin COMPU_METHOD _CNV_R_R_Def_f_ub_b_553_CM "Def_f_ub_b1" RAT_FUNC "%6.3" "-" COEFFS 0. 256. 0. 0. 0. 1. /end COMPU_METHOD
/begin COMPU_METHOD _CNV_R_R_Def_m_sw_q_554_CM "Def_m_sw_q0p1" RAT_FUNC "%6.3" "Nm" COEFFS 0. 10. 0. 0. 0. 1. /end COMPU_METHOD
/begin COMPU_METHOD _CNV_R_R_Def_f_uw_b_555_CM "Def_f_uw_b100" RAT_FUNC "%6.3" "%" COEFFS 0. 65536. 0. 0. 0. 100. /end COMPU_METHOD
/begin COMPU_METHOD _CNV_S_2_Def_bit_ub_563_CM "Def_bit_ub_0" TAB_VERB "%6.3" "-" COMPU_TAB_REF _CNV_S_2_Def_bit_ub_563 /end COMPU_METHOD
/begin COMPU_VTAB _CNV_S_2_Def_bit_ub_563 "Def_bit_ub_0" TAB_VERB 2 0 "FALSE" 1 "TRUE" /end COMPU_VTAB
/begin COMPU_METHOD _CNV_R_R_Def_f_uw_b_571_CM "Def_f_uw_b1" RAT_FUNC "%6.3" "-" COEFFS 0. 65536. 0. 0. 0. 1. /end COMPU_METHOD
/begin COMPU_METHOD _CNV_R_R_Def_p_sw_q_576_CM "Def_p_sw_q0p039" RAT_FUNC "%6.3" "hPa" COEFFS 0. 256. 0. 0. 0. 10. /end COMPU_METHOD
/begin COMPU_METHOD _CNV_R_R_Def_t_sw_q_578_CM "Def_t_sw_q0p1" RAT_FUNC "%6.3" "°C" COEFFS 0. 10. 0. 0. 0. 1. /end COMPU_METHOD
/begin COMPU_METHOD _CNV_R_R_Def_t_sw_q_579_CM "Def_t_sw_q0p01" RAT_FUNC "%6.3" "°C" COEFFS 0. 100. 0. 0. 0. 1. /end COMPU_METHOD
/begin COMPU_METHOD _CNV_R_R_Def_f_uw_b_590_CM "Def_f_uw_b2" RAT_FUNC "%6.3" "-" COEFFS 0. 65536. 0. 0. 0. 2. /end COMPU_METHOD
/begin COMPU_METHOD _CNV_R_R_Def_f_sw_b_592_CM "Def_f_sw_b8" RAT_FUNC "%6.3" "-" COEFFS 0. 32768. 0. 0. 0. 8. /end COMPU_METHOD
/begin COMPU_METHOD _CNV_R_R_Def_ms_uw__594_CM "Def_ms_uw_q0p03125" RAT_FUNC "%6.3" "kg/h" COEFFS 0. 32. 0. 0. 0. 1. /end COMPU_METHOD
/begin COMPU_METHOD _CNV_R_R_Def_n_sw_q_595_CM "Def_n_sw_q1p0" RAT_FUNC "%6.3" "Upm" COEFFS 0. 1. 0. 0. 0. 1. /end COMPU_METHOD
/begin COMPU_METHOD _CNV_R_R_Def_rf_sw__598_CM "Def_rf_sw_q0p01" RAT_FUNC "%6.3" "%" COEFFS 0. 100. 0. 0. 0. 1. /end COMPU_METHOD
/begin COMPU_METHOD _CNV_R_R_Def_zw_sw__604_CM "Def_zw_sw_q0p1" RAT_FUNC "%6.3" "°" COEFFS 0. 10. 0. 0. 0. 1. /end COMPU_METHOD
/begin COMPU_METHOD _CNV_R_R_Def_eta_sw_606_CM "Def_eta_sw_q0p00305" RAT_FUNC "%6.3" "%" COEFFS 0. 32767. 0. 0. 0. 100. /end COMPU_METHOD
/begin COMPU_METHOD _CNV_R_R_Def_zw_sw__607_CM "Def_zw_sw_b64" RAT_FUNC "%6.3" "°" COEFFS 0. 32768. 0. 0. 0. 64. /end COMPU_METHOD
/begin COMPU_METHOD _CNV_R_R_Def_td_ub__609_CM "Def_td_ub_q0p05" RAT_FUNC "%6.3" "s" COEFFS 0. 20. 0. 0. 0. 1. /end COMPU_METHOD
/begin COMPU_METHOD _CNV_R_R_Def_f_ub_b_613_CM "Def_f_ub_b2" RAT_FUNC "%6.3" "-" COEFFS 0. 256. 0. 0. 0. 2. /end COMPU_METHOD
/begin COMPU_METHOD _CNV_R_R_Def_f_sw_b_616_CM "Def_f_sw_b2" RAT_FUNC "%6.3" "-" COEFFS 0. 65536. 0. 0. 0. 4. /end COMPU_METHOD
/begin COMPU_METHOD _CNV_R_R_Def_f_uw_b_617_CM "Def_f_uw_b64" RAT_FUNC "%6.3" "-" COEFFS 0. 65536. 0. 0. 0. 64. /end COMPU_METHOD
/begin COMPU_METHOD _CNV_R_R_Def_f_ub_b_619_CM "Def_f_ub_b1p0" RAT_FUNC "%6.3" "-" COEFFS 0. 255. 0. 0. 0. 1. /end COMPU_METHOD
/begin COMPU_METHOD _CNV_R_R_Def_f_uw_b_621_CM "Def_f_uw_b256" RAT_FUNC "%6.3" "-" COEFFS 0. 65536. 0. 0. 0. 256. /end COMPU_METHOD
/begin COMPU_METHOD _CNV_R_R_Def_f_uw_b_629_CM "Def_f_uw_b0p3" RAT_FUNC "%6.3" "%/hPa" COEFFS 0. 65536. 0. 0. 0. 0.3 /end COMPU_METHOD
/begin COMPU_METHOD _CNV_R_R_Def_f_ub_b_632_CM "Def_f_ub_b4" RAT_FUNC "%6.3" "-" COEFFS 0. 256. 0. 0. 0. 4. /end COMPU_METHOD
/begin COMPU_METHOD _CNV_R_R_Def_md_rel_651_CM "Def_md_rel_q0p1" RAT_FUNC "%6.3" "%" COEFFS 0. 10. 0. 0. 0. 1. /end COMPU_METHOD
/begin COMPU_METHOD _CNV_R_R_Def_ngrd_s_661_CM "Def_ngrd_sb_q32p0" RAT_FUNC "%6.3" "Upm/s" COEFFS 0. 1. 0. 0. 0. 32. /end COMPU_METHOD
/begin COMPU_METHOD _CNV_R_R_Def_td_uw__673_CM "Def_td_uw_q0p01" RAT_FUNC "%6.3" "s" COEFFS 0. 100. 0. 0. 0. 1. /end COMPU_METHOD
/begin COMPU_METHOD _CNV_R_R_Def_pwggrd_682_CM "Def_pwggrd_sw_b2500" RAT_FUNC "%6.3" "%/s" COEFFS 0. 4096. 0. 0. 0. 2500. /end COMPU_METHOD
/begin COMPU_METHOD _CNV_R_R_Def_wdk_sw_683_CM "Def_wdk_sw_q0p0244" RAT_FUNC "%6.3" "%" COEFFS 0. 4096. 0. 0. 0. 100. /end COMPU_METHOD
/begin COMPU_METHOD _CNV_R_R_Def_f_ub_b_694_CM "Def_f_ub_b8" RAT_FUNC "%6.3" "-" COEFFS 0. 256. 0. 0. 0. 8. /end COMPU_METHOD
/begin COMPU_METHOD _CNV_R_R_Def_f_sb_b_703_CM "Def_f_sb_b1" RAT_FUNC "%6.3" "-" COEFFS 0. 128. 0. 0. 0. 1. /end COMPU_METHOD
/begin COMPU_METHOD _CNV_R_R_Def_ti_uw__714_CM "Def_ti_uw_q0p0128" RAT_FUNC "%6.3" "ms" COEFFS 0. 78.125 0. 0. 0. 1. /end COMPU_METHOD
/begin COMPU_METHOD _CNV_R_R_Def_zk10ms_715_CM "Def_zk10ms_uw_b655p36" RAT_FUNC "%6.3" "s" COEFFS 0. 0. 655.36 0. 1. 0. /end COMPU_METHOD
/begin COMPU_METHOD _CNV_R_R_Def_v_uw_q_726_CM "Def_v_uw_q1p0" RAT_FUNC "%6.3" "km/h" COEFFS 0. 1. 0. 0. 0. 1. /end COMPU_METHOD
/begin COMPU_METHOD _CNV_R_R_Def_f_ub_b_737_CM "Def_f_ub_b3" RAT_FUNC "%6.3" "-" COEFFS 0. 255. 0. 0. 0. 3. /end COMPU_METHOD
/begin COMPU_METHOD _CNV_R_R_Def_f_sb_b_742_CM "Def_f_sb_b0p25" RAT_FUNC "%6.3" "-" COEFFS 0. 512. 0. 0. 0. 1. /end COMPU_METHOD
/begin COMPU_METHOD _CNV_R_R_Def_f_ub_b_743_CM "Def_f_ub_b16" RAT_FUNC "%6.3" "-" COEFFS 0. 256. 0. 0. 0. 16. /end COMPU_METHOD
/begin COMPU_METHOD _CNV_R_R_Def_rk_uw__746_CM "Def_rk_uw_b16" RAT_FUNC "%6.3" "-" COEFFS 0. 2048. 0. 0. 0. 1. /end COMPU_METHOD
/begin RECORD_LAYOUT _REC_VAL_20_u1 FNC_VALUES 1 UBYTE COLUMN_DIR DIRECT /end RECORD_LAYOUT
/begin RECORD_LAYOUT _REC_VAL_20_u2 FNC_VALUES 1 UWORD COLUMN_DIR DIRECT /end RECORD_LAYOUT
/begin RECORD_LAYOUT _REC_VAL_20_s2 FNC_VALUES 1 SWORD COLUMN_DIR DIRECT /end RECORD_LAYOUT
/begin RECORD_LAYOUT _REC_VAL_20_s1 FNC_VALUES 1 SBYTE COLUMN_DIR DIRECT /end RECORD_LAYOUT
/begin RECORD_LAYOUT _REC_MAP_52_UBYTE_s2_s2_u2 NO_AXIS_PTS_X 1 UBYTE NO_AXIS_PTS_Y 2 UBYTE AXIS_PTS_X 3 SWORD INDEX_INCR DIRECT AXIS_PTS_Y 4 UWORD INDEX_INCR DIRECT FNC_VALUES 5 SWORD COLUMN_DIR DIRECT /end RECORD_LAYOUT
/begin RECORD_LAYOUT _REC_MAP_52_u1_s2_s2 NO_AXIS_PTS_X 1 UBYTE NO_AXIS_PTS_Y 2 UBYTE AXIS_PTS_X 3 SWORD INDEX_INCR DIRECT AXIS_PTS_Y 4 SWORD INDEX_INCR DIRECT FNC_VALUES 5 UBYTE COLUMN_DIR DIRECT /end RECORD_LAYOUT
/begin RECORD_LAYOUT _REC_MAP_52_UBYTE_u2_s2_u2 NO_AXIS_PTS_X 1 UBYTE NO_AXIS_PTS_Y 2 UBYTE AXIS_PTS_X 3 SWORD INDEX_INCR DIRECT AXIS_PTS_Y 4 UWORD INDEX_INCR DIRECT FNC_VALUES 5 UWORD COLUMN_DIR DIRECT /end RECORD_LAYOUT
/begin RECORD_LAYOUT _REC_MAP_52_UBYTE_u2_s2_s2 NO_AXIS_PTS_X 1 UBYTE NO_AXIS_PTS_Y 2 UBYTE AXIS_PTS_X 3 SWORD INDEX_INCR DIRECT AXIS_PTS_Y 4 SWORD INDEX_INCR DIRECT FNC_VALUES 5 UWORD COLUMN_DIR DIRECT /end RECORD_LAYOUT
/begin RECORD_LAYOUT _REC_MAP_52_UBYTE_s2_s2_s2 NO_AXIS_PTS_X 1 UBYTE NO_AXIS_PTS_Y 2 UBYTE AXIS_PTS_X 3 SWORD INDEX_INCR DIRECT AXIS_PTS_Y 4 SWORD INDEX_INCR DIRECT FNC_VALUES 5 SWORD COLUMN_DIR DIRECT /end RECORD_LAYOUT
/begin RECORD_LAYOUT _REC_MAP_52_UBYTE_u2_u2_s2 NO_AXIS_PTS_X 1 UBYTE NO_AXIS_PTS_Y 2 UBYTE AXIS_PTS_X 3 UWORD INDEX_INCR DIRECT AXIS_PTS_Y 4 SWORD INDEX_INCR DIRECT FNC_VALUES 5 UWORD COLUMN_DIR DIRECT /end RECORD_LAYOUT
/begin RECORD_LAYOUT _REC_MAP_52_UBYTE_s2_s2_u1 NO_AXIS_PTS_X 1 UBYTE NO_AXIS_PTS_Y 2 UBYTE AXIS_PTS_X 3 SWORD INDEX_INCR DIRECT AXIS_PTS_Y 4 UBYTE INDEX_INCR DIRECT FNC_VALUES 5 SWORD COLUMN_DIR DIRECT /end RECORD_LAYOUT
/begin RECORD_LAYOUT _REC_MAP_52_u1_u1_u2 NO_AXIS_PTS_X 1 UBYTE NO_AXIS_PTS_Y 2 UBYTE AXIS_PTS_X 3 UBYTE INDEX_INCR DIRECT AXIS_PTS_Y 4 UWORD INDEX_INCR DIRECT FNC_VALUES 5 UBYTE COLUMN_DIR DIRECT /end RECORD_LAYOUT
/begin RECORD_LAYOUT _REC_MAP_52_u1_u2_s2 NO_AXIS_PTS_X 1 UBYTE NO_AXIS_PTS_Y 2 UBYTE AXIS_PTS_X 3 UWORD INDEX_INCR DIRECT AXIS_PTS_Y 4 SWORD INDEX_INCR DIRECT FNC_VALUES 5 UBYTE COLUMN_DIR DIRECT /end RECORD_LAYOUT
/begin RECORD_LAYOUT _REC_MAP_52_UBYTE_s2_u2_s2 NO_AXIS_PTS_X 1 UBYTE NO_AXIS_PTS_Y 2 UBYTE AXIS_PTS_X 3 UWORD INDEX_INCR DIRECT AXIS_PTS_Y 4 SWORD INDEX_INCR DIRECT FNC_VALUES 5 SWORD COLUMN_DIR DIRECT /end RECORD_LAYOUT
/begin RECORD_LAYOUT _REC_MAP_52_UBYTE_s1_s2_s2 NO_AXIS_PTS_X 1 UBYTE NO_AXIS_PTS_Y 2 UBYTE AXIS_PTS_X 3 SWORD INDEX_INCR DIRECT AXIS_PTS_Y 4 SWORD INDEX_INCR DIRECT FNC_VALUES 5 SBYTE COLUMN_DIR DIRECT /end RECORD_LAYOUT
/begin RECORD_LAYOUT _REC_MAP_52_UBYTE_s1_u1_s2 NO_AXIS_PTS_X 1 UBYTE NO_AXIS_PTS_Y 2 UBYTE AXIS_PTS_X 3 UBYTE INDEX_INCR DIRECT AXIS_PTS_Y 4 SWORD INDEX_INCR DIRECT FNC_VALUES 5 SBYTE COLUMN_DIR DIRECT /end RECORD_LAYOUT
/begin RECORD_LAYOUT _REC_MAP_52_u1_u1_u1 NO_AXIS_PTS_X 1 UBYTE NO_AXIS_PTS_Y 2 UBYTE AXIS_PTS_X 3 UBYTE INDEX_INCR DIRECT AXIS_PTS_Y 4 UBYTE INDEX_INCR DIRECT FNC_VALUES 5 UBYTE COLUMN_DIR DIRECT /end RECORD_LAYOUT
/begin RECORD_LAYOUT _REC_MAP_52_u1_u1_s2 NO_AXIS_PTS_X 1 UBYTE NO_AXIS_PTS_Y 2 UBYTE AXIS_PTS_X 3 UBYTE INDEX_INCR DIRECT AXIS_PTS_Y 4 SWORD INDEX_INCR DIRECT FNC_VALUES 5 UBYTE COLUMN_DIR DIRECT /end RECORD_LAYOUT
/begin RECORD_LAYOUT _REC_MAP_52_UBYTE_u2_s2_u1 NO_AXIS_PTS_X 1 UBYTE NO_AXIS_PTS_Y 2 UBYTE AXIS_PTS_X 3 SWORD INDEX_INCR DIRECT AXIS_PTS_Y 4 UBYTE INDEX_INCR DIRECT FNC_VALUES 5 UWORD COLUMN_DIR DIRECT /end RECORD_LAYOUT
/begin RECORD_LAYOUT _REC_CUR_TKL_UW_VV__u2_u2 NO_AXIS_PTS_X 1 UBYTE RESERVED 2 BYTE AXIS_PTS_X 3 UWORD INDEX_INCR DIRECT FNC_VALUES 4 UWORD COLUMN_DIR DIRECT /end RECORD_LAYOUT
/begin RECORD_LAYOUT _REC_CUR_TKL_UW_VV__u2_s2 NO_AXIS_PTS_X 1 UBYTE RESERVED 2 BYTE AXIS_PTS_X 3 SWORD INDEX_INCR DIRECT FNC_VALUES 4 UWORD COLUMN_DIR DIRECT /end RECORD_LAYOUT
/begin RECORD_LAYOUT _REC_CUR_TKL_UW_VV__u1_s2 NO_AXIS_PTS_X 1 UBYTE RESERVED 2 BYTE AXIS_PTS_X 3 SWORD INDEX_INCR DIRECT FNC_VALUES 4 UBYTE COLUMN_DIR DIRECT /end RECORD_LAYOUT
/begin RECORD_LAYOUT _REC_CUR_TKL_UW_VV__s2_s2 NO_AXIS_PTS_X 1 UBYTE RESERVED 2 BYTE AXIS_PTS_X 3 SWORD INDEX_INCR DIRECT FNC_VALUES 4 SWORD COLUMN_DIR DIRECT /end RECORD_LAYOUT
/begin RECORD_LAYOUT _REC_CUR_TKL_UW_VV__u1_u2 NO_AXIS_PTS_X 1 UBYTE RESERVED 2 BYTE AXIS_PTS_X 3 UWORD INDEX_INCR DIRECT FNC_VALUES 4 UBYTE COLUMN_DIR DIRECT /end RECORD_LAYOUT
/begin RECORD_LAYOUT _REC_CUR_TKL_UW_VV__s2_u2 NO_AXIS_PTS_X 1 UBYTE RESERVED 2 BYTE AXIS_PTS_X 3 UWORD INDEX_INCR DIRECT FNC_VALUES 4 SWORD COLUMN_DIR DIRECT /end RECORD_LAYOUT
/begin RECORD_LAYOUT _REC_CUR_TKL_UW_VV__u1_u1 NO_AXIS_PTS_X 1 UBYTE RESERVED 2 BYTE AXIS_PTS_X 3 UBYTE INDEX_INCR DIRECT FNC_VALUES 4 UBYTE COLUMN_DIR DIRECT /end RECORD_LAYOUT
/begin RECORD_LAYOUT _REC_CUR_TKL_UW_VV__s2_u1 NO_AXIS_PTS_X 1 UBYTE RESERVED 2 BYTE AXIS_PTS_X 3 UBYTE INDEX_INCR DIRECT FNC_VALUES 4 SWORD COLUMN_DIR DIRECT /end RECORD_LAYOUT
/begin RECORD_LAYOUT _REC_CUR_TKL_UW_VV__s2_s1 NO_AXIS_PTS_X 1 UBYTE RESERVED 2 BYTE AXIS_PTS_X 3 SBYTE INDEX_INCR DIRECT FNC_VALUES 4 SWORD COLUMN_DIR DIRECT /end RECORD_LAYOUT
/begin RECORD_LAYOUT _REC_VAL_2_u1 FNC_VALUES 1 UBYTE COLUMN_DIR DIRECT /end RECORD_LAYOUT
/begin RECORD_LAYOUT _REC_VAL_2_s2 FNC_VALUES 1 SWORD COLUMN_DIR DIRECT /end RECORD_LAYOUT
/begin RECORD_LAYOUT _REC_VAL_2_u2 FNC_VALUES 1 UWORD COLUMN_DIR DIRECT /end RECORD_LAYOUT
/begin FUNCTION MDLDYNF ""
 /begin DEF_CHARACTERISTIC CW_FMKNUL CW_S_SPORT CW_TRQTR1 CW_TRQTR2 KF_DASHMDK3 KF_DASHMDK3_MN KF_DMDNA_MN KF_DMDP1 KF_DMDP1A KF_DMDP2 KF_DMDP2A KF_DMDP3 KF_DMDP3A KF_DMDPON KF_DMLS1GD KF_DMLS1GDA KF_DMLS1UD KF_DMLS1UDA KF_DMLS2GD KF_DMLS2GDA KF_DMLS2UD KF_DMLS2UDA KF_DMLSDON KF_DMXLS3GD KF_DMXLS3GDA KF_DMXLS3UD KF_DMXLS3UDA KF_DMXLS4 KF_DPSFTD KF_FDASHMDK3 KF_FDASHPWG3 KF_FDASH_TMOT KF_FDASH_TMOTA KF_FDMDPA12 KF_FDMDPA3 KF_FDMFBT KF_FLSDMDKL KF_FLSDPWGL KF_FMDKWUGRAD12 KF_FMDKWUGRAD3 KF_LSDUEB_T KF_LSSPORT KF_MDKW_L KF_MDKW_LGD KF_MDK_DP_O KF_MDK_DP_U KF_MDK_LSD_O KF_MDK_LSD_U KF_RFVKOR_DASH KF_UEB_MD KF_ZKDP3 KF_ZKDP3A KF_ZKLS3GD KF_ZKLS3GDA KF_ZKLS3UD KF_ZKLS3UDA KL_DMDPOFF KL_DMLSDOFF KL_FDASH3_NKW KL_FDASHINI KL_FJMOT KL_FLSDINI KL_FLSDMDK12 KL_FLSDMDK3 KL_FLSDPWG12 KL_FLSDPWG3 KL_F_UEB KL_KUPP_ENABLE KL_MU_WAN KL_T_LRAMP KL_VL_LRAMP KL_VL_LRAMPVERZ KL_ZK_ETAWAN K_AQMAX_SPS K_DMDKDP_MX K_DMDKLSD_MN K_F_SPORT K_KFATHS_EIN K_LSD4_PS K_LSD4_PSHYS K_LSD4_PSSOL K_MDKMINHYS_SA K_MDKMIN_SA K_MDK_WUNSCHHYST K_NGFSAWE K_TLMD_AUS K_TLMD_EIN K_TVDPSTEND K_TVFSAWE K_VNULL K_ZK_MDKWUNSCH S_DMLS3_PWG S_PWG2MDK S_PWGMAX_AKT S_VLSCH_DASH /end DEF_CHARACTERISTIC
 /begin OUT_MEASUREMENT A_quer_abs Dm_jmot Dmdk_wunsch_l Dmdk_wunsch_min Dmdkdp Dmdklsd Dmdp1 Dmdp2 Dmdp3 Dmdpoff Dmdpon Dmls1 Dmls2 Dmls3 Dmls3f Dmlsdoff Dmlsdon Dpsfaktd F_etawan F_rfvkor_dash Fdmfbt Flsdpwgl Ftrq_wfl_dp Kl_kuppenable_aus Mdi_dash_ini Mdi_lsd_ini Mdi_res_dashini Mdi_res_lsini Mdi_res_mdar Mdk_dash Mdk_dp_o Mdk_dp_u Mdk_iwfdp Mdk_iwflsd Mdk_lsd Mdk_lsd_ag Mdk_lsd_o Mdk_lsd_u Mdk_lsd_wakor Mdk_w_f Mdk_wu_lramp Mdk_wunsch_d Mdk_wunsch_gradmx Mdk_wunsch_l Mdk_wunsch_ref_hsa Mdk_wunsch_ref_sa Mdk_wunsch_t Ntnkw St_dp_ber St_ls_ber St_mdar0 St_mdar0.B_dmdp St_mdar0.B_dmls St_mdar0.B_dp St_mdar0.B_edp St_mdar0.B_elsd St_mdar0.B_ifdp St_mdar0.B_ls St_mdar0.B_lsd St_mdar1 St_mdar1.B_dash St_mdar1.B_iflsd St_mdar1.B_kf_at St_mdar1.B_ll_md St_mdar1.B_tl_md St_mdar1.B_vlschalt_verz St_mdar2 St_mdar2.B_lsd4 St_mini St_mini.B_mdimin_sa St_mini.B_zwmin_ext T_dash T_lsd T_lsd4 Var_at Wandler_mu /end OUT_MEASUREMENT
 /begin IN_MEASUREMENT A_quer Dpsfak Dpssol Dpssolgd Gangi Kfdps_aus Md_na_ramp Mdi_bas Mdi_reib Mdk_ist Mdk_min_f Mdk_wunsch Mdk_wunsch_grad Nkw Nkw_grad Nturb Ps Pssol Pu Pwg_grad Pwg_ist Pwg_max St_atlstat St_atlstat.B_atl_bereit St_atlstat.B_atldyn St_atlstat.B_atlr St_atlstat.B_tvld_mod St_atlstat.B_ulvdyn St_atlstat.B_vlschalt St_bgkuppl St_bgkuppl.B_kupp St_bgkuppl.B_kupp1 St_bgkuppl.B_kupp2 St_bgkuppl.B_kupp_ext St_bgkuppl.B_kupp_mod St_bgkuppl1 St_bgkuppl1.B_ll St_fdc St_fdc.B_sport St_fzg_1 St_getriebe St_getriebe.B_autget St_mdar0.B_dmdp St_mdar0.B_dmls St_mdar0.B_dp St_mdar0.B_edp St_mdar0.B_elsd St_mdar0.B_ifdp St_mdar0.B_ls St_mdar0.B_lsd St_mdar1.B_dash St_mdar1.B_iflsd St_mdar1.B_kf_at St_mdar1.B_ll_md St_mdar1.B_tl_md St_mdar1.B_vlschalt_verz St_mdk1 St_mdk1.B_md_dynman1 St_mdk1.B_mdzw_min1 St_mdk1.B_mdzw_min2 St_mdk1.B_mdzw_plus St_mdk1.B_zwe_ar St_mdk1.B_zwe_fzdyn St_mdk1.B_zwe_kh St_mdk1.B_zwe_kupp St_mdk1.B_zwe_llr St_mdk1.B_zwe_res St_mdk1.B_zwe_resa St_mdk1.B_zwe_sa St_mdk1.B_zwe_start St_mini.B_mdimin_sa St_mini.B_zwmin_ext St_mkwchn St_mkwchn.B_kwdreht St_sawe St_sawe.B_sa St_sawe.B_sae St_sawe.B_safast St_start St_start.B_jumpstart St_start.B_sta St_start.B_start St_start.B_startende St_start.B_wst Tget Tmot V Var_smg /end IN_MEASUREMENT
/end FUNCTION
/begin FUNCTION MDLDYNR ""
 /begin DEF_CHARACTERISTIC CW_AR KF_D_PAR KF_D_PARA KF_MDIAR_MX KF_PAR_NULL KF_PAR_NULLA KF_SNFILT_ARAN KF_SNFILT_ARAUS KF_TAR_AUS KF_TDAR KF_W_ARMD KL_TAR_KUP KL_TMOT_ARMD K_CNTAR_AUS K_ENTPR_FL K_ENTPR_SCH K_FGRENZ1_AR K_FGRENZ1_ARA K_FGRENZ_AR K_FGRENZ_ARA K_FILTBP_DEK K_KEINAR_AT K_KEINAR_SMG K_NFILTMN K_NFILTMX K_ORDF_AR K_PAR_MAX K_PAR_MAXA K_PAR_MIN K_PAR_MINA K_PWGGRAD_AR K_PWGGRAD_ARN K_SONKW_AR K_SSCHWINGUNG_AR K_STMOT_AR K_SUNKW_AR K_SV_AR K_TAR_AUS K_TAR_EIN S_ARAUS S_FZDYN_F S_WL_AR /end DEF_CHARACTERISTIC
 /begin OUT_MEASUREMENT Cnt_ar_aus F_filtbp Mdi_ar_f Mdi_fzdyn Mdk_fzdyn Mdk_wunsch_filt N_filt N_filt_abs N_filt_alt N_filt_bp N_filt_tp P_ar Pwg_grad St_ar1 St_ar1.B_ar_akt St_ar1.B_ar_ber St_ar1.B_filtbp_ngrd St_ar1.B_kein_ar St_ar1.B_td_kupp St_ar1.B_zr_ar T_ar_aus T_p_ar Td_ar_an Td_ar_ber Td_kupp Zr_entpr_fl Zr_fl_ar Zr_schwingung_ar Zr_vbar /end OUT_MEASUREMENT
 /begin IN_MEASUREMENT Gangi Mdk_wunsch Nkw Pwg_ist Rf_soll St_ar1.B_ar_akt St_ar1.B_ar_ber St_ar1.B_filtbp_ngrd St_ar1.B_kein_ar St_ar1.B_td_kupp St_ar1.B_zr_ar St_bgkuppl St_bgkuppl.B_kupp St_bgkuppl.B_kupp1 St_bgkuppl.B_kupp2 St_bgkuppl.B_kupp_ext St_bgkuppl.B_kupp_mod St_bgkuppl1 St_bgkuppl1.B_ll St_kupp_smg St_mdar0 St_mdar0.B_dmdp St_mdar0.B_dmls St_mdar0.B_dp St_mdar0.B_edp St_mdar0.B_elsd St_mdar0.B_ifdp St_mdar0.B_ls St_mdar0.B_lsd St_mdar1 St_mdar1.B_dash St_mdar1.B_iflsd St_mdar1.B_kf_at St_mdar1.B_ll_md St_mdar1.B_tl_md St_mdar1.B_vlschalt_verz St_mdinfo_s St_start St_start.B_jumpstart St_start.B_sta St_start.B_start St_start.B_startende St_start.B_wst St_wk Tmot V Var_at Var_smg /end IN_MEASUREMENT
/end FUNCTION
/begin FUNCTION MDMAX ""
 /begin DEF_CHARACTERISTIC CW_MD_TURBO CW_TZKMDMX CW_VL KF_MDIOP_1 KF_MDIOP_2 KF_MDIOP_3 KL_FHO_UL KL_FMDI_VL KL_FTVDK_MDMAX KL_LAMX KL_LAMX_FP KL_LAMX_FV KL_RFMXATLNL KL_TASCHE KL_TMZE KL_T_2UMDREH KL_WT_UMDREH K_D_FVLAUS K_F_RFMXFMN K_F_RFMXLESS K_F_RFMXPLUS K_F_RFMXTEHYST K_N_TIMDRED K_TI1HOM K_TI2HOM K_ZKRFMXATL S_FHO_UL /end DEF_CHARACTERISTIC
 /begin REF_CHARACTERISTIC S_ATL_FSP /end REF_CHARACTERISTIC
 /begin OUT_MEASUREMENT F_lamx_fp F_md_fhot F_mdivl F_rfmx F_rfv_lamx F_vl_aus Kl_tasche_aus Kl_tmze_aus Mdi_max Mdi_max_l1 Mdk_max Mdk_max_real Rf_dvvt_max Rf_tim_mx Rf_umax Rf_vl Rf_vl_max Rf_vl_ob Rf_vl_obatl Rfv_vl_max Rfv_vl_roh St_ti_b St_ti_b.B_temxon T_umdreh_wt Ti_quot /end OUT_MEASUREMENT
 /begin IN_MEASUREMENT F_tevpstnorm F_tvdk Fho Ftbr_kor Ftev Md_reib_vl Mdi_ml_soll Mdi_soll Mdr_wunsch Nkw Rf Rfmxatl Rk_1 Rk_2 St_atldiag_tmp St_atldiag_tmp.B_fi_atllekfast St_atldiag_tmp.B_fi_pldmn St_atldiag_tmp.B_fi_pldmx St_ti_b.B_temxon Tans Tevt_mdl Ti_1_homext Ti_2_homext Tmot /end IN_MEASUREMENT
/end FUNCTION
/begin FUNCTION MDNA "" /begin DEF_CHARACTERISTIC CW_NA /end DEF_CHARACTERISTIC
 /begin OUT_MEASUREMENT Md_na Md_na_ges Md_na_sum Na_bnanteil St_mdna St_mdna.B_lastab /end OUT_MEASUREMENT
 /begin IN_MEASUREMENT Md_gennm Md_na_ac Md_na_ars Md_na_defrost Md_na_ef Md_na_el Md_na_ewapu Md_na_ext Md_na_mlad Md_na_sl Md_na_sls Md_na_thermo /end IN_MEASUREMENT
/end FUNCTION
/begin FUNCTION MDNREG ""
 /begin DEF_CHARACTERISTIC KF_MDSCHALT_I KF_MDSCHALT_P KF_MDSCHALT_PZ KF_MDSCHALT_RES KF_SCHALT_WS K_DN_SCHALT K_GANG_MAX K_GANG_MINUS K_GANG_PLUS K_HSCHALT_WS K_I_GANG K_MDSCHALTRIMN K_MDSCHALTRIMX K_MDSCHALTRMN K_MDSCHALTRMX K_MDSCHALT_OFF K_NGANG_APPL K_NSTAT_OFF K_RSCHALT_WS K_TDNSCHALT K_TDSCHALT_MAX K_ZK_DMDK S_GANG_MOD S_NGANG_APPL /end DEF_CHARACTERISTIC
 /begin REF_CHARACTERISTIC S_FZDYN_F /end REF_CHARACTERISTIC
 /begin OUT_MEASUREMENT Dmdk Dmdk_wunsch Dn_gang Dnkw_reg Gang_soll Md_res_schalt Md_schalt_i Md_schalt_p Md_schalt_pi Md_schalt_pz Md_schalt_st Md_schalti_aus Md_schaltp_aus Mdk_anschl_reg Mdk_fzdyn_vb Mdk_wunsch_anf Mdk_wunsch_cnt Mdk_wunsch_proz N_gang_neu Pwg_fvv_fak Schalt_ws St_nschalt St_nschalt.B_aufregelung St_nschalt.B_schalt_dkgalt Tdnschalt Tdschalt_max /end OUT_MEASUREMENT
 /begin IN_MEASUREMENT Gang_mod Gangi Md_anfhi Mdi_fzdyn Mdi_reib Mdk_fzdyn Mdk_kupp_verl Mdk_max Mdk_min_f Mdk_wunsch Mdk_wunsch_d Mdk_wunsch_filt N_ab N_schalt_dkg Nkw Nsllm Nstat St_anman1 St_anman1.B_ldm_ena St_anman1.B_ldm_nofil St_anman1.B_nosa St_bgkuppl St_bgkuppl.B_kupp St_bgkuppl.B_kupp1 St_bgkuppl.B_kupp2 St_bgkuppl.B_kupp_ext St_bgkuppl.B_kupp_mod St_dkg St_dkg.B_schalt_dkg St_fw St_fw.B_hschalt_komb St_fw.B_kupp_extalt St_fw.B_ldm_akt04 St_fw.B_ldm_off St_fw.B_ldm_offhs St_fw.B_ldm_offreg St_fw.B_ldm_offrs St_fw.B_rschalt_komb St_fw1 St_fw1.B_nschalt_akt St_fw1.B_nschalt_aktalt Var_at Var_dkg Var_smg /end IN_MEASUREMENT
/end FUNCTION
/begin FUNCTION MDPWG "" /begin DEF_CHARACTERISTIC KF_MDR_ABV KF_PEDAL KL_MDMAX K_ETA_GETR /end DEF_CHARACTERISTIC
 /begin OUT_MEASUREMENT Md_ab_max Md_ab_min Md_ab_wunsch Md_rad_wunsch Mdr_ab_max Mdr_ab_virt Mdr_ab_wunsch Mdr_pedal Mdr_pedal_max Mdr_wunsch Pwg_ist_kor Pwg_max Pwg_virt St_fgr St_fgr.B_fgr_akt St_fgr.B_sport_aktiv /end OUT_MEASUREMENT
 /begin IN_MEASUREMENT I_fw_ber I_ha Md_rad_soll Mdk_fw Mdk_max Mdk_min_f Mdk_wunsch Mdr_fgr Nkw Nkw_opt Pwg_ist St_fgr.B_fgr_akt St_fgr.B_sport_aktiv V /end IN_MEASUREMENT
/end FUNCTION
/begin FUNCTION MDR2MDK "" /begin DEF_CHARACTERISTIC K_MDASR_RAMP /end DEF_CHARACTERISTIC
 /begin OUT_MEASUREMENT Md_asr_sor Mdk_asr_l Mdk_asr_s Mdk_msr_l Mdk_msr_s Mdk_wunsch_ipm Mdk_wunsch_rad St_mdr2mdk St_mdr2mdk.B_md_asr_grdl /end OUT_MEASUREMENT
 /begin IN_MEASUREMENT I_ges Md_rad_asrl Md_rad_asrs Md_rad_ksoll Md_rad_msrl Md_rad_msrs Md_rad_soll Mdk_max Mdk_min_f St_dsc_mradsoll /end IN_MEASUREMENT
/end FUNCTION
/begin FUNCTION MDRDMK "" /begin REF_CHARACTERISTIC S_IPM_06 S_IPM_BSPORT /end REF_CHARACTERISTIC /begin OUT_MEASUREMENT Md_rad_ksoll /end OUT_MEASUREMENT
 /begin IN_MEASUREMENT Md_rad_soll Md_rad_wunsch St_anman St_anman.B_2fl_gangi St_anman.B_antieb St_anman.B_antieb_starr St_anman.B_kein_gang St_anman.B_kupp_int St_anman.B_ldm_mdrad St_fdc St_fdc.B_sport /end IN_MEASUREMENT
/end FUNCTION
/begin FUNCTION MDREIB ""
 /begin DEF_CHARACTERISTIC KF_MDREIBSA_MN KF_MDREIB_ADDBA1 KF_MDREIB_ADDBA2 KF_MDREIB_ADD_KM KF_MDREIB_BA1 KF_MDREIB_BA2 KF_MDREIB_BA3 KF_MDREIB_ST_T KF_MDST_A1 KF_MDST_A2 KF_MDST_M1 KF_MDST_M2 KL_FMDST KL_MDREIB_ADDBA1 KL_MDREIB_ADDBA2 KL_MDREIB_STBA1 KL_MDREIB_STBA2 KL_NKWST_MX KL_SELB_STAB K_F_REIBMAX K_F_REIBMIN K_MAT_MDST K_MAT_REIB K_MAT_REIB_ADD K_MDNKWST_1 K_MDNKWST_2 /end DEF_CHARACTERISTIC
 /begin OUT_MEASUREMENT Md_reib_add Md_reib_sa Md_reib_st Md_reib_stini Md_reib_vl Md_st Md_st_vf Mdi_reib Mdi_reib1 Mdi_reib2 Mdi_reib3 Mdi_reib_kf Mdk_min Mdk_min_reib Mdk_min_sa Nkw_dif_stmx Nkw_soll_dif Nkw_st_mx St_llr St_llr.B_llrein St_mdreib St_mdreib.B_mdst_ba St_mdreib.B_reib_addba2 /end OUT_MEASUREMENT
 /begin IN_MEASUREMENT Ba_ist Ba_soll F_n_nstat Km_st Md_getriebe Md_na_ges Mdi_llrad Mdi_llri Nkw Nkw_soll Nkw_zahn Pu Rf Rf_min Rf_vl St_getriebe St_getriebe.B_autget St_llr.B_llrein St_mkwchn St_mkwchn.B_kwdreht St_start St_start.B_jumpstart St_start.B_sta St_start.B_start St_start.B_startende St_start.B_wst Tmot Tmot_start Tn_start_10 Toel /end IN_MEASUREMENT
/end FUNCTION
/begin FUNCTION MDRES ""
 /begin DEF_CHARACTERISTIC K_MDRESMN_FGRHYS K_MDRESMN_HYS K_MDRES_DEK K_MDRES_GLLL K_MDRES_MN K_MDRES_MNFGR S_KHDI S_MDRES_VLS /end DEF_CHARACTERISTIC
 /begin OUT_MEASUREMENT Eta_res Eta_zw_minres Md_res Md_res_anf Md_res_anf1 Md_res_anfmx Md_res_glll Md_res_katreg Md_res_max Mdi_fzdyn_korr Mdi_fzdyn_korr1 Mdi_res Mdi_res_anf Mdi_res_anfkh Mdi_res_anfmx Mdi_res_max Mdi_res_maxll Mdk_res Ms_res_max Rf_res_max St_mdres St_mdres.B_md_res St_mdres.B_mdres_akt /end OUT_MEASUREMENT
 /begin IN_MEASUREMENT Eta_zw_min Eta_zw_mint Eta_zwve_m F_mdres_rgn F_umsrfn Md_res_anfhi Md_res_krll Mdi_fzdyn Mdi_max Mdi_reib Mdi_res_ac Mdi_res_afs Mdi_res_gdi Mdi_res_gs Mdi_res_heiz Mdi_res_kh Mdi_res_llmn Mdi_res_llmx Mdi_res_mdar Mdi_res_sl Mdi_res_st Mdi_res_tev Mdi_res_wm Mdk_fzdyn Nkw St_atlstat St_atlstat.B_atl_bereit St_atlstat.B_atldyn St_atlstat.B_atlr St_atlstat.B_tvld_mod St_atlstat.B_ulvdyn St_atlstat.B_vlschalt St_baumsch St_baumsch.B_ba_toggle St_baumsch.B_ba_toggletime St_baumsch.B_babr St_baumsch.B_mdres_glll St_fgr St_fgr.B_fgr_akt St_fgr.B_sport_aktiv St_sawe St_sawe.B_sa St_sawe.B_sae St_sawe.B_safast /end IN_MEASUREMENT
/end FUNCTION
/begin FUNCTION MDRESKRLL ""
 /begin DEF_CHARACTERISTIC KL_DZW_KRFR KL_DZW_KRSP KL_MDRESKRLL K_DZWKRLLMNS K_DZWKRLLMX K_DZWKRMN K_TDBLLK S_MDRES_KRLL /end DEF_CHARACTERISTIC
 /begin OUT_MEASUREMENT Dzw_krkorll Dzw_krkorlls Md_res_krll St_mdreskrll St_mdreskrll.B_llk_verz St_mdreskrll.B_mdres_krll St_mdreskrll.B_zwe_krll Td_bllk /end OUT_MEASUREMENT
 /begin IN_MEASUREMENT Dzw_mm Nkw Segakt St_blshub St_blshub.B_fhubvnsi_ini St_blshub.B_hubst St_blshub.B_llk St_blshub.B_nwe St_blshub.B_vns_spron St_blshub.B_vsean_loc St_blshub.B_vvtclose St_kr St_kr.B_clradkr St_kr.B_krdws St_kr.B_krndy St_kr.B_zwkraa St_kr1 St_kr1.B_krakt St_llr St_llr.B_llrein St_mdk St_mdk.B_asr_akt St_mdk.B_getr_plus St_mdk.B_md_dynman St_mdk.B_mdk_plus St_mdk.B_msr_aktiv St_mdk.B_san St_mdk.B_siko_akt St_mdk.B_zw_dynman Zw_min Zw_ve /end IN_MEASUREMENT
/end FUNCTION
/begin FUNCTION MDRFMXATL ""
 /begin DEF_CHARACTERISTIC KF_FRFMXKR KF_FRFMXTALD KL_FPLDPUMP KL_FPLDSTOPF KL_FRFMXTMLD KL_FUPSRF_ATL KL_LAMX_ATL KL_LAMX_ATLAT KL_LDRFKRA KL_PIRG_ATL KL_TLKRLDAB KL_TLKRLDAUF K_FKRFMXATL /end DEF_CHARACTERISTIC
 /begin OUT_MEASUREMENT Dzw_ldkr Dzw_ldkrstat Frfmxkrld Frfmxtald Frfmxtmld Fupsrfatl_k Pirgatl_k Psmxatl Rfmxatl Rfmxkorr Rfmxldts /end OUT_MEASUREMENT
 /begin IN_MEASUREMENT Dpllk Drfmx_ob Dzw_krann Dzw_mkr Dzwt F_tzylkor Fho Mssolatl_k Nkw Pvld Rf Rf_vl_max St_atlaus St_atlaus.B_atl_rfmaxred St_atlaus.B_atladp_off St_atlaus.B_atldiag_off St_atlaus.B_atlreg_off St_atldiag_10ms St_atldiag_10ms.B_atl_err St_atldiag_10ms.B_atllekfast St_atldiag_10ms.B_atlr_errmn St_atldiag_10ms.B_atlr_errmx St_atldiag_10ms.B_beratllek St_pwf St_pwf.B_pwf Tans Tmot Var_at /end IN_MEASUREMENT
/end FUNCTION
/end MODULE
/end PROJECT
