ASAP2_VERSION 1 4
/begin PROJECT P_558 "EDC17_CP02"
/begin HEADER "" VERSION "V1C1" PROJECT_NO P_558 /end HEADER
/begin MODULE DIM ""
/begin MOD_COMMON "" BYTE_ORDER MSB_LAST ALIGNMENT_BYTE 1 ALIGNMENT_WORD 2 ALIGNMENT_LONG 4 ALIGNMENT_FLOAT32_IEEE 4 /end MOD_COMMON
/begin CHARACTERISTIC DFES_DTCM.DFC_AirCtlGovDvtEOMMax_C "/" VALUE 0x80073F12 Val_Wu16 65535.00 DFES_OneToOne 0.00 65535.00 FORMAT "%8.2" /end CHARACTERISTIC
/begin CHARACTERISTIC DFES_DTCM.DFC_AirCtlGovDvtEOMMin_C "/" VALUE 0x80073F14 Val_Wu16 65535.00 DFES_OneToOne 0.00 65535.00 FORMAT "%8.2" /end CHARACTERISTIC
/begin CHARACTERISTIC DFES_DTCM.DFC_AirCtlGovDvtMax_C "/" VALUE 0x80073F16 Val_Wu16 65535.00 DFES_OneToOne 0.00 65535.00 FORMAT "%8.2" /end CHARACTERISTIC
/begin CHARACTERISTIC DFES_DTCM.DFC_AirCtlGovDvtMin_C "/" VALUE 0x80073F18 Val_Wu16 65535.00 DFES_OneToOne 0.00 65535.00 FORMAT "%8.2" /end CHARACTERISTIC
/begin CHARACTERISTIC DFES_DTCM.DFC_Cj945SpiCom1_C "/" VALUE 0x80073F1A Val_Wu16 65535.00 DFES_OneToOne 0.00 65535.00 FORMAT "%8.2" /end CHARACTERISTIC
/begin CHARACTERISTIC DFES_DTCM.DFC_ComButtonMSASig_C "/" VALUE 0x80073F1C Val_Wu16 65535.00 DFES_OneToOne 0.00 65535.00 FORMAT "%8.2" /end CHARACTERISTIC
/begin CHARACTERISTIC DFES_DTCM.DFC_ComButtonMSATo_C "/" VALUE 0x80073F1E Val_Wu16 65535.00 DFES_OneToOne 0.00 65535.00 FORMAT "%8.2" /end CHARACTERISTIC
/begin CHARACTERISTIC DFES_DTCM.DFC_ComGearboxData2Sig_C "/" VALUE 0x80073F20 Val_Wu16 65535.00 DFES_OneToOne 0.00 65535.00 FORMAT "%8.2" /end CHARACTERISTIC
/begin CHARACTERISTIC DFES_DTCM.DFC_ComGearboxData2To_C "/" VALUE 0x80073F22 Val_Wu16 65535.00 DFES_OneToOne 0.00 65535.00 FORMAT "%8.2" /end CHARACTERISTIC
/begin CHARACTERISTIC DFES_DTCM.DFC_ComGearboxDataSig_C "/" VALUE 0x80073F24 Val_Wu16 65535.00 DFES_OneToOne 0.00 65535.00 FORMAT "%8.2" /end CHARACTERISTIC
/begin CHARACTERISTIC DFES_DTCM.DFC_ComGearboxDataTo_C "/" VALUE 0x80073F26 Val_Wu16 65535.00 DFES_OneToOne 0.00 65535.00 FORMAT "%8.2" /end CHARACTERISTIC
/begin CHARACTERISTIC DFES_DTCM.DFC_ComHeatACSig_C "/" VALUE 0x80073F28 Val_Wu16 65535.00 DFES_OneToOne 0.00 65535.00 FORMAT "%8.2" /end CHARACTERISTIC
/begin CHARACTERISTIC DFES_DTCM.DFC_ComHeatACTo_C "/" VALUE 0x80073F2A Val_Wu16 65535.00 DFES_OneToOne 0.00 65535.00 FORMAT "%8.2" /end CHARACTERISTIC
/begin CHARACTERISTIC DFES_DTCM.DFC_ComLenkradwinkelSig_C "/" VALUE 0x80073F2C Val_Wu16 65535.00 DFES_OneToOne 0.00 65535.00 FORMAT "%8.2" /end CHARACTERISTIC
/begin CHARACTERISTIC DFES_DTCM.DFC_ComLenkradwinkelTo_C "/" VALUE 0x80073F2E Val_Wu16 65535.00 DFES_OneToOne 0.00 65535.00 FORMAT "%8.2" /end CHARACTERISTIC
/begin CHARACTERISTIC DFES_DTCM.DFC_ComMileageRangeSig_C "/" VALUE 0x80073F30 Val_Wu16 65535.00 DFES_OneToOne 0.00 65535.00 FORMAT "%8.2" /end CHARACTERISTIC
/begin CHARACTERISTIC DFES_DTCM.DFC_ComMileageRangeTo_C "/" VALUE 0x80073F32 Val_Wu16 65535.00 DFES_OneToOne 0.00 65535.00 FORMAT "%8.2" /end CHARACTERISTIC
/begin CHARACTERISTIC DFES_DTCM.DFC_ComPspSig_C "/" VALUE 0x80073F34 Val_Wu16 65535.00 DFES_OneToOne 0.00 65535.00 FORMAT "%8.2" /end CHARACTERISTIC
/begin CHARACTERISTIC DFES_DTCM.DFC_ComPspTo_C "/" VALUE 0x80073F36 Val_Wu16 65535.00 DFES_OneToOne 0.00 65535.00 FORMAT "%8.2" /end CHARACTERISTIC
/begin CHARACTERISTIC DFES_DTCM.DFC_ComShutOffPSPSig_C "/" VALUE 0x80073F38 Val_Wu16 65535.00 DFES_OneToOne 0.00 65535.00 FORMAT "%8.2" /end CHARACTERISTIC
/begin CHARACTERISTIC DFES_DTCM.DFC_ComShutOffPSPTo_C "/" VALUE 0x80073F3A Val_Wu16 65535.00 DFES_OneToOne 0.00 65535.00 FORMAT "%8.2" /end CHARACTERISTIC
/begin CHARACTERISTIC DFES_DTCM.DFC_ComStKombiCtr_C "/" VALUE 0x80073F3C Val_Wu16 65535.00 DFES_OneToOne 0.00 65535.00 FORMAT "%8.2" /end CHARACTERISTIC
/begin CHARACTERISTIC DFES_DTCM.DFC_ComStKombiSig_C "/" VALUE 0x80073F3E Val_Wu16 65535.00 DFES_OneToOne 0.00 65535.00 FORMAT "%8.2" /end CHARACTERISTIC
/begin CHARACTERISTIC DFES_DTCM.DFC_ComStKombiTo_C "/" VALUE 0x80073F40 Val_Wu16 65535.00 DFES_OneToOne 0.00 65535.00 FORMAT "%8.2" /end CHARACTERISTIC
/begin CHARACTERISTIC DFES_DTCM.DFC_ComStateARSCtr_C "/" VALUE 0x80073F42 Val_Wu16 65535.00 DFES_OneToOne 0.00 65535.00 FORMAT "%8.2" /end CHARACTERISTIC
/begin CHARACTERISTIC DFES_DTCM.DFC_ComStateARSSig_C "/" VALUE 0x80073F44 Val_Wu16 65535.00 DFES_OneToOne 0.00 65535.00 FORMAT "%8.2" /end CHARACTERISTIC
/begin CHARACTERISTIC DFES_DTCM.DFC_ComStateARSTo_C "/" VALUE 0x80073F46 Val_Wu16 65535.00 DFES_OneToOne 0.00 65535.00 FORMAT "%8.2" /end CHARACTERISTIC
/begin CHARACTERISTIC DFES_DTCM.DFC_ComStateDscSig_C "/" VALUE 0x80073F48 Val_Wu16 65535.00 DFES_OneToOne 0.00 65535.00 FORMAT "%8.2" /end CHARACTERISTIC
/begin CHARACTERISTIC DFES_DTCM.DFC_ComStateDscTo_C "/" VALUE 0x80073F4A Val_Wu16 65535.00 DFES_OneToOne 0.00 65535.00 FORMAT "%8.2" /end CHARACTERISTIC
/begin CHARACTERISTIC DFES_DTCM.DFC_ComStateSeatSig_C "/" VALUE 0x80073F4C Val_Wu16 65535.00 DFES_OneToOne 0.00 65535.00 FORMAT "%8.2" /end CHARACTERISTIC
/begin CHARACTERISTIC DFES_DTCM.DFC_ComStateSeatTo_C "/" VALUE 0x80073F4E Val_Wu16 65535.00 DFES_OneToOne 0.00 65535.00 FORMAT "%8.2" /end CHARACTERISTIC
/begin CHARACTERISTIC DFES_DTCM.DFC_ComTempRelTimeSig_C "/" VALUE 0x80073F50 Val_Wu16 65535.00 DFES_OneToOne 0.00 65535.00 FORMAT "%8.2" /end CHARACTERISTIC
/begin CHARACTERISTIC DFES_DTCM.DFC_ComTempRelTimeTo_C "/" VALUE 0x80073F52 Val_Wu16 65535.00 DFES_OneToOne 0.00 65535.00 FORMAT "%8.2" /end CHARACTERISTIC
/begin CHARACTERISTIC DFES_DTCM.DFC_ComTerminalChk_C "/" VALUE 0x80073F54 Val_Wu16 65535.00 DFES_OneToOne 0.00 65535.00 FORMAT "%8.2" /end CHARACTERISTIC
/begin CHARACTERISTIC DFES_DTCM.DFC_ComTerminalCtr_C "/" VALUE 0x80073F56 Val_Wu16 65535.00 DFES_OneToOne 0.00 65535.00 FORMAT "%8.2" /end CHARACTERISTIC
/begin CHARACTERISTIC DFES_DTCM.DFC_ComTerminalSig_C "/" VALUE 0x80073F58 Val_Wu16 65535.00 DFES_OneToOne 0.00 65535.00 FORMAT "%8.2" /end CHARACTERISTIC
/begin CHARACTERISTIC DFES_DTCM.DFC_ComTerminalTo_C "/" VALUE 0x80073F5A Val_Wu16 65535.00 DFES_OneToOne 0.00 65535.00 FORMAT "%8.2" /end CHARACTERISTIC
/begin CHARACTERISTIC DFES_DTCM.DFC_ComTimeDateSig_C "/" VALUE 0x80073F5C Val_Wu16 65535.00 DFES_OneToOne 0.00 65535.00 FORMAT "%8.2" /end CHARACTERISTIC
/begin CHARACTERISTIC DFES_DTCM.DFC_ComTimeDateTo_C "/" VALUE 0x80073F5E Val_Wu16 65535.00 DFES_OneToOne 0.00 65535.00 FORMAT "%8.2" /end CHARACTERISTIC
/begin CHARACTERISTIC DFES_DTCM.DFC_ComTrailerSig_C "/" VALUE 0x80073F60 Val_Wu16 65535.00 DFES_OneToOne 0.00 65535.00 FORMAT "%8.2" /end CHARACTERISTIC
/begin CHARACTERISTIC DFES_DTCM.DFC_ComTrailerTo_C "/" VALUE 0x80073F62 Val_Wu16 65535.00 DFES_OneToOne 0.00 65535.00 FORMAT "%8.2" /end CHARACTERISTIC
/begin CHARACTERISTIC DFES_DTCM.DFC_ComTrqDemandAfsChk_C "/" VALUE 0x80073F64 Val_Wu16 65535.00 DFES_OneToOne 0.00 65535.00 FORMAT "%8.2" /end CHARACTERISTIC
/begin CHARACTERISTIC DFES_DTCM.DFC_ComTrqDemandAfsCtr_C "/" VALUE 0x80073F66 Val_Wu16 65535.00 DFES_OneToOne 0.00 65535.00 FORMAT "%8.2" /end CHARACTERISTIC
/begin CHARACTERISTIC DFES_DTCM.DFC_ComTrqDemandAfsSig_C "/" VALUE 0x80073F68 Val_Wu16 65535.00 DFES_OneToOne 0.00 65535.00 FORMAT "%8.2" /end CHARACTERISTIC
/begin CHARACTERISTIC DFES_DTCM.DFC_ComTrqDemandAfsTo_C "/" VALUE 0x80073F6A Val_Wu16 65535.00 DFES_OneToOne 0.00 65535.00 FORMAT "%8.2" /end CHARACTERISTIC
/begin CHARACTERISTIC DFES_DTCM.DFC_ComTrqDemandDscChk_C "/" VALUE 0x80073F6C Val_Wu16 65535.00 DFES_OneToOne 0.00 65535.00 FORMAT "%8.2" /end CHARACTERISTIC
/begin CHARACTERISTIC DFES_DTCM.DFC_ComTrqDemandDscCtr_C "/" VALUE 0x80073F6E Val_Wu16 65535.00 DFES_OneToOne 0.00 65535.00 FORMAT "%8.2" /end CHARACTERISTIC
/begin CHARACTERISTIC DFES_DTCM.DFC_ComTrqDemandDscSig_C "/" VALUE 0x80073F70 Val_Wu16 65535.00 DFES_OneToOne 0.00 65535.00 FORMAT "%8.2" /end CHARACTERISTIC
/begin CHARACTERISTIC DFES_DTCM.DFC_ComTrqDemandDscTo_C "/" VALUE 0x80073F72 Val_Wu16 65535.00 DFES_OneToOne 0.00 65535.00 FORMAT "%8.2" /end CHARACTERISTIC
/begin CHARACTERISTIC DFES_DTCM.DFC_ComTrqDemandGbxChk_C "/" VALUE 0x80073F74 Val_Wu16 65535.00 DFES_OneToOne 0.00 65535.00 FORMAT "%8.2" /end CHARACTERISTIC
/begin CHARACTERISTIC DFES_DTCM.DFC_ComTrqDemandGbxCtr_C "/" VALUE 0x80073F76 Val_Wu16 65535.00 DFES_OneToOne 0.00 65535.00 FORMAT "%8.2" /end CHARACTERISTIC
/begin CHARACTERISTIC DFES_DTCM.DFC_ComTrqDemandGbxSig_C "/" VALUE 0x80073F78 Val_Wu16 65535.00 DFES_OneToOne 0.00 65535.00 FORMAT "%8.2" /end CHARACTERISTIC
/begin CHARACTERISTIC DFES_DTCM.DFC_ComTrqDemandGbxTo_C "/" VALUE 0x80073F7A Val_Wu16 65535.00 DFES_OneToOne 0.00 65535.00 FORMAT "%8.2" /end CHARACTERISTIC
/begin CHARACTERISTIC DFES_DTCM.DFC_ComVelocitySig_C "/" VALUE 0x80073F7C Val_Wu16 65535.00 DFES_OneToOne 0.00 65535.00 FORMAT "%8.2" /end CHARACTERISTIC
/begin CHARACTERISTIC DFES_DTCM.DFC_ComVelocityTo_C "/" VALUE 0x80073F7E Val_Wu16 65535.00 DFES_OneToOne 0.00 65535.00 FORMAT "%8.2" /end CHARACTERISTIC
/begin CHARACTERISTIC DFES_DTCM.DFC_ComWheelSpeedSig_C "/" VALUE 0x80073F80 Val_Wu16 65535.00 DFES_OneToOne 0.00 65535.00 FORMAT "%8.2" /end CHARACTERISTIC
/begin CHARACTERISTIC DFES_DTCM.DFC_ComWheelSpeedTo_C "/" VALUE 0x80073F82 Val_Wu16 65535.00 DFES_OneToOne 0.00 65535.00 FORMAT "%8.2" /end CHARACTERISTIC
/begin CHARACTERISTIC DFES_DTCM.DFC_ComZvKlappenSig_C "/" VALUE 0x80073F84 Val_Wu16 65535.00 DFES_OneToOne 0.00 65535.00 FORMAT "%8.2" /end CHARACTERISTIC
/begin CHARACTERISTIC DFES_DTCM.DFC_ComZvKlappenTo_C "/" VALUE 0x80073F86 Val_Wu16 65535.00 DFES_OneToOne 0.00 65535.00 FORMAT "%8.2" /end CHARACTERISTIC
/begin CHARACTERISTIC DFES_DTCM.DFC_Cy150SpiCom_C "/" VALUE 0x80073F88 Val_Wu16 65535.00 DFES_OneToOne 0.00 65535.00 FORMAT "%8.2" /end CHARACTERISTIC
/begin CHARACTERISTIC DFES_DTCM.DFC_Cy320SpiCom_C "/" VALUE 0x80073F8A Val_Wu16 65535.00 DFES_OneToOne 0.00 65535.00 FORMAT "%8.2" /end CHARACTERISTIC
/begin CHARACTERISTIC DFES_DTCM.DFC_ETCtlDvtInrMax_C "/" VALUE 0x80073F8C Val_Wu16 65535.00 DFES_OneToOne 0.00 65535.00 FORMAT "%8.2" /end CHARACTERISTIC
/begin CHARACTERISTIC DFES_DTCM.DFC_ETCtlDvtInrMin_C "/" VALUE 0x80073F8E Val_Wu16 65535.00 DFES_OneToOne 0.00 65535.00 FORMAT "%8.2" /end CHARACTERISTIC
/begin CHARACTERISTIC DFES_DTCM.DFC_ETCtlDvtOutrMax_C "/" VALUE 0x80073F90 Val_Wu16 65535.00 DFES_OneToOne 0.00 65535.00 FORMAT "%8.2" /end CHARACTERISTIC
/begin CHARACTERISTIC DFES_DTCM.DFC_ETCtlDvtOutrMin_C "/" VALUE 0x80073F92 Val_Wu16 65535.00 DFES_OneToOne 0.00 65535.00 FORMAT "%8.2" /end CHARACTERISTIC
/begin CHARACTERISTIC DFES_DTCM.DFC_Fan4WinErr1_C "/" VALUE 0x80073F94 Val_Wu16 65535.00 DFES_OneToOne 0.00 65535.00 FORMAT "%8.2" /end CHARACTERISTIC
/begin CHARACTERISTIC DFES_DTCM.DFC_Fan4WinErr2_C "/" VALUE 0x80073F96 Val_Wu16 65535.00 DFES_OneToOne 0.00 65535.00 FORMAT "%8.2" /end CHARACTERISTIC
/begin CHARACTERISTIC DFES_DTCM.DFC_Fan4WinErr3_C "/" VALUE 0x80073F98 Val_Wu16 65535.00 DFES_OneToOne 0.00 65535.00 FORMAT "%8.2" /end CHARACTERISTIC
/begin CHARACTERISTIC DFES_DTCM.DFC_Fan4WinErr4_C "/" VALUE 0x80073F9A Val_Wu16 65535.00 DFES_OneToOne 0.00 65535.00 FORMAT "%8.2" /end CHARACTERISTIC
/begin CHARACTERISTIC DFES_DTCM.DFC_FanSCG_C "/" VALUE 0x80073F9C Val_Wu16 65535.00 DFES_OneToOne 0.00 65535.00 FORMAT "%8.2" /end CHARACTERISTIC
/begin CHARACTERISTIC DFES_DTCM.DFC_PCRGovDvtLPMax_C "/" VALUE 0x80073F9E Val_Wu16 65535.00 DFES_OneToOne 0.00 65535.00 FORMAT "%8.2" /end CHARACTERISTIC
/begin CHARACTERISTIC DFES_DTCM.DFC_PCRGovDvtLPMin_C "/" VALUE 0x80073FA0 Val_Wu16 65535.00 DFES_OneToOne 0.00 65535.00 FORMAT "%8.2" /end CHARACTERISTIC
/begin CHARACTERISTIC DFES_DTCM.DFC_PCRGovDvtMax_C "/" VALUE 0x80073FA2 Val_Wu16 65535.00 DFES_OneToOne 0.00 65535.00 FORMAT "%8.2" /end CHARACTERISTIC
/begin CHARACTERISTIC DFES_DTCM.DFC_PCRGovDvtMin_C "/" VALUE 0x80073FA4 Val_Wu16 65535.00 DFES_OneToOne 0.00 65535.00 FORMAT "%8.2" /end CHARACTERISTIC
/begin CHARACTERISTIC DFES_DTCM.DFC_RailCPC1_C "/" VALUE 0x80073FA6 Val_Wu16 65535.00 DFES_OneToOne 0.00 65535.00 FORMAT "%8.2" /end CHARACTERISTIC
/begin CHARACTERISTIC DFES_DTCM.DFC_RailCPC3_C "/" VALUE 0x80073FA8 Val_Wu16 65535.00 DFES_OneToOne 0.00 65535.00 FORMAT "%8.2" /end CHARACTERISTIC
/begin CHARACTERISTIC DFES_DTCM.DFC_RailCPC4_C "/" VALUE 0x80073FAA Val_Wu16 65535.00 DFES_OneToOne 0.00 65535.00 FORMAT "%8.2" /end CHARACTERISTIC
/begin CHARACTERISTIC DFES_DTCM.DFC_RailMeUn0_C "/" VALUE 0x80073FAC Val_Wu16 65535.00 DFES_OneToOne 0.00 65535.00 FORMAT "%8.2" /end CHARACTERISTIC
/begin CHARACTERISTIC DFES_DTCM.DFC_RailMeUn1_C "/" VALUE 0x80073FAE Val_Wu16 65535.00 DFES_OneToOne 0.00 65535.00 FORMAT "%8.2" /end CHARACTERISTIC
/begin CHARACTERISTIC DFES_DTCM.DFC_RailMeUn2_C "/" VALUE 0x80073FB0 Val_Wu16 65535.00 DFES_OneToOne 0.00 65535.00 FORMAT "%8.2" /end CHARACTERISTIC
/begin CHARACTERISTIC DFES_DTCM.DFC_RailMeUn3_C "/" VALUE 0x80073FB2 Val_Wu16 65535.00 DFES_OneToOne 0.00 65535.00 FORMAT "%8.2" /end CHARACTERISTIC
/begin CHARACTERISTIC DFES_DTCM.DFC_RailMeUn4_C "/" VALUE 0x80073FB4 Val_Wu16 65535.00 DFES_OneToOne 0.00 65535.00 FORMAT "%8.2" /end CHARACTERISTIC
/begin CHARACTERISTIC DFES_DTCM.DFC_RailPCV0_C "/" VALUE 0x80073FB6 Val_Wu16 65535.00 DFES_OneToOne 0.00 65535.00 FORMAT "%8.2" /end CHARACTERISTIC
/begin CHARACTERISTIC DFES_DTCM.DFC_RailPCV1_C "/" VALUE 0x80073FB8 Val_Wu16 65535.00 DFES_OneToOne 0.00 65535.00 FORMAT "%8.2" /end CHARACTERISTIC
/begin CHARACTERISTIC DFES_DTCM.DFC_RailPCV2_C "/" VALUE 0x80073FBA Val_Wu16 65535.00 DFES_OneToOne 0.00 65535.00 FORMAT "%8.2" /end CHARACTERISTIC
/begin CHARACTERISTIC DFES_DTCM.DFC_RailPCV3_C "/" VALUE 0x80073FBC Val_Wu16 65535.00 DFES_OneToOne 0.00 65535.00 FORMAT "%8.2" /end CHARACTERISTIC
/begin CHARACTERISTIC DFES_DTCM.DFC_RailPCV4_C "/" VALUE 0x80073FBE Val_Wu16 65535.00 DFES_OneToOne 0.00 65535.00 FORMAT "%8.2" /end CHARACTERISTIC
/begin CHARACTERISTIC DFES_DTCM.DFC_RailPMonStrt_C "/" VALUE 0x80073FC0 Val_Wu16 65535.00 DFES_OneToOne 0.00 65535.00 FORMAT "%8.2" /end CHARACTERISTIC
/begin CHARACTERISTIC DFES_DTCM.DFC_SSpMon1_C "/" VALUE 0x80073FC2 Val_Wu16 65535.00 DFES_OneToOne 0.00 65535.00 FORMAT "%8.2" /end CHARACTERISTIC
/begin CHARACTERISTIC DFES_DTCM.DFC_SSpMon2_C "/" VALUE 0x80073FC4 Val_Wu16 65535.00 DFES_OneToOne 0.00 65535.00 FORMAT "%8.2" /end CHARACTERISTIC
/begin CHARACTERISTIC DFES_DTCM.DFC_SSpMon3_C "/" VALUE 0x80073FC6 Val_Wu16 65535.00 DFES_OneToOne 0.00 65535.00 FORMAT "%8.2" /end CHARACTERISTIC
/begin CHARACTERISTIC DFES_DTCM.DFC_Sia_E1_C "/" VALUE 0x80073FC8 Val_Wu16 65535.00 DFES_OneToOne 0.00 65535.00 FORMAT "%8.2" /end CHARACTERISTIC
/begin CHARACTERISTIC DFES_DTCM.DFC_Sia_E10_C "/" VALUE 0x80073FCA Val_Wu16 65535.00 DFES_OneToOne 0.00 65535.00 FORMAT "%8.2" /end CHARACTERISTIC
/begin CHARACTERISTIC DFES_DTCM.DFC_Sia_E11_C "/" VALUE 0x80073FCC Val_Wu16 65535.00 DFES_OneToOne 0.00 65535.00 FORMAT "%8.2" /end CHARACTERISTIC
/begin CHARACTERISTIC DFES_DTCM.DFC_Sia_E12_C "/" VALUE 0x80073FCE Val_Wu16 65535.00 DFES_OneToOne 0.00 65535.00 FORMAT "%8.2" /end CHARACTERISTIC
/begin CHARACTERISTIC DFES_DTCM.DFC_Sia_E13_C "/" VALUE 0x80073FD0 Val_Wu16 65535.00 DFES_OneToOne 0.00 65535.00 FORMAT "%8.2" /end CHARACTERISTIC
/begin CHARACTERISTIC DFES_DTCM.DFC_Sia_E14_C "/" VALUE 0x80073FD2 Val_Wu16 65535.00 DFES_OneToOne 0.00 65535.00 FORMAT "%8.2" /end CHARACTERISTIC
/begin CHARACTERISTIC DFES_DTCM.DFC_Sia_E15_C "/" VALUE 0x80073FD4 Val_Wu16 65535.00 DFES_OneToOne 0.00 65535.00 FORMAT "%8.2" /end CHARACTERISTIC
/begin CHARACTERISTIC DFES_DTCM.DFC_Sia_E2_C "/" VALUE 0x80073FD6 Val_Wu16 65535.00 DFES_OneToOne 0.00 65535.00 FORMAT "%8.2" /end CHARACTERISTIC
/begin CHARACTERISTIC DFES_DTCM.DFC_Sia_E3_C "/" VALUE 0x80073FD8 Val_Wu16 65535.00 DFES_OneToOne 0.00 65535.00 FORMAT "%8.2" /end CHARACTERISTIC
/begin CHARACTERISTIC DFES_DTCM.DFC_Sia_E4_C "/" VALUE 0x80073FDA Val_Wu16 65535.00 DFES_OneToOne 0.00 65535.00 FORMAT "%8.2" /end CHARACTERISTIC
/begin CHARACTERISTIC DFES_DTCM.DFC_Sia_E5_C "/" VALUE 0x80073FDC Val_Wu16 65535.00 DFES_OneToOne 0.00 65535.00 FORMAT "%8.2" /end CHARACTERISTIC
/begin CHARACTERISTIC DFES_DTCM.DFC_Sia_E6_C "/" VALUE 0x80073FDE Val_Wu16 65535.00 DFES_OneToOne 0.00 65535.00 FORMAT "%8.2" /end CHARACTERISTIC
/begin CHARACTERISTIC DFES_DTCM.DFC_Sia_E7_C "/" VALUE 0x80073FE0 Val_Wu16 65535.00 DFES_OneToOne 0.00 65535.00 FORMAT "%8.2" /end CHARACTERISTIC
/begin CHARACTERISTIC DFES_DTCM.DFC_Sia_E8_C "/" VALUE 0x80073FE2 Val_Wu16 65535.00 DFES_OneToOne 0.00 65535.00 FORMAT "%8.2" /end CHARACTERISTIC
/begin CHARACTERISTIC DFES_DTCM.DFC_Sia_E9_C "/" VALUE 0x80073FE4 Val_Wu16 65535.00 DFES_OneToOne 0.00 65535.00 FORMAT "%8.2" /end CHARACTERISTIC
/begin CHARACTERISTIC DFES_DTCM.DFC_ThrVlv4WinErr1_C "/" VALUE 0x80073FE6 Val_Wu16 65535.00 DFES_OneToOne 0.00 65535.00 FORMAT "%8.2" /end CHARACTERISTIC
/begin CHARACTERISTIC DFES_DTCM.DFC_ThrVlv4WinErr2_C "/" VALUE 0x80073FE8 Val_Wu16 65535.00 DFES_OneToOne 0.00 65535.00 FORMAT "%8.2" /end CHARACTERISTIC
/begin CHARACTERISTIC DFES_DTCM.DFC_ThrVlv4WinErr3_C "/" VALUE 0x80073FEA Val_Wu16 65535.00 DFES_OneToOne 0.00 65535.00 FORMAT "%8.2" /end CHARACTERISTIC
/begin CHARACTERISTIC DFES_DTCM.DFC_ThrVlv4WinErr4_C "/" VALUE 0x80073FEC Val_Wu16 65535.00 DFES_OneToOne 0.00 65535.00 FORMAT "%8.2" /end CHARACTERISTIC
/begin CHARACTERISTIC DFES_DTCM.DFC_ThrVlvSCG_C "/" VALUE 0x80073FEE Val_Wu16 65535.00 DFES_OneToOne 0.00 65535.00 FORMAT "%8.2" /end CHARACTERISTIC
/begin CHARACTERISTIC DFES_DTCM.DFC_TrbCh4WinErr1_C "/" VALUE 0x80073FF0 Val_Wu16 65535.00 DFES_OneToOne 0.00 65535.00 FORMAT "%8.2" /end CHARACTERISTIC
/begin CHARACTERISTIC DFES_DTCM.DFC_TrbCh4WinErr2_C "/" VALUE 0x80073FF2 Val_Wu16 65535.00 DFES_OneToOne 0.00 65535.00 FORMAT "%8.2" /end CHARACTERISTIC
/begin CHARACTERISTIC DFES_DTCM.DFC_TrbCh4WinErr3_C "/" VALUE 0x80073FF4 Val_Wu16 65535.00 DFES_OneToOne 0.00 65535.00 FORMAT "%8.2" /end CHARACTERISTIC
/begin CHARACTERISTIC DFES_DTCM.DFC_TrbCh4WinErr4_C "/" VALUE 0x80073FF6 Val_Wu16 65535.00 DFES_OneToOne 0.00 65535.00 FORMAT "%8.2" /end CHARACTERISTIC
/begin CHARACTERISTIC DFES_DTCM.DFC_TrbChSCG_C "/" VALUE 0x80073FF8 Val_Wu16 65535.00 DFES_OneToOne 0.00 65535.00 FORMAT "%8.2" /end CHARACTERISTIC
/begin CHARACTERISTIC DFES_DTCM.DFC_TrbChSRCMax_C "/" VALUE 0x80073FFA Val_Wu16 65535.00 DFES_OneToOne 0.00 65535.00 FORMAT "%8.2" /end CHARACTERISTIC
/begin CHARACTERISTIC DFES_DTCM.DFC_TrbChSRCMin_C "/" VALUE 0x80073FFC Val_Wu16 65535.00 DFES_OneToOne 0.00 65535.00 FORMAT "%8.2" /end CHARACTERISTIC
/begin CHARACTERISTIC DFES_DTCM.DFC_WaHtEl4WinErr1_C "/" VALUE 0x80073FFE Val_Wu16 65535.00 DFES_OneToOne 0.00 65535.00 FORMAT "%8.2" /end CHARACTERISTIC
/begin CHARACTERISTIC DFES_DTCM.DFC_WaHtEl4WinErr2_C "/" VALUE 0x80074000 Val_Wu16 65535.00 DFES_OneToOne 0.00 65535.00 FORMAT "%8.2" /end CHARACTERISTIC
/begin CHARACTERISTIC DFES_DTCM.DFC_WaHtEl4WinErr3_C "/" VALUE 0x80074002 Val_Wu16 65535.00 DFES_OneToOne 0.00 65535.00 FORMAT "%8.2" /end CHARACTERISTIC
/begin CHARACTERISTIC DFES_DTCM.DFC_WaHtEl4WinErr4_C "/" VALUE 0x80074004 Val_Wu16 65535.00 DFES_OneToOne 0.00 65535.00 FORMAT "%8.2" /end CHARACTERISTIC
/begin CHARACTERISTIC DFES_DTCM.DFC_WaHtElSCG_C "/" VALUE 0x80074006 Val_Wu16 65535.00 DFES_OneToOne 0.00 65535.00 FORMAT "%8.2" /end CHARACTERISTIC
/begin CHARACTERISTIC DFES_DTCM.DFC_ETClbETFltMax_C "/" VALUE 0x80074008 Val_Wu16 65535.00 DFES_OneToOne 0.00 65535.00 FORMAT "%8.2" /end CHARACTERISTIC
/begin CHARACTERISTIC DFES_DTCM.DFC_ETClbETFltMin_C "/" VALUE 0x8007400A Val_Wu16 65535.00 DFES_OneToOne 0.00 65535.00 FORMAT "%8.2" /end CHARACTERISTIC
/begin CHARACTERISTIC DFES_DTCM.DFC_InjCrvInjLimChrgBal_C "/" VALUE 0x8007400C Val_Wu16 65535.00 DFES_OneToOne 0.00 65535.00 FORMAT "%8.2" /end CHARACTERISTIC
/begin CHARACTERISTIC DFES_DTCM.DFC_InjCrvInjLimQntBal_C "/" VALUE 0x8007400E Val_Wu16 65535.00 DFES_OneToOne 0.00 65535.00 FORMAT "%8.2" /end CHARACTERISTIC
/begin CHARACTERISTIC DFES_DTCM.DFC_InjCrvInjLimSys_C "/" VALUE 0x80074010 Val_Wu16 65535.00 DFES_OneToOne 0.00 65535.00 FORMAT "%8.2" /end CHARACTERISTIC
/begin CHARACTERISTIC DFES_DTCM.DFC_InjCrvNumInjRtmLim_C "/" VALUE 0x80074012 Val_Wu16 65535.00 DFES_OneToOne 0.00 65535.00 FORMAT "%8.2" /end CHARACTERISTIC
/begin CHARACTERISTIC DFES_DTCM.DFC_LSUHtCoupSig_0_C "/" VALUE 0x80074014 Val_Wu16 65535.00 DFES_OneToOne 0.00 65535.00 FORMAT "%8.2" /end CHARACTERISTIC
/begin CHARACTERISTIC DFES_DTCM.DFC_LSUHtCoupSig_1_C "/" VALUE 0x80074016 Val_Wu16 65535.00 DFES_OneToOne 0.00 65535.00 FORMAT "%8.2" /end CHARACTERISTIC
/begin CHARACTERISTIC DFES_DTCM.DFC_LSUHtCoupSig_2_C "/" VALUE 0x80074018 Val_Wu16 65535.00 DFES_OneToOne 0.00 65535.00 FORMAT "%8.2" /end CHARACTERISTIC
/begin CHARACTERISTIC DFES_DTCM.DFC_LSUHtCoupSig_3_C "/" VALUE 0x8007401A Val_Wu16 65535.00 DFES_OneToOne 0.00 65535.00 FORMAT "%8.2" /end CHARACTERISTIC
/begin CHARACTERISTIC DFES_DTCM.DFC_CtT_C "/" VALUE 0x8007401C Val_Wu16 65535.00 DFES_OneToOne 0.00 65535.00 FORMAT "%8.2" /end CHARACTERISTIC
/begin CHARACTERISTIC DFES_DTCM.DFC_DSMDummy_C "/" VALUE 0x8007401E Val_Wu16 65535.00 DFES_OneToOne 0.00 65535.00 FORMAT "%8.2" /end CHARACTERISTIC
/begin CHARACTERISTIC DFES_DTCM.DFC_MeUnOL_C "/" VALUE 0x80074020 Val_Wu16 65535.00 DFES_OneToOne 0.00 65535.00 FORMAT "%8.2" /end CHARACTERISTIC
/begin CHARACTERISTIC DFES_DTCM.DFC_MeUnSCB_C "/" VALUE 0x80074022 Val_Wu16 65535.00 DFES_OneToOne 0.00 65535.00 FORMAT "%8.2" /end CHARACTERISTIC
/begin CHARACTERISTIC DFES_DTCM.DFC_MeUnSRCMax_C "/" VALUE 0x80074024 Val_Wu16 65535.00 DFES_OneToOne 0.00 65535.00 FORMAT "%8.2" /end CHARACTERISTIC
/begin CHARACTERISTIC DFES_DTCM.DFC_MeUnSRCMin_C "/" VALUE 0x80074026 Val_Wu16 65535.00 DFES_OneToOne 0.00 65535.00 FORMAT "%8.2" /end CHARACTERISTIC
/begin CHARACTERISTIC DFES_DTCM.DFC_PCVOL_C "/" VALUE 0x80074028 Val_Wu16 65535.00 DFES_OneToOne 0.00 65535.00 FORMAT "%8.2" /end CHARACTERISTIC
/begin CHARACTERISTIC DFES_DTCM.DFC_PCVSCB_C "/" VALUE 0x8007402A Val_Wu16 65535.00 DFES_OneToOne 0.00 65535.00 FORMAT "%8.2" /end CHARACTERISTIC
/begin CHARACTERISTIC DFES_DTCM.DFC_PCVSRCMax_C "/" VALUE 0x8007402C Val_Wu16 65535.00 DFES_OneToOne 0.00 65535.00 FORMAT "%8.2" /end CHARACTERISTIC
/begin CHARACTERISTIC DFES_DTCM.DFC_PCVSRCMin_C "/" VALUE 0x8007402E Val_Wu16 65535.00 DFES_OneToOne 0.00 65535.00 FORMAT "%8.2" /end CHARACTERISTIC
/begin CHARACTERISTIC DFES_DTCM.DFC_RailPSRCMax_C "/" VALUE 0x80074030 Val_Wu16 65535.00 DFES_OneToOne 0.00 65535.00 FORMAT "%8.2" /end CHARACTERISTIC
/begin CHARACTERISTIC DFES_DTCM.DFC_RailPSRCMin_C "/" VALUE 0x80074032 Val_Wu16 65535.00 DFES_OneToOne 0.00 65535.00 FORMAT "%8.2" /end CHARACTERISTIC
/begin CHARACTERISTIC DFES_DTCM.DFC_IVActrVltgSRCMax_C "/" VALUE 0x80074034 Val_Wu16 65535.00 DFES_OneToOne 0.00 65535.00 FORMAT "%8.2" /end CHARACTERISTIC
/begin CHARACTERISTIC DFES_DTCM.DFC_IVActrVltgSRCMin_C "/" VALUE 0x80074036 Val_Wu16 65535.00 DFES_OneToOne 0.00 65535.00 FORMAT "%8.2" /end CHARACTERISTIC
/begin CHARACTERISTIC DFES_DTCM.DFC_IVPSplyDCDC_C "/" VALUE 0x80074038 Val_Wu16 65535.00 DFES_OneToOne 0.00 65535.00 FORMAT "%8.2" /end CHARACTERISTIC
/begin CHARACTERISTIC DFES_DTCM.DFC_IVPSplyVltgSRCMax_C "/" VALUE 0x8007403A Val_Wu16 65535.00 DFES_OneToOne 0.00 65535.00 FORMAT "%8.2" /end CHARACTERISTIC
/begin CHARACTERISTIC DFES_DTCM.DFC_IVPSplyVltgSRCMin_C "/" VALUE 0x8007403C Val_Wu16 65535.00 DFES_OneToOne 0.00 65535.00 FORMAT "%8.2" /end CHARACTERISTIC
/begin CHARACTERISTIC DFES_DTCM.DFC_AFSOffsDrftMax_C "/" VALUE 0x8007403E Val_Wu16 65535.00 DFES_OneToOne 0.00 65535.00 FORMAT "%8.2" /end CHARACTERISTIC
/begin CHARACTERISTIC DFES_DTCM.DFC_AFSOffsDrftMin_C "/" VALUE 0x80074040 Val_Wu16 65535.00 DFES_OneToOne 0.00 65535.00 FORMAT "%8.2" /end CHARACTERISTIC
/begin CHARACTERISTIC DFES_DTCM.DFC_AFSSRCCorMax_C "/" VALUE 0x80074042 Val_Wu16 65535.00 DFES_OneToOne 0.00 65535.00 FORMAT "%8.2" /end CHARACTERISTIC
/begin CHARACTERISTIC DFES_DTCM.DFC_AFSSRCCorMin_C "/" VALUE 0x80074044 Val_Wu16 65535.00 DFES_OneToOne 0.00 65535.00 FORMAT "%8.2" /end CHARACTERISTIC
/begin CHARACTERISTIC DFES_DTCM.DFC_AFSSRCRawMax_C "/" VALUE 0x80074046 Val_Wu16 65535.00 DFES_OneToOne 0.00 65535.00 FORMAT "%8.2" /end CHARACTERISTIC
/begin CHARACTERISTIC DFES_DTCM.DFC_AFSSRCRawMin_C "/" VALUE 0x80074048 Val_Wu16 65535.00 DFES_OneToOne 0.00 65535.00 FORMAT "%8.2" /end CHARACTERISTIC
/begin CHARACTERISTIC DFES_DTCM.DFC_AFSSetyDrftMax_C "/" VALUE 0x8007404A Val_Wu16 65535.00 DFES_OneToOne 0.00 65535.00 FORMAT "%8.2" /end CHARACTERISTIC
/begin CHARACTERISTIC DFES_DTCM.DFC_AFSSetyDrftMin_C "/" VALUE 0x8007404C Val_Wu16 65535.00 DFES_OneToOne 0.00 65535.00 FORMAT "%8.2" /end CHARACTERISTIC
/begin CHARACTERISTIC DFES_DTCM.DFC_AirCClntPAnaSRCMax_C "/" VALUE 0x8007404E Val_Wu16 65535.00 DFES_OneToOne 0.00 65535.00 FORMAT "%8.2" /end CHARACTERISTIC
/begin CHARACTERISTIC DFES_DTCM.DFC_AirCClntPAnaSRCMin_C "/" VALUE 0x80074050 Val_Wu16 65535.00 DFES_OneToOne 0.00 65535.00 FORMAT "%8.2" /end CHARACTERISTIC
/begin CHARACTERISTIC DFES_DTCM.DFC_AirCClntPPerSRCMax_C "/" VALUE 0x80074052 Val_Wu16 65535.00 DFES_OneToOne 0.00 65535.00 FORMAT "%8.2" /end CHARACTERISTIC
/begin CHARACTERISTIC DFES_DTCM.DFC_AirCClntPPerSRCMin_C "/" VALUE 0x80074054 Val_Wu16 65535.00 DFES_OneToOne 0.00 65535.00 FORMAT "%8.2" /end CHARACTERISTIC
/begin CHARACTERISTIC DFES_DTCM.DFC_AirCClntPdcycSRCMax_C "/" VALUE 0x80074056 Val_Wu16 65535.00 DFES_OneToOne 0.00 65535.00 FORMAT "%8.2" /end CHARACTERISTIC
/begin CHARACTERISTIC DFES_DTCM.DFC_AirCClntPdcycSRCMin_C "/" VALUE 0x80074058 Val_Wu16 65535.00 DFES_OneToOne 0.00 65535.00 FORMAT "%8.2" /end CHARACTERISTIC
/begin CHARACTERISTIC DFES_DTCM.DFC_AirCCmprOL_C "/" VALUE 0x8007405A Val_Wu16 65535.00 DFES_OneToOne 0.00 65535.00 FORMAT "%8.2" /end CHARACTERISTIC
/begin CHARACTERISTIC DFES_DTCM.DFC_AirCCmprRedTrqOL_C "/" VALUE 0x8007405C Val_Wu16 65535.00 DFES_OneToOne 0.00 65535.00 FORMAT "%8.2" /end CHARACTERISTIC
/begin CHARACTERISTIC DFES_DTCM.DFC_AirCCmprRedTrqSCB_C "/" VALUE 0x8007405E Val_Wu16 65535.00 DFES_OneToOne 0.00 65535.00 FORMAT "%8.2" /end CHARACTERISTIC
/begin CHARACTERISTIC DFES_DTCM.DFC_AirCCmprRedTrqSCG_C "/" VALUE 0x80074060 Val_Wu16 65535.00 DFES_OneToOne 0.00 65535.00 FORMAT "%8.2" /end CHARACTERISTIC
/begin CHARACTERISTIC DFES_DTCM.DFC_AirCCmprSCB_C "/" VALUE 0x80074062 Val_Wu16 65535.00 DFES_OneToOne 0.00 65535.00 FORMAT "%8.2" /end CHARACTERISTIC
/begin CHARACTERISTIC DFES_DTCM.DFC_AirCCmprSCG_C "/" VALUE 0x80074064 Val_Wu16 65535.00 DFES_OneToOne 0.00 65535.00 FORMAT "%8.2" /end CHARACTERISTIC
/begin CHARACTERISTIC DFES_DTCM.DFC_AirCSwtNpl_C "/" VALUE 0x80074066 Val_Wu16 65535.00 DFES_OneToOne 0.00 65535.00 FORMAT "%8.2" /end CHARACTERISTIC
/begin CHARACTERISTIC DFES_DTCM.DFC_AirCSwtSig_C "/" VALUE 0x80074068 Val_Wu16 65535.00 DFES_OneToOne 0.00 65535.00 FORMAT "%8.2" /end CHARACTERISTIC
/begin CHARACTERISTIC DFES_DTCM.DFC_BattUSRCMax_C "/" VALUE 0x8007406A Val_Wu16 65535.00 DFES_OneToOne 0.00 65535.00 FORMAT "%8.2" /end CHARACTERISTIC
/begin CHARACTERISTIC DFES_DTCM.DFC_BattUSRCMin_C "/" VALUE 0x8007406C Val_Wu16 65535.00 DFES_OneToOne 0.00 65535.00 FORMAT "%8.2" /end CHARACTERISTIC
/begin CHARACTERISTIC DFES_DTCM.DFC_BrkNpl_C "/" VALUE 0x8007406E Val_Wu16 65535.00 DFES_OneToOne 0.00 65535.00 FORMAT "%8.2" /end CHARACTERISTIC
/begin CHARACTERISTIC DFES_DTCM.DFC_BrkPSRCMax_C "/" VALUE 0x80074070 Val_Wu16 65535.00 DFES_OneToOne 0.00 65535.00 FORMAT "%8.2" /end CHARACTERISTIC
/begin CHARACTERISTIC DFES_DTCM.DFC_BrkPSRCMin_C "/" VALUE 0x80074072 Val_Wu16 65535.00 DFES_OneToOne 0.00 65535.00 FORMAT "%8.2" /end CHARACTERISTIC
/begin CHARACTERISTIC DFES_DTCM.DFC_BrkSig_C "/" VALUE 0x80074074 Val_Wu16 65535.00 DFES_OneToOne 0.00 65535.00 FORMAT "%8.2" /end CHARACTERISTIC
/begin CHARACTERISTIC DFES_DTCM.DFC_CByVlvOL_C "/" VALUE 0x80074076 Val_Wu16 65535.00 DFES_OneToOne 0.00 65535.00 FORMAT "%8.2" /end CHARACTERISTIC
/begin CHARACTERISTIC DFES_DTCM.DFC_CByVlvSCB_C "/" VALUE 0x80074078 Val_Wu16 65535.00 DFES_OneToOne 0.00 65535.00 FORMAT "%8.2" /end CHARACTERISTIC
/begin CHARACTERISTIC DFES_DTCM.DFC_CByVlvSCG_C "/" VALUE 0x8007407A Val_Wu16 65535.00 DFES_OneToOne 0.00 65535.00 FORMAT "%8.2" /end CHARACTERISTIC
/begin CHARACTERISTIC DFES_DTCM.DFC_CEngDsTSRCMax_C "/" VALUE 0x8007407C Val_Wu16 65535.00 DFES_OneToOne 0.00 65535.00 FORMAT "%8.2" /end CHARACTERISTIC
/begin CHARACTERISTIC DFES_DTCM.DFC_CEngDsTSRCMin_C "/" VALUE 0x8007407E Val_Wu16 65535.00 DFES_OneToOne 0.00 65535.00 FORMAT "%8.2" /end CHARACTERISTIC
/begin CHARACTERISTIC DFES_DTCM.DFC_CEngDsTSig_C "/" VALUE 0x80074080 Val_Wu16 65535.00 DFES_OneToOne 0.00 65535.00 FORMAT "%8.2" /end CHARACTERISTIC
/begin CHARACTERISTIC DFES_DTCM.DFC_CEngUsTSRCMax_C "/" VALUE 0x80074082 Val_Wu16 65535.00 DFES_OneToOne 0.00 65535.00 FORMAT "%8.2" /end CHARACTERISTIC
/begin CHARACTERISTIC DFES_DTCM.DFC_CEngUsTSRCMin_C "/" VALUE 0x80074084 Val_Wu16 65535.00 DFES_OneToOne 0.00 65535.00 FORMAT "%8.2" /end CHARACTERISTIC
/begin CHARACTERISTIC DFES_DTCM.DFC_CThmstOL_C "/" VALUE 0x80074086 Val_Wu16 65535.00 DFES_OneToOne 0.00 65535.00 FORMAT "%8.2" /end CHARACTERISTIC
/begin CHARACTERISTIC DFES_DTCM.DFC_CThmstSCB_C "/" VALUE 0x80074088 Val_Wu16 65535.00 DFES_OneToOne 0.00 65535.00 FORMAT "%8.2" /end CHARACTERISTIC
/begin CHARACTERISTIC DFES_DTCM.DFC_CThmstSCG_C "/" VALUE 0x8007408A Val_Wu16 65535.00 DFES_OneToOne 0.00 65535.00 FORMAT "%8.2" /end CHARACTERISTIC
/begin CHARACTERISTIC DFES_DTCM.DFC_ClthSig_C "/" VALUE 0x8007408C Val_Wu16 65535.00 DFES_OneToOne 0.00 65535.00 FORMAT "%8.2" /end CHARACTERISTIC
/begin CHARACTERISTIC DFES_DTCM.DFC_ECBVlvOL_C "/" VALUE 0x8007408E Val_Wu16 65535.00 DFES_OneToOne 0.00 65535.00 FORMAT "%8.2" /end CHARACTERISTIC
/begin CHARACTERISTIC DFES_DTCM.DFC_ECBVlvSCB_C "/" VALUE 0x80074090 Val_Wu16 65535.00 DFES_OneToOne 0.00 65535.00 FORMAT "%8.2" /end CHARACTERISTIC
/begin CHARACTERISTIC DFES_DTCM.DFC_ECBVlvSCG_C "/" VALUE 0x80074092 Val_Wu16 65535.00 DFES_OneToOne 0.00 65535.00 FORMAT "%8.2" /end CHARACTERISTIC
/begin CHARACTERISTIC DFES_DTCM.DFC_ECBVlvSRCMax_C "/" VALUE 0x80074094 Val_Wu16 65535.00 DFES_OneToOne 0.00 65535.00 FORMAT "%8.2" /end CHARACTERISTIC
/begin CHARACTERISTIC DFES_DTCM.DFC_ECBVlvSRCMin_C "/" VALUE 0x80074096 Val_Wu16 65535.00 DFES_OneToOne 0.00 65535.00 FORMAT "%8.2" /end CHARACTERISTIC
/begin CHARACTERISTIC DFES_DTCM.DFC_EGRVlvGovDvtMax_C "/" VALUE 0x80074098 Val_Wu16 65535.00 DFES_OneToOne 0.00 65535.00 FORMAT "%8.2" /end CHARACTERISTIC
/begin CHARACTERISTIC DFES_DTCM.DFC_EGRVlvGovDvtMin_C "/" VALUE 0x8007409A Val_Wu16 65535.00 DFES_OneToOne 0.00 65535.00 FORMAT "%8.2" /end CHARACTERISTIC
/begin CHARACTERISTIC DFES_DTCM.DFC_EGRVlvOL_C "/" VALUE 0x8007409C Val_Wu16 65535.00 DFES_OneToOne 0.00 65535.00 FORMAT "%8.2" /end CHARACTERISTIC
/begin CHARACTERISTIC DFES_DTCM.DFC_EGRVlvSCB_C "/" VALUE 0x8007409E Val_Wu16 65535.00 DFES_OneToOne 0.00 65535.00 FORMAT "%8.2" /end CHARACTERISTIC
/begin CHARACTERISTIC DFES_DTCM.DFC_EGRVlvSCG_C "/" VALUE 0x800740A0 Val_Wu16 65535.00 DFES_OneToOne 0.00 65535.00 FORMAT "%8.2" /end CHARACTERISTIC
/begin CHARACTERISTIC DFES_DTCM.DFC_EGRVlvSRCMax_C "/" VALUE 0x800740A2 Val_Wu16 65535.00 DFES_OneToOne 0.00 65535.00 FORMAT "%8.2" /end CHARACTERISTIC
/begin CHARACTERISTIC DFES_DTCM.DFC_EGRVlvSRCMin_C "/" VALUE 0x800740A4 Val_Wu16 65535.00 DFES_OneToOne 0.00 65535.00 FORMAT "%8.2" /end CHARACTERISTIC
/begin CHARACTERISTIC DFES_DTCM.DFC_EMDmpOL_0_C "/" VALUE 0x800740A6 Val_Wu16 65535.00 DFES_OneToOne 0.00 65535.00 FORMAT "%8.2" /end CHARACTERISTIC
/begin CHARACTERISTIC DFES_DTCM.DFC_EMDmpOL_1_C "/" VALUE 0x800740A8 Val_Wu16 65535.00 DFES_OneToOne 0.00 65535.00 FORMAT "%8.2" /end CHARACTERISTIC
/begin CHARACTERISTIC DFES_DTCM.DFC_EMDmpSCB_0_C "/" VALUE 0x800740AA Val_Wu16 65535.00 DFES_OneToOne 0.00 65535.00 FORMAT "%8.2" /end CHARACTERISTIC
/begin CHARACTERISTIC DFES_DTCM.DFC_EMDmpSCB_1_C "/" VALUE 0x800740AC Val_Wu16 65535.00 DFES_OneToOne 0.00 65535.00 FORMAT "%8.2" /end CHARACTERISTIC
/begin CHARACTERISTIC DFES_DTCM.DFC_EMDmpSCG_0_C "/" VALUE 0x800740AE Val_Wu16 65535.00 DFES_OneToOne 0.00 65535.00 FORMAT "%8.2" /end CHARACTERISTIC
/begin CHARACTERISTIC DFES_DTCM.DFC_EMDmpSCG_1_C "/" VALUE 0x800740B0 Val_Wu16 65535.00 DFES_OneToOne 0.00 65535.00 FORMAT "%8.2" /end CHARACTERISTIC
/begin CHARACTERISTIC DFES_DTCM.DFC_EngStAOL_C "/" VALUE 0x800740B2 Val_Wu16 65535.00 DFES_OneToOne 0.00 65535.00 FORMAT "%8.2" /end CHARACTERISTIC
/begin CHARACTERISTIC DFES_DTCM.DFC_EngStASCB_C "/" VALUE 0x800740B4 Val_Wu16 65535.00 DFES_OneToOne 0.00 65535.00 FORMAT "%8.2" /end CHARACTERISTIC
/begin CHARACTERISTIC DFES_DTCM.DFC_EngStASCG_C "/" VALUE 0x800740B6 Val_Wu16 65535.00 DFES_OneToOne 0.00 65535.00 FORMAT "%8.2" /end CHARACTERISTIC
/begin CHARACTERISTIC DFES_DTCM.DFC_EnvPSRCMax_C "/" VALUE 0x800740B8 Val_Wu16 65535.00 DFES_OneToOne 0.00 65535.00 FORMAT "%8.2" /end CHARACTERISTIC
/begin CHARACTERISTIC DFES_DTCM.DFC_EnvPSRCMin_C "/" VALUE 0x800740BA Val_Wu16 65535.00 DFES_OneToOne 0.00 65535.00 FORMAT "%8.2" /end CHARACTERISTIC
/begin CHARACTERISTIC DFES_DTCM.DFC_EnvPSig_C "/" VALUE 0x800740BC Val_Wu16 65535.00 DFES_OneToOne 0.00 65535.00 FORMAT "%8.2" /end CHARACTERISTIC
/begin CHARACTERISTIC DFES_DTCM.DFC_EnvTSRCMax_C "/" VALUE 0x800740BE Val_Wu16 65535.00 DFES_OneToOne 0.00 65535.00 FORMAT "%8.2" /end CHARACTERISTIC
/begin CHARACTERISTIC DFES_DTCM.DFC_EnvTSRCMin_C "/" VALUE 0x800740C0 Val_Wu16 65535.00 DFES_OneToOne 0.00 65535.00 FORMAT "%8.2" /end CHARACTERISTIC
/begin CHARACTERISTIC DFES_DTCM.DFC_FanOL_C "/" VALUE 0x800740C2 Val_Wu16 65535.00 DFES_OneToOne 0.00 65535.00 FORMAT "%8.2" /end CHARACTERISTIC
/begin CHARACTERISTIC DFES_DTCM.DFC_FanSCB_C "/" VALUE 0x800740C4 Val_Wu16 65535.00 DFES_OneToOne 0.00 65535.00 FORMAT "%8.2" /end CHARACTERISTIC
/begin CHARACTERISTIC DFES_DTCM.DFC_FlFltSig_C "/" VALUE 0x800740C6 Val_Wu16 65535.00 DFES_OneToOne 0.00 65535.00 FORMAT "%8.2" /end CHARACTERISTIC
/begin CHARACTERISTIC DFES_DTCM.DFC_FuelTSRCMax_C "/" VALUE 0x800740C8 Val_Wu16 65535.00 DFES_OneToOne 0.00 65535.00 FORMAT "%8.2" /end CHARACTERISTIC
/begin CHARACTERISTIC DFES_DTCM.DFC_FuelTSRCMin_C "/" VALUE 0x800740CA Val_Wu16 65535.00 DFES_OneToOne 0.00 65535.00 FORMAT "%8.2" /end CHARACTERISTIC
/begin CHARACTERISTIC DFES_DTCM.DFC_GbxNPosPPerSRCMax_C "/" VALUE 0x800740CC Val_Wu16 65535.00 DFES_OneToOne 0.00 65535.00 FORMAT "%8.2" /end CHARACTERISTIC
/begin CHARACTERISTIC DFES_DTCM.DFC_GbxNPosPPerSRCMin_C "/" VALUE 0x800740CE Val_Wu16 65535.00 DFES_OneToOne 0.00 65535.00 FORMAT "%8.2" /end CHARACTERISTIC
/begin CHARACTERISTIC DFES_DTCM.DFC_GbxNPosPdcycSRCMax_C "/" VALUE 0x800740D0 Val_Wu16 65535.00 DFES_OneToOne 0.00 65535.00 FORMAT "%8.2" /end CHARACTERISTIC
/begin CHARACTERISTIC DFES_DTCM.DFC_GbxNPosPdcycSRCMin_C "/" VALUE 0x800740D2 Val_Wu16 65535.00 DFES_OneToOne 0.00 65535.00 FORMAT "%8.2" /end CHARACTERISTIC
/begin CHARACTERISTIC DFES_DTCM.DFC_GbxNPosSig_C "/" VALUE 0x800740D4 Val_Wu16 65535.00 DFES_OneToOne 0.00 65535.00 FORMAT "%8.2" /end CHARACTERISTIC
/begin CHARACTERISTIC DFES_DTCM.DFC_GlwPlgBSDOL_0_C "/" VALUE 0x800740D6 Val_Wu16 65535.00 DFES_OneToOne 0.00 65535.00 FORMAT "%8.2" /end CHARACTERISTIC
/begin CHARACTERISTIC DFES_DTCM.DFC_GlwPlgBSDOL_1_C "/" VALUE 0x800740D8 Val_Wu16 65535.00 DFES_OneToOne 0.00 65535.00 FORMAT "%8.2" /end CHARACTERISTIC
/begin CHARACTERISTIC DFES_DTCM.DFC_GlwPlgBSDOL_2_C "/" VALUE 0x800740DA Val_Wu16 65535.00 DFES_OneToOne 0.00 65535.00 FORMAT "%8.2" /end CHARACTERISTIC
/begin CHARACTERISTIC DFES_DTCM.DFC_GlwPlgBSDOL_3_C "/" VALUE 0x800740DC Val_Wu16 65535.00 DFES_OneToOne 0.00 65535.00 FORMAT "%8.2" /end CHARACTERISTIC
/begin CHARACTERISTIC DFES_DTCM.DFC_GlwPlgBSDOL_4_C "/" VALUE 0x800740DE Val_Wu16 65535.00 DFES_OneToOne 0.00 65535.00 FORMAT "%8.2" /end CHARACTERISTIC
/begin CHARACTERISTIC DFES_DTCM.DFC_GlwPlgBSDOL_5_C "/" VALUE 0x800740E0 Val_Wu16 65535.00 DFES_OneToOne 0.00 65535.00 FORMAT "%8.2" /end CHARACTERISTIC
/begin CHARACTERISTIC DFES_DTCM.DFC_GlwPlgBSDOL_6_C "/" VALUE 0x800740E2 Val_Wu16 65535.00 DFES_OneToOne 0.00 65535.00 FORMAT "%8.2" /end CHARACTERISTIC
/begin CHARACTERISTIC DFES_DTCM.DFC_GlwPlgBSDOL_7_C "/" VALUE 0x800740E4 Val_Wu16 65535.00 DFES_OneToOne 0.00 65535.00 FORMAT "%8.2" /end CHARACTERISTIC
/begin CHARACTERISTIC DFES_DTCM.DFC_GlwPlgBSDOT_0_C "/" VALUE 0x800740E6 Val_Wu16 65535.00 DFES_OneToOne 0.00 65535.00 FORMAT "%8.2" /end CHARACTERISTIC
/begin CHARACTERISTIC DFES_DTCM.DFC_GlwPlgBSDOT_1_C "/" VALUE 0x800740E8 Val_Wu16 65535.00 DFES_OneToOne 0.00 65535.00 FORMAT "%8.2" /end CHARACTERISTIC
/begin CHARACTERISTIC DFES_DTCM.DFC_GlwPlgBSDOT_2_C "/" VALUE 0x800740EA Val_Wu16 65535.00 DFES_OneToOne 0.00 65535.00 FORMAT "%8.2" /end CHARACTERISTIC
/begin CHARACTERISTIC DFES_DTCM.DFC_GlwPlgBSDOT_3_C "/" VALUE 0x800740EC Val_Wu16 65535.00 DFES_OneToOne 0.00 65535.00 FORMAT "%8.2" /end CHARACTERISTIC
/begin CHARACTERISTIC DFES_DTCM.DFC_GlwPlgBSDOT_4_C "/" VALUE 0x800740EE Val_Wu16 65535.00 DFES_OneToOne 0.00 65535.00 FORMAT "%8.2" /end CHARACTERISTIC
/begin CHARACTERISTIC DFES_DTCM.DFC_GlwPlgBSDOT_5_C "/" VALUE 0x800740F0 Val_Wu16 65535.00 DFES_OneToOne 0.00 65535.00 FORMAT "%8.2" /end CHARACTERISTIC
/begin CHARACTERISTIC DFES_DTCM.DFC_GlwPlgBSDOT_6_C "/" VALUE 0x800740F2 Val_Wu16 65535.00 DFES_OneToOne 0.00 65535.00 FORMAT "%8.2" /end CHARACTERISTIC
/begin CHARACTERISTIC DFES_DTCM.DFC_GlwPlgBSDOT_7_C "/" VALUE 0x800740F4 Val_Wu16 65535.00 DFES_OneToOne 0.00 65535.00 FORMAT "%8.2" /end CHARACTERISTIC
/begin CHARACTERISTIC DFES_DTCM.DFC_GlwPlgBSDSC_0_C "/" VALUE 0x800740F6 Val_Wu16 65535.00 DFES_OneToOne 0.00 65535.00 FORMAT "%8.2" /end CHARACTERISTIC
/begin CHARACTERISTIC DFES_DTCM.DFC_GlwPlgBSDSC_1_C "/" VALUE 0x800740F8 Val_Wu16 65535.00 DFES_OneToOne 0.00 65535.00 FORMAT "%8.2" /end CHARACTERISTIC
/begin CHARACTERISTIC DFES_DTCM.DFC_GlwPlgBSDSC_2_C "/" VALUE 0x800740FA Val_Wu16 65535.00 DFES_OneToOne 0.00 65535.00 FORMAT "%8.2" /end CHARACTERISTIC
/begin CHARACTERISTIC DFES_DTCM.DFC_GlwPlgBSDSC_3_C "/" VALUE 0x800740FC Val_Wu16 65535.00 DFES_OneToOne 0.00 65535.00 FORMAT "%8.2" /end CHARACTERISTIC
/begin CHARACTERISTIC DFES_DTCM.DFC_GlwPlgBSDSC_4_C "/" VALUE 0x800740FE Val_Wu16 65535.00 DFES_OneToOne 0.00 65535.00 FORMAT "%8.2" /end CHARACTERISTIC
/begin CHARACTERISTIC DFES_DTCM.DFC_GlwPlgBSDSC_5_C "/" VALUE 0x80074100 Val_Wu16 65535.00 DFES_OneToOne 0.00 65535.00 FORMAT "%8.2" /end CHARACTERISTIC
/begin CHARACTERISTIC DFES_DTCM.DFC_GlwPlgBSDSC_6_C "/" VALUE 0x80074102 Val_Wu16 65535.00 DFES_OneToOne 0.00 65535.00 FORMAT "%8.2" /end CHARACTERISTIC
/begin CHARACTERISTIC DFES_DTCM.DFC_GlwPlgBSDSC_7_C "/" VALUE 0x80074104 Val_Wu16 65535.00 DFES_OneToOne 0.00 65535.00 FORMAT "%8.2" /end CHARACTERISTIC
/begin CHARACTERISTIC DFES_DTCM.DFC_GlwPlgComErr_C "/" VALUE 0x80074106 Val_Wu16 65535.00 DFES_OneToOne 0.00 65535.00 FORMAT "%8.2" /end CHARACTERISTIC
/begin CHARACTERISTIC DFES_DTCM.DFC_InjVlvPresMin_C "/" VALUE 0x80074108 Val_Wu16 65535.00 DFES_OneToOne 0.00 65535.00 FORMAT "%8.2" /end CHARACTERISTIC
/begin CHARACTERISTIC DFES_DTCM.DFC_LSUCircNernstMax_0_C "/" VALUE 0x8007410A Val_Wu16 65535.00 DFES_OneToOne 0.00 65535.00 FORMAT "%8.2" /end CHARACTERISTIC
/begin CHARACTERISTIC DFES_DTCM.DFC_LSUCircNernstMax_1_C "/" VALUE 0x8007410C Val_Wu16 65535.00 DFES_OneToOne 0.00 65535.00 FORMAT "%8.2" /end CHARACTERISTIC
/begin CHARACTERISTIC DFES_DTCM.DFC_LSUCircNernstMax_2_C "/" VALUE 0x8007410E Val_Wu16 65535.00 DFES_OneToOne 0.00 65535.00 FORMAT "%8.2" /end CHARACTERISTIC
/begin CHARACTERISTIC DFES_DTCM.DFC_LSUCircNernstMax_3_C "/" VALUE 0x80074110 Val_Wu16 65535.00 DFES_OneToOne 0.00 65535.00 FORMAT "%8.2" /end CHARACTERISTIC
/begin CHARACTERISTIC DFES_DTCM.DFC_LSUCircNernstMin_0_C "/" VALUE 0x80074112 Val_Wu16 65535.00 DFES_OneToOne 0.00 65535.00 FORMAT "%8.2" /end CHARACTERISTIC
/begin CHARACTERISTIC DFES_DTCM.DFC_LSUCircNernstMin_1_C "/" VALUE 0x80074114 Val_Wu16 65535.00 DFES_OneToOne 0.00 65535.00 FORMAT "%8.2" /end CHARACTERISTIC
/begin CHARACTERISTIC DFES_DTCM.DFC_LSUCircNernstMin_2_C "/" VALUE 0x80074116 Val_Wu16 65535.00 DFES_OneToOne 0.00 65535.00 FORMAT "%8.2" /end CHARACTERISTIC
/begin CHARACTERISTIC DFES_DTCM.DFC_LSUCircNernstMin_3_C "/" VALUE 0x80074118 Val_Wu16 65535.00 DFES_OneToOne 0.00 65535.00 FORMAT "%8.2" /end CHARACTERISTIC
/begin CHARACTERISTIC DFES_DTCM.DFC_LSUCircNernstSig_0_C "/" VALUE 0x8007411A Val_Wu16 65535.00 DFES_OneToOne 0.00 65535.00 FORMAT "%8.2" /end CHARACTERISTIC
/begin CHARACTERISTIC DFES_DTCM.DFC_LSUCircNernstSig_1_C "/" VALUE 0x8007411C Val_Wu16 65535.00 DFES_OneToOne 0.00 65535.00 FORMAT "%8.2" /end CHARACTERISTIC
/begin CHARACTERISTIC DFES_DTCM.DFC_LSUCircNernstSig_2_C "/" VALUE 0x8007411E Val_Wu16 65535.00 DFES_OneToOne 0.00 65535.00 FORMAT "%8.2" /end CHARACTERISTIC
/begin CHARACTERISTIC DFES_DTCM.DFC_LSUCircNernstSig_3_C "/" VALUE 0x80074120 Val_Wu16 65535.00 DFES_OneToOne 0.00 65535.00 FORMAT "%8.2" /end CHARACTERISTIC
/begin CHARACTERISTIC DFES_DTCM.DFC_LSUCircPmpCurMax_0_C "/" VALUE 0x80074122 Val_Wu16 65535.00 DFES_OneToOne 0.00 65535.00 FORMAT "%8.2" /end CHARACTERISTIC
/begin CHARACTERISTIC DFES_DTCM.DFC_LSUCircPmpCurMax_1_C "/" VALUE 0x80074124 Val_Wu16 65535.00 DFES_OneToOne 0.00 65535.00 FORMAT "%8.2" /end CHARACTERISTIC
/begin CHARACTERISTIC DFES_DTCM.DFC_LSUCircPmpCurMax_2_C "/" VALUE 0x80074126 Val_Wu16 65535.00 DFES_OneToOne 0.00 65535.00 FORMAT "%8.2" /end CHARACTERISTIC
/begin CHARACTERISTIC DFES_DTCM.DFC_LSUCircPmpCurMax_3_C "/" VALUE 0x80074128 Val_Wu16 65535.00 DFES_OneToOne 0.00 65535.00 FORMAT "%8.2" /end CHARACTERISTIC
/begin CHARACTERISTIC DFES_DTCM.DFC_LSUCircPmpCurMin_0_C "/" VALUE 0x8007412A Val_Wu16 65535.00 DFES_OneToOne 0.00 65535.00 FORMAT "%8.2" /end CHARACTERISTIC
/begin CHARACTERISTIC DFES_DTCM.DFC_LSUCircPmpCurMin_1_C "/" VALUE 0x8007412C Val_Wu16 65535.00 DFES_OneToOne 0.00 65535.00 FORMAT "%8.2" /end CHARACTERISTIC
/begin CHARACTERISTIC DFES_DTCM.DFC_LSUCircPmpCurMin_2_C "/" VALUE 0x8007412E Val_Wu16 65535.00 DFES_OneToOne 0.00 65535.00 FORMAT "%8.2" /end CHARACTERISTIC
/begin CHARACTERISTIC DFES_DTCM.DFC_LSUCircPmpCurMin_3_C "/" VALUE 0x80074130 Val_Wu16 65535.00 DFES_OneToOne 0.00 65535.00 FORMAT "%8.2" /end CHARACTERISTIC
/begin CHARACTERISTIC DFES_DTCM.DFC_LSUCircPmpCurSig_0_C "/" VALUE 0x80074132 Val_Wu16 65535.00 DFES_OneToOne 0.00 65535.00 FORMAT "%8.2" /end CHARACTERISTIC
/begin CHARACTERISTIC DFES_DTCM.DFC_LSUCircPmpCurSig_1_C "/" VALUE 0x80074134 Val_Wu16 65535.00 DFES_OneToOne 0.00 65535.00 FORMAT "%8.2" /end CHARACTERISTIC
/begin CHARACTERISTIC DFES_DTCM.DFC_LSUCircPmpCurSig_2_C "/" VALUE 0x80074136 Val_Wu16 65535.00 DFES_OneToOne 0.00 65535.00 FORMAT "%8.2" /end CHARACTERISTIC
/begin CHARACTERISTIC DFES_DTCM.DFC_LSUCircPmpCurSig_3_C "/" VALUE 0x80074138 Val_Wu16 65535.00 DFES_OneToOne 0.00 65535.00 FORMAT "%8.2" /end CHARACTERISTIC
/begin CHARACTERISTIC DFES_DTCM.DFC_LSUCircVirtGndMax_0_C "/" VALUE 0x8007413A Val_Wu16 65535.00 DFES_OneToOne 0.00 65535.00 FORMAT "%8.2" /end CHARACTERISTIC
/begin CHARACTERISTIC DFES_DTCM.DFC_LSUCircVirtGndMax_1_C "/" VALUE 0x8007413C Val_Wu16 65535.00 DFES_OneToOne 0.00 65535.00 FORMAT "%8.2" /end CHARACTERISTIC
/begin CHARACTERISTIC DFES_DTCM.DFC_LSUCircVirtGndMax_2_C "/" VALUE 0x8007413E Val_Wu16 65535.00 DFES_OneToOne 0.00 65535.00 FORMAT "%8.2" /end CHARACTERISTIC
/begin CHARACTERISTIC DFES_DTCM.DFC_LSUCircVirtGndMax_3_C "/" VALUE 0x80074140 Val_Wu16 65535.00 DFES_OneToOne 0.00 65535.00 FORMAT "%8.2" /end CHARACTERISTIC
/begin CHARACTERISTIC DFES_DTCM.DFC_LSUCircVirtGndMin_0_C "/" VALUE 0x80074142 Val_Wu16 65535.00 DFES_OneToOne 0.00 65535.00 FORMAT "%8.2" /end CHARACTERISTIC
/begin CHARACTERISTIC DFES_DTCM.DFC_LSUCircVirtGndMin_1_C "/" VALUE 0x80074144 Val_Wu16 65535.00 DFES_OneToOne 0.00 65535.00 FORMAT "%8.2" /end CHARACTERISTIC
/begin CHARACTERISTIC DFES_DTCM.DFC_LSUCircVirtGndMin_2_C "/" VALUE 0x80074146 Val_Wu16 65535.00 DFES_OneToOne 0.00 65535.00 FORMAT "%8.2" /end CHARACTERISTIC
/begin CHARACTERISTIC DFES_DTCM.DFC_LSUCircVirtGndMin_3_C "/" VALUE 0x80074148 Val_Wu16 65535.00 DFES_OneToOne 0.00 65535.00 FORMAT "%8.2" /end CHARACTERISTIC
/begin CHARACTERISTIC DFES_DTCM.DFC_LSUCircVirtGndSig_0_C "/" VALUE 0x8007414A Val_Wu16 65535.00 DFES_OneToOne 0.00 65535.00 FORMAT "%8.2" /end CHARACTERISTIC
/begin CHARACTERISTIC DFES_DTCM.DFC_LSUCircVirtGndSig_1_C "/" VALUE 0x8007414C Val_Wu16 65535.00 DFES_OneToOne 0.00 65535.00 FORMAT "%8.2" /end CHARACTERISTIC
/begin CHARACTERISTIC DFES_DTCM.DFC_LSUCircVirtGndSig_2_C "/" VALUE 0x8007414E Val_Wu16 65535.00 DFES_OneToOne 0.00 65535.00 FORMAT "%8.2" /end CHARACTERISTIC
/begin CHARACTERISTIC DFES_DTCM.DFC_LSUCircVirtGndSig_3_C "/" VALUE 0x80074150 Val_Wu16 65535.00 DFES_OneToOne 0.00 65535.00 FORMAT "%8.2" /end CHARACTERISTIC
/begin CHARACTERISTIC DFES_DTCM.DFC_LSUHtrMax_0_C "/" VALUE 0x80074152 Val_Wu16 65535.00 DFES_OneToOne 0.00 65535.00 FORMAT "%8.2" /end CHARACTERISTIC
/begin CHARACTERISTIC DFES_DTCM.DFC_LSUHtrMax_1_C "/" VALUE 0x80074154 Val_Wu16 65535.00 DFES_OneToOne 0.00 65535.00 FORMAT "%8.2" /end CHARACTERISTIC
/begin CHARACTERISTIC DFES_DTCM.DFC_LSUHtrMax_2_C "/" VALUE 0x80074156 Val_Wu16 65535.00 DFES_OneToOne 0.00 65535.00 FORMAT "%8.2" /end CHARACTERISTIC
/begin CHARACTERISTIC DFES_DTCM.DFC_LSUHtrMax_3_C "/" VALUE 0x80074158 Val_Wu16 65535.00 DFES_OneToOne 0.00 65535.00 FORMAT "%8.2" /end CHARACTERISTIC
/begin CHARACTERISTIC DFES_DTCM.DFC_LSUHtrMin_0_C "/" VALUE 0x8007415A Val_Wu16 65535.00 DFES_OneToOne 0.00 65535.00 FORMAT "%8.2" /end CHARACTERISTIC
/begin CHARACTERISTIC DFES_DTCM.DFC_LSUHtrMin_1_C "/" VALUE 0x8007415C Val_Wu16 65535.00 DFES_OneToOne 0.00 65535.00 FORMAT "%8.2" /end CHARACTERISTIC
/begin CHARACTERISTIC DFES_DTCM.DFC_LSUHtrMin_2_C "/" VALUE 0x8007415E Val_Wu16 65535.00 DFES_OneToOne 0.00 65535.00 FORMAT "%8.2" /end CHARACTERISTIC
/begin CHARACTERISTIC DFES_DTCM.DFC_LSUHtrMin_3_C "/" VALUE 0x80074160 Val_Wu16 65535.00 DFES_OneToOne 0.00 65535.00 FORMAT "%8.2" /end CHARACTERISTIC
/begin CHARACTERISTIC DFES_DTCM.DFC_LSUHtrSig_0_C "/" VALUE 0x80074162 Val_Wu16 65535.00 DFES_OneToOne 0.00 65535.00 FORMAT "%8.2" /end CHARACTERISTIC
/begin CHARACTERISTIC DFES_DTCM.DFC_LSUHtrSig_1_C "/" VALUE 0x80074164 Val_Wu16 65535.00 DFES_OneToOne 0.00 65535.00 FORMAT "%8.2" /end CHARACTERISTIC
/begin CHARACTERISTIC DFES_DTCM.DFC_LSUHtrSig_2_C "/" VALUE 0x80074166 Val_Wu16 65535.00 DFES_OneToOne 0.00 65535.00 FORMAT "%8.2" /end CHARACTERISTIC
/begin CHARACTERISTIC DFES_DTCM.DFC_LSUHtrSig_3_C "/" VALUE 0x80074168 Val_Wu16 65535.00 DFES_OneToOne 0.00 65535.00 FORMAT "%8.2" /end CHARACTERISTIC
/begin CHARACTERISTIC DFES_DTCM.DFC_LSUO2Max_0_C "/" VALUE 0x8007416A Val_Wu16 65535.00 DFES_OneToOne 0.00 65535.00 FORMAT "%8.2" /end CHARACTERISTIC
/begin CHARACTERISTIC DFES_DTCM.DFC_LSUO2Max_1_C "/" VALUE 0x8007416C Val_Wu16 65535.00 DFES_OneToOne 0.00 65535.00 FORMAT "%8.2" /end CHARACTERISTIC
/begin CHARACTERISTIC DFES_DTCM.DFC_LSUO2Max_2_C "/" VALUE 0x8007416E Val_Wu16 65535.00 DFES_OneToOne 0.00 65535.00 FORMAT "%8.2" /end CHARACTERISTIC
/begin CHARACTERISTIC DFES_DTCM.DFC_LSUO2Max_3_C "/" VALUE 0x80074170 Val_Wu16 65535.00 DFES_OneToOne 0.00 65535.00 FORMAT "%8.2" /end CHARACTERISTIC
/begin CHARACTERISTIC DFES_DTCM.DFC_LSUO2Min_0_C "/" VALUE 0x80074172 Val_Wu16 65535.00 DFES_OneToOne 0.00 65535.00 FORMAT "%8.2" /end CHARACTERISTIC
/begin CHARACTERISTIC DFES_DTCM.DFC_LSUO2Min_1_C "/" VALUE 0x80074174 Val_Wu16 65535.00 DFES_OneToOne 0.00 65535.00 FORMAT "%8.2" /end CHARACTERISTIC
/begin CHARACTERISTIC DFES_DTCM.DFC_LSUO2Min_2_C "/" VALUE 0x80074176 Val_Wu16 65535.00 DFES_OneToOne 0.00 65535.00 FORMAT "%8.2" /end CHARACTERISTIC
/begin CHARACTERISTIC DFES_DTCM.DFC_LSUO2Min_3_C "/" VALUE 0x80074178 Val_Wu16 65535.00 DFES_OneToOne 0.00 65535.00 FORMAT "%8.2" /end CHARACTERISTIC
/begin CHARACTERISTIC DFES_DTCM.DFC_LSUSPIBattLowMin_0_C "/" VALUE 0x8007417A Val_Wu16 65535.00 DFES_OneToOne 0.00 65535.00 FORMAT "%8.2" /end CHARACTERISTIC
/begin CHARACTERISTIC DFES_DTCM.DFC_LSUSPIBattLowMin_1_C "/" VALUE 0x8007417C Val_Wu16 65535.00 DFES_OneToOne 0.00 65535.00 FORMAT "%8.2" /end CHARACTERISTIC
/begin CHARACTERISTIC DFES_DTCM.DFC_LSUSPIBattLowMin_2_C "/" VALUE 0x8007417E Val_Wu16 65535.00 DFES_OneToOne 0.00 65535.00 FORMAT "%8.2" /end CHARACTERISTIC
/begin CHARACTERISTIC DFES_DTCM.DFC_LSUSPIBattLowMin_3_C "/" VALUE 0x80074180 Val_Wu16 65535.00 DFES_OneToOne 0.00 65535.00 FORMAT "%8.2" /end CHARACTERISTIC
/begin CHARACTERISTIC DFES_DTCM.DFC_LSUSPISig_0_C "/" VALUE 0x80074182 Val_Wu16 65535.00 DFES_OneToOne 0.00 65535.00 FORMAT "%8.2" /end CHARACTERISTIC
/begin CHARACTERISTIC DFES_DTCM.DFC_LSUSPISig_1_C "/" VALUE 0x80074184 Val_Wu16 65535.00 DFES_OneToOne 0.00 65535.00 FORMAT "%8.2" /end CHARACTERISTIC
/begin CHARACTERISTIC DFES_DTCM.DFC_LSUSPISig_2_C "/" VALUE 0x80074186 Val_Wu16 65535.00 DFES_OneToOne 0.00 65535.00 FORMAT "%8.2" /end CHARACTERISTIC
/begin CHARACTERISTIC DFES_DTCM.DFC_LSUSPISig_3_C "/" VALUE 0x80074188 Val_Wu16 65535.00 DFES_OneToOne 0.00 65535.00 FORMAT "%8.2" /end CHARACTERISTIC
/begin CHARACTERISTIC DFES_DTCM.DFC_LSUtExcMax_0_C "/" VALUE 0x8007418A Val_Wu16 65535.00 DFES_OneToOne 0.00 65535.00 FORMAT "%8.2" /end CHARACTERISTIC
/begin CHARACTERISTIC DFES_DTCM.DFC_LSUtExcMax_1_C "/" VALUE 0x8007418C Val_Wu16 65535.00 DFES_OneToOne 0.00 65535.00 FORMAT "%8.2" /end CHARACTERISTIC
/begin CHARACTERISTIC DFES_DTCM.DFC_LSUtExcMax_2_C "/" VALUE 0x8007418E Val_Wu16 65535.00 DFES_OneToOne 0.00 65535.00 FORMAT "%8.2" /end CHARACTERISTIC
/begin CHARACTERISTIC DFES_DTCM.DFC_LSUtExcMax_3_C "/" VALUE 0x80074190 Val_Wu16 65535.00 DFES_OneToOne 0.00 65535.00 FORMAT "%8.2" /end CHARACTERISTIC
/begin CHARACTERISTIC DFES_DTCM.DFC_LSUtExcMin_0_C "/" VALUE 0x80074192 Val_Wu16 65535.00 DFES_OneToOne 0.00 65535.00 FORMAT "%8.2" /end CHARACTERISTIC
/begin CHARACTERISTIC DFES_DTCM.DFC_LSUtExcMin_1_C "/" VALUE 0x80074194 Val_Wu16 65535.00 DFES_OneToOne 0.00 65535.00 FORMAT "%8.2" /end CHARACTERISTIC
/begin CHARACTERISTIC DFES_DTCM.DFC_LSUtExcMin_2_C "/" VALUE 0x80074196 Val_Wu16 65535.00 DFES_OneToOne 0.00 65535.00 FORMAT "%8.2" /end CHARACTERISTIC
/begin CHARACTERISTIC DFES_DTCM.DFC_LSUtExcMin_3_C "/" VALUE 0x80074198 Val_Wu16 65535.00 DFES_OneToOne 0.00 65535.00 FORMAT "%8.2" /end CHARACTERISTIC
/begin CHARACTERISTIC DFES_DTCM.DFC_MILOL_C "/" VALUE 0x8007419A Val_Wu16 65535.00 DFES_OneToOne 0.00 65535.00 FORMAT "%8.2" /end CHARACTERISTIC
/begin CHARACTERISTIC DFES_DTCM.DFC_MILSCB_C "/" VALUE 0x8007419C Val_Wu16 65535.00 DFES_OneToOne 0.00 65535.00 FORMAT "%8.2" /end CHARACTERISTIC
/begin CHARACTERISTIC DFES_DTCM.DFC_MILSCG_C "/" VALUE 0x8007419E Val_Wu16 65535.00 DFES_OneToOne 0.00 65535.00 FORMAT "%8.2" /end CHARACTERISTIC
/begin CHARACTERISTIC DFES_DTCM.DFC_MeUnSCG_C "/" VALUE 0x800741A0 Val_Wu16 65535.00 DFES_OneToOne 0.00 65535.00 FORMAT "%8.2" /end CHARACTERISTIC
/begin CHARACTERISTIC DFES_DTCM.DFC_NplHsChngPPFltDiff_C "/" VALUE 0x800741A2 Val_Wu16 65535.00 DFES_OneToOne 0.00 65535.00 FORMAT "%8.2" /end CHARACTERISTIC
/begin CHARACTERISTIC DFES_DTCM.DFC_NplPAirFltDs_C "/" VALUE 0x800741A4 Val_Wu16 65535.00 DFES_OneToOne 0.00 65535.00 FORMAT "%8.2" /end CHARACTERISTIC
/begin CHARACTERISTIC DFES_DTCM.DFC_NplTPFltUs_C "/" VALUE 0x800741A6 Val_Wu16 65535.00 DFES_OneToOne 0.00 65535.00 FORMAT "%8.2" /end CHARACTERISTIC
/begin CHARACTERISTIC DFES_DTCM.DFC_OilComErr_C "/" VALUE 0x800741A8 Val_Wu16 65535.00 DFES_OneToOne 0.00 65535.00 FORMAT "%8.2" /end CHARACTERISTIC
/begin CHARACTERISTIC DFES_DTCM.DFC_OilPLmpOL_C "/" VALUE 0x800741AA Val_Wu16 65535.00 DFES_OneToOne 0.00 65535.00 FORMAT "%8.2" /end CHARACTERISTIC
/begin CHARACTERISTIC DFES_DTCM.DFC_OilPLmpSCB_C "/" VALUE 0x800741AC Val_Wu16 65535.00 DFES_OneToOne 0.00 65535.00 FORMAT "%8.2" /end CHARACTERISTIC
/begin CHARACTERISTIC DFES_DTCM.DFC_OilPLmpSCG_C "/" VALUE 0x800741AE Val_Wu16 65535.00 DFES_OneToOne 0.00 65535.00 FORMAT "%8.2" /end CHARACTERISTIC
/begin CHARACTERISTIC DFES_DTCM.DFC_OilPNpl_C "/" VALUE 0x800741B0 Val_Wu16 65535.00 DFES_OneToOne 0.00 65535.00 FORMAT "%8.2" /end CHARACTERISTIC
/begin CHARACTERISTIC DFES_DTCM.DFC_OilTNpl_C "/" VALUE 0x800741B2 Val_Wu16 65535.00 DFES_OneToOne 0.00 65535.00 FORMAT "%8.2" /end CHARACTERISTIC
/begin CHARACTERISTIC DFES_DTCM.DFC_OilTSRCMax_C "/" VALUE 0x800741B4 Val_Wu16 65535.00 DFES_OneToOne 0.00 65535.00 FORMAT "%8.2" /end CHARACTERISTIC
/begin CHARACTERISTIC DFES_DTCM.DFC_OilTSRCMin_C "/" VALUE 0x800741B6 Val_Wu16 65535.00 DFES_OneToOne 0.00 65535.00 FORMAT "%8.2" /end CHARACTERISTIC
/begin CHARACTERISTIC DFES_DTCM.DFC_PCACDsEnvPPls_C "/" VALUE 0x800741B8 Val_Wu16 65535.00 DFES_OneToOne 0.00 65535.00 FORMAT "%8.2" /end CHARACTERISTIC
/begin CHARACTERISTIC DFES_DTCM.DFC_PCACDsSRCMax_C "/" VALUE 0x800741BA Val_Wu16 65535.00 DFES_OneToOne 0.00 65535.00 FORMAT "%8.2" /end CHARACTERISTIC
/begin CHARACTERISTIC DFES_DTCM.DFC_PCACDsSRCMin_C "/" VALUE 0x800741BC Val_Wu16 65535.00 DFES_OneToOne 0.00 65535.00 FORMAT "%8.2" /end CHARACTERISTIC
/begin CHARACTERISTIC DFES_DTCM.DFC_PCVSCG_C "/" VALUE 0x800741BE Val_Wu16 65535.00 DFES_OneToOne 0.00 65535.00 FORMAT "%8.2" /end CHARACTERISTIC
/begin CHARACTERISTIC DFES_DTCM.DFC_PFltCharPDiffMin_C "/" VALUE 0x800741C0 Val_Wu16 65535.00 DFES_OneToOne 0.00 65535.00 FORMAT "%8.2" /end CHARACTERISTIC
/begin CHARACTERISTIC DFES_DTCM.DFC_PFltDstrMin_C "/" VALUE 0x800741C2 Val_Wu16 65535.00 DFES_OneToOne 0.00 65535.00 FORMAT "%8.2" /end CHARACTERISTIC
/begin CHARACTERISTIC DFES_DTCM.DFC_PFltEngPrt_C "/" VALUE 0x800741C4 Val_Wu16 65535.00 DFES_OneToOne 0.00 65535.00 FORMAT "%8.2" /end CHARACTERISTIC
/begin CHARACTERISTIC DFES_DTCM.DFC_PFltLmpOL_C "/" VALUE 0x800741C6 Val_Wu16 65535.00 DFES_OneToOne 0.00 65535.00 FORMAT "%8.2" /end CHARACTERISTIC
/begin CHARACTERISTIC DFES_DTCM.DFC_PFltLmpSCB_C "/" VALUE 0x800741C8 Val_Wu16 65535.00 DFES_OneToOne 0.00 65535.00 FORMAT "%8.2" /end CHARACTERISTIC
/begin CHARACTERISTIC DFES_DTCM.DFC_PFltLmpSCG_C "/" VALUE 0x800741CA Val_Wu16 65535.00 DFES_OneToOne 0.00 65535.00 FORMAT "%8.2" /end CHARACTERISTIC
/begin CHARACTERISTIC DFES_DTCM.DFC_PFltRgnPerm_C "/" VALUE 0x800741CC Val_Wu16 65535.00 DFES_OneToOne 0.00 65535.00 FORMAT "%8.2" /end CHARACTERISTIC
/begin CHARACTERISTIC DFES_DTCM.DFC_PFltSRCMaxFlwRstn_C "/" VALUE 0x800741CE Val_Wu16 65535.00 DFES_OneToOne 0.00 65535.00 FORMAT "%8.2" /end CHARACTERISTIC
/begin CHARACTERISTIC DFES_DTCM.DFC_PFltSRCMinFlwRstn_C "/" VALUE 0x800741D0 Val_Wu16 65535.00 DFES_OneToOne 0.00 65535.00 FORMAT "%8.2" /end CHARACTERISTIC
/begin CHARACTERISTIC DFES_DTCM.DFC_PFltSotMsDvtMax_C "/" VALUE 0x800741D2 Val_Wu16 65535.00 DFES_OneToOne 0.00 65535.00 FORMAT "%8.2" /end CHARACTERISTIC
/begin CHARACTERISTIC DFES_DTCM.DFC_PFltSotMsDvtMin_C "/" VALUE 0x800741D4 Val_Wu16 65535.00 DFES_OneToOne 0.00 65535.00 FORMAT "%8.2" /end CHARACTERISTIC
/begin CHARACTERISTIC DFES_DTCM.DFC_PFltSotMsMax_C "/" VALUE 0x800741D6 Val_Wu16 65535.00 DFES_OneToOne 0.00 65535.00 FORMAT "%8.2" /end CHARACTERISTIC
/begin CHARACTERISTIC DFES_DTCM.DFC_PSPOL_C "/" VALUE 0x800741D8 Val_Wu16 65535.00 DFES_OneToOne 0.00 65535.00 FORMAT "%8.2" /end CHARACTERISTIC
/begin CHARACTERISTIC DFES_DTCM.DFC_PSPSCB_C "/" VALUE 0x800741DA Val_Wu16 65535.00 DFES_OneToOne 0.00 65535.00 FORMAT "%8.2" /end CHARACTERISTIC
/begin CHARACTERISTIC DFES_DTCM.DFC_PSPSCG_C "/" VALUE 0x800741DC Val_Wu16 65535.00 DFES_OneToOne 0.00 65535.00 FORMAT "%8.2" /end CHARACTERISTIC
/begin CHARACTERISTIC DFES_DTCM.DFC_SRCHighAPP1_C "/" VALUE 0x800741DE Val_Wu16 65535.00 DFES_OneToOne 0.00 65535.00 FORMAT "%8.2" /end CHARACTERISTIC
/begin CHARACTERISTIC DFES_DTCM.DFC_SRCHighAPP2_C "/" VALUE 0x800741E0 Val_Wu16 65535.00 DFES_OneToOne 0.00 65535.00 FORMAT "%8.2" /end CHARACTERISTIC
/begin CHARACTERISTIC DFES_DTCM.DFC_SRCLowAPP1_C "/" VALUE 0x800741E2 Val_Wu16 65535.00 DFES_OneToOne 0.00 65535.00 FORMAT "%8.2" /end CHARACTERISTIC
/begin CHARACTERISTIC DFES_DTCM.DFC_SRCLowAPP2_C "/" VALUE 0x800741E4 Val_Wu16 65535.00 DFES_OneToOne 0.00 65535.00 FORMAT "%8.2" /end CHARACTERISTIC
/begin CHARACTERISTIC DFES_DTCM.DFC_SRCMaxPAirFltDs_C "/" VALUE 0x800741E6 Val_Wu16 65535.00 DFES_OneToOne 0.00 65535.00 FORMAT "%8.2" /end CHARACTERISTIC
/begin CHARACTERISTIC DFES_DTCM.DFC_SRCMaxPPFltUs_C "/" VALUE 0x800741E8 Val_Wu16 65535.00 DFES_OneToOne 0.00 65535.00 FORMAT "%8.2" /end CHARACTERISTIC
/begin CHARACTERISTIC DFES_DTCM.DFC_SRCMaxTECU_C "/" VALUE 0x800741EA Val_Wu16 65535.00 DFES_OneToOne 0.00 65535.00 FORMAT "%8.2" /end CHARACTERISTIC
/begin CHARACTERISTIC DFES_DTCM.DFC_SRCMaxTOxiCatUs_C "/" VALUE 0x800741EC Val_Wu16 65535.00 DFES_OneToOne 0.00 65535.00 FORMAT "%8.2" /end CHARACTERISTIC
/begin CHARACTERISTIC DFES_DTCM.DFC_SRCMaxTPFltUs_C "/" VALUE 0x800741EE Val_Wu16 65535.00 DFES_OneToOne 0.00 65535.00 FORMAT "%8.2" /end CHARACTERISTIC
/begin CHARACTERISTIC DFES_DTCM.DFC_SRCMinPAirFltDs_C "/" VALUE 0x800741F0 Val_Wu16 65535.00 DFES_OneToOne 0.00 65535.00 FORMAT "%8.2" /end CHARACTERISTIC
/begin CHARACTERISTIC DFES_DTCM.DFC_SRCMinPPFltUs_C "/" VALUE 0x800741F2 Val_Wu16 65535.00 DFES_OneToOne 0.00 65535.00 FORMAT "%8.2" /end CHARACTERISTIC
/begin CHARACTERISTIC DFES_DTCM.DFC_SRCMinTECU_C "/" VALUE 0x800741F4 Val_Wu16 65535.00 DFES_OneToOne 0.00 65535.00 FORMAT "%8.2" /end CHARACTERISTIC
/begin CHARACTERISTIC DFES_DTCM.DFC_SRCMinTOxiCatUs_C "/" VALUE 0x800741F6 Val_Wu16 65535.00 DFES_OneToOne 0.00 65535.00 FORMAT "%8.2" /end CHARACTERISTIC
/begin CHARACTERISTIC DFES_DTCM.DFC_SRCMinTPFltUs_C "/" VALUE 0x800741F8 Val_Wu16 65535.00 DFES_OneToOne 0.00 65535.00 FORMAT "%8.2" /end CHARACTERISTIC
/begin CHARACTERISTIC DFES_DTCM.DFC_SVSOL_C "/" VALUE 0x800741FA Val_Wu16 65535.00 DFES_OneToOne 0.00 65535.00 FORMAT "%8.2" /end CHARACTERISTIC
/begin CHARACTERISTIC DFES_DTCM.DFC_SVSSCB_C "/" VALUE 0x800741FC Val_Wu16 65535.00 DFES_OneToOne 0.00 65535.00 FORMAT "%8.2" /end CHARACTERISTIC
/begin CHARACTERISTIC DFES_DTCM.DFC_SVSSCG_C "/" VALUE 0x800741FE Val_Wu16 65535.00 DFES_OneToOne 0.00 65535.00 FORMAT "%8.2" /end CHARACTERISTIC
/begin CHARACTERISTIC DFES_DTCM.DFC_StrtOL_C "/" VALUE 0x80074200 Val_Wu16 65535.00 DFES_OneToOne 0.00 65535.00 FORMAT "%8.2" /end CHARACTERISTIC
/begin CHARACTERISTIC DFES_DTCM.DFC_StrtSCB_C "/" VALUE 0x80074202 Val_Wu16 65535.00 DFES_OneToOne 0.00 65535.00 FORMAT "%8.2" /end CHARACTERISTIC
/begin CHARACTERISTIC DFES_DTCM.DFC_StrtSCG_C "/" VALUE 0x80074204 Val_Wu16 65535.00 DFES_OneToOne 0.00 65535.00 FORMAT "%8.2" /end CHARACTERISTIC
/begin CHARACTERISTIC DFES_DTCM.DFC_SyncAPP_C "/" VALUE 0x80074206 Val_Wu16 65535.00 DFES_OneToOne 0.00 65535.00 FORMAT "%8.2" /end CHARACTERISTIC
/begin CHARACTERISTIC DFES_DTCM.DFC_T15Npl_C "/" VALUE 0x80074208 Val_Wu16 65535.00 DFES_OneToOne 0.00 65535.00 FORMAT "%8.2" /end CHARACTERISTIC
/begin CHARACTERISTIC DFES_DTCM.DFC_TAFSDtyCycHi_C "/" VALUE 0x8007420A Val_Wu16 65535.00 DFES_OneToOne 0.00 65535.00 FORMAT "%8.2" /end CHARACTERISTIC
/begin CHARACTERISTIC DFES_DTCM.DFC_TAFSDtyCycLo_C "/" VALUE 0x8007420C Val_Wu16 65535.00 DFES_OneToOne 0.00 65535.00 FORMAT "%8.2" /end CHARACTERISTIC
/begin CHARACTERISTIC DFES_DTCM.DFC_TAFSPerHi_C "/" VALUE 0x8007420E Val_Wu16 65535.00 DFES_OneToOne 0.00 65535.00 FORMAT "%8.2" /end CHARACTERISTIC
/begin CHARACTERISTIC DFES_DTCM.DFC_TAFSPerLo_C "/" VALUE 0x80074210 Val_Wu16 65535.00 DFES_OneToOne 0.00 65535.00 FORMAT "%8.2" /end CHARACTERISTIC
/begin CHARACTERISTIC DFES_DTCM.DFC_TCACDsSRCMax_C "/" VALUE 0x80074212 Val_Wu16 65535.00 DFES_OneToOne 0.00 65535.00 FORMAT "%8.2" /end CHARACTERISTIC
/begin CHARACTERISTIC DFES_DTCM.DFC_TCACDsSRCMin_C "/" VALUE 0x80074214 Val_Wu16 65535.00 DFES_OneToOne 0.00 65535.00 FORMAT "%8.2" /end CHARACTERISTIC
/begin CHARACTERISTIC DFES_DTCM.DFC_ThrVlvOL_C "/" VALUE 0x80074216 Val_Wu16 65535.00 DFES_OneToOne 0.00 65535.00 FORMAT "%8.2" /end CHARACTERISTIC
/begin CHARACTERISTIC DFES_DTCM.DFC_ThrVlvSCB_C "/" VALUE 0x80074218 Val_Wu16 65535.00 DFES_OneToOne 0.00 65535.00 FORMAT "%8.2" /end CHARACTERISTIC
/begin CHARACTERISTIC DFES_DTCM.DFC_ThrVlvSRCMax_C "/" VALUE 0x8007421A Val_Wu16 65535.00 DFES_OneToOne 0.00 65535.00 FORMAT "%8.2" /end CHARACTERISTIC
/begin CHARACTERISTIC DFES_DTCM.DFC_ThrVlvSRCMin_C "/" VALUE 0x8007421C Val_Wu16 65535.00 DFES_OneToOne 0.00 65535.00 FORMAT "%8.2" /end CHARACTERISTIC
/begin CHARACTERISTIC DFES_DTCM.DFC_TrbChLPOL_C "/" VALUE 0x8007421E Val_Wu16 65535.00 DFES_OneToOne 0.00 65535.00 FORMAT "%8.2" /end CHARACTERISTIC
/begin CHARACTERISTIC DFES_DTCM.DFC_TrbChLPSCB_C "/" VALUE 0x80074220 Val_Wu16 65535.00 DFES_OneToOne 0.00 65535.00 FORMAT "%8.2" /end CHARACTERISTIC
/begin CHARACTERISTIC DFES_DTCM.DFC_TrbChLPSCG_C "/" VALUE 0x80074222 Val_Wu16 65535.00 DFES_OneToOne 0.00 65535.00 FORMAT "%8.2" /end CHARACTERISTIC
/begin CHARACTERISTIC DFES_DTCM.DFC_TrbChOL_C "/" VALUE 0x80074224 Val_Wu16 65535.00 DFES_OneToOne 0.00 65535.00 FORMAT "%8.2" /end CHARACTERISTIC
/begin CHARACTERISTIC DFES_DTCM.DFC_TrbChSCB_C "/" VALUE 0x80074226 Val_Wu16 65535.00 DFES_OneToOne 0.00 65535.00 FORMAT "%8.2" /end CHARACTERISTIC
/begin CHARACTERISTIC DFES_DTCM.DFC_VSwVlvGovDvtMax_C "/" VALUE 0x80074228 Val_Wu16 65535.00 DFES_OneToOne 0.00 65535.00 FORMAT "%8.2" /end CHARACTERISTIC
/begin CHARACTERISTIC DFES_DTCM.DFC_VSwVlvGovDvtMin_C "/" VALUE 0x8007422A Val_Wu16 65535.00 DFES_OneToOne 0.00 65535.00 FORMAT "%8.2" /end CHARACTERISTIC
/begin CHARACTERISTIC DFES_DTCM.DFC_VSwVlvOL_C "/" VALUE 0x8007422C Val_Wu16 65535.00 DFES_OneToOne 0.00 65535.00 FORMAT "%8.2" /end CHARACTERISTIC
/begin CHARACTERISTIC DFES_DTCM.DFC_VSwVlvSCB_C "/" VALUE 0x8007422E Val_Wu16 65535.00 DFES_OneToOne 0.00 65535.00 FORMAT "%8.2" /end CHARACTERISTIC
/begin CHARACTERISTIC DFES_DTCM.DFC_VSwVlvSCG_C "/" VALUE 0x80074230 Val_Wu16 65535.00 DFES_OneToOne 0.00 65535.00 FORMAT "%8.2" /end CHARACTERISTIC
/begin CHARACTERISTIC DFES_DTCM.DFC_VSwVlvSRCMax_C "/" VALUE 0x80074232 Val_Wu16 65535.00 DFES_OneToOne 0.00 65535.00 FORMAT "%8.2" /end CHARACTERISTIC
/begin CHARACTERISTIC DFES_DTCM.DFC_VSwVlvSRCMin_C "/" VALUE 0x80074234 Val_Wu16 65535.00 DFES_OneToOne 0.00 65535.00 FORMAT "%8.2" /end CHARACTERISTIC
/begin CHARACTERISTIC DFES_DTCM.DFC_VehVHW_C "/" VALUE 0x80074236 Val_Wu16 65535.00 DFES_OneToOne 0.00 65535.00 FORMAT "%8.2" /end CHARACTERISTIC
/begin CHARACTERISTIC DFES_DTCM.DFC_VehVMax_C "/" VALUE 0x80074238 Val_Wu16 65535.00 DFES_OneToOne 0.00 65535.00 FORMAT "%8.2" /end CHARACTERISTIC
/begin CHARACTERISTIC DFES_DTCM.DFC_VehVPlaus_C "/" VALUE 0x8007423A Val_Wu16 65535.00 DFES_OneToOne 0.00 65535.00 FORMAT "%8.2" /end CHARACTERISTIC
/begin CHARACTERISTIC DFES_DTCM.DFC_VehVSig_C "/" VALUE 0x8007423C Val_Wu16 65535.00 DFES_OneToOne 0.00 65535.00 FORMAT "%8.2" /end CHARACTERISTIC
/begin CHARACTERISTIC DFES_DTCM.DFC_WaHtElOL_C "/" VALUE 0x8007423E Val_Wu16 65535.00 DFES_OneToOne 0.00 65535.00 FORMAT "%8.2" /end CHARACTERISTIC
/begin CHARACTERISTIC DFES_DTCM.DFC_WaHtElSCB_C "/" VALUE 0x80074240 Val_Wu16 65535.00 DFES_OneToOne 0.00 65535.00 FORMAT "%8.2" /end CHARACTERISTIC
/begin CHARACTERISTIC DFES_DTCM.DFC_ClthNpl_C "/" VALUE 0x80074242 Val_Wu16 65535.00 DFES_OneToOne 0.00 65535.00 FORMAT "%8.2" /end CHARACTERISTIC
/begin CHARACTERISTIC DFES_DTCM.DFC_ETClbETMax_0_C "/" VALUE 0x80074244 Val_Wu16 65535.00 DFES_OneToOne 0.00 65535.00 FORMAT "%8.2" /end CHARACTERISTIC
/begin CHARACTERISTIC DFES_DTCM.DFC_ETClbETMax_1_C "/" VALUE 0x80074246 Val_Wu16 65535.00 DFES_OneToOne 0.00 65535.00 FORMAT "%8.2" /end CHARACTERISTIC
/begin CHARACTERISTIC DFES_DTCM.DFC_ETClbETMax_2_C "/" VALUE 0x80074248 Val_Wu16 65535.00 DFES_OneToOne 0.00 65535.00 FORMAT "%8.2" /end CHARACTERISTIC
/begin CHARACTERISTIC DFES_DTCM.DFC_ETClbETMax_3_C "/" VALUE 0x8007424A Val_Wu16 65535.00 DFES_OneToOne 0.00 65535.00 FORMAT "%8.2" /end CHARACTERISTIC
/begin CHARACTERISTIC DFES_DTCM.DFC_ETClbETMax_4_C "/" VALUE 0x8007424C Val_Wu16 65535.00 DFES_OneToOne 0.00 65535.00 FORMAT "%8.2" /end CHARACTERISTIC
/begin CHARACTERISTIC DFES_DTCM.DFC_ETClbETMax_5_C "/" VALUE 0x8007424E Val_Wu16 65535.00 DFES_OneToOne 0.00 65535.00 FORMAT "%8.2" /end CHARACTERISTIC
/begin CHARACTERISTIC DFES_DTCM.DFC_ETClbETMin_0_C "/" VALUE 0x80074250 Val_Wu16 65535.00 DFES_OneToOne 0.00 65535.00 FORMAT "%8.2" /end CHARACTERISTIC
/begin CHARACTERISTIC DFES_DTCM.DFC_ETClbETMin_1_C "/" VALUE 0x80074252 Val_Wu16 65535.00 DFES_OneToOne 0.00 65535.00 FORMAT "%8.2" /end CHARACTERISTIC
/begin CHARACTERISTIC DFES_DTCM.DFC_ETClbETMin_2_C "/" VALUE 0x80074254 Val_Wu16 65535.00 DFES_OneToOne 0.00 65535.00 FORMAT "%8.2" /end CHARACTERISTIC
/begin CHARACTERISTIC DFES_DTCM.DFC_ETClbETMin_3_C "/" VALUE 0x80074256 Val_Wu16 65535.00 DFES_OneToOne 0.00 65535.00 FORMAT "%8.2" /end CHARACTERISTIC
/begin CHARACTERISTIC DFES_DTCM.DFC_ETClbETMin_4_C "/" VALUE 0x80074258 Val_Wu16 65535.00 DFES_OneToOne 0.00 65535.00 FORMAT "%8.2" /end CHARACTERISTIC
/begin CHARACTERISTIC DFES_DTCM.DFC_ETClbETMin_5_C "/" VALUE 0x8007425A Val_Wu16 65535.00 DFES_OneToOne 0.00 65535.00 FORMAT "%8.2" /end CHARACTERISTIC
/begin CHARACTERISTIC DFES_DTCM.DFC_IVDiaBnkShCirBSH_0_C "/" VALUE 0x8007425C Val_Wu16 65535.00 DFES_OneToOne 0.00 65535.00 FORMAT "%8.2" /end CHARACTERISTIC
/begin CHARACTERISTIC DFES_DTCM.DFC_IVDiaBnkShCirBSH_1_C "/" VALUE 0x8007425E Val_Wu16 65535.00 DFES_OneToOne 0.00 65535.00 FORMAT "%8.2" /end CHARACTERISTIC
/begin CHARACTERISTIC DFES_DTCM.DFC_IVDiaBnkShCirChSwt_0_C "/" VALUE 0x80074260 Val_Wu16 65535.00 DFES_OneToOne 0.00 65535.00 FORMAT "%8.2" /end CHARACTERISTIC
/begin CHARACTERISTIC DFES_DTCM.DFC_IVDiaBnkShCirChSwt_1_C "/" VALUE 0x80074262 Val_Wu16 65535.00 DFES_OneToOne 0.00 65535.00 FORMAT "%8.2" /end CHARACTERISTIC
/begin CHARACTERISTIC DFES_DTCM.DFC_IVDiaBnkShCirHSBatt_0_C "/" VALUE 0x80074264 Val_Wu16 65535.00 DFES_OneToOne 0.00 65535.00 FORMAT "%8.2" /end CHARACTERISTIC
/begin CHARACTERISTIC DFES_DTCM.DFC_IVDiaBnkShCirHSBatt_1_C "/" VALUE 0x80074266 Val_Wu16 65535.00 DFES_OneToOne 0.00 65535.00 FORMAT "%8.2" /end CHARACTERISTIC
/begin CHARACTERISTIC DFES_DTCM.DFC_IVDiaBnkShCirHiRstnc_0_C "/" VALUE 0x80074268 Val_Wu16 65535.00 DFES_OneToOne 0.00 65535.00 FORMAT "%8.2" /end CHARACTERISTIC
/begin CHARACTERISTIC DFES_DTCM.DFC_IVDiaBnkShCirHiRstnc_1_C "/" VALUE 0x8007426A Val_Wu16 65535.00 DFES_OneToOne 0.00 65535.00 FORMAT "%8.2" /end CHARACTERISTIC
/begin CHARACTERISTIC DFES_DTCM.DFC_IVDiaBnkShCirLSHSGnd_0_C "/" VALUE 0x8007426C Val_Wu16 65535.00 DFES_OneToOne 0.00 65535.00 FORMAT "%8.2" /end CHARACTERISTIC
/begin CHARACTERISTIC DFES_DTCM.DFC_IVDiaBnkShCirLSHSGnd_1_C "/" VALUE 0x8007426E Val_Wu16 65535.00 DFES_OneToOne 0.00 65535.00 FORMAT "%8.2" /end CHARACTERISTIC
/begin CHARACTERISTIC DFES_DTCM.DFC_IVDiaBnkShCirTransfer_0_C "/" VALUE 0x80074270 Val_Wu16 65535.00 DFES_OneToOne 0.00 65535.00 FORMAT "%8.2" /end CHARACTERISTIC
/begin CHARACTERISTIC DFES_DTCM.DFC_IVDiaBnkShCirTransfer_1_C "/" VALUE 0x80074272 Val_Wu16 65535.00 DFES_OneToOne 0.00 65535.00 FORMAT "%8.2" /end CHARACTERISTIC
/begin CHARACTERISTIC DFES_DTCM.DFC_IVDiaCylNoCls_0_C "/" VALUE 0x80074274 Val_Wu16 65535.00 DFES_OneToOne 0.00 65535.00 FORMAT "%8.2" /end CHARACTERISTIC
/begin CHARACTERISTIC DFES_DTCM.DFC_IVDiaCylNoCls_1_C "/" VALUE 0x80074276 Val_Wu16 65535.00 DFES_OneToOne 0.00 65535.00 FORMAT "%8.2" /end CHARACTERISTIC
/begin CHARACTERISTIC DFES_DTCM.DFC_IVDiaCylNoCls_2_C "/" VALUE 0x80074278 Val_Wu16 65535.00 DFES_OneToOne 0.00 65535.00 FORMAT "%8.2" /end CHARACTERISTIC
/begin CHARACTERISTIC DFES_DTCM.DFC_IVDiaCylNoCls_3_C "/" VALUE 0x8007427A Val_Wu16 65535.00 DFES_OneToOne 0.00 65535.00 FORMAT "%8.2" /end CHARACTERISTIC
/begin CHARACTERISTIC DFES_DTCM.DFC_IVDiaCylNoCls_4_C "/" VALUE 0x8007427C Val_Wu16 65535.00 DFES_OneToOne 0.00 65535.00 FORMAT "%8.2" /end CHARACTERISTIC
/begin CHARACTERISTIC DFES_DTCM.DFC_IVDiaCylNoCls_5_C "/" VALUE 0x8007427E Val_Wu16 65535.00 DFES_OneToOne 0.00 65535.00 FORMAT "%8.2" /end CHARACTERISTIC
/begin CHARACTERISTIC DFES_DTCM.DFC_IVDiaCylNoLd_0_C "/" VALUE 0x80074280 Val_Wu16 65535.00 DFES_OneToOne 0.00 65535.00 FORMAT "%8.2" /end CHARACTERISTIC
/begin CHARACTERISTIC DFES_DTCM.DFC_IVDiaCylNoLd_1_C "/" VALUE 0x80074282 Val_Wu16 65535.00 DFES_OneToOne 0.00 65535.00 FORMAT "%8.2" /end CHARACTERISTIC
/begin CHARACTERISTIC DFES_DTCM.DFC_IVDiaCylNoLd_2_C "/" VALUE 0x80074284 Val_Wu16 65535.00 DFES_OneToOne 0.00 65535.00 FORMAT "%8.2" /end CHARACTERISTIC
/begin CHARACTERISTIC DFES_DTCM.DFC_IVDiaCylNoLd_3_C "/" VALUE 0x80074286 Val_Wu16 65535.00 DFES_OneToOne 0.00 65535.00 FORMAT "%8.2" /end CHARACTERISTIC
/begin CHARACTERISTIC DFES_DTCM.DFC_IVDiaCylNoLd_4_C "/" VALUE 0x80074288 Val_Wu16 65535.00 DFES_OneToOne 0.00 65535.00 FORMAT "%8.2" /end CHARACTERISTIC
/begin CHARACTERISTIC DFES_DTCM.DFC_IVDiaCylNoLd_5_C "/" VALUE 0x8007428A Val_Wu16 65535.00 DFES_OneToOne 0.00 65535.00 FORMAT "%8.2" /end CHARACTERISTIC
/begin CHARACTERISTIC DFES_DTCM.DFC_IVDiaCylShCirHiRstnc_0_C "/" VALUE 0x8007428C Val_Wu16 65535.00 DFES_OneToOne 0.00 65535.00 FORMAT "%8.2" /end CHARACTERISTIC
/begin CHARACTERISTIC DFES_DTCM.DFC_IVDiaCylShCirHiRstnc_1_C "/" VALUE 0x8007428E Val_Wu16 65535.00 DFES_OneToOne 0.00 65535.00 FORMAT "%8.2" /end CHARACTERISTIC
/begin CHARACTERISTIC DFES_DTCM.DFC_IVDiaCylShCirHiRstnc_2_C "/" VALUE 0x80074290 Val_Wu16 65535.00 DFES_OneToOne 0.00 65535.00 FORMAT "%8.2" /end CHARACTERISTIC
/begin CHARACTERISTIC DFES_DTCM.DFC_IVDiaCylShCirHiRstnc_3_C "/" VALUE 0x80074292 Val_Wu16 65535.00 DFES_OneToOne 0.00 65535.00 FORMAT "%8.2" /end CHARACTERISTIC
/begin CHARACTERISTIC DFES_DTCM.DFC_IVDiaCylShCirHiRstnc_4_C "/" VALUE 0x80074294 Val_Wu16 65535.00 DFES_OneToOne 0.00 65535.00 FORMAT "%8.2" /end CHARACTERISTIC
/begin CHARACTERISTIC DFES_DTCM.DFC_IVDiaCylShCirHiRstnc_5_C "/" VALUE 0x80074296 Val_Wu16 65535.00 DFES_OneToOne 0.00 65535.00 FORMAT "%8.2" /end CHARACTERISTIC
/begin CHARACTERISTIC DFES_DTCM.DFC_IVDiaCylShCirLSBatt_0_C "/" VALUE 0x80074298 Val_Wu16 65535.00 DFES_OneToOne 0.00 65535.00 FORMAT "%8.2" /end CHARACTERISTIC
/begin CHARACTERISTIC DFES_DTCM.DFC_IVDiaCylShCirLSBatt_1_C "/" VALUE 0x8007429A Val_Wu16 65535.00 DFES_OneToOne 0.00 65535.00 FORMAT "%8.2" /end CHARACTERISTIC
/begin CHARACTERISTIC DFES_DTCM.DFC_IVDiaCylShCirLSBatt_2_C "/" VALUE 0x8007429C Val_Wu16 65535.00 DFES_OneToOne 0.00 65535.00 FORMAT "%8.2" /end CHARACTERISTIC
/begin CHARACTERISTIC DFES_DTCM.DFC_IVDiaCylShCirLSBatt_3_C "/" VALUE 0x8007429E Val_Wu16 65535.00 DFES_OneToOne 0.00 65535.00 FORMAT "%8.2" /end CHARACTERISTIC
/begin CHARACTERISTIC DFES_DTCM.DFC_IVDiaCylShCirLSBatt_4_C "/" VALUE 0x800742A0 Val_Wu16 65535.00 DFES_OneToOne 0.00 65535.00 FORMAT "%8.2" /end CHARACTERISTIC
/begin CHARACTERISTIC DFES_DTCM.DFC_IVDiaCylShCirLSBatt_5_C "/" VALUE 0x800742A2 Val_Wu16 65535.00 DFES_OneToOne 0.00 65535.00 FORMAT "%8.2" /end CHARACTERISTIC
/begin CHARACTERISTIC DFES_DTCM.DFC_IVDiaCylShCirLSHS_0_C "/" VALUE 0x800742A4 Val_Wu16 65535.00 DFES_OneToOne 0.00 65535.00 FORMAT "%8.2" /end CHARACTERISTIC
/begin CHARACTERISTIC DFES_DTCM.DFC_IVDiaCylShCirLSHS_1_C "/" VALUE 0x800742A6 Val_Wu16 65535.00 DFES_OneToOne 0.00 65535.00 FORMAT "%8.2" /end CHARACTERISTIC
/begin CHARACTERISTIC DFES_DTCM.DFC_IVDiaCylShCirLSHS_2_C "/" VALUE 0x800742A8 Val_Wu16 65535.00 DFES_OneToOne 0.00 65535.00 FORMAT "%8.2" /end CHARACTERISTIC
/begin CHARACTERISTIC DFES_DTCM.DFC_IVDiaCylShCirLSHS_3_C "/" VALUE 0x800742AA Val_Wu16 65535.00 DFES_OneToOne 0.00 65535.00 FORMAT "%8.2" /end CHARACTERISTIC
/begin CHARACTERISTIC DFES_DTCM.DFC_IVDiaCylShCirLSHS_4_C "/" VALUE 0x800742AC Val_Wu16 65535.00 DFES_OneToOne 0.00 65535.00 FORMAT "%8.2" /end CHARACTERISTIC
/begin CHARACTERISTIC DFES_DTCM.DFC_IVDiaCylShCirLSHS_5_C "/" VALUE 0x800742AE Val_Wu16 65535.00 DFES_OneToOne 0.00 65535.00 FORMAT "%8.2" /end CHARACTERISTIC
/begin CHARACTERISTIC DFES_DTCM.DFC_IVDiaCylShCirLsLs_0_C "/" VALUE 0x800742B0 Val_Wu16 65535.00 DFES_OneToOne 0.00 65535.00 FORMAT "%8.2" /end CHARACTERISTIC
/begin CHARACTERISTIC DFES_DTCM.DFC_IVDiaCylShCirLsLs_1_C "/" VALUE 0x800742B2 Val_Wu16 65535.00 DFES_OneToOne 0.00 65535.00 FORMAT "%8.2" /end CHARACTERISTIC
/begin CHARACTERISTIC DFES_DTCM.DFC_IVDiaCylShCirLsLs_2_C "/" VALUE 0x800742B4 Val_Wu16 65535.00 DFES_OneToOne 0.00 65535.00 FORMAT "%8.2" /end CHARACTERISTIC
/begin CHARACTERISTIC DFES_DTCM.DFC_IVDiaCylShCirLsLs_3_C "/" VALUE 0x800742B6 Val_Wu16 65535.00 DFES_OneToOne 0.00 65535.00 FORMAT "%8.2" /end CHARACTERISTIC
/begin CHARACTERISTIC DFES_DTCM.DFC_IVDiaCylShCirLsLs_4_C "/" VALUE 0x800742B8 Val_Wu16 65535.00 DFES_OneToOne 0.00 65535.00 FORMAT "%8.2" /end CHARACTERISTIC
/begin CHARACTERISTIC DFES_DTCM.DFC_IVDiaCylShCirLsLs_5_C "/" VALUE 0x800742BA Val_Wu16 65535.00 DFES_OneToOne 0.00 65535.00 FORMAT "%8.2" /end CHARACTERISTIC
/begin CHARACTERISTIC DFES_DTCM.DFC_IVDiaSPICfg_C "/" VALUE 0x800742BC Val_Wu16 65535.00 DFES_OneToOne 0.00 65535.00 FORMAT "%8.2" /end CHARACTERISTIC
/begin CHARACTERISTIC DFES_DTCM.DFC_IVDiaSPIColl_C "/" VALUE 0x800742BE Val_Wu16 65535.00 DFES_OneToOne 0.00 65535.00 FORMAT "%8.2" /end CHARACTERISTIC
/begin CHARACTERISTIC DFES_DTCM.DFC_IVDiaSPICtrl_C "/" VALUE 0x800742C0 Val_Wu16 65535.00 DFES_OneToOne 0.00 65535.00 FORMAT "%8.2" /end CHARACTERISTIC
/begin CHARACTERISTIC DFES_DTCM.DFC_IVDiaSPIRam_C "/" VALUE 0x800742C2 Val_Wu16 65535.00 DFES_OneToOne 0.00 65535.00 FORMAT "%8.2" /end CHARACTERISTIC
/begin CHARACTERISTIC DFES_DTCM.DFC_IVDiaSPITrans_C "/" VALUE 0x800742C4 Val_Wu16 65535.00 DFES_OneToOne 0.00 65535.00 FORMAT "%8.2" /end CHARACTERISTIC
/begin CHARACTERISTIC DFES_DTCM.DFC_LSUCmpChk_0_C "/" VALUE 0x800742C6 Val_Wu16 65535.00 DFES_OneToOne 0.00 65535.00 FORMAT "%8.2" /end CHARACTERISTIC
/begin CHARACTERISTIC DFES_DTCM.DFC_LSUCmpChk_1_C "/" VALUE 0x800742C8 Val_Wu16 65535.00 DFES_OneToOne 0.00 65535.00 FORMAT "%8.2" /end CHARACTERISTIC
/begin CHARACTERISTIC DFES_DTCM.DFC_LSUCmpChk_2_C "/" VALUE 0x800742CA Val_Wu16 65535.00 DFES_OneToOne 0.00 65535.00 FORMAT "%8.2" /end CHARACTERISTIC
/begin CHARACTERISTIC DFES_DTCM.DFC_LSUCmpChk_3_C "/" VALUE 0x800742CC Val_Wu16 65535.00 DFES_OneToOne 0.00 65535.00 FORMAT "%8.2" /end CHARACTERISTIC
/begin CHARACTERISTIC DFES_DTCM.DFC_LSUCmpChk_4_C "/" VALUE 0x800742CE Val_Wu16 65535.00 DFES_OneToOne 0.00 65535.00 FORMAT "%8.2" /end CHARACTERISTIC
/begin CHARACTERISTIC DFES_DTCM.DFC_LSUCmpChk_5_C "/" VALUE 0x800742D0 Val_Wu16 65535.00 DFES_OneToOne 0.00 65535.00 FORMAT "%8.2" /end CHARACTERISTIC
/begin CHARACTERISTIC DFES_DTCM.DFC_LSUDynChk_0_C "/" VALUE 0x800742D2 Val_Wu16 65535.00 DFES_OneToOne 0.00 65535.00 FORMAT "%8.2" /end CHARACTERISTIC
/begin CHARACTERISTIC DFES_DTCM.DFC_LSUDynChk_1_C "/" VALUE 0x800742D4 Val_Wu16 65535.00 DFES_OneToOne 0.00 65535.00 FORMAT "%8.2" /end CHARACTERISTIC
/begin CHARACTERISTIC DFES_DTCM.DFC_LSUDynChk_2_C "/" VALUE 0x800742D6 Val_Wu16 65535.00 DFES_OneToOne 0.00 65535.00 FORMAT "%8.2" /end CHARACTERISTIC
/begin CHARACTERISTIC DFES_DTCM.DFC_LSUDynChk_3_C "/" VALUE 0x800742D8 Val_Wu16 65535.00 DFES_OneToOne 0.00 65535.00 FORMAT "%8.2" /end CHARACTERISTIC
/begin CHARACTERISTIC DFES_DTCM.DFC_LSUO2ClbMax_0_C "/" VALUE 0x800742DA Val_Wu16 65535.00 DFES_OneToOne 0.00 65535.00 FORMAT "%8.2" /end CHARACTERISTIC
/begin CHARACTERISTIC DFES_DTCM.DFC_LSUO2ClbMax_1_C "/" VALUE 0x800742DC Val_Wu16 65535.00 DFES_OneToOne 0.00 65535.00 FORMAT "%8.2" /end CHARACTERISTIC
/begin CHARACTERISTIC DFES_DTCM.DFC_LSUO2ClbMax_2_C "/" VALUE 0x800742DE Val_Wu16 65535.00 DFES_OneToOne 0.00 65535.00 FORMAT "%8.2" /end CHARACTERISTIC
/begin CHARACTERISTIC DFES_DTCM.DFC_LSUO2ClbMax_3_C "/" VALUE 0x800742E0 Val_Wu16 65535.00 DFES_OneToOne 0.00 65535.00 FORMAT "%8.2" /end CHARACTERISTIC
/begin CHARACTERISTIC DFES_DTCM.DFC_LSUO2ClbMin_0_C "/" VALUE 0x800742E2 Val_Wu16 65535.00 DFES_OneToOne 0.00 65535.00 FORMAT "%8.2" /end CHARACTERISTIC
/begin CHARACTERISTIC DFES_DTCM.DFC_LSUO2ClbMin_1_C "/" VALUE 0x800742E4 Val_Wu16 65535.00 DFES_OneToOne 0.00 65535.00 FORMAT "%8.2" /end CHARACTERISTIC
/begin CHARACTERISTIC DFES_DTCM.DFC_LSUO2ClbMin_2_C "/" VALUE 0x800742E6 Val_Wu16 65535.00 DFES_OneToOne 0.00 65535.00 FORMAT "%8.2" /end CHARACTERISTIC
/begin CHARACTERISTIC DFES_DTCM.DFC_LSUO2ClbMin_3_C "/" VALUE 0x800742E8 Val_Wu16 65535.00 DFES_OneToOne 0.00 65535.00 FORMAT "%8.2" /end CHARACTERISTIC
/begin CHARACTERISTIC DFES_DTCM.DFC_LSUO2PlausMax_0_C "/" VALUE 0x800742EA Val_Wu16 65535.00 DFES_OneToOne 0.00 65535.00 FORMAT "%8.2" /end CHARACTERISTIC
/begin CHARACTERISTIC DFES_DTCM.DFC_LSUO2PlausMax_1_C "/" VALUE 0x800742EC Val_Wu16 65535.00 DFES_OneToOne 0.00 65535.00 FORMAT "%8.2" /end CHARACTERISTIC
/begin CHARACTERISTIC DFES_DTCM.DFC_LSUO2PlausMax_2_C "/" VALUE 0x800742EE Val_Wu16 65535.00 DFES_OneToOne 0.00 65535.00 FORMAT "%8.2" /end CHARACTERISTIC
/begin CHARACTERISTIC DFES_DTCM.DFC_LSUO2PlausMax_3_C "/" VALUE 0x800742F0 Val_Wu16 65535.00 DFES_OneToOne 0.00 65535.00 FORMAT "%8.2" /end CHARACTERISTIC
/begin CHARACTERISTIC DFES_DTCM.DFC_LSUO2PlausMin_0_C "/" VALUE 0x800742F2 Val_Wu16 65535.00 DFES_OneToOne 0.00 65535.00 FORMAT "%8.2" /end CHARACTERISTIC
/begin CHARACTERISTIC DFES_DTCM.DFC_LSUO2PlausMin_1_C "/" VALUE 0x800742F4 Val_Wu16 65535.00 DFES_OneToOne 0.00 65535.00 FORMAT "%8.2" /end CHARACTERISTIC
/begin CHARACTERISTIC DFES_DTCM.DFC_LSUO2PlausMin_2_C "/" VALUE 0x800742F6 Val_Wu16 65535.00 DFES_OneToOne 0.00 65535.00 FORMAT "%8.2" /end CHARACTERISTIC
/begin CHARACTERISTIC DFES_DTCM.DFC_LSUO2PlausMin_3_C "/" VALUE 0x800742F8 Val_Wu16 65535.00 DFES_OneToOne 0.00 65535.00 FORMAT "%8.2" /end CHARACTERISTIC
/begin CHARACTERISTIC DFES_DTCM.DFC_LSURiClbMax_0_C "/" VALUE 0x800742FA Val_Wu16 65535.00 DFES_OneToOne 0.00 65535.00 FORMAT "%8.2" /end CHARACTERISTIC
/begin CHARACTERISTIC DFES_DTCM.DFC_LSURiClbMax_1_C "/" VALUE 0x800742FC Val_Wu16 65535.00 DFES_OneToOne 0.00 65535.00 FORMAT "%8.2" /end CHARACTERISTIC
/begin CHARACTERISTIC DFES_DTCM.DFC_LSURiClbMax_2_C "/" VALUE 0x800742FE Val_Wu16 65535.00 DFES_OneToOne 0.00 65535.00 FORMAT "%8.2" /end CHARACTERISTIC
/begin CHARACTERISTIC DFES_DTCM.DFC_LSURiClbMax_3_C "/" VALUE 0x80074300 Val_Wu16 65535.00 DFES_OneToOne 0.00 65535.00 FORMAT "%8.2" /end CHARACTERISTIC
/begin CHARACTERISTIC DFES_DTCM.DFC_LSURiClbMin_0_C "/" VALUE 0x80074302 Val_Wu16 65535.00 DFES_OneToOne 0.00 65535.00 FORMAT "%8.2" /end CHARACTERISTIC
/begin CHARACTERISTIC DFES_DTCM.DFC_LSURiClbMin_1_C "/" VALUE 0x80074304 Val_Wu16 65535.00 DFES_OneToOne 0.00 65535.00 FORMAT "%8.2" /end CHARACTERISTIC
/begin CHARACTERISTIC DFES_DTCM.DFC_LSURiClbMin_2_C "/" VALUE 0x80074306 Val_Wu16 65535.00 DFES_OneToOne 0.00 65535.00 FORMAT "%8.2" /end CHARACTERISTIC
/begin CHARACTERISTIC DFES_DTCM.DFC_LSURiClbMin_3_C "/" VALUE 0x80074308 Val_Wu16 65535.00 DFES_OneToOne 0.00 65535.00 FORMAT "%8.2" /end CHARACTERISTIC
/begin CHARACTERISTIC DFES_DTCM.DFC_LSUWireIPSig_0_C "/" VALUE 0x8007430A Val_Wu16 65535.00 DFES_OneToOne 0.00 65535.00 FORMAT "%8.2" /end CHARACTERISTIC
/begin CHARACTERISTIC DFES_DTCM.DFC_LSUWireIPSig_1_C "/" VALUE 0x8007430C Val_Wu16 65535.00 DFES_OneToOne 0.00 65535.00 FORMAT "%8.2" /end CHARACTERISTIC
/begin CHARACTERISTIC DFES_DTCM.DFC_LSUWireIPSig_2_C "/" VALUE 0x8007430E Val_Wu16 65535.00 DFES_OneToOne 0.00 65535.00 FORMAT "%8.2" /end CHARACTERISTIC
/begin CHARACTERISTIC DFES_DTCM.DFC_LSUWireIPSig_3_C "/" VALUE 0x80074310 Val_Wu16 65535.00 DFES_OneToOne 0.00 65535.00 FORMAT "%8.2" /end CHARACTERISTIC
/begin CHARACTERISTIC DFES_DTCM.DFC_AFSDrftIdlAdjVal_C "/" VALUE 0x80074312 Val_Wu16 65535.00 DFES_OneToOne 0.00 65535.00 FORMAT "%8.2" /end CHARACTERISTIC
/begin CHARACTERISTIC DFES_DTCM.DFC_AFSDrftLdAdjVal_C "/" VALUE 0x80074314 Val_Wu16 65535.00 DFES_OneToOne 0.00 65535.00 FORMAT "%8.2" /end CHARACTERISTIC
/begin CHARACTERISTIC DFES_DTCM.DFC_AdcI_ADC0_Cal_C "/" VALUE 0x80074316 Val_Wu16 65535.00 DFES_OneToOne 0.00 65535.00 FORMAT "%8.2" /end CHARACTERISTIC
/begin CHARACTERISTIC DFES_DTCM.DFC_AdcI_ADC0_Conv_C "/" VALUE 0x80074318 Val_Wu16 65535.00 DFES_OneToOne 0.00 65535.00 FORMAT "%8.2" /end CHARACTERISTIC
/begin CHARACTERISTIC DFES_DTCM.DFC_CmbChbMisfireMax_0_C "/" VALUE 0x8007431A Val_Wu16 65535.00 DFES_OneToOne 0.00 65535.00 FORMAT "%8.2" /end CHARACTERISTIC
/begin CHARACTERISTIC DFES_DTCM.DFC_CmbChbMisfireMax_1_C "/" VALUE 0x8007431C Val_Wu16 65535.00 DFES_OneToOne 0.00 65535.00 FORMAT "%8.2" /end CHARACTERISTIC
/begin CHARACTERISTIC DFES_DTCM.DFC_CmbChbMisfireMax_2_C "/" VALUE 0x8007431E Val_Wu16 65535.00 DFES_OneToOne 0.00 65535.00 FORMAT "%8.2" /end CHARACTERISTIC
/begin CHARACTERISTIC DFES_DTCM.DFC_CmbChbMisfireMax_3_C "/" VALUE 0x80074320 Val_Wu16 65535.00 DFES_OneToOne 0.00 65535.00 FORMAT "%8.2" /end CHARACTERISTIC
/begin CHARACTERISTIC DFES_DTCM.DFC_CmbChbMisfireMax_4_C "/" VALUE 0x80074322 Val_Wu16 65535.00 DFES_OneToOne 0.00 65535.00 FORMAT "%8.2" /end CHARACTERISTIC
/begin CHARACTERISTIC DFES_DTCM.DFC_CmbChbMisfireMax_5_C "/" VALUE 0x80074324 Val_Wu16 65535.00 DFES_OneToOne 0.00 65535.00 FORMAT "%8.2" /end CHARACTERISTIC
/begin CHARACTERISTIC DFES_DTCM.DFC_CmbChbMisfireMul_C "/" VALUE 0x80074326 Val_Wu16 65535.00 DFES_OneToOne 0.00 65535.00 FORMAT "%8.2" /end CHARACTERISTIC
/begin CHARACTERISTIC DFES_DTCM.DFC_INJVLVBUSY_C "/" VALUE 0x80074328 Val_Wu16 65535.00 DFES_OneToOne 0.00 65535.00 FORMAT "%8.2" /end CHARACTERISTIC
/begin CHARACTERISTIC DFES_DTCM.DFC_IVAdjIVA_0_C "/" VALUE 0x8007432A Val_Wu16 65535.00 DFES_OneToOne 0.00 65535.00 FORMAT "%8.2" /end CHARACTERISTIC
/begin CHARACTERISTIC DFES_DTCM.DFC_IVAdjIVA_1_C "/" VALUE 0x8007432C Val_Wu16 65535.00 DFES_OneToOne 0.00 65535.00 FORMAT "%8.2" /end CHARACTERISTIC
/begin CHARACTERISTIC DFES_DTCM.DFC_IVAdjIVA_2_C "/" VALUE 0x8007432E Val_Wu16 65535.00 DFES_OneToOne 0.00 65535.00 FORMAT "%8.2" /end CHARACTERISTIC
/begin CHARACTERISTIC DFES_DTCM.DFC_IVAdjIVA_3_C "/" VALUE 0x80074330 Val_Wu16 65535.00 DFES_OneToOne 0.00 65535.00 FORMAT "%8.2" /end CHARACTERISTIC
/begin CHARACTERISTIC DFES_DTCM.DFC_IVAdjIVA_4_C "/" VALUE 0x80074332 Val_Wu16 65535.00 DFES_OneToOne 0.00 65535.00 FORMAT "%8.2" /end CHARACTERISTIC
/begin CHARACTERISTIC DFES_DTCM.DFC_IVAdjIVA_5_C "/" VALUE 0x80074334 Val_Wu16 65535.00 DFES_OneToOne 0.00 65535.00 FORMAT "%8.2" /end CHARACTERISTIC
/begin CHARACTERISTIC DFES_DTCM.DFC_InjCtlAdjQntEEPCS_C "/" VALUE 0x80074336 Val_Wu16 65535.00 DFES_OneToOne 0.00 65535.00 FORMAT "%8.2" /end CHARACTERISTIC
/begin CHARACTERISTIC DFES_DTCM.DFC_InjCtlDriftEEPCS_C "/" VALUE 0x80074338 Val_Wu16 65535.00 DFES_OneToOne 0.00 65535.00 FORMAT "%8.2" /end CHARACTERISTIC
/begin CHARACTERISTIC DFES_DTCM.DFC_MRlyErlyOpng_C "/" VALUE 0x8007433A Val_Wu16 65535.00 DFES_OneToOne 0.00 65535.00 FORMAT "%8.2" /end CHARACTERISTIC
/begin CHARACTERISTIC DFES_DTCM.DFC_MRlyStk_C "/" VALUE 0x8007433C Val_Wu16 65535.00 DFES_OneToOne 0.00 65535.00 FORMAT "%8.2" /end CHARACTERISTIC
/begin CHARACTERISTIC DFES_DTCM.DFC_SensFrzPPFltUs_C "/" VALUE 0x8007433E Val_Wu16 65535.00 DFES_OneToOne 0.00 65535.00 FORMAT "%8.2" /end CHARACTERISTIC
/begin CHARACTERISTIC DFES_DTCM.DFC_T15Sig_C "/" VALUE 0x80074340 Val_Wu16 65535.00 DFES_OneToOne 0.00 65535.00 FORMAT "%8.2" /end CHARACTERISTIC
/begin CHARACTERISTIC DFES_DTCM.DFC_AirCtlRmpTOut_C "/" VALUE 0x80074342 Val_Wu16 65535.00 DFES_OneToOne 0.00 65535.00 FORMAT "%8.2" /end CHARACTERISTIC
/begin CHARACTERISTIC DFES_DTCM.DFC_CEngDsTDynTst_C "/" VALUE 0x80074344 Val_Wu16 65535.00 DFES_OneToOne 0.00 65535.00 FORMAT "%8.2" /end CHARACTERISTIC
/begin CHARACTERISTIC DFES_DTCM.DFC_EGRVlvJamVlvClsd_C "/" VALUE 0x80074346 Val_Wu16 65535.00 DFES_OneToOne 0.00 65535.00 FORMAT "%8.2" /end CHARACTERISTIC
/begin CHARACTERISTIC DFES_DTCM.DFC_EGRVlvJamVlvOpn_C "/" VALUE 0x80074348 Val_Wu16 65535.00 DFES_OneToOne 0.00 65535.00 FORMAT "%8.2" /end CHARACTERISTIC
/begin CHARACTERISTIC DFES_DTCM.DFC_EGRVlvLgTDrft_C "/" VALUE 0x8007434A Val_Wu16 65535.00 DFES_OneToOne 0.00 65535.00 FORMAT "%8.2" /end CHARACTERISTIC
/begin CHARACTERISTIC DFES_DTCM.DFC_EGRVlvOfsLrnJamVlv_C "/" VALUE 0x8007434C Val_Wu16 65535.00 DFES_OneToOne 0.00 65535.00 FORMAT "%8.2" /end CHARACTERISTIC
/begin CHARACTERISTIC DFES_DTCM.DFC_EGRVlvShTDrft_C "/" VALUE 0x8007434E Val_Wu16 65535.00 DFES_OneToOne 0.00 65535.00 FORMAT "%8.2" /end CHARACTERISTIC
/begin CHARACTERISTIC DFES_DTCM.DFC_EGTRgnOilDilMax_C "/" VALUE 0x80074350 Val_Wu16 65535.00 DFES_OneToOne 0.00 65535.00 FORMAT "%8.2" /end CHARACTERISTIC
/begin CHARACTERISTIC DFES_DTCM.DFC_EngICO_C "/" VALUE 0x80074352 Val_Wu16 65535.00 DFES_OneToOne 0.00 65535.00 FORMAT "%8.2" /end CHARACTERISTIC
/begin CHARACTERISTIC DFES_DTCM.DFC_EpmCaSI1ErrSig_C "/" VALUE 0x80074354 Val_Wu16 65535.00 DFES_OneToOne 0.00 65535.00 FORMAT "%8.2" /end CHARACTERISTIC
/begin CHARACTERISTIC DFES_DTCM.DFC_EpmCaSI1NoSig_C "/" VALUE 0x80074356 Val_Wu16 65535.00 DFES_OneToOne 0.00 65535.00 FORMAT "%8.2" /end CHARACTERISTIC
/begin CHARACTERISTIC DFES_DTCM.DFC_EpmCaSI1OfsErr_C "/" VALUE 0x80074358 Val_Wu16 65535.00 DFES_OneToOne 0.00 65535.00 FORMAT "%8.2" /end CHARACTERISTIC
/begin CHARACTERISTIC DFES_DTCM.DFC_EpmCrSErrSig_C "/" VALUE 0x8007435A Val_Wu16 65535.00 DFES_OneToOne 0.00 65535.00 FORMAT "%8.2" /end CHARACTERISTIC
/begin CHARACTERISTIC DFES_DTCM.DFC_EpmCrSNoSig_C "/" VALUE 0x8007435C Val_Wu16 65535.00 DFES_OneToOne 0.00 65535.00 FORMAT "%8.2" /end CHARACTERISTIC
/begin CHARACTERISTIC DFES_DTCM.DFC_MoCADCCmp_C "/" VALUE 0x8007435E Val_Wu16 65535.00 DFES_OneToOne 0.00 65535.00 FORMAT "%8.2" /end CHARACTERISTIC
/begin CHARACTERISTIC DFES_DTCM.DFC_MoCADCTst_C "/" VALUE 0x80074360 Val_Wu16 65535.00 DFES_OneToOne 0.00 65535.00 FORMAT "%8.2" /end CHARACTERISTIC
/begin CHARACTERISTIC DFES_DTCM.DFC_MoCADCVltgRatio_C "/" VALUE 0x80074362 Val_Wu16 65535.00 DFES_OneToOne 0.00 65535.00 FORMAT "%8.2" /end CHARACTERISTIC
/begin CHARACTERISTIC DFES_DTCM.DFC_MoCSOPLoLi_C "/" VALUE 0x80074364 Val_Wu16 65535.00 DFES_OneToOne 0.00 65535.00 FORMAT "%8.2" /end CHARACTERISTIC
/begin CHARACTERISTIC DFES_DTCM.DFC_MoCSOPMM_C "/" VALUE 0x80074366 Val_Wu16 65535.00 DFES_OneToOne 0.00 65535.00 FORMAT "%8.2" /end CHARACTERISTIC
/begin CHARACTERISTIC DFES_DTCM.DFC_MoCSOPTimeOut_C "/" VALUE 0x80074368 Val_Wu16 65535.00 DFES_OneToOne 0.00 65535.00 FORMAT "%8.2" /end CHARACTERISTIC
/begin CHARACTERISTIC DFES_DTCM.DFC_MoCSOPUpLi_C "/" VALUE 0x8007436A Val_Wu16 65535.00 DFES_OneToOne 0.00 65535.00 FORMAT "%8.2" /end CHARACTERISTIC
/begin CHARACTERISTIC DFES_DTCM.DFC_MoFAPP_C "/" VALUE 0x8007436C Val_Wu16 65535.00 DFES_OneToOne 0.00 65535.00 FORMAT "%8.2" /end CHARACTERISTIC
/begin CHARACTERISTIC DFES_DTCM.DFC_MoFESpd_C "/" VALUE 0x8007436E Val_Wu16 65535.00 DFES_OneToOne 0.00 65535.00 FORMAT "%8.2" /end CHARACTERISTIC
/begin CHARACTERISTIC DFES_DTCM.DFC_MoFInjDatPhi_C "/" VALUE 0x80074370 Val_Wu16 65535.00 DFES_OneToOne 0.00 65535.00 FORMAT "%8.2" /end CHARACTERISTIC
/begin CHARACTERISTIC DFES_DTCM.DFC_MoFInjDatQnt_C "/" VALUE 0x80074372 Val_Wu16 65535.00 DFES_OneToOne 0.00 65535.00 FORMAT "%8.2" /end CHARACTERISTIC
/begin CHARACTERISTIC DFES_DTCM.DFC_MoFInjQnt_C "/" VALUE 0x80074374 Val_Wu16 65535.00 DFES_OneToOne 0.00 65535.00 FORMAT "%8.2" /end CHARACTERISTIC
/begin CHARACTERISTIC DFES_DTCM.DFC_MoFOvR_C "/" VALUE 0x80074376 Val_Wu16 65535.00 DFES_OneToOne 0.00 65535.00 FORMAT "%8.2" /end CHARACTERISTIC
/begin CHARACTERISTIC DFES_DTCM.DFC_MoFQntCor_C "/" VALUE 0x80074378 Val_Wu16 65535.00 DFES_OneToOne 0.00 65535.00 FORMAT "%8.2" /end CHARACTERISTIC
/begin CHARACTERISTIC DFES_DTCM.DFC_MoFTrqCmp_C "/" VALUE 0x8007437A Val_Wu16 65535.00 DFES_OneToOne 0.00 65535.00 FORMAT "%8.2" /end CHARACTERISTIC
/begin CHARACTERISTIC DFES_DTCM.DFC_NplTOxiCatUs_C "/" VALUE 0x8007437C Val_Wu16 65535.00 DFES_OneToOne 0.00 65535.00 FORMAT "%8.2" /end CHARACTERISTIC
/begin CHARACTERISTIC DFES_DTCM.DFC_PhyModNonMonMapNpl_C "/" VALUE 0x8007437E Val_Wu16 65535.00 DFES_OneToOne 0.00 65535.00 FORMAT "%8.2" /end CHARACTERISTIC
/begin CHARACTERISTIC DFES_DTCM.DFC_RailPOfsTstMax_C "/" VALUE 0x80074380 Val_Wu16 65535.00 DFES_OneToOne 0.00 65535.00 FORMAT "%8.2" /end CHARACTERISTIC
/begin CHARACTERISTIC DFES_DTCM.DFC_RailPOfsTstMin_C "/" VALUE 0x80074382 Val_Wu16 65535.00 DFES_OneToOne 0.00 65535.00 FORMAT "%8.2" /end CHARACTERISTIC
/begin CHARACTERISTIC DFES_DTCM.DFC_SWReset_0_C "/" VALUE 0x80074384 Val_Wu16 65535.00 DFES_OneToOne 0.00 65535.00 FORMAT "%8.2" /end CHARACTERISTIC
/begin CHARACTERISTIC DFES_DTCM.DFC_SWReset_1_C "/" VALUE 0x80074386 Val_Wu16 65535.00 DFES_OneToOne 0.00 65535.00 FORMAT "%8.2" /end CHARACTERISTIC
/begin CHARACTERISTIC DFES_DTCM.DFC_SWReset_2_C "/" VALUE 0x80074388 Val_Wu16 65535.00 DFES_OneToOne 0.00 65535.00 FORMAT "%8.2" /end CHARACTERISTIC
/begin CHARACTERISTIC DFES_DTCM.DFC_VSwVlvJamVlv_C "/" VALUE 0x8007438A Val_Wu16 65535.00 DFES_OneToOne 0.00 65535.00 FORMAT "%8.2" /end CHARACTERISTIC
/begin CHARACTERISTIC DFES_DTCM.DFC_VSwVlvLgTDrft_C "/" VALUE 0x8007438C Val_Wu16 65535.00 DFES_OneToOne 0.00 65535.00 FORMAT "%8.2" /end CHARACTERISTIC
/begin CHARACTERISTIC DFES_DTCM.DFC_VSwVlvOfsLrnJamVlv_C "/" VALUE 0x8007438E Val_Wu16 65535.00 DFES_OneToOne 0.00 65535.00 FORMAT "%8.2" /end CHARACTERISTIC
/begin CHARACTERISTIC DFES_DTCM.DFC_VSwVlvShTDrft_C "/" VALUE 0x80074390 Val_Wu16 65535.00 DFES_OneToOne 0.00 65535.00 FORMAT "%8.2" /end CHARACTERISTIC
/begin FUNCTION dfes_dtc_man_auto ""
 /begin DEF_CHARACTERISTIC DFES_DTCM.DFC_AirCtlGovDvtEOMMax_C DFES_DTCM.DFC_AirCtlGovDvtEOMMin_C DFES_DTCM.DFC_AirCtlGovDvtMax_C DFES_DTCM.DFC_AirCtlGovDvtMin_C DFES_DTCM.DFC_Cj945SpiCom1_C DFES_DTCM.DFC_ComButtonMSASig_C DFES_DTCM.DFC_ComButtonMSATo_C DFES_DTCM.DFC_ComGearboxData2Sig_C DFES_DTCM.DFC_ComGearboxData2To_C DFES_DTCM.DFC_ComGearboxDataSig_C DFES_DTCM.DFC_ComGearboxDataTo_C DFES_DTCM.DFC_ComHeatACSig_C DFES_DTCM.DFC_ComHeatACTo_C DFES_DTCM.DFC_ComLenkradwinkelSig_C DFES_DTCM.DFC_ComLenkradwinkelTo_C DFES_DTCM.DFC_ComMileageRangeSig_C DFES_DTCM.DFC_ComMileageRangeTo_C DFES_DTCM.DFC_ComPspSig_C DFES_DTCM.DFC_ComPspTo_C DFES_DTCM.DFC_ComShutOffPSPSig_C DFES_DTCM.DFC_ComShutOffPSPTo_C DFES_DTCM.DFC_ComStKombiCtr_C DFES_DTCM.DFC_ComStKombiSig_C DFES_DTCM.DFC_ComStKombiTo_C DFES_DTCM.DFC_ComStateARSCtr_C DFES_DTCM.DFC_ComStateARSSig_C DFES_DTCM.DFC_ComStateARSTo_C DFES_DTCM.DFC_ComStateDscSig_C DFES_DTCM.DFC_ComStateDscTo_C DFES_DTCM.DFC_ComStateSeatSig_C DFES_DTCM.DFC_ComStateSeatTo_C DFES_DTCM.DFC_ComTempRelTimeSig_C DFES_DTCM.DFC_ComTempRelTimeTo_C DFES_DTCM.DFC_ComTerminalChk_C DFES_DTCM.DFC_ComTerminalCtr_C DFES_DTCM.DFC_ComTerminalSig_C DFES_DTCM.DFC_ComTerminalTo_C DFES_DTCM.DFC_ComTimeDateSig_C DFES_DTCM.DFC_ComTimeDateTo_C DFES_DTCM.DFC_ComTrailerSig_C DFES_DTCM.DFC_ComTrailerTo_C DFES_DTCM.DFC_ComTrqDemandAfsChk_C DFES_DTCM.DFC_ComTrqDemandAfsCtr_C DFES_DTCM.DFC_ComTrqDemandAfsSig_C DFES_DTCM.DFC_ComTrqDemandAfsTo_C DFES_DTCM.DFC_ComTrqDemandDscChk_C DFES_DTCM.DFC_ComTrqDemandDscCtr_C DFES_DTCM.DFC_ComTrqDemandDscSig_C DFES_DTCM.DFC_ComTrqDemandDscTo_C DFES_DTCM.DFC_ComTrqDemandGbxChk_C DFES_DTCM.DFC_ComTrqDemandGbxCtr_C DFES_DTCM.DFC_ComTrqDemandGbxSig_C DFES_DTCM.DFC_ComTrqDemandGbxTo_C DFES_DTCM.DFC_ComVelocitySig_C DFES_DTCM.DFC_ComVelocityTo_C DFES_DTCM.DFC_ComWheelSpeedSig_C DFES_DTCM.DFC_ComWheelSpeedTo_C DFES_DTCM.DFC_ComZvKlappenSig_C DFES_DTCM.DFC_ComZvKlappenTo_C DFES_DTCM.DFC_Cy150SpiCom_C DFES_DTCM.DFC_Cy320SpiCom_C DFES_DTCM.DFC_ETCtlDvtInrMax_C DFES_DTCM.DFC_ETCtlDvtInrMin_C DFES_DTCM.DFC_ETCtlDvtOutrMax_C DFES_DTCM.DFC_ETCtlDvtOutrMin_C DFES_DTCM.DFC_Fan4WinErr1_C DFES_DTCM.DFC_Fan4WinErr2_C DFES_DTCM.DFC_Fan4WinErr3_C DFES_DTCM.DFC_Fan4WinErr4_C DFES_DTCM.DFC_FanSCG_C DFES_DTCM.DFC_PCRGovDvtLPMax_C DFES_DTCM.DFC_PCRGovDvtLPMin_C DFES_DTCM.DFC_PCRGovDvtMax_C DFES_DTCM.DFC_PCRGovDvtMin_C DFES_DTCM.DFC_RailCPC1_C DFES_DTCM.DFC_RailCPC3_C DFES_DTCM.DFC_RailCPC4_C DFES_DTCM.DFC_RailMeUn0_C DFES_DTCM.DFC_RailMeUn1_C DFES_DTCM.DFC_RailMeUn2_C DFES_DTCM.DFC_RailMeUn3_C DFES_DTCM.DFC_RailMeUn4_C DFES_DTCM.DFC_RailPCV0_C DFES_DTCM.DFC_RailPCV1_C DFES_DTCM.DFC_RailPCV2_C DFES_DTCM.DFC_RailPCV3_C DFES_DTCM.DFC_RailPCV4_C DFES_DTCM.DFC_RailPMonStrt_C DFES_DTCM.DFC_SSpMon1_C DFES_DTCM.DFC_SSpMon2_C DFES_DTCM.DFC_SSpMon3_C DFES_DTCM.DFC_Sia_E1_C DFES_DTCM.DFC_Sia_E10_C DFES_DTCM.DFC_Sia_E11_C DFES_DTCM.DFC_Sia_E12_C DFES_DTCM.DFC_Sia_E13_C DFES_DTCM.DFC_Sia_E14_C DFES_DTCM.DFC_Sia_E15_C DFES_DTCM.DFC_Sia_E2_C DFES_DTCM.DFC_Sia_E3_C DFES_DTCM.DFC_Sia_E4_C DFES_DTCM.DFC_Sia_E5_C DFES_DTCM.DFC_Sia_E6_C DFES_DTCM.DFC_Sia_E7_C DFES_DTCM.DFC_Sia_E8_C DFES_DTCM.DFC_Sia_E9_C DFES_DTCM.DFC_ThrVlv4WinErr1_C DFES_DTCM.DFC_ThrVlv4WinErr2_C DFES_DTCM.DFC_ThrVlv4WinErr3_C DFES_DTCM.DFC_ThrVlv4WinErr4_C DFES_DTCM.DFC_ThrVlvSCG_C DFES_DTCM.DFC_TrbCh4WinErr1_C DFES_DTCM.DFC_TrbCh4WinErr2_C DFES_DTCM.DFC_TrbCh4WinErr3_C DFES_DTCM.DFC_TrbCh4WinErr4_C DFES_DTCM.DFC_TrbChSCG_C DFES_DTCM.DFC_TrbChSRCMax_C DFES_DTCM.DFC_TrbChSRCMin_C DFES_DTCM.DFC_WaHtEl4WinErr1_C DFES_DTCM.DFC_WaHtEl4WinErr2_C DFES_DTCM.DFC_WaHtEl4WinErr3_C DFES_DTCM.DFC_WaHtEl4WinErr4_C DFES_DTCM.DFC_WaHtElSCG_C DFES_DTCM.DFC_ETClbETFltMax_C DFES_DTCM.DFC_ETClbETFltMin_C DFES_DTCM.DFC_InjCrvInjLimChrgBal_C DFES_DTCM.DFC_InjCrvInjLimQntBal_C DFES_DTCM.DFC_InjCrvInjLimSys_C DFES_DTCM.DFC_InjCrvNumInjRtmLim_C DFES_DTCM.DFC_LSUHtCoupSig_0_C DFES_DTCM.DFC_LSUHtCoupSig_1_C DFES_DTCM.DFC_LSUHtCoupSig_2_C DFES_DTCM.DFC_LSUHtCoupSig_3_C DFES_DTCM.DFC_CtT_C DFES_DTCM.DFC_DSMDummy_C DFES_DTCM.DFC_MeUnOL_C DFES_DTCM.DFC_MeUnSCB_C DFES_DTCM.DFC_MeUnSRCMax_C DFES_DTCM.DFC_MeUnSRCMin_C DFES_DTCM.DFC_PCVOL_C DFES_DTCM.DFC_PCVSCB_C DFES_DTCM.DFC_PCVSRCMax_C DFES_DTCM.DFC_PCVSRCMin_C DFES_DTCM.DFC_RailPSRCMax_C DFES_DTCM.DFC_RailPSRCMin_C DFES_DTCM.DFC_IVActrVltgSRCMax_C DFES_DTCM.DFC_IVActrVltgSRCMin_C DFES_DTCM.DFC_IVPSplyDCDC_C DFES_DTCM.DFC_IVPSplyVltgSRCMax_C DFES_DTCM.DFC_IVPSplyVltgSRCMin_C DFES_DTCM.DFC_AFSOffsDrftMax_C DFES_DTCM.DFC_AFSOffsDrftMin_C DFES_DTCM.DFC_AFSSRCCorMax_C DFES_DTCM.DFC_AFSSRCCorMin_C DFES_DTCM.DFC_AFSSRCRawMax_C DFES_DTCM.DFC_AFSSRCRawMin_C DFES_DTCM.DFC_AFSSetyDrftMax_C DFES_DTCM.DFC_AFSSetyDrftMin_C DFES_DTCM.DFC_AirCClntPAnaSRCMax_C DFES_DTCM.DFC_AirCClntPAnaSRCMin_C DFES_DTCM.DFC_AirCClntPPerSRCMax_C DFES_DTCM.DFC_AirCClntPPerSRCMin_C DFES_DTCM.DFC_AirCClntPdcycSRCMax_C DFES_DTCM.DFC_AirCClntPdcycSRCMin_C DFES_DTCM.DFC_AirCCmprOL_C DFES_DTCM.DFC_AirCCmprRedTrqOL_C DFES_DTCM.DFC_AirCCmprRedTrqSCB_C DFES_DTCM.DFC_AirCCmprRedTrqSCG_C DFES_DTCM.DFC_AirCCmprSCB_C DFES_DTCM.DFC_AirCCmprSCG_C DFES_DTCM.DFC_AirCSwtNpl_C DFES_DTCM.DFC_AirCSwtSig_C DFES_DTCM.DFC_BattUSRCMax_C DFES_DTCM.DFC_BattUSRCMin_C DFES_DTCM.DFC_BrkNpl_C DFES_DTCM.DFC_BrkPSRCMax_C DFES_DTCM.DFC_BrkPSRCMin_C DFES_DTCM.DFC_BrkSig_C DFES_DTCM.DFC_CByVlvOL_C DFES_DTCM.DFC_CByVlvSCB_C DFES_DTCM.DFC_CByVlvSCG_C DFES_DTCM.DFC_CEngDsTSRCMax_C DFES_DTCM.DFC_CEngDsTSRCMin_C DFES_DTCM.DFC_CEngDsTSig_C DFES_DTCM.DFC_CEngUsTSRCMax_C DFES_DTCM.DFC_CEngUsTSRCMin_C DFES_DTCM.DFC_CThmstOL_C DFES_DTCM.DFC_CThmstSCB_C DFES_DTCM.DFC_CThmstSCG_C DFES_DTCM.DFC_ClthSig_C DFES_DTCM.DFC_ECBVlvOL_C DFES_DTCM.DFC_ECBVlvSCB_C DFES_DTCM.DFC_ECBVlvSCG_C DFES_DTCM.DFC_ECBVlvSRCMax_C DFES_DTCM.DFC_ECBVlvSRCMin_C DFES_DTCM.DFC_EGRVlvGovDvtMax_C DFES_DTCM.DFC_EGRVlvGovDvtMin_C DFES_DTCM.DFC_EGRVlvOL_C DFES_DTCM.DFC_EGRVlvSCB_C DFES_DTCM.DFC_EGRVlvSCG_C DFES_DTCM.DFC_EGRVlvSRCMax_C DFES_DTCM.DFC_EGRVlvSRCMin_C DFES_DTCM.DFC_EMDmpOL_0_C DFES_DTCM.DFC_EMDmpOL_1_C DFES_DTCM.DFC_EMDmpSCB_0_C DFES_DTCM.DFC_EMDmpSCB_1_C DFES_DTCM.DFC_EMDmpSCG_0_C DFES_DTCM.DFC_EMDmpSCG_1_C DFES_DTCM.DFC_EngStAOL_C DFES_DTCM.DFC_EngStASCB_C DFES_DTCM.DFC_EngStASCG_C DFES_DTCM.DFC_EnvPSRCMax_C DFES_DTCM.DFC_EnvPSRCMin_C DFES_DTCM.DFC_EnvPSig_C DFES_DTCM.DFC_EnvTSRCMax_C DFES_DTCM.DFC_EnvTSRCMin_C DFES_DTCM.DFC_FanOL_C DFES_DTCM.DFC_FanSCB_C DFES_DTCM.DFC_FlFltSig_C DFES_DTCM.DFC_FuelTSRCMax_C DFES_DTCM.DFC_FuelTSRCMin_C DFES_DTCM.DFC_GbxNPosPPerSRCMax_C DFES_DTCM.DFC_GbxNPosPPerSRCMin_C DFES_DTCM.DFC_GbxNPosPdcycSRCMax_C DFES_DTCM.DFC_GbxNPosPdcycSRCMin_C DFES_DTCM.DFC_GbxNPosSig_C DFES_DTCM.DFC_GlwPlgBSDOL_0_C DFES_DTCM.DFC_GlwPlgBSDOL_1_C DFES_DTCM.DFC_GlwPlgBSDOL_2_C DFES_DTCM.DFC_GlwPlgBSDOL_3_C DFES_DTCM.DFC_GlwPlgBSDOL_4_C DFES_DTCM.DFC_GlwPlgBSDOL_5_C DFES_DTCM.DFC_GlwPlgBSDOL_6_C DFES_DTCM.DFC_GlwPlgBSDOL_7_C DFES_DTCM.DFC_GlwPlgBSDOT_0_C DFES_DTCM.DFC_GlwPlgBSDOT_1_C DFES_DTCM.DFC_GlwPlgBSDOT_2_C DFES_DTCM.DFC_GlwPlgBSDOT_3_C DFES_DTCM.DFC_GlwPlgBSDOT_4_C DFES_DTCM.DFC_GlwPlgBSDOT_5_C DFES_DTCM.DFC_GlwPlgBSDOT_6_C DFES_DTCM.DFC_GlwPlgBSDOT_7_C DFES_DTCM.DFC_GlwPlgBSDSC_0_C DFES_DTCM.DFC_GlwPlgBSDSC_1_C DFES_DTCM.DFC_GlwPlgBSDSC_2_C DFES_DTCM.DFC_GlwPlgBSDSC_3_C DFES_DTCM.DFC_GlwPlgBSDSC_4_C DFES_DTCM.DFC_GlwPlgBSDSC_5_C DFES_DTCM.DFC_GlwPlgBSDSC_6_C DFES_DTCM.DFC_GlwPlgBSDSC_7_C DFES_DTCM.DFC_GlwPlgComErr_C DFES_DTCM.DFC_InjVlvPresMin_C DFES_DTCM.DFC_LSUCircNernstMax_0_C DFES_DTCM.DFC_LSUCircNernstMax_1_C DFES_DTCM.DFC_LSUCircNernstMax_2_C DFES_DTCM.DFC_LSUCircNernstMax_3_C DFES_DTCM.DFC_LSUCircNernstMin_0_C DFES_DTCM.DFC_LSUCircNernstMin_1_C DFES_DTCM.DFC_LSUCircNernstMin_2_C DFES_DTCM.DFC_LSUCircNernstMin_3_C DFES_DTCM.DFC_LSUCircNernstSig_0_C DFES_DTCM.DFC_LSUCircNernstSig_1_C DFES_DTCM.DFC_LSUCircNernstSig_2_C DFES_DTCM.DFC_LSUCircNernstSig_3_C DFES_DTCM.DFC_LSUCircPmpCurMax_0_C DFES_DTCM.DFC_LSUCircPmpCurMax_1_C DFES_DTCM.DFC_LSUCircPmpCurMax_2_C DFES_DTCM.DFC_LSUCircPmpCurMax_3_C DFES_DTCM.DFC_LSUCircPmpCurMin_0_C DFES_DTCM.DFC_LSUCircPmpCurMin_1_C DFES_DTCM.DFC_LSUCircPmpCurMin_2_C DFES_DTCM.DFC_LSUCircPmpCurMin_3_C DFES_DTCM.DFC_LSUCircPmpCurSig_0_C DFES_DTCM.DFC_LSUCircPmpCurSig_1_C DFES_DTCM.DFC_LSUCircPmpCurSig_2_C DFES_DTCM.DFC_LSUCircPmpCurSig_3_C DFES_DTCM.DFC_LSUCircVirtGndMax_0_C DFES_DTCM.DFC_LSUCircVirtGndMax_1_C DFES_DTCM.DFC_LSUCircVirtGndMax_2_C DFES_DTCM.DFC_LSUCircVirtGndMax_3_C DFES_DTCM.DFC_LSUCircVirtGndMin_0_C DFES_DTCM.DFC_LSUCircVirtGndMin_1_C DFES_DTCM.DFC_LSUCircVirtGndMin_2_C DFES_DTCM.DFC_LSUCircVirtGndMin_3_C DFES_DTCM.DFC_LSUCircVirtGndSig_0_C DFES_DTCM.DFC_LSUCircVirtGndSig_1_C DFES_DTCM.DFC_LSUCircVirtGndSig_2_C DFES_DTCM.DFC_LSUCircVirtGndSig_3_C DFES_DTCM.DFC_LSUHtrMax_0_C DFES_DTCM.DFC_LSUHtrMax_1_C DFES_DTCM.DFC_LSUHtrMax_2_C DFES_DTCM.DFC_LSUHtrMax_3_C DFES_DTCM.DFC_LSUHtrMin_0_C DFES_DTCM.DFC_LSUHtrMin_1_C DFES_DTCM.DFC_LSUHtrMin_2_C DFES_DTCM.DFC_LSUHtrMin_3_C DFES_DTCM.DFC_LSUHtrSig_0_C DFES_DTCM.DFC_LSUHtrSig_1_C DFES_DTCM.DFC_LSUHtrSig_2_C DFES_DTCM.DFC_LSUHtrSig_3_C DFES_DTCM.DFC_LSUO2Max_0_C DFES_DTCM.DFC_LSUO2Max_1_C DFES_DTCM.DFC_LSUO2Max_2_C DFES_DTCM.DFC_LSUO2Max_3_C DFES_DTCM.DFC_LSUO2Min_0_C DFES_DTCM.DFC_LSUO2Min_1_C DFES_DTCM.DFC_LSUO2Min_2_C DFES_DTCM.DFC_LSUO2Min_3_C DFES_DTCM.DFC_LSUSPIBattLowMin_0_C DFES_DTCM.DFC_LSUSPIBattLowMin_1_C DFES_DTCM.DFC_LSUSPIBattLowMin_2_C DFES_DTCM.DFC_LSUSPIBattLowMin_3_C DFES_DTCM.DFC_LSUSPISig_0_C DFES_DTCM.DFC_LSUSPISig_1_C DFES_DTCM.DFC_LSUSPISig_2_C DFES_DTCM.DFC_LSUSPISig_3_C DFES_DTCM.DFC_LSUtExcMax_0_C DFES_DTCM.DFC_LSUtExcMax_1_C DFES_DTCM.DFC_LSUtExcMax_2_C DFES_DTCM.DFC_LSUtExcMax_3_C DFES_DTCM.DFC_LSUtExcMin_0_C DFES_DTCM.DFC_LSUtExcMin_1_C DFES_DTCM.DFC_LSUtExcMin_2_C DFES_DTCM.DFC_LSUtExcMin_3_C DFES_DTCM.DFC_MILOL_C DFES_DTCM.DFC_MILSCB_C DFES_DTCM.DFC_MILSCG_C DFES_DTCM.DFC_MeUnSCG_C DFES_DTCM.DFC_NplHsChngPPFltDiff_C DFES_DTCM.DFC_NplPAirFltDs_C DFES_DTCM.DFC_NplTPFltUs_C DFES_DTCM.DFC_OilComErr_C DFES_DTCM.DFC_OilPLmpOL_C DFES_DTCM.DFC_OilPLmpSCB_C DFES_DTCM.DFC_OilPLmpSCG_C DFES_DTCM.DFC_OilPNpl_C DFES_DTCM.DFC_OilTNpl_C DFES_DTCM.DFC_OilTSRCMax_C DFES_DTCM.DFC_OilTSRCMin_C DFES_DTCM.DFC_PCACDsEnvPPls_C DFES_DTCM.DFC_PCACDsSRCMax_C DFES_DTCM.DFC_PCACDsSRCMin_C DFES_DTCM.DFC_PCVSCG_C DFES_DTCM.DFC_PFltCharPDiffMin_C DFES_DTCM.DFC_PFltDstrMin_C DFES_DTCM.DFC_PFltEngPrt_C DFES_DTCM.DFC_PFltLmpOL_C DFES_DTCM.DFC_PFltLmpSCB_C DFES_DTCM.DFC_PFltLmpSCG_C DFES_DTCM.DFC_PFltRgnPerm_C DFES_DTCM.DFC_PFltSRCMaxFlwRstn_C DFES_DTCM.DFC_PFltSRCMinFlwRstn_C DFES_DTCM.DFC_PFltSotMsDvtMax_C DFES_DTCM.DFC_PFltSotMsDvtMin_C DFES_DTCM.DFC_PFltSotMsMax_C DFES_DTCM.DFC_PSPOL_C DFES_DTCM.DFC_PSPSCB_C DFES_DTCM.DFC_PSPSCG_C DFES_DTCM.DFC_SRCHighAPP1_C DFES_DTCM.DFC_SRCHighAPP2_C DFES_DTCM.DFC_SRCLowAPP1_C DFES_DTCM.DFC_SRCLowAPP2_C DFES_DTCM.DFC_SRCMaxPAirFltDs_C DFES_DTCM.DFC_SRCMaxPPFltUs_C DFES_DTCM.DFC_SRCMaxTECU_C DFES_DTCM.DFC_SRCMaxTOxiCatUs_C DFES_DTCM.DFC_SRCMaxTPFltUs_C DFES_DTCM.DFC_SRCMinPAirFltDs_C DFES_DTCM.DFC_SRCMinPPFltUs_C DFES_DTCM.DFC_SRCMinTECU_C DFES_DTCM.DFC_SRCMinTOxiCatUs_C DFES_DTCM.DFC_SRCMinTPFltUs_C DFES_DTCM.DFC_SVSOL_C DFES_DTCM.DFC_SVSSCB_C DFES_DTCM.DFC_SVSSCG_C DFES_DTCM.DFC_StrtOL_C DFES_DTCM.DFC_StrtSCB_C DFES_DTCM.DFC_StrtSCG_C DFES_DTCM.DFC_SyncAPP_C DFES_DTCM.DFC_T15Npl_C DFES_DTCM.DFC_TAFSDtyCycHi_C DFES_DTCM.DFC_TAFSDtyCycLo_C DFES_DTCM.DFC_TAFSPerHi_C DFES_DTCM.DFC_TAFSPerLo_C DFES_DTCM.DFC_TCACDsSRCMax_C DFES_DTCM.DFC_TCACDsSRCMin_C DFES_DTCM.DFC_ThrVlvOL_C DFES_DTCM.DFC_ThrVlvSCB_C DFES_DTCM.DFC_ThrVlvSRCMax_C DFES_DTCM.DFC_ThrVlvSRCMin_C DFES_DTCM.DFC_TrbChLPOL_C DFES_DTCM.DFC_TrbChLPSCB_C DFES_DTCM.DFC_TrbChLPSCG_C DFES_DTCM.DFC_TrbChOL_C DFES_DTCM.DFC_TrbChSCB_C DFES_DTCM.DFC_VSwVlvGovDvtMax_C DFES_DTCM.DFC_VSwVlvGovDvtMin_C DFES_DTCM.DFC_VSwVlvOL_C DFES_DTCM.DFC_VSwVlvSCB_C DFES_DTCM.DFC_VSwVlvSCG_C DFES_DTCM.DFC_VSwVlvSRCMax_C DFES_DTCM.DFC_VSwVlvSRCMin_C DFES_DTCM.DFC_VehVHW_C DFES_DTCM.DFC_VehVMax_C DFES_DTCM.DFC_VehVPlaus_C DFES_DTCM.DFC_VehVSig_C DFES_DTCM.DFC_WaHtElOL_C DFES_DTCM.DFC_WaHtElSCB_C DFES_DTCM.DFC_ClthNpl_C DFES_DTCM.DFC_ETClbETMax_0_C DFES_DTCM.DFC_ETClbETMax_1_C DFES_DTCM.DFC_ETClbETMax_2_C DFES_DTCM.DFC_ETClbETMax_3_C DFES_DTCM.DFC_ETClbETMax_4_C DFES_DTCM.DFC_ETClbETMax_5_C DFES_DTCM.DFC_ETClbETMin_0_C DFES_DTCM.DFC_ETClbETMin_1_C DFES_DTCM.DFC_ETClbETMin_2_C DFES_DTCM.DFC_ETClbETMin_3_C DFES_DTCM.DFC_ETClbETMin_4_C DFES_DTCM.DFC_ETClbETMin_5_C DFES_DTCM.DFC_IVDiaBnkShCirBSH_0_C DFES_DTCM.DFC_IVDiaBnkShCirBSH_1_C DFES_DTCM.DFC_IVDiaBnkShCirChSwt_0_C DFES_DTCM.DFC_IVDiaBnkShCirChSwt_1_C DFES_DTCM.DFC_IVDiaBnkShCirHSBatt_0_C DFES_DTCM.DFC_IVDiaBnkShCirHSBatt_1_C DFES_DTCM.DFC_IVDiaBnkShCirHiRstnc_0_C DFES_DTCM.DFC_IVDiaBnkShCirHiRstnc_1_C DFES_DTCM.DFC_IVDiaBnkShCirLSHSGnd_0_C DFES_DTCM.DFC_IVDiaBnkShCirLSHSGnd_1_C DFES_DTCM.DFC_IVDiaBnkShCirTransfer_0_C DFES_DTCM.DFC_IVDiaBnkShCirTransfer_1_C DFES_DTCM.DFC_IVDiaCylNoCls_0_C DFES_DTCM.DFC_IVDiaCylNoCls_1_C DFES_DTCM.DFC_IVDiaCylNoCls_2_C DFES_DTCM.DFC_IVDiaCylNoCls_3_C DFES_DTCM.DFC_IVDiaCylNoCls_4_C DFES_DTCM.DFC_IVDiaCylNoCls_5_C DFES_DTCM.DFC_IVDiaCylNoLd_0_C DFES_DTCM.DFC_IVDiaCylNoLd_1_C DFES_DTCM.DFC_IVDiaCylNoLd_2_C DFES_DTCM.DFC_IVDiaCylNoLd_3_C DFES_DTCM.DFC_IVDiaCylNoLd_4_C DFES_DTCM.DFC_IVDiaCylNoLd_5_C DFES_DTCM.DFC_IVDiaCylShCirHiRstnc_0_C DFES_DTCM.DFC_IVDiaCylShCirHiRstnc_1_C DFES_DTCM.DFC_IVDiaCylShCirHiRstnc_2_C DFES_DTCM.DFC_IVDiaCylShCirHiRstnc_3_C DFES_DTCM.DFC_IVDiaCylShCirHiRstnc_4_C DFES_DTCM.DFC_IVDiaCylShCirHiRstnc_5_C DFES_DTCM.DFC_IVDiaCylShCirLSBatt_0_C DFES_DTCM.DFC_IVDiaCylShCirLSBatt_1_C DFES_DTCM.DFC_IVDiaCylShCirLSBatt_2_C DFES_DTCM.DFC_IVDiaCylShCirLSBatt_3_C DFES_DTCM.DFC_IVDiaCylShCirLSBatt_4_C DFES_DTCM.DFC_IVDiaCylShCirLSBatt_5_C DFES_DTCM.DFC_IVDiaCylShCirLSHS_0_C DFES_DTCM.DFC_IVDiaCylShCirLSHS_1_C DFES_DTCM.DFC_IVDiaCylShCirLSHS_2_C DFES_DTCM.DFC_IVDiaCylShCirLSHS_3_C DFES_DTCM.DFC_IVDiaCylShCirLSHS_4_C DFES_DTCM.DFC_IVDiaCylShCirLSHS_5_C DFES_DTCM.DFC_IVDiaCylShCirLsLs_0_C DFES_DTCM.DFC_IVDiaCylShCirLsLs_1_C DFES_DTCM.DFC_IVDiaCylShCirLsLs_2_C DFES_DTCM.DFC_IVDiaCylShCirLsLs_3_C DFES_DTCM.DFC_IVDiaCylShCirLsLs_4_C DFES_DTCM.DFC_IVDiaCylShCirLsLs_5_C DFES_DTCM.DFC_IVDiaSPICfg_C DFES_DTCM.DFC_IVDiaSPIColl_C DFES_DTCM.DFC_IVDiaSPICtrl_C DFES_DTCM.DFC_IVDiaSPIRam_C DFES_DTCM.DFC_IVDiaSPITrans_C DFES_DTCM.DFC_LSUCmpChk_0_C DFES_DTCM.DFC_LSUCmpChk_1_C DFES_DTCM.DFC_LSUCmpChk_2_C DFES_DTCM.DFC_LSUCmpChk_3_C DFES_DTCM.DFC_LSUCmpChk_4_C DFES_DTCM.DFC_LSUCmpChk_5_C DFES_DTCM.DFC_LSUDynChk_0_C DFES_DTCM.DFC_LSUDynChk_1_C DFES_DTCM.DFC_LSUDynChk_2_C DFES_DTCM.DFC_LSUDynChk_3_C DFES_DTCM.DFC_LSUO2ClbMax_0_C DFES_DTCM.DFC_LSUO2ClbMax_1_C DFES_DTCM.DFC_LSUO2ClbMax_2_C DFES_DTCM.DFC_LSUO2ClbMax_3_C DFES_DTCM.DFC_LSUO2ClbMin_0_C DFES_DTCM.DFC_LSUO2ClbMin_1_C DFES_DTCM.DFC_LSUO2ClbMin_2_C DFES_DTCM.DFC_LSUO2ClbMin_3_C DFES_DTCM.DFC_LSUO2PlausMax_0_C DFES_DTCM.DFC_LSUO2PlausMax_1_C DFES_DTCM.DFC_LSUO2PlausMax_2_C DFES_DTCM.DFC_LSUO2PlausMax_3_C DFES_DTCM.DFC_LSUO2PlausMin_0_C DFES_DTCM.DFC_LSUO2PlausMin_1_C DFES_DTCM.DFC_LSUO2PlausMin_2_C DFES_DTCM.DFC_LSUO2PlausMin_3_C DFES_DTCM.DFC_LSURiClbMax_0_C DFES_DTCM.DFC_LSURiClbMax_1_C DFES_DTCM.DFC_LSURiClbMax_2_C DFES_DTCM.DFC_LSURiClbMax_3_C DFES_DTCM.DFC_LSURiClbMin_0_C DFES_DTCM.DFC_LSURiClbMin_1_C DFES_DTCM.DFC_LSURiClbMin_2_C DFES_DTCM.DFC_LSURiClbMin_3_C DFES_DTCM.DFC_LSUWireIPSig_0_C DFES_DTCM.DFC_LSUWireIPSig_1_C DFES_DTCM.DFC_LSUWireIPSig_2_C DFES_DTCM.DFC_LSUWireIPSig_3_C DFES_DTCM.DFC_AFSDrftIdlAdjVal_C DFES_DTCM.DFC_AFSDrftLdAdjVal_C DFES_DTCM.DFC_AdcI_ADC0_Cal_C DFES_DTCM.DFC_AdcI_ADC0_Conv_C DFES_DTCM.DFC_CmbChbMisfireMax_0_C DFES_DTCM.DFC_CmbChbMisfireMax_1_C DFES_DTCM.DFC_CmbChbMisfireMax_2_C DFES_DTCM.DFC_CmbChbMisfireMax_3_C DFES_DTCM.DFC_CmbChbMisfireMax_4_C DFES_DTCM.DFC_CmbChbMisfireMax_5_C DFES_DTCM.DFC_CmbChbMisfireMul_C DFES_DTCM.DFC_INJVLVBUSY_C DFES_DTCM.DFC_IVAdjIVA_0_C DFES_DTCM.DFC_IVAdjIVA_1_C DFES_DTCM.DFC_IVAdjIVA_2_C DFES_DTCM.DFC_IVAdjIVA_3_C DFES_DTCM.DFC_IVAdjIVA_4_C DFES_DTCM.DFC_IVAdjIVA_5_C DFES_DTCM.DFC_InjCtlAdjQntEEPCS_C DFES_DTCM.DFC_InjCtlDriftEEPCS_C DFES_DTCM.DFC_MRlyErlyOpng_C DFES_DTCM.DFC_MRlyStk_C DFES_DTCM.DFC_SensFrzPPFltUs_C DFES_DTCM.DFC_T15Sig_C DFES_DTCM.DFC_AirCtlRmpTOut_C DFES_DTCM.DFC_CEngDsTDynTst_C DFES_DTCM.DFC_EGRVlvJamVlvClsd_C DFES_DTCM.DFC_EGRVlvJamVlvOpn_C DFES_DTCM.DFC_EGRVlvLgTDrft_C DFES_DTCM.DFC_EGRVlvOfsLrnJamVlv_C DFES_DTCM.DFC_EGRVlvShTDrft_C DFES_DTCM.DFC_EGTRgnOilDilMax_C DFES_DTCM.DFC_EngICO_C DFES_DTCM.DFC_EpmCaSI1ErrSig_C DFES_DTCM.DFC_EpmCaSI1NoSig_C DFES_DTCM.DFC_EpmCaSI1OfsErr_C DFES_DTCM.DFC_EpmCrSErrSig_C DFES_DTCM.DFC_EpmCrSNoSig_C DFES_DTCM.DFC_MoCADCCmp_C DFES_DTCM.DFC_MoCADCTst_C DFES_DTCM.DFC_MoCADCVltgRatio_C DFES_DTCM.DFC_MoCSOPLoLi_C DFES_DTCM.DFC_MoCSOPMM_C DFES_DTCM.DFC_MoCSOPTimeOut_C DFES_DTCM.DFC_MoCSOPUpLi_C DFES_DTCM.DFC_MoFAPP_C DFES_DTCM.DFC_MoFESpd_C DFES_DTCM.DFC_MoFInjDatPhi_C DFES_DTCM.DFC_MoFInjDatQnt_C DFES_DTCM.DFC_MoFInjQnt_C DFES_DTCM.DFC_MoFOvR_C DFES_DTCM.DFC_MoFQntCor_C DFES_DTCM.DFC_MoFTrqCmp_C DFES_DTCM.DFC_NplTOxiCatUs_C DFES_DTCM.DFC_PhyModNonMonMapNpl_C DFES_DTCM.DFC_RailPOfsTstMax_C DFES_DTCM.DFC_RailPOfsTstMin_C DFES_DTCM.DFC_SWReset_0_C DFES_DTCM.DFC_SWReset_1_C DFES_DTCM.DFC_SWReset_2_C DFES_DTCM.DFC_VSwVlvJamVlv_C DFES_DTCM.DFC_VSwVlvLgTDrft_C DFES_DTCM.DFC_VSwVlvOfsLrnJamVlv_C DFES_DTCM.DFC_VSwVlvShTDrft_C /end DEF_CHARACTERISTIC
/end FUNCTION
/begin COMPU_METHOD DFES_OneToOne "" RAT_FUNC "%6.2" "-" COEFFS 0 1 0 0 0 1 /end COMPU_METHOD
/begin RECORD_LAYOUT Val_Wu16 FNC_VALUES 1 UWORD COLUMN_DIR DIRECT /end RECORD_LAYOUT
/end MODULE
/end PROJECT
