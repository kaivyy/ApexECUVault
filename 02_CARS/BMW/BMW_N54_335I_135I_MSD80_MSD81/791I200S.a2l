/* -------------------------------------------------------------------------
Visu-IT!
Data Declaration System (DDS)
- ASAP2 export -
DDS-Version 4.0.1
Component-Version Build<000030.02> 2004/05/17 09:45:46
CreationDate 21 Feb 2006, 15:15:42
Project MSD85
Number 791
Structure 3F1
Serial Nr. 00
Option Project (DataBase) D:\p\4d8\3f1_pis\mc1_u\tmp\db
Option Verbose false
Option ASAP2File D:\p\4d8\3f1_pis\mc1_u\out\cal\4d83f130.a2l
Option IgnoreAddressCheck false
Option ASAP2Version 1.41
Option ExportSoftwareGrouping false
Option ExportComponentGrouping false
Option SuppressFunctionGrouping false
Option SuppressAxisFunctionGrouping false
Option ExportDisplayIdentifier <2>
Option ExportLongIdentifier <0>
Option ExportAnnotation false
Option PartialExportViaFunction
Option MemoryRegionAutoAssignment <0>
Option ExportReference2MemorySegment false
Option AddressOffset <0>
Option IfDataTemplateList 'CCP ASAP1B v2.4 (using ccp-definition)'
'ETK_V1_1_0_P2'
'CNP_KWPONCAN'
Option A2MLMode <0>
Option CalibrationMethodList
Option SuppressEcuAddress false
Option SuppressFloat false
Option SuppressVariantCoding false
Option VariantCodingMode <0>
Option OnlineOnly false
Option ExportHiddenData false
Option Map2PointLinearConv2RatFunc true
Option NonLinearConvMode <0>
Option MapVTabRange2VTab false
Option MaxCompuTabValuePairs <512>
Option DefaultFormat4VerbalConvers...
Option WriteEscapeCharacters false
Option AllowASAP1_3IdentsAlso4NonI... true
Option IgnorePartialIdentLengthCheck true
------------------------------------------------------------------------- */
ASAP2_VERSION 1 41
/begin PROJECT MSD85 "Spray Guided DI-System with Piezo Injectors for 8-Cylinder"
/begin HEADER "_default_HeaderComment" PROJECT_NO _91 /end HEADER
/begin MODULE _default_ModuleName "_default_ModuleLongIdentifier"
/begin MOD_PAR "_default_ModParComment" ADDR_EPK 0xa0800008 EPK "7913F100"
 /begin MEMORY_SEGMENT _INT_RAM "DRAM" VARIABLES RAM INTERN 0xd0000000 0x10000 -1 -1 -1 -1 -1 /begin IF_DATA ETK DP_BLOB 0xd0000000 0x10000 /end IF_DATA /end MEMORY_SEGMENT
 /begin MEMORY_SEGMENT _ROM "CAL" DATA FLASH EXTERN 0xa0800000 0x40000 -1 -1 -1 -1 -1 /begin IF_DATA ETK DP_BLOB 0xa0800000 0x40000 /end IF_DATA /end MEMORY_SEGMENT
 /begin MEMORY_SEGMENT _RAM "SRAM" VARIABLES RAM EXTERN 0xc0000000 0x10000 -1 -1 -1 -1 -1 /begin IF_DATA ETK DP_BLOB 0xc0000000 0x10000 /end IF_DATA /end MEMORY_SEGMENT
/end MOD_PAR
/begin MOD_COMMON "_default_ModCommonComment" DEPOSIT ABSOLUTE BYTE_ORDER MSB_LAST ALIGNMENT_BYTE 1 ALIGNMENT_WORD 2 ALIGNMENT_LONG 2 ALIGNMENT_FLOAT32_IEEE 2 ALIGNMENT_FLOAT64_IEEE 4 /end MOD_COMMON
/begin IF_DATA ASAP1B_CCP
 /begin SOURCE "CrankSyncCyl0" 0 0 DISPLAY_IDENTIFIER "DAQ0" /begin QP_BLOB 1 LENGTH 10 CAN_ID_FIXED 0x7a2 RASTER 1 FIRST_PID 0 /end QP_BLOB /end SOURCE
 /begin SOURCE "CrankSyncCyl1" 0 0 DISPLAY_IDENTIFIER "DAQ1" /begin QP_BLOB 2 LENGTH 10 CAN_ID_FIXED 0x7a2 RASTER 2 FIRST_PID 16 /end QP_BLOB /end SOURCE
 /begin SOURCE "CrankSyncCyl2" 0 0 DISPLAY_IDENTIFIER "DAQ2" /begin QP_BLOB 3 LENGTH 10 CAN_ID_FIXED 0x7a2 RASTER 3 FIRST_PID 32 /end QP_BLOB /end SOURCE
 /begin SOURCE "CrankSyncCyl3" 0 0 DISPLAY_IDENTIFIER "DAQ3" /begin QP_BLOB 4 LENGTH 10 CAN_ID_FIXED 0x7a2 RASTER 4 FIRST_PID 48 /end QP_BLOB /end SOURCE
 /begin SOURCE "CrankSyncCyl4" 0 0 DISPLAY_IDENTIFIER "DAQ4" /begin QP_BLOB 5 LENGTH 10 CAN_ID_FIXED 0x7a2 RASTER 5 FIRST_PID 64 /end QP_BLOB /end SOURCE
 /begin SOURCE "CrankSyncCyl5" 0 0 DISPLAY_IDENTIFIER "DAQ5" /begin QP_BLOB 6 LENGTH 10 CAN_ID_FIXED 0x7a2 RASTER 6 FIRST_PID 80 /end QP_BLOB /end SOURCE
 /begin SOURCE "CrankSyncCyl6" 0 0 DISPLAY_IDENTIFIER "DAQ6" /begin QP_BLOB 7 LENGTH 10 CAN_ID_FIXED 0x7a2 RASTER 7 FIRST_PID 96 /end QP_BLOB /end SOURCE
 /begin SOURCE "CrankSyncCyl7" 0 0 DISPLAY_IDENTIFIER "DAQ7" /begin QP_BLOB 8 LENGTH 10 CAN_ID_FIXED 0x7a2 RASTER 8 FIRST_PID 112 /end QP_BLOB /end SOURCE
 /begin SOURCE "TimeSync10ms" 0 0 DISPLAY_IDENTIFIER "10ms" /begin QP_BLOB 30 LENGTH 10 CAN_ID_FIXED 0x7a3 RASTER 30 FIRST_PID 128 /end QP_BLOB /end SOURCE
 /begin SOURCE "Display" 0 0 DISPLAY_IDENTIFIER "DSPL" /begin QP_BLOB 31 LENGTH 60 CAN_ID_FIXED 0x7a4 RASTER 31 FIRST_PID 144 /end QP_BLOB /end SOURCE
 /begin RASTER "CrankSyncCyl0" "CYL0" 1 103 1 /end RASTER
 /begin RASTER "CrankSyncCyl1" "CYL1" 2 103 1 /end RASTER
 /begin RASTER "CrankSyncCyl2" "CYL2" 3 103 1 /end RASTER
 /begin RASTER "CrankSyncCyl3" "CYL3" 4 103 1 /end RASTER
 /begin RASTER "CrankSyncCyl4" "CYL4" 5 103 1 /end RASTER
 /begin RASTER "CrankSyncCyl5" "CYL5" 6 103 1 /end RASTER
 /begin RASTER "CrankSyncCyl6" "CYL6" 7 103 1 /end RASTER
 /begin RASTER "CrankSyncCyl7" "CYL7" 8 103 1 /end RASTER
 /begin RASTER "TimeSync10ms" "10ms" 30 3 10 /end RASTER
 /begin RASTER "Display" "DISP" 31 3 100 /end RASTER
 /begin EVENT_GROUP "CrankSyncCyl0-7" "CRANK" RASTER 1 RASTER 2 RASTER 3 RASTER 4 RASTER 5 RASTER 6 RASTER 7 RASTER 8 /end EVENT_GROUP
 /begin SEED_KEY "internal.dll" "internal.dll" "internal.dll" /end SEED_KEY
 /begin CHECKSUM "CRC16.DLL" /end CHECKSUM
 /begin TP_BLOB 0x0201 0x0204 0x7a0 0x7a1 0x1 2 BAUDRATE 1000000 SAMPLE_POINT 60 SAMPLE_RATE 1 BTL_CYCLES 16 SJW 2 SYNC_EDGE DUAL RESUME_SUPPORTED STORE_SUPPORTED /begin CHECKSUM_PARAM 0x9001 0x200 CHECKSUM_CALCULATION ACTIVE_PAGE /end CHECKSUM_PARAM
  /begin DEFINED_PAGES 1 "Working Page" 0 0xa0880000 0x40000 RAM RAM_INIT_BY_ECU FLASH_BACK /end DEFINED_PAGES
  /begin DEFINED_PAGES 2 "Reference Page" 0 0xa0800000 0x40000 FLASH DEFAULT /end DEFINED_PAGES
  OPTIONAL_CMD 0x5 OPTIONAL_CMD 0x8 OPTIONAL_CMD 0x9 OPTIONAL_CMD 0xc OPTIONAL_CMD 0xd OPTIONAL_CMD 0xe OPTIONAL_CMD 0x11 OPTIONAL_CMD 0x12 OPTIONAL_CMD 0x13 OPTIONAL_CMD 0x19 OPTIONAL_CMD 0x23 /end TP_BLOB
/end IF_DATA
/begin IF_DATA ETK
 /begin SOURCE "Segment Synchronous" 103 1 QP_BLOB 1 0x3c 0x0 0x0 0x0 0 0 0 /end SOURCE
 /begin SOURCE "Time Synchronous 10ms" 4 1 QP_BLOB 2 0x5c 0x0 0x0 0x0 10 0 0 /end SOURCE
 /begin SOURCE "Time Synchronous 100ms" 5 1 QP_BLOB 3 0x5c 0x0 0x0 0x0 100 0 0 /end SOURCE
 /begin SOURCE "Bypass Segment Synchronous" 103 1 QP_BLOB 4 0x30 0x0 0x0 0x0 0 0x10 0x0 /end SOURCE
 /begin SOURCE "Bypass Time Synchronous" 4 1 QP_BLOB 5 0x30 0x0 0x0 0x0 10 0x20 0x0 /end SOURCE
 /begin TP_BLOB 16777217 0 2048 /begin DISTAB_CFG 13 273 1 25682176 16843008 TRG_MOD 0 183 0 0 0 /end DISTAB_CFG CODE_CHK 0 0 0 0 ETK_CFG 2 226 78 223 239 78 223 239 78 207 251 254 255 255 251 255 255 255 255 255 3 255 1 255 RESERVED 8774864 1536 EXTERN -1 -1 -1 -1 -1 /end TP_BLOB
/end IF_DATA
/begin IF_DATA CNP_KWPONCAN
 /begin TP_BLOB
  /begin KWP 331 0 255 500 10000 1000 0 "" 0x09 0x00 0xFF 0 0 0 0x4F1 0x971 1 0x1C 0x10 0xF1 0x600 0 0 1 0x92 0x81 0x93 /end KWP
  /begin DLL 7 0 0 0 CAL_RAM 0x0 0x0 /end DLL
  /begin CAN 282 1 0x4B 0x14 4096 "" 5555 0 0 /end CAN
  /begin CNP_INI 14 "CNP_INI" /end CNP_INI
 /end TP_BLOB
/end IF_DATA
/begin CHARACTERISTIC c_vs_min_ef_at "Speed threshold for continuously opened exhaust flap, automatically shifted transmission" VALUE 0xa080c4d9 _REC_VAL_20_u1 255. _CNV_A_R_LINEAR_____6_CM 0. 255. DISPLAY_IDENTIFIER C_VS_MIN_EF_AT FORMAT "%3.0" /end CHARACTERISTIC
/begin CHARACTERISTIC c_vs_min_ef_mt "Speed threshold for continuously opened exhaust flap, manually shifted transmission" VALUE 0xa080c4da _REC_VAL_20_u1 255. _CNV_A_R_LINEAR_____6_CM 0. 255. DISPLAY_IDENTIFIER C_VS_MIN_EF_MT FORMAT "%3.0" /end CHARACTERISTIC
/begin CHARACTERISTIC c_t_ef_ast "Cranking time for EF actuation active" VALUE 0xa080c1a8 _REC_VAL_20_u1 25.5 _CNV_A_R_LINEAR_____4_CM 0. 25.5 DISPLAY_IDENTIFIER C_T_EF_AST FORMAT "%4.1" /end CHARACTERISTIC
/begin AXIS_PTS ldpm_gear_ef_1 "" 0xa0809444 gear_ef _REC_AXS_20_u1 6. _CNV_A_R_LINEAR_____0_CM 7 0. 6. FORMAT "%1.0" /end AXIS_PTS
/begin CHARACTERISTIC id_fac_tq_ef_thd_ctop_open_mt "Switching threshold FAC_TQ_EF for convertible top open MT" MAP 0xa0813c28 _REC_MAP_20_u2_u1_u1 1.99996948242188 _CNV_A_R_LINEAR_____9_CM 0. 1.99996948242188 DISPLAY_IDENTIFIER ID_FAC_TQ_EF_THD_CTOP_OPEN_MT FORMAT "%9.8"
 /begin AXIS_DESCR COM_AXIS n_ef _CNV_A_R_LINEAR_____10_CM 6 0. 8160. FORMAT "%4.0" AXIS_PTS_REF ldpm_n_ef /end AXIS_DESCR
 /begin AXIS_DESCR COM_AXIS gear_ef _CNV_A_R_LINEAR_____0_CM 7 0. 6. FORMAT "%1.0" AXIS_PTS_REF ldpm_gear_ef_1 /end AXIS_DESCR
/end CHARACTERISTIC
/begin CHARACTERISTIC id_fac_tq_ef_thd_ctop_open_at "Switching threshold FAC_TQ_EF for convertible top open  AT" MAP 0xa0813bd4 _REC_MAP_20_u2_u1_u1 1.99996948242188 _CNV_A_R_LINEAR_____9_CM 0. 1.99996948242188 DISPLAY_IDENTIFIER ID_FAC_TQ_EF_THD_CTOP_OPEN_AT FORMAT "%9.8"
 /begin AXIS_DESCR COM_AXIS n_ef _CNV_A_R_LINEAR_____10_CM 6 0. 8160. FORMAT "%4.0" AXIS_PTS_REF ldpm_n_ef /end AXIS_DESCR
 /begin AXIS_DESCR COM_AXIS gear_ef _CNV_A_R_LINEAR_____0_CM 7 0. 6. FORMAT "%1.0" AXIS_PTS_REF ldpm_gear_ef_1 /end AXIS_DESCR
/end CHARACTERISTIC
/begin AXIS_PTS ldpm_n_ef "" 0xa08096aa n_ef _REC_AXS_20_u1 8160. _CNV_A_R_LINEAR_____10_CM 6 0. 8160. FORMAT "%4.0" /end AXIS_PTS
/begin CHARACTERISTIC id_fac_tq_ef_thd_ctop_close_at "Switching threshold FAC_TQ_EF for convertible top close  AT" MAP 0xa0813b2c _REC_MAP_20_u2_u1_u1 1.99996948242188 _CNV_A_R_LINEAR_____9_CM 0. 1.99996948242188 DISPLAY_IDENTIFIER ID_FAC_TQ_EF_THD_CTOP_CLOSE_AT FORMAT "%9.8"
 /begin AXIS_DESCR COM_AXIS n_ef _CNV_A_R_LINEAR_____10_CM 6 0. 8160. FORMAT "%4.0" AXIS_PTS_REF ldpm_n_ef /end AXIS_DESCR
 /begin AXIS_DESCR COM_AXIS gear_ef _CNV_A_R_LINEAR_____0_CM 7 0. 6. FORMAT "%1.0" AXIS_PTS_REF ldpm_gear_ef_1 /end AXIS_DESCR
/end CHARACTERISTIC
/begin CHARACTERISTIC id_fac_tq_ef_thd_ctop_close_mt "Switching threshold FAC_TQ_EF for convertible top close  MT" MAP 0xa0813b80 _REC_MAP_20_u2_u1_u1 1.99996948242188 _CNV_A_R_LINEAR_____9_CM 0. 1.99996948242188 DISPLAY_IDENTIFIER ID_FAC_TQ_EF_THD_CTOP_CLOSE_MT FORMAT "%9.8"
 /begin AXIS_DESCR COM_AXIS n_ef _CNV_A_R_LINEAR_____10_CM 6 0. 8160. FORMAT "%4.0" AXIS_PTS_REF ldpm_n_ef /end AXIS_DESCR
 /begin AXIS_DESCR COM_AXIS gear_ef _CNV_A_R_LINEAR_____0_CM 7 0. 6. FORMAT "%1.0" AXIS_PTS_REF ldpm_gear_ef_1 /end AXIS_DESCR
/end CHARACTERISTIC
/begin CHARACTERISTIC ip_t_dly_ef "Time delay for closing exhaust flap" CURVE 0xa080b410 _REC_CUR_20_u1_u1 25.5 _CNV_A_R_LINEAR_____4_CM 0. 25.5 DISPLAY_IDENTIFIER IP_T_DLY_EF FORMAT "%4.1"
 /begin AXIS_DESCR COM_AXIS n_32 _CNV_A_R_LINEAR_____10_CM 8 0. 8160. FORMAT "%4.0" AXIS_PTS_REF ldp_n_32_ip_t_dly_ef /end AXIS_DESCR
/end CHARACTERISTIC
/begin CHARACTERISTIC lc_ef_conf "Switch for inverted exhaust flap = 0 normal flap; =1 inverted flap" VALUE 0xa080c54f _REC_VAL_20_u1 1. _CNV_A_R_LINEAR_____0_CM 0. 1. DISPLAY_IDENTIFIER LC_EF_CONF FORMAT "%2.0" /end CHARACTERISTIC
/begin CHARACTERISTIC c_n_ef_hys "Switch for inverted exhaust flap = 0 normal flap; =1 inverted flap" VALUE 0xa080bf2f _REC_VAL_20_u1 8160. _CNV_A_R_LINEAR_____10_CM 0. 8160. DISPLAY_IDENTIFIER C_N_EF_HYS FORMAT "%4.0" /end CHARACTERISTIC
/begin CHARACTERISTIC c_fac_tq_ef_thd_hys "Hysteresis for switching threshold" VALUE 0xa080bd08 _REC_VAL_20_s2 3.999938965 _CNV_A_R_LINEAR_____11_CM -2. 1.999938965 DISPLAY_IDENTIFIER C_FAC_TQ_EF_THD_HYS FORMAT "%8.4" /end CHARACTERISTIC
/begin MEASUREMENT lv_ef "Logical value exhaust flap, 1 = closed flap" UBYTE _CNV_S_2_RANGE__0___1_CM 1 100. 0. 1. DISPLAY_IDENTIFIER LV_EF ECU_ADDRESS 0xd0008d14 BIT_MASK 0x1 /end MEASUREMENT
/begin MEASUREMENT fac_tq_ef_thd "Switching threshold for exhaust flap" UWORD _CNV_A_R_LINEAR_____9_CM 1 100. 0. 1.99996948242188 DISPLAY_IDENTIFIER FAC_TQ_EF_THD ECU_ADDRESS 0xd0000324 FORMAT "%7.5" /end MEASUREMENT
/begin MEASUREMENT fac_tq_ef_thd_ctop "Switching threshold for exhaust flap without hysteresis" UWORD _CNV_A_R_LINEAR_____9_CM 1 100. 0. 1.99996948242188 DISPLAY_IDENTIFIER FAC_TQ_EF_THD_CTOP ECU_ADDRESS 0xd0000326 FORMAT "%7.5" /end MEASUREMENT
/begin MEASUREMENT n_ef "N for exhaust flap" UBYTE _CNV_A_R_LINEAR_____10_CM 1 100. 0. 8160. DISPLAY_IDENTIFIER N_EF ECU_ADDRESS 0xd000032c FORMAT "%4.0" /end MEASUREMENT
/begin MEASUREMENT t_dly_ef "Time delay for closing exhaust flap" UBYTE _CNV_A_R_LINEAR_____4_CM 1 100. 0. 25.5 DISPLAY_IDENTIFIER T_DLY_EF ECU_ADDRESS 0xd000032d FORMAT "%4.1" /end MEASUREMENT
/begin AXIS_PTS ldp_n_32_ip_t_dly_ef "" 0xa0808a38 n_32 _REC_AXS_20_u1 8160. _CNV_A_R_LINEAR_____10_CM 8 0. 8160. FORMAT "%4.0" /end AXIS_PTS
/begin CHARACTERISTIC lc_state_ch_ef "Exhaust flap actuation in case catalyst heating with increased idle speed" VALUE 0xa080c5ef _REC_VAL_20_u1 1. _CNV_A_R_LINEAR_____0_CM 0. 1. DISPLAY_IDENTIFIER LC_STATE_CH_EF FORMAT "%2.0" /end CHARACTERISTIC
/begin CHARACTERISTIC lc_state_vs_min_ef_at "Exhaust flap actuation in case of vs < C_VS_MIN_EF_AT for AT version" VALUE 0xa080c5f3 _REC_VAL_20_u1 1. _CNV_A_R_LINEAR_____0_CM 0. 1. DISPLAY_IDENTIFIER LC_STATE_VS_MIN_EF_AT FORMAT "%2.0" /end CHARACTERISTIC
/begin CHARACTERISTIC lc_state_vs_min_ef_mt "Exhaust flap actuation in case of vs < C_VS_MIN_EF_MT for MT version" VALUE 0xa080c5f4 _REC_VAL_20_u1 1. _CNV_A_R_LINEAR_____0_CM 0. 1. DISPLAY_IDENTIFIER LC_STATE_VS_MIN_EF_MT FORMAT "%2.0" /end CHARACTERISTIC
/begin CHARACTERISTIC lc_state_ef_ast "State exhaust flap after start" VALUE 0xa080c5f0 _REC_VAL_20_u1 1. _CNV_A_R_LINEAR_____0_CM 0. 1. DISPLAY_IDENTIFIER LC_STATE_EF_AST FORMAT "%2.0" /end CHARACTERISTIC
/begin CHARACTERISTIC c_v_sof_swi_on_bol "Voltage-Treshold bottom limit for sport mode ON" VALUE 0xa080c408 _REC_VAL_20_u2 4.9951171875 _CNV_A_R_LINEAR_____2_CM 0. 4.9951171875 DISPLAY_IDENTIFIER C_V_SOF_SWI_ON_BOL FORMAT "%5.3" /end CHARACTERISTIC
/begin MEASUREMENT lv_sof_swi_req "Sport Mode required by switch" UBYTE _CNV_S_2_RANGE__0___1_CM 1 100. 0. 1. DISPLAY_IDENTIFIER LV_SOF_SWI_REQ ECU_ADDRESS 0xd0008d18 BIT_MASK 0x1 /end MEASUREMENT
/begin MEASUREMENT lv_sof_swi "Sport Mode switch acting" UBYTE _CNV_S_2_RANGE__0___1_CM 1 100. 0. 1. DISPLAY_IDENTIFIER LV_SOF_SWI ECU_ADDRESS 0xd0008d19 BIT_MASK 0x1 /end MEASUREMENT
/begin MEASUREMENT lv_sof_swi_amt "Sport-mode switch AMT acting" UBYTE _CNV_S_2_RANGE__0___1_CM 1 100. 0. 1. DISPLAY_IDENTIFIER LV_SOF_SWI_AMT ECU_ADDRESS 0xd0008d1a BIT_MASK 0x1 /end MEASUREMENT
/begin MEASUREMENT lv_sof_swi_amt_req "Sport-mode AMT required by switch" UBYTE _CNV_S_2_RANGE__0___1_CM 1 100. 0. 1. DISPLAY_IDENTIFIER LV_SOF_SWI_AMT_REQ ECU_ADDRESS 0xd0008d1b BIT_MASK 0x1 /end MEASUREMENT
/begin CHARACTERISTIC c_v_sof_swi_on_tol "Voltage-Treshold top limit for sport mode ON (AMT)" VALUE 0xa080c40a _REC_VAL_20_u2 4.9951171875 _CNV_A_R_LINEAR_____2_CM 0. 4.9951171875 DISPLAY_IDENTIFIER C_V_SOF_SWI_ON_TOL FORMAT "%5.3" /end CHARACTERISTIC
/begin CHARACTERISTIC c_v_sof_swi_amt_on_tol "Voltage-Treshold top limit for sport mode ON" VALUE 0xa080c402 _REC_VAL_20_u2 4.9951171875 _CNV_A_R_LINEAR_____2_CM 0. 4.9951171875 DISPLAY_IDENTIFIER C_V_SOF_SWI_AMT_ON_TOL FORMAT "%5.3" /end CHARACTERISTIC
/begin CHARACTERISTIC lc_var_sof_swi "Calibration switch (1 on / 0 off)" VALUE 0xa080c61c _REC_VAL_20_u1 1. _CNV_A_R_LINEAR_____0_CM 0. 1. DISPLAY_IDENTIFIER LC_VAR_SOF_SWI FORMAT "%2.0" /end CHARACTERISTIC
/begin CHARACTERISTIC lc_var_sof_swi_amt "Calibration switch (1 on / 0 off)" VALUE 0xa080c61d _REC_VAL_20_u1 1. _CNV_A_R_LINEAR_____0_CM 0. 1. DISPLAY_IDENTIFIER LC_VAR_SOF_SWI_AMT FORMAT "%2.0" /end CHARACTERISTIC
/begin CHARACTERISTIC lc_conf_city_ena "Enable condition regarding lv_city (1 on / 0 off)" VALUE 0xa080c53e _REC_VAL_20_u1 1. _CNV_A_R_LINEAR_____0_CM 0. 1. DISPLAY_IDENTIFIER LC_CONF_CITY_ENA FORMAT "%2.0" /end CHARACTERISTIC
/begin CHARACTERISTIC c_vs_min_sof_mt "Speed threshold for continously opened sound flap (manuel transmission)" VALUE 0xa080c4ec _REC_VAL_20_u1 255. _CNV_A_R_LINEAR_____6_CM 0. 255. DISPLAY_IDENTIFIER C_VS_MIN_SOF_MT FORMAT "%3.0" /end CHARACTERISTIC
/begin CHARACTERISTIC c_vs_min_sof_at "Speed threshold for continously opened sound flap (automatic transmission)" VALUE 0xa080c4eb _REC_VAL_20_u1 255. _CNV_A_R_LINEAR_____6_CM 0. 255. DISPLAY_IDENTIFIER C_VS_MIN_SOF_AT FORMAT "%3.0" /end CHARACTERISTIC
/begin MEASUREMENT lv_sof "Logical value sound flap (1 = activated)" UBYTE _CNV_S_2_RANGE__0___1_CM 1 100. 0. 1. DISPLAY_IDENTIFIER LV_SOF ECU_ADDRESS 0xd0008d1c BIT_MASK 0x1 /end MEASUREMENT
/begin MEASUREMENT fac_tq_sof_thd "Switching threshold for sound flap" UWORD _CNV_A_R_LINEAR_____9_CM 1 100. 0. 1.99996948242188 DISPLAY_IDENTIFIER FAC_TQ_SOF_THD ECU_ADDRESS 0xd0000338 FORMAT "%7.5" /end MEASUREMENT
/begin MEASUREMENT fac_tq_sof_thd_ctop "Switching threshold for sound flap without hysteresis" UWORD _CNV_A_R_LINEAR_____9_CM 1 100. 0. 1.99996948242188 DISPLAY_IDENTIFIER FAC_TQ_SOF_THD_CTOP ECU_ADDRESS 0xd000033a FORMAT "%7.5" /end MEASUREMENT
/begin MEASUREMENT n_sof "N for sound flap" UBYTE _CNV_A_R_LINEAR_____10_CM 1 100. 0. 8160. DISPLAY_IDENTIFIER N_SOF ECU_ADDRESS 0xd0000340 FORMAT "%4.0" /end MEASUREMENT
/begin MEASUREMENT t_dly_sof "Time delay for closing sound flap" UBYTE _CNV_A_R_LINEAR_____4_CM 1 100. 0. 25.5 DISPLAY_IDENTIFIER T_DLY_SOF ECU_ADDRESS 0xd0000341 FORMAT "%4.1" /end MEASUREMENT
/begin CHARACTERISTIC c_t_sof_ast "cranking time for SOF actuation active" VALUE 0xa080c271 _REC_VAL_20_u1 25.5 _CNV_A_R_LINEAR_____4_CM 0. 25.5 DISPLAY_IDENTIFIER C_T_SOF_AST FORMAT "%4.1" /end CHARACTERISTIC
/begin CHARACTERISTIC c_n_sof_hys "N hysteresis SOF" VALUE 0xa080bfb3 _REC_VAL_20_u1 8160. _CNV_A_R_LINEAR_____10_CM 0. 8160. DISPLAY_IDENTIFIER C_N_SOF_HYS FORMAT "%4.0" /end CHARACTERISTIC
/begin CHARACTERISTIC c_fac_tq_sof_thd_hys "Hysteresis for switching threshold sound flap" VALUE 0xa080bd24 _REC_VAL_20_s2 3.99993896484375 _CNV_A_R_LINEAR_____24_CM -2. 1.99993896484375 DISPLAY_IDENTIFIER C_FAC_TQ_SOF_THD_HYS FORMAT "%8.5" /end CHARACTERISTIC
/begin AXIS_PTS ldpm_n_sof "" 0xa08096ea n_sof _REC_AXS_20_u1 8160. _CNV_A_R_LINEAR_____10_CM 6 0. 8160. FORMAT "%4.0" /end AXIS_PTS
/begin AXIS_PTS ldp_n_32_ip_t_dly_sof "" 0xa0808a44 n_32 _REC_AXS_20_u1 8160. _CNV_A_R_LINEAR_____10_CM 8 0. 8160. FORMAT "%4.0" /end AXIS_PTS
/begin CHARACTERISTIC ip_t_dly_sof "Time delay for closing sound flap" CURVE 0xa080b42c _REC_CUR_20_u1_u1 25.5 _CNV_A_R_LINEAR_____4_CM 0. 25.5 DISPLAY_IDENTIFIER IP_T_DLY_SOF FORMAT "%4.1"
 /begin AXIS_DESCR COM_AXIS n_32 _CNV_A_R_LINEAR_____10_CM 8 0. 8160. FORMAT "%4.0" AXIS_PTS_REF ldp_n_32_ip_t_dly_sof /end AXIS_DESCR
/end CHARACTERISTIC
/begin CHARACTERISTIC id_fac_tq_sof_thd_ctop_open_mt "Switching threshold FAC_TQ_SOF for convertible top open (manuel transmission)" MAP 0xa0813d78 _REC_MAP_20_u2_u1_u1 1.99996948242188 _CNV_A_R_LINEAR_____9_CM 0. 1.99996948242188 DISPLAY_IDENTIFIER ID_FAC_TQ_SOF_THD_CTOP_OPEN_MT FORMAT "%7.5"
 /begin AXIS_DESCR COM_AXIS n_sof _CNV_A_R_LINEAR_____10_CM 6 0. 8160. FORMAT "%4.0" AXIS_PTS_REF ldpm_n_sof /end AXIS_DESCR
 /begin AXIS_DESCR COM_AXIS gear_ef _CNV_A_R_LINEAR_____0_CM 7 0. 6. FORMAT "%1.0" AXIS_PTS_REF ldpm_gear_ef_1 /end AXIS_DESCR
/end CHARACTERISTIC
/begin CHARACTERISTIC id_fac_tq_sof_thd_ctop_open_at "Switching threshold FAC_TQ_SOF for convertible top open (automatic transmission)" MAP 0xa0813d24 _REC_MAP_20_u2_u1_u1 1.99996948242188 _CNV_A_R_LINEAR_____9_CM 0. 1.99996948242188 DISPLAY_IDENTIFIER ID_FAC_TQ_SOF_THD_CTOP_OPEN_AT FORMAT "%7.5"
 /begin AXIS_DESCR COM_AXIS n_sof _CNV_A_R_LINEAR_____10_CM 6 0. 8160. FORMAT "%4.0" AXIS_PTS_REF ldpm_n_sof /end AXIS_DESCR
 /begin AXIS_DESCR COM_AXIS gear_ef _CNV_A_R_LINEAR_____0_CM 7 0. 6. FORMAT "%1.0" AXIS_PTS_REF ldpm_gear_ef_1 /end AXIS_DESCR
/end CHARACTERISTIC
/begin CHARACTERISTIC id_fac_tq_sof_thd_ctop_close_mt "Switching threshold FAC_TQ_SOF for convertible top closed (manuel transmission)" MAP 0xa0813cd0 _REC_MAP_20_u2_u1_u1 1.99996948242188 _CNV_A_R_LINEAR_____9_CM 0. 1.99996948242188 DISPLAY_IDENTIFIER ID_FAC_TQ_SOF_THD_CTOP_CLOSE_MT FORMAT "%7.5"
 /begin AXIS_DESCR COM_AXIS n_sof _CNV_A_R_LINEAR_____10_CM 6 0. 8160. FORMAT "%4.0" AXIS_PTS_REF ldpm_n_sof /end AXIS_DESCR
 /begin AXIS_DESCR COM_AXIS gear_ef _CNV_A_R_LINEAR_____0_CM 7 0. 6. FORMAT "%1.0" AXIS_PTS_REF ldpm_gear_ef_1 /end AXIS_DESCR
/end CHARACTERISTIC
/begin CHARACTERISTIC id_fac_tq_sof_thd_ctop_close_at "Switching threshold FAC_TQ_SOF for convertible top closed (automatic transmission)" MAP 0xa0813c7c _REC_MAP_20_u2_u1_u1 1.99996948242188 _CNV_A_R_LINEAR_____9_CM 0. 1.99996948242188 DISPLAY_IDENTIFIER ID_FAC_TQ_SOF_THD_CTOP_CLOSE_AT FORMAT "%7.5"
 /begin AXIS_DESCR COM_AXIS n_sof _CNV_A_R_LINEAR_____10_CM 6 0. 8160. FORMAT "%4.0" AXIS_PTS_REF ldpm_n_sof /end AXIS_DESCR
 /begin AXIS_DESCR COM_AXIS gear_ef _CNV_A_R_LINEAR_____0_CM 7 0. 6. FORMAT "%1.0" AXIS_PTS_REF ldpm_gear_ef_1 /end AXIS_DESCR
/end CHARACTERISTIC
/begin CHARACTERISTIC lc_state_vs_min_sof_mt "State sound flap in case of VS < C_VS_MIN_SOF_MT (manuel transmission)" VALUE 0xa080c5f6 _REC_VAL_20_u1 1. _CNV_A_R_LINEAR_____0_CM 0. 1. DISPLAY_IDENTIFIER LC_STATE_VS_MIN_SOF_MT FORMAT "%2.0" /end CHARACTERISTIC
/begin CHARACTERISTIC lc_state_vs_min_sof_at "State sound flap in case of VS < C_VS_MIN_SOF_MT (automatic transmission)" VALUE 0xa080c5f5 _REC_VAL_20_u1 1. _CNV_A_R_LINEAR_____0_CM 0. 1. DISPLAY_IDENTIFIER LC_STATE_VS_MIN_SOF_AT FORMAT "%2.0" /end CHARACTERISTIC
/begin CHARACTERISTIC lc_state_sof_ast "State sound flap during C_T_SOF_AST" VALUE 0xa080c5f1 _REC_VAL_20_u1 1. _CNV_A_R_LINEAR_____0_CM 0. 1. DISPLAY_IDENTIFIER LC_STATE_SOF_AST FORMAT "%2.0" /end CHARACTERISTIC
/begin MEASUREMENT lv_accout_rly_ena "LV indicating that the conditions for activating the ACC-relay are fullfilled" UBYTE _CNV_S_2_RANGE__0___1_CM 1 100. 0. 1. DISPLAY_IDENTIFIER LV_ACCOUT_RLY_ENA ECU_ADDRESS 0xd0008cfa BIT_MASK 0x1 /end MEASUREMENT
/begin CHARACTERISTIC c_vs_max_accin "Speed condition for ACC suppression at high load" VALUE 0xa080c4c8 _REC_VAL_20_u1 255. _CNV_A_R_LINEAR_____6_CM 0. 255. DISPLAY_IDENTIFIER C_VS_MAX_ACCIN FORMAT "%3.0" /end CHARACTERISTIC
/begin CHARACTERISTIC c_accin_dly_1 "Delay for ACC suppression in transition after full load" VALUE 0xa080ba76 _REC_VAL_20_u2 655.34 _CNV_A_R_LINEAR_____3_CM 1.e-002 655.35 DISPLAY_IDENTIFIER C_ACCIN_DLY_1 FORMAT "%6.2" /end CHARACTERISTIC
/begin CHARACTERISTIC c_accin_dly_1_lock_fl "Blocking time for renewed triggering of the ACC suppression at high load" VALUE 0xa080ba78 _REC_VAL_20_u2 655.35 _CNV_A_R_LINEAR_____3_CM 0. 655.35 DISPLAY_IDENTIFIER C_ACCIN_DLY_1_LOCK_FL FORMAT "%6.2" /end CHARACTERISTIC
/begin CHARACTERISTIC c_accin_dly_4 "Delay in transition from start" VALUE 0xa080ba7a _REC_VAL_20_u2 6553.5 _CNV_A_R_LINEAR_____4_CM 0. 6553.5 DISPLAY_IDENTIFIER C_ACCIN_DLY_4 FORMAT "%6.1" /end CHARACTERISTIC
/begin CHARACTERISTIC c_pvs_fl_accin "PV-threshold for ACC suppression" VALUE 0xa080c096 _REC_VAL_20_u1 99.609375 _CNV_A_R_LINEAR_____5_CM 0. 99.609375 DISPLAY_IDENTIFIER C_PVS_FL_ACCIN FORMAT "%4.1" /end CHARACTERISTIC
/begin CHARACTERISTIC c_accin_dly_5 "Delay before renewed reactivation of the ACC" VALUE 0xa080ba7c _REC_VAL_20_u2 655.35 _CNV_A_R_LINEAR_____3_CM 0. 655.35 DISPLAY_IDENTIFIER C_ACCIN_DLY_5 FORMAT "%6.2" /end CHARACTERISTIC
/begin MEASUREMENT lv_accout_rly "LV to activate the ACC-relay" UBYTE _CNV_S_2_RANGE__0___1_CM 1 100. 0. 1. DISPLAY_IDENTIFIER LV_ACCOUT_RLY ECU_ADDRESS 0xd0008cfb BIT_MASK 0x1 /end MEASUREMENT
/begin CHARACTERISTIC c_tco_max_accin_hys "Hysteresis for leaving ACC suppression" VALUE 0xa080c2c7 _REC_VAL_20_u1 60. _CNV_A_R_LINEAR_____25_CM 0. 60. DISPLAY_IDENTIFIER C_TCO_MAX_ACCIN_HYS FORMAT "%4.1" /end CHARACTERISTIC
/begin AXIS_PTS ldpm_n_32__t_acc "" 0xa0809600 n_32 _REC_AXS_20_u1 8160. _CNV_A_R_LINEAR_____10_CM 3 0. 8160. FORMAT "%4.0" /end AXIS_PTS
/begin MEASUREMENT t_acc "Timer for duration of transient TQ_LOSS_ACC correction " UBYTE _CNV_A_R_LINEAR_____3_CM 1 100. 0. 2.55 DISPLAY_IDENTIFIER T_ACC ECU_ADDRESS 0xd0008cf8 FORMAT "%4.2" /end MEASUREMENT
/begin MEASUREMENT t_acc_dly "delay time for start of TQ_LOSS_ACC-calculation & ACC-relay" UBYTE _CNV_A_R_LINEAR_____3_CM 1 100. 0. 2.55 DISPLAY_IDENTIFIER T_ACC_DLY ECU_ADDRESS 0xd0008cf9 FORMAT "%4.2" /end MEASUREMENT
/begin CHARACTERISTIC ip_t_acc_dly_on__n_32 "Turn-On-Delay for start of T_ACC depending on N_32" CURVE 0xa080b3c0 _REC_CUR_20_u1_u1 2.55 _CNV_A_R_LINEAR_____3_CM 0. 2.55 DISPLAY_IDENTIFIER IP_T_ACC_DLY_ON__N_32 FORMAT "%4.2"
 /begin AXIS_DESCR COM_AXIS n_32 _CNV_A_R_LINEAR_____10_CM 3 0. 8160. FORMAT "%4.0" AXIS_PTS_REF ldpm_n_32__t_acc /end AXIS_DESCR
/end CHARACTERISTIC
/begin CHARACTERISTIC ip_t_acc_dly_off__n_32 "Turn-Off-Delay for start of T_ACC depending on N_32" CURVE 0xa080b3bc _REC_CUR_20_u1_u1 2.55 _CNV_A_R_LINEAR_____3_CM 0. 2.55 DISPLAY_IDENTIFIER IP_T_ACC_DLY_OFF__N_32 FORMAT "%4.2"
 /begin AXIS_DESCR COM_AXIS n_32 _CNV_A_R_LINEAR_____10_CM 3 0. 8160. FORMAT "%4.0" AXIS_PTS_REF ldpm_n_32__t_acc /end AXIS_DESCR
/end CHARACTERISTIC
/begin CHARACTERISTIC c_tco_max_accin "TCC threshold for ACC suppression" VALUE 0xa080c2c6 _REC_VAL_20_u1 190.5 _CNV_A_R_LINEAR_____17_CM -48. 142.5 DISPLAY_IDENTIFIER C_TCO_MAX_ACCIN FORMAT "%5.1" /end CHARACTERISTIC
/begin CHARACTERISTIC c_toil_max_accin "TOIL threshold for ACC suppression" VALUE 0xa080c34b _REC_VAL_20_u1 200. _CNV_A_R_LINEAR_____26_CM -40. 160. DISPLAY_IDENTIFIER C_TOIL_MAX_ACCIN FORMAT "%3.0" /end CHARACTERISTIC
/begin CHARACTERISTIC c_toil_max_accin_hys "TOIL hysteresis for ACC suppression" VALUE 0xa080c34c _REC_VAL_20_u1 60. _CNV_A_R_LINEAR_____25_CM 0. 60. DISPLAY_IDENTIFIER C_TOIL_MAX_ACCIN_HYS FORMAT "%4.1" /end CHARACTERISTIC
/begin CHARACTERISTIC c_temp_gb_max_accin "TEMP_GB threshold for ACC suppression" VALUE 0xa080c311 _REC_VAL_20_u1 255. _CNV_A_R_LINEAR_____26_CM -40. 215. DISPLAY_IDENTIFIER C_TEMP_GB_MAX_ACCIN FORMAT "%3.0" /end CHARACTERISTIC
/begin CHARACTERISTIC c_temp_gb_max_accin_hys "TEMP_GB hysteresis for ACC suppression" VALUE 0xa080c312 _REC_VAL_20_u1 60. _CNV_A_R_LINEAR_____25_CM 0. 60. DISPLAY_IDENTIFIER C_TEMP_GB_MAX_ACCIN_HYS FORMAT "%4.1" /end CHARACTERISTIC
/begin MEASUREMENT state_efp_ctl "State which EFP-control is active" UBYTE _CNV_A_R_LINEAR_____0_CM 1 100. 0. 3. DISPLAY_IDENTIFIER STATE_EFP_CTL ECU_ADDRESS 0xd00081f0 FORMAT "%1.0" /end MEASUREMENT
/begin MEASUREMENT state_efp_ctl_ecu "Output State of  status closed loop control (DME to EFP)" UBYTE _CNV_A_R_LINEAR_____0_CM 1 100. 0. 3. DISPLAY_IDENTIFIER STATE_EFP_CTL_ECU ECU_ADDRESS 0xd00081f1 FORMAT "%1.0" /end MEASUREMENT
/begin MEASUREMENT state_veh_cns_fct "State functionality of vehicle consumer" UBYTE _CNV_A_R_LINEAR_____0_CM 1 100. 0. 3. DISPLAY_IDENTIFIER STATE_VEH_CNS_FCT ECU_ADDRESS 0xd00081ce FORMAT "%1.0" /end MEASUREMENT
/begin MEASUREMENT cur_eng_efp "Engine current of the EFP" UBYTE _CNV_A_R_LINEAR_____74_CM 1 100. 0. 25.5 DISPLAY_IDENTIFIER CUR_ENG_EFP ECU_ADDRESS 0xd0008274 FORMAT "%4.1" /end MEASUREMENT
/begin MEASUREMENT lv_efp_on_ext_adj_can "switch ON of EFP via CAN (tester diagnosis9" UBYTE _CNV_S_2_RANGE__0___1_CM 1 100. 0. 1. DISPLAY_IDENTIFIER LV_EFP_ON_EXT_ADJ_CAN ECU_ADDRESS 0xd0008277 BIT_MASK 0x1 /end MEASUREMENT
/begin MEASUREMENT lv_efp_off_ext_adj_can "switch OFF of EFP via CAN (tester diagnosis9" UBYTE _CNV_S_2_RANGE__0___1_CM 1 100. 0. 1. DISPLAY_IDENTIFIER LV_EFP_OFF_EXT_ADJ_CAN ECU_ADDRESS 0xd0008278 BIT_MASK 0x1 /end MEASUREMENT
/begin MEASUREMENT vb_efp "VB measured by EFP" UBYTE _CNV_A_R_LINEAR_____77_CM 1 100. 5. 30.5 DISPLAY_IDENTIFIER VB_EFP ECU_ADDRESS 0xd0008276 FORMAT "%4.1" /end MEASUREMENT
/begin MEASUREMENT n_efp_av "Engine speed of the EFP" UBYTE _CNV_A_R_LINEAR_____78_CM 1 100. 0. 12750. DISPLAY_IDENTIFIER N_EFP_AV ECU_ADDRESS 0xd0008275 FORMAT "%6.0" /end MEASUREMENT
/begin MEASUREMENT state_diag_efp "diagnosis status of the electical fuel pump" UBYTE _CNV_A_R_LINEAR_____0_CM 1 100. 0. 255. DISPLAY_IDENTIFIER STATE_DIAG_EFP ECU_ADDRESS 0xd0008271 FORMAT "%3.0" /end MEASUREMENT
/begin MEASUREMENT state_efp_can "EFP - state for EOL and ASA diagnosis" UBYTE _CNV_A_R_LINEAR_____0_CM 1 100. 0. 3. DISPLAY_IDENTIFIER STATE_EFP_CAN ECU_ADDRESS 0xd0008272 FORMAT "%1.0" /end MEASUREMENT
/begin MEASUREMENT v_eng_efp "Engine voltage of the EFP" UBYTE _CNV_A_R_LINEAR_____77_CM 1 100. 5. 30.5 DISPLAY_IDENTIFIER V_ENG_EFP ECU_ADDRESS 0xd0008273 FORMAT "%4.1" /end MEASUREMENT
/begin MEASUREMENT lv_ebox_cfa "control bit EBOX cooling fan" UBYTE _CNV_S_2_RANGE__0___1_CM 1 100. 0. 1. DISPLAY_IDENTIFIER LV_EBOX_CFA ECU_ADDRESS 0xd0008d04 BIT_MASK 0x1 /end MEASUREMENT
/begin CHARACTERISTIC c_tecu_thd_ebox_cfa "TECU threshold for EBOX cooling fan ON" VALUE 0xa080c2f7 _REC_VAL_20_u1 190.5 _CNV_A_R_LINEAR_____17_CM -48. 142.5 DISPLAY_IDENTIFIER C_TECU_THD_EBOX_CFA FORMAT "%5.1" /end CHARACTERISTIC
/begin CHARACTERISTIC c_tecu_hys_ebox_cfa "TECU hysteresis for EBOX cooling fan" VALUE 0xa080c2ee _REC_VAL_20_u1 190.5 _CNV_A_R_LINEAR_____25_CM 0. 190.5 DISPLAY_IDENTIFIER C_TECU_HYS_EBOX_CFA FORMAT "%5.1" /end CHARACTERISTIC
/begin CHARACTERISTIC c_tia_thd_ebox_cfa "TIA threshold for EBOX cooling fan ON" VALUE 0xa080c32f _REC_VAL_20_u1 190.5 _CNV_A_R_LINEAR_____17_CM -48. 142.5 DISPLAY_IDENTIFIER C_TIA_THD_EBOX_CFA FORMAT "%5.1" /end CHARACTERISTIC
/begin CHARACTERISTIC c_tia_hys_ebox_cfa "TIA hysteresis for EBOX cooling fan" VALUE 0xa080c327 _REC_VAL_20_u1 190.5 _CNV_A_R_LINEAR_____25_CM 0. 190.5 DISPLAY_IDENTIFIER C_TIA_HYS_EBOX_CFA FORMAT "%5.1" /end CHARACTERISTIC
/begin CHARACTERISTIC c_t_max_ebox_cfa_act "maximum time for activation of EBOX_CFA after Kl.15 on (for diagnosis)" VALUE 0xa080c1ea _REC_VAL_20_u1 255. _CNV_A_R_LINEAR_____36_CM 0. 255. DISPLAY_IDENTIFIER C_T_MAX_EBOX_CFA_ACT FORMAT "%3.0" /end CHARACTERISTIC
/begin CHARACTERISTIC c_n_thd_ebox_cfa_act "N threshold for activation of EBOX_CFA after Kl.15 on (for diagnosis)" VALUE 0xa080bfd6 _REC_VAL_20_u2 8160. _CNV_A_R_LINEAR_____14_CM 0. 8160. DISPLAY_IDENTIFIER C_N_THD_EBOX_CFA_ACT FORMAT "%4.0" /end CHARACTERISTIC
/begin MEASUREMENT fup_efp_sp "Fuel pressure setpoint of electrical fuel pump" UWORD _CNV_A_R_LINEAR_____173_CM 1 100. 0. 173888. DISPLAY_IDENTIFIER FUP_EFP_SP ECU_ADDRESS 0xd000a3fc FORMAT "%8.1" /end MEASUREMENT
/begin MEASUREMENT fup_efp_sp_tmp "Temporary value of fuel pressure setpoint of electrical fuel pump before limitation" UWORD _CNV_A_R_LINEAR_____173_CM 1 100. 0. 173888. DISPLAY_IDENTIFIER FUP_EFP_SP_TMP ECU_ADDRESS 0xd0000cf8 FORMAT "%8.1" /end MEASUREMENT
/begin CHARACTERISTIC c_fup_efp_sp_man "Manual FUP_EFP_SP" VALUE 0xa080bd6a _REC_VAL_20_u2 173888. _CNV_A_R_LINEAR_____173_CM 0. 173888. DISPLAY_IDENTIFIER C_FUP_EFP_SP_MAN FORMAT "%8.1" /end CHARACTERISTIC
/begin CHARACTERISTIC c_fup_efp_sp_ext_req "External FUP_EFP_SP" VALUE 0xa080bd62 _REC_VAL_20_u2 173888. _CNV_A_R_LINEAR_____173_CM 0. 173888. DISPLAY_IDENTIFIER C_FUP_EFP_SP_EXT_REQ FORMAT "%8.1" /end CHARACTERISTIC
/begin CHARACTERISTIC c_fup_efp_sp_hpp_lih "Fuel pressure setpoint for high pressure pump limp home " VALUE 0xa080bd64 _REC_VAL_20_u2 173888. _CNV_A_R_LINEAR_____173_CM 0. 173888. DISPLAY_IDENTIFIER C_FUP_EFP_SP_HPP_LIH FORMAT "%8.1" /end CHARACTERISTIC
/begin CHARACTERISTIC c_fup_efp_sp_lim_inc "Increment for fuel pressure setpoint limitation" VALUE 0xa080bd68 _REC_VAL_20_u2 173888. _CNV_A_R_LINEAR_____173_CM 0. 173888. DISPLAY_IDENTIFIER C_FUP_EFP_SP_LIM_INC FORMAT "%8.1" /end CHARACTERISTIC
/begin CHARACTERISTIC c_fup_efp_sp_lim_dec "Decrement for fuel pressure setpoint limitation" VALUE 0xa080bd66 _REC_VAL_20_u2 173888. _CNV_A_R_LINEAR_____173_CM 0. 173888. DISPLAY_IDENTIFIER C_FUP_EFP_SP_LIM_DEC FORMAT "%8.1" /end CHARACTERISTIC
/begin CHARACTERISTIC lc_fup_efp_sp_man_act "Switch for manual FUP_EFP_SP" VALUE 0xa080c579 _REC_VAL_20_u1 1. _CNV_A_R_LINEAR_____0_CM 0. 1. DISPLAY_IDENTIFIER LC_FUP_EFP_SP_MAN_ACT FORMAT "%1.0" /end CHARACTERISTIC
/begin CHARACTERISTIC c_fup_efp_sp_puc "Low fuel pressure setpoint in PU/PUC" VALUE 0xa080bd70 _REC_VAL_20_u2 173888. _CNV_A_R_LINEAR_____173_CM 0. 173888. DISPLAY_IDENTIFIER C_FUP_EFP_SP_PUC FORMAT "%8.1" /end CHARACTERISTIC
/begin CHARACTERISTIC c_fup_efp_sp_pwl "Low fuel pressure setpoint during power latch phase of EFP" VALUE 0xa080bd72 _REC_VAL_20_u2 173888. _CNV_A_R_LINEAR_____173_CM 0. 173888. DISPLAY_IDENTIFIER C_FUP_EFP_SP_PWL FORMAT "%8.1" /end CHARACTERISTIC
/begin AXIS_PTS ldp_mff_sp_fup_ctl_ip_efp_sp "" 0xa0808948 mff_sp_fup_ctl _REC_AXS_20_u2 1389. _CNV_A_R_LINEAR_____111_CM 4 0. 1389. FORMAT "%7.2" /end AXIS_PTS
/begin AXIS_PTS ldp_n_32_ip_fup_efp_sp "" 0xa0808a1a n_32 _REC_AXS_20_u1 8160. _CNV_A_R_LINEAR_____10_CM 4 0. 8160. FORMAT "%4.0" /end AXIS_PTS
/begin CHARACTERISTIC ip_fup_efp_sp "Fuel pressure setpoint of low pressure pump for normal operation" MAP 0xa080acbc _REC_MAP_20_u2_u2_u1 173888. _CNV_A_R_LINEAR_____173_CM 0. 173888. DISPLAY_IDENTIFIER IP_FUP_EFP_SP FORMAT "%8.1"
 /begin AXIS_DESCR COM_AXIS mff_sp_fup_ctl _CNV_A_R_LINEAR_____111_CM 4 0. 1389. FORMAT "%7.2" AXIS_PTS_REF ldp_mff_sp_fup_ctl_ip_efp_sp /end AXIS_DESCR
 /begin AXIS_DESCR COM_AXIS n_32 _CNV_A_R_LINEAR_____10_CM 4 0. 8160. FORMAT "%4.0" AXIS_PTS_REF ldp_n_32_ip_fup_efp_sp /end AXIS_DESCR
/end CHARACTERISTIC
/begin AXIS_PTS ldp_tfu_ip_fup_efp_sp "" 0xa0808e78 tfu _REC_AXS_20_u1 190.5 _CNV_A_R_LINEAR_____17_CM 8 -48. 142.5 FORMAT "%6.2" /end AXIS_PTS
/begin CHARACTERISTIC ip_fup_efp_sp_min "Minimum fuel pressure setpoint of low pressure pump" MAP 0xa08147f4 _REC_MAP_20_u2_u1_u2 173888. _CNV_A_R_LINEAR_____173_CM 0. 173888. DISPLAY_IDENTIFIER IP_FUP_EFP_SP_MIN FORMAT "%8.1"
 /begin AXIS_DESCR COM_AXIS tfu _CNV_A_R_LINEAR_____17_CM 8 -48. 142.5 FORMAT "%6.2" AXIS_PTS_REF ldp_tfu_ip_fup_efp_sp /end AXIS_DESCR
 /begin AXIS_DESCR COM_AXIS mff_sp_fup_ctl _CNV_A_R_LINEAR_____111_CM 8 0. 1389. FORMAT "%7.2" AXIS_PTS_REF ldpm_mff_sp_fup_ctl_fusl /end AXIS_DESCR
/end CHARACTERISTIC
/begin AXIS_PTS ldpm_mff_sp_fup_ctl_fusl "" 0xa0809548 mff_sp_fup_ctl _REC_AXS_20_u2 1389. _CNV_A_R_LINEAR_____111_CM 8 0. 1389. FORMAT "%7.2" /end AXIS_PTS
/begin AXIS_PTS ldp_tco_st_ip_t_fup_efp_sp_hst "" 0xa0808e0e tco_st _REC_AXS_20_u1 190.5 _CNV_A_R_LINEAR_____17_CM 3 -48. 142.5 FORMAT "%6.2" /end AXIS_PTS
/begin CHARACTERISTIC ip_fup_efp_sp_hst "Map with the FUP_EFP setpoint for the hot start" CURVE 0xa080acec _REC_CUR_20_u2_u2 173888. _CNV_A_R_LINEAR_____173_CM 0. 173888. DISPLAY_IDENTIFIER IP_FUP_EFP_SP_HST FORMAT "%8.1"
 /begin AXIS_DESCR COM_AXIS mff_sp_fup_ctl _CNV_A_R_LINEAR_____111_CM 8 0. 1389. FORMAT "%7.2" AXIS_PTS_REF ldpm_mff_sp_fup_ctl_fusl /end AXIS_DESCR
/end CHARACTERISTIC
/begin CHARACTERISTIC ip_t_fup_efp_sp_hst "Map with the time for the FUP_EFP setpoint for the hot start" CURVE 0xa080b434 _REC_CUR_20_u2_u1 655.34 _CNV_A_R_LINEAR_____3_CM 1.e-002 655.35 DISPLAY_IDENTIFIER IP_T_FUP_EFP_SP_HST FORMAT "%6.2"
 /begin AXIS_DESCR COM_AXIS tco_st _CNV_A_R_LINEAR_____17_CM 3 -48. 142.5 FORMAT "%6.2" AXIS_PTS_REF ldp_tco_st_ip_t_fup_efp_sp_hst /end AXIS_DESCR
/end CHARACTERISTIC
/begin MEASUREMENT vff_efp_add "Additive value of the amount of fuel from the pump" UBYTE _CNV_A_R_LINEAR_____174_CM 1 100. 0. 255. DISPLAY_IDENTIFIER VFF_EFP_ADD ECU_ADDRESS 0xd00088b9 FORMAT "%3.0" /end MEASUREMENT
/begin MEASUREMENT state_efp_tran "States of electrical fuel pump function" UBYTE _CNV_S_11_RANGE_STAT_175_CM 1 100. 0. 10. DISPLAY_IDENTIFIER STATE_EFP_TRAN ECU_ADDRESS 0xd00088b8 /end MEASUREMENT
/begin MEASUREMENT t_efp "Time counter for activated EFP" UWORD _CNV_A_R_LINEAR_____3_CM 1 100. 0. 655.35 DISPLAY_IDENTIFIER T_EFP ECU_ADDRESS 0xd0000b3c FORMAT "%6.2" /end MEASUREMENT
/begin MEASUREMENT lv_pump_pre_run_stop "Logical bit indicating pre run of the pump stopped" UBYTE _CNV_S_2_RANGE__0___1_CM 1 100. 0. 1. DISPLAY_IDENTIFIER LV_PUMP_PRE_RUN_STOP ECU_ADDRESS 0xd0000b44 BIT_MASK 0x1 /end MEASUREMENT
/begin MEASUREMENT lv_err_fup_efp_lih "Logical bit indicating limp home of EFP pump requested" UBYTE _CNV_S_2_RANGE__0___1_CM 1 100. 0. 1. DISPLAY_IDENTIFIER LV_ERR_FUP_EFP_LIH ECU_ADDRESS 0xd0000b43 BIT_MASK 0x1 /end MEASUREMENT
/begin MEASUREMENT fup_efp_stop_h "Pressure at observation stop for the pressure increase" UWORD _CNV_A_R_LINEAR_____173_CM 1 100. 0. 173888. DISPLAY_IDENTIFIER FUP_EFP_STOP_H ECU_ADDRESS 0xd000a410 FORMAT "%8.1" /end MEASUREMENT
/begin MEASUREMENT fup_efp_st_h "Pressure at observation start for the pressure increase" UWORD _CNV_A_R_LINEAR_____173_CM 1 100. 0. 173888. DISPLAY_IDENTIFIER FUP_EFP_ST_H ECU_ADDRESS 0xd000a412 FORMAT "%8.1" /end MEASUREMENT
/begin MEASUREMENT tco_mem_fup_efp_h "Coolant temperature for the pressure increase" UBYTE _CNV_A_R_LINEAR_____17_CM 1 100. -48. 142.5 DISPLAY_IDENTIFIER TCO_MEM_FUP_EFP_H ECU_ADDRESS 0xd00088bb FORMAT "%6.2" /end MEASUREMENT
/begin MEASUREMENT t_efp_mem_h "Time for the pressure increase" UWORD _CNV_A_R_LINEAR_____3_CM 1 100. 0. 655.35 DISPLAY_IDENTIFIER T_EFP_MEM_H ECU_ADDRESS 0xd000a414 FORMAT "%6.2" /end MEASUREMENT
/begin MEASUREMENT fup_efp_stop_l "Pressure at observation stop for the pressure decrease" UWORD _CNV_A_R_LINEAR_____173_CM 1 100. 0. 173888. DISPLAY_IDENTIFIER FUP_EFP_STOP_L ECU_ADDRESS 0xd000a416 FORMAT "%8.1" /end MEASUREMENT
/begin MEASUREMENT fup_efp_tmp_l "Temporary pressure at observation start for the pressure decrease" UWORD _CNV_A_R_LINEAR_____173_CM 1 100. 0. 173888. DISPLAY_IDENTIFIER FUP_EFP_TMP_L ECU_ADDRESS 0xd0000b3a FORMAT "%8.1" /end MEASUREMENT
/begin MEASUREMENT fup_efp_tmp_h "Temporary pressure at observation start for the pressure increase" UWORD _CNV_A_R_LINEAR_____173_CM 1 100. 0. 173888. DISPLAY_IDENTIFIER FUP_EFP_TMP_H ECU_ADDRESS 0xd0000b36 FORMAT "%8.1" /end MEASUREMENT
/begin MEASUREMENT fup_efp_st_l "Pressure at observation start for the pressure decrease" UWORD _CNV_A_R_LINEAR_____173_CM 1 100. 0. 173888. DISPLAY_IDENTIFIER FUP_EFP_ST_L ECU_ADDRESS 0xd000a40c FORMAT "%8.1" /end MEASUREMENT
/begin MEASUREMENT tco_mem_fup_efp_l "Coolant temperature for the pressure decrease" UBYTE _CNV_A_R_LINEAR_____17_CM 1 100. -48. 142.5 DISPLAY_IDENTIFIER TCO_MEM_FUP_EFP_L ECU_ADDRESS 0xd00088ba FORMAT "%6.2" /end MEASUREMENT
/begin MEASUREMENT tco_tmp_l "Temporary coolant temperature for the pressure decrease" UBYTE _CNV_A_R_LINEAR_____17_CM 1 100. -48. 142.5 DISPLAY_IDENTIFIER TCO_TMP_L ECU_ADDRESS 0xd0000b40 FORMAT "%6.2" /end MEASUREMENT
/begin MEASUREMENT tco_tmp_h "Temporary coolant temperature for the pressure increase" UBYTE _CNV_A_R_LINEAR_____17_CM 1 100. -48. 142.5 DISPLAY_IDENTIFIER TCO_TMP_H ECU_ADDRESS 0xd0000b41 FORMAT "%6.2" /end MEASUREMENT
/begin MEASUREMENT t_efp_mem_l "Time for the pressure decrease" UWORD _CNV_A_R_LINEAR_____3_CM 1 100. 0. 655.35 DISPLAY_IDENTIFIER T_EFP_MEM_L ECU_ADDRESS 0xd000a40e FORMAT "%6.2" /end MEASUREMENT
/begin MEASUREMENT t_efp_act_l "Timer for the pressure decrease" UWORD _CNV_A_R_LINEAR_____3_CM 1 100. 0. 655.35 DISPLAY_IDENTIFIER T_EFP_ACT_L ECU_ADDRESS 0xd0000b34 FORMAT "%6.2" /end MEASUREMENT
/begin MEASUREMENT t_efp_act_h "Timer for the pressure increase" UWORD _CNV_A_R_LINEAR_____3_CM 1 100. 0. 655.35 DISPLAY_IDENTIFIER T_EFP_ACT_H ECU_ADDRESS 0xd0000b38 FORMAT "%6.2" /end MEASUREMENT
/begin CHARACTERISTIC c_vff_efp_add "Additive value for the amount of fuel from the pump" VALUE 0xa080c440 _REC_VAL_20_u1 255. _CNV_A_R_LINEAR_____174_CM 0. 255. DISPLAY_IDENTIFIER C_VFF_EFP_ADD FORMAT "%3.0" /end CHARACTERISTIC
/begin CHARACTERISTIC lc_efppwm_man_act "Switch for manual EFPPWM" VALUE 0xa080c555 _REC_VAL_20_u1 1. _CNV_A_R_LINEAR_____0_CM 0. 1. DISPLAY_IDENTIFIER LC_EFPPWM_MAN_ACT FORMAT "%1.0" /end CHARACTERISTIC
/begin CHARACTERISTIC c_fup_efp_st_h_min "Start fuel pressure level to store values for start pressure increase observation in any case" VALUE 0xa080bd74 _REC_VAL_20_u2 173888. _CNV_A_R_LINEAR_____173_CM 0. 173888. DISPLAY_IDENTIFIER C_FUP_EFP_ST_H_MIN FORMAT "%8.1" /end CHARACTERISTIC
/begin CHARACTERISTIC c_fup_efp_mem_l_dif "Fuel pressure difference to store values for start pressure decrease observation" VALUE 0xa080bd5e _REC_VAL_20_u2 173888. _CNV_A_R_LINEAR_____173_CM 0. 173888. DISPLAY_IDENTIFIER C_FUP_EFP_MEM_L_DIF FORMAT "%8.1" /end CHARACTERISTIC
/begin CHARACTERISTIC c_tco_mem_fup_efp_l_tol "Coolant temperature threshold to start fuel pressure decrease observation" VALUE 0xa080c2cd _REC_VAL_20_u1 190.5 _CNV_A_R_LINEAR_____17_CM -48. 142.5 DISPLAY_IDENTIFIER C_TCO_MEM_FUP_EFP_L_TOL FORMAT "%6.2" /end CHARACTERISTIC
/begin CHARACTERISTIC c_tia_fup_efp_l_hys "Intake temperature hysteresis for fuel pressure decrease observation" VALUE 0xa080c325 _REC_VAL_20_u1 190.5 _CNV_A_R_LINEAR_____25_CM 0. 190.5 DISPLAY_IDENTIFIER C_TIA_FUP_EFP_L_HYS FORMAT "%6.2" /end CHARACTERISTIC
/begin CHARACTERISTIC c_t_efp "Time counter for activated EFP within power latch" VALUE 0xa080c1aa _REC_VAL_20_u2 655.35 _CNV_A_R_LINEAR_____3_CM 0. 655.35 DISPLAY_IDENTIFIER C_T_EFP FORMAT "%6.2" /end CHARACTERISTIC
/begin MEASUREMENT efppwm_min_ad "Minimum pump speed of the electrical fuel pump as PWM signal" UWORD _CNV_A_R_LINEAR_____8_CM 1 100. 0. 99.99847412109381 DISPLAY_IDENTIFIER EFPPWM_MIN_AD ECU_ADDRESS 0xd000a41e /end MEASUREMENT
/begin MEASUREMENT efppwm_bas "Precontroller value of EFPPWM" UWORD _CNV_A_R_LINEAR_____8_CM 1 100. 0. 99.99847412109381 DISPLAY_IDENTIFIER EFPPWM_BAS ECU_ADDRESS 0xd0000b0c /end MEASUREMENT
/begin MEASUREMENT efppwm_i "I-part of the controller" SWORD _CNV_A_R_LINEAR_____113_CM 1 100. -50. 49.9984741210938 DISPLAY_IDENTIFIER EFPPWM_I ECU_ADDRESS 0xd000a41a FORMAT "%7.3" /end MEASUREMENT
/begin MEASUREMENT efppwm_i_tmp "Temporary I-part of the controller" SWORD _CNV_A_R_LINEAR_____113_CM 1 100. -50. 49.9984741210938 DISPLAY_IDENTIFIER EFPPWM_I_TMP ECU_ADDRESS 0xd0000b18 FORMAT "%7.3" /end MEASUREMENT
/begin MEASUREMENT efppwm_i_ad "Adaptive I-part of the controller" SWORD _CNV_A_R_LINEAR_____113_CM 1 100. -50. 49.9984741210938 DISPLAY_IDENTIFIER EFPPWM_I_AD ECU_ADDRESS 0xd000a41c FORMAT "%7.3" /end MEASUREMENT
/begin MEASUREMENT efppwm_i_ad_dif "Adaptive I-part difference of the controller" SWORD _CNV_A_R_LINEAR_____113_CM 1 100. -50. 49.9984741210938 DISPLAY_IDENTIFIER EFPPWM_I_AD_DIF ECU_ADDRESS 0xd0000b1a FORMAT "%7.3" /end MEASUREMENT
/begin MEASUREMENT efppwm_p "P-part of the controller" SWORD _CNV_A_R_LINEAR_____113_CM 1 100. -50. 49.9984741210938 DISPLAY_IDENTIFIER EFPPWM_P ECU_ADDRESS 0xd0000b1c FORMAT "%7.3" /end MEASUREMENT
/begin MEASUREMENT fup_efp_dif "Deviation of the fuel pressure after fuel pump from the setpoint" SWORD _CNV_A_R_LINEAR_____173_CM 1 100. -86945.3266803998 86942.6733196002 DISPLAY_IDENTIFIER FUP_EFP_DIF ECU_ADDRESS 0xd0000b16 FORMAT "%9.2" /end MEASUREMENT
/begin MEASUREMENT vff_efp_clc "Calculated requested amount of fuel from the pump" UWORD _CNV_A_R_LINEAR_____176_CM 1 100. 0. 255. DISPLAY_IDENTIFIER VFF_EFP_CLC ECU_ADDRESS 0xd0000b12 FORMAT "%7.3" /end MEASUREMENT
/begin MEASUREMENT fup_efp_grd "Calculated requested amount of fuel from the pump" SWORD _CNV_A_R_LINEAR_____177_CM 1 100. -86945.3266803998 86942.6733196002 DISPLAY_IDENTIFIER FUP_EFP_GRD ECU_ADDRESS 0xd0000b10 FORMAT "%9.2" /end MEASUREMENT
/begin MEASUREMENT lv_efppwm_ctl_stop "Logical variable for I-part freeze" UBYTE _CNV_S_2_RANGE__0___1_CM 1 100. 0. 1. DISPLAY_IDENTIFIER LV_EFPPWM_CTL_STOP ECU_ADDRESS 0xd0000b2c BIT_MASK 0x1 /end MEASUREMENT
/begin MEASUREMENT lv_efppwm_ctl_rst "Logical variable for controller reset" UBYTE _CNV_S_2_RANGE__0___1_CM 1 100. 0. 1. DISPLAY_IDENTIFIER LV_EFPPWM_CTL_RST ECU_ADDRESS 0xd0000b2e BIT_MASK 0x1 /end MEASUREMENT
/begin MEASUREMENT lv_efppwm_ad_stop "Logical variable for adaptation stop" UBYTE _CNV_S_2_RANGE__0___1_CM 1 100. 0. 1. DISPLAY_IDENTIFIER LV_EFPPWM_AD_STOP ECU_ADDRESS 0xd00088be BIT_MASK 0x1 /end MEASUREMENT
/begin MEASUREMENT lv_efppwm_min_ad_act "Logical variable showing active minimum EFPPWM adaptation" UBYTE _CNV_S_2_RANGE__0___1_CM 1 100. 0. 1. DISPLAY_IDENTIFIER LV_EFPPWM_MIN_AD_ACT ECU_ADDRESS 0xd0000b2d BIT_MASK 0x1 /end MEASUREMENT
/begin MEASUREMENT ctr_seg_efppwm_min_ad "Segment counter before minimum PWM adaptation is allowed" UWORD _CNV_A_R_LINEAR_____0_CM 1 100. 0. 65535. DISPLAY_IDENTIFIER CTR_SEG_EFPPWM_MIN_AD ECU_ADDRESS 0xd0000b1e FORMAT "%5.0" /end MEASUREMENT
/begin MEASUREMENT ctr_seg_efppwm_i_ad "Segment counter before I-part adaptation is allowed" UWORD _CNV_A_R_LINEAR_____0_CM 1 100. 0. 65535. DISPLAY_IDENTIFIER CTR_SEG_EFPPWM_I_AD ECU_ADDRESS 0xd0000b0e FORMAT "%5.0" /end MEASUREMENT
/begin MEASUREMENT lv_efppwm_i_ad_vld "Logical variable showing valid adaptive I-Part of EFPPWM" UBYTE _CNV_S_2_RANGE__0___1_CM 1 100. 0. 1. DISPLAY_IDENTIFIER LV_EFPPWM_I_AD_VLD ECU_ADDRESS 0xd00088c0 BIT_MASK 0x1 /end MEASUREMENT
/begin CHARACTERISTIC ip_efppwm_bas_l_pow "Basic value of the EFPPWM for low power version" CURVE 0xa080a1f0 _REC_CUR_20_u2_u2 99.99847412109381 _CNV_A_R_LINEAR_____8_CM 0. 99.99847412109381 DISPLAY_IDENTIFIER IP_EFPPWM_BAS_L_POW
 /begin AXIS_DESCR COM_AXIS vff_efp_req _CNV_A_R_LINEAR_____176_CM 8 0. 255. FORMAT "%7.3" AXIS_PTS_REF ldp_vff_efp_req_ip_efppwm_bas /end AXIS_DESCR
/end CHARACTERISTIC
/begin CHARACTERISTIC ip_fac_efppwm_bas_l_pow "Correction factor for the basic value of the EFPPWM for low power version" MAP 0xa08143e4 _REC_MAP_20_u2_u1_u2 1.99996948242188 _CNV_A_R_LINEAR_____9_CM 0. 1.99996948242188 DISPLAY_IDENTIFIER IP_FAC_EFPPWM_BAS_L_POW FORMAT "%7.5"
 /begin AXIS_DESCR COM_AXIS tfu_efp _CNV_A_R_LINEAR_____17_CM 6 -48. 142.5 FORMAT "%6.2" AXIS_PTS_REF ldp_tfu_efp_ip_fac_efppwm_bas /end AXIS_DESCR
 /begin AXIS_DESCR COM_AXIS fup_efp_sp _CNV_A_R_LINEAR_____173_CM 8 0. 173888. FORMAT "%8.1" AXIS_PTS_REF ldp_fup_efp_sp_ip_fac_efppwm /end AXIS_DESCR
/end CHARACTERISTIC
/begin CHARACTERISTIC ip_efppwm_p "P-part of the controller" CURVE 0xa080a220 _REC_CUR_20_u2_u2 99.99847412 _CNV_A_R_LINEAR_____178_CM -50. 49.99847412 DISPLAY_IDENTIFIER IP_EFPPWM_P FORMAT "%7.3"
 /begin AXIS_DESCR COM_AXIS fup_efp_dif _CNV_A_R_LINEAR_____179_CM 8 -86945.3266803998 86942.6733196002 FORMAT "%9.2" AXIS_PTS_REF ldp_fup_efp_dif_ip_efppwm_p /end AXIS_DESCR
/end CHARACTERISTIC
/begin CHARACTERISTIC c_efppwm_min_1 "Min. electrical fuel pump speed at state EFP_ON" VALUE 0xa080bc82 _REC_VAL_20_u2 99.99847412109381 _CNV_A_R_LINEAR_____8_CM 0. 99.99847412109381 DISPLAY_IDENTIFIER C_EFPPWM_MIN_1 /end CHARACTERISTIC
/begin CHARACTERISTIC c_efppwm_min_2 "Min. electrical fuel pump speed at state EFP_OFF" VALUE 0xa080bc84 _REC_VAL_20_u2 99.99847412109381 _CNV_A_R_LINEAR_____8_CM 0. 99.99847412109381 DISPLAY_IDENTIFIER C_EFPPWM_MIN_2 /end CHARACTERISTIC
/begin CHARACTERISTIC c_efppwm_crash "Min. electrical fuel pump speed at state EFP_CRASH" VALUE 0xa080bc64 _REC_VAL_20_u2 99.99847412109381 _CNV_A_R_LINEAR_____8_CM 0. 99.99847412109381 DISPLAY_IDENTIFIER C_EFPPWM_CRASH /end CHARACTERISTIC
/begin CHARACTERISTIC c_efppwm_i_min "Min. value for the I-part of the controller" VALUE 0xa080bc78 _REC_VAL_20_s2 99.99847412109381 _CNV_A_R_LINEAR_____113_CM -50. 49.9984741210938 DISPLAY_IDENTIFIER C_EFPPWM_I_MIN FORMAT "%7.3" /end CHARACTERISTIC
/begin CHARACTERISTIC c_efppwm_i_max "Max. value for the I-part of the controller" VALUE 0xa080bc74 _REC_VAL_20_s2 99.99847412109381 _CNV_A_R_LINEAR_____113_CM -50. 49.9984741210938 DISPLAY_IDENTIFIER C_EFPPWM_I_MAX FORMAT "%7.3" /end CHARACTERISTIC
/begin CHARACTERISTIC c_efppwm_i_ad_min "Min. value for the adaptive I-part of the controller" VALUE 0xa080bc6e _REC_VAL_20_s2 99.99847412109381 _CNV_A_R_LINEAR_____113_CM -50. 49.9984741210938 DISPLAY_IDENTIFIER C_EFPPWM_I_AD_MIN FORMAT "%7.3" /end CHARACTERISTIC
/begin CHARACTERISTIC c_efppwm_i_ad_max "Max. value for the adaptive I-part of the controller" VALUE 0xa080bc6c _REC_VAL_20_s2 99.99847412109381 _CNV_A_R_LINEAR_____113_CM -50. 49.9984741210938 DISPLAY_IDENTIFIER C_EFPPWM_I_AD_MAX FORMAT "%7.3" /end CHARACTERISTIC
/begin CHARACTERISTIC c_efppwm_man_act "Manual value for the EFPPWM" VALUE 0xa080bc7e _REC_VAL_20_u2 99.99847412109381 _CNV_A_R_LINEAR_____8_CM 0. 99.99847412109381 DISPLAY_IDENTIFIER C_EFPPWM_MAN_ACT /end CHARACTERISTIC
/begin CHARACTERISTIC lc_fup_efp_avl "Logical variable indicating \"fuel pressure sensor for low pressure line available\"" VALUE 0xa080c578 _REC_VAL_20_u1 1. _CNV_A_R_LINEAR_____0_CM 0. 1. DISPLAY_IDENTIFIER LC_FUP_EFP_AVL FORMAT "%1.0" /end CHARACTERISTIC
/begin CHARACTERISTIC lc_efppwm_i_ad_clr "Logical variable to clear the adaptive I-part of the controller" VALUE 0xa080c553 _REC_VAL_20_u1 1. _CNV_A_R_LINEAR_____0_CM 0. 1. DISPLAY_IDENTIFIER LC_EFPPWM_I_AD_CLR FORMAT "%1.0" /end CHARACTERISTIC
/begin CHARACTERISTIC c_tco_max_efppwm_ad "Maximum coolant temperature for allowing adaptation" VALUE 0xa080c2c9 _REC_VAL_20_u1 190.5 _CNV_A_R_LINEAR_____17_CM -48. 142.5 DISPLAY_IDENTIFIER C_TCO_MAX_EFPPWM_AD FORMAT "%6.2" /end CHARACTERISTIC
/begin CHARACTERISTIC c_tco_min_efppwm_ad "Minimum coolant temperature for allowing adaptation" VALUE 0xa080c2d0 _REC_VAL_20_u1 190.5 _CNV_A_R_LINEAR_____17_CM -48. 142.5 DISPLAY_IDENTIFIER C_TCO_MIN_EFPPWM_AD FORMAT "%6.2" /end CHARACTERISTIC
/begin CHARACTERISTIC c_fup_efp_dif_max_efppwm_ad "Maximum deviation of the fuel pressure after fuel pump from the setpoint for adaptation" VALUE 0xa080bd58 _REC_VAL_20_s2 173888. _CNV_A_R_LINEAR_____173_CM -86945.3266803998 86942.6733196002 DISPLAY_IDENTIFIER C_FUP_EFP_DIF_MAX_EFPPWM_AD FORMAT "%9.2" /end CHARACTERISTIC
/begin CHARACTERISTIC c_efppwm_min_cor "Correction value for the EFPPWM to reach \"zero delivery\"" VALUE 0xa080bc8e _REC_VAL_20_s2 99.99847412109381 _CNV_A_R_LINEAR_____113_CM -50. 49.9984741210938 DISPLAY_IDENTIFIER C_EFPPWM_MIN_COR FORMAT "%7.3" /end CHARACTERISTIC
/begin CHARACTERISTIC c_crlc_efppwm_i_ad "Correlation constant for I-part adaptation" VALUE 0xa080bace _REC_VAL_20_u1 0.99609375 _CNV_A_R_LINEAR_____28_CM 0. 0.99609375 DISPLAY_IDENTIFIER C_CRLC_EFPPWM_I_AD FORMAT "%5.3" /end CHARACTERISTIC
/begin CHARACTERISTIC c_ctr_seg_efppwm_i_ad_max "Maximum segment counter for the I-part adaptation" VALUE 0xa080bbc2 _REC_VAL_20_u2 65535. _CNV_A_R_LINEAR_____0_CM 0. 65535. DISPLAY_IDENTIFIER C_CTR_SEG_EFPPWM_I_AD_MAX FORMAT "%5.0" /end CHARACTERISTIC
/begin CHARACTERISTIC c_mff_sp_max_efppwm_i_ad "Maximum injected fuel mass for allowing I-part adaptation" VALUE 0xa080bea6 _REC_VAL_20_u2 1389. _CNV_A_R_LINEAR_____180_CM 0. 1389. DISPLAY_IDENTIFIER C_MFF_SP_MAX_EFPPWM_I_AD FORMAT "%7.2" /end CHARACTERISTIC
/begin CHARACTERISTIC c_mff_sp_min_efppwm_i_ad "Minimum injected fuel mass for allowing I-part adaptation" VALUE 0xa080beb2 _REC_VAL_20_u2 1389. _CNV_A_R_LINEAR_____180_CM 0. 1389. DISPLAY_IDENTIFIER C_MFF_SP_MIN_EFPPWM_I_AD FORMAT "%7.2" /end CHARACTERISTIC
/begin CHARACTERISTIC c_mff_sp_max_efppwm_min_ad "Maximum injected fuel mass for allowing minimum EFPPWM adaptation" VALUE 0xa080bea8 _REC_VAL_20_u2 1389. _CNV_A_R_LINEAR_____180_CM 0. 1389. DISPLAY_IDENTIFIER C_MFF_SP_MAX_EFPPWM_MIN_AD FORMAT "%7.2" /end CHARACTERISTIC
/begin CHARACTERISTIC c_mff_sp_min_efppwm_min_ad "Minimum injected fuel mass for allowing minimum EFPPWM adaptation" VALUE 0xa080beb4 _REC_VAL_20_u2 1389. _CNV_A_R_LINEAR_____180_CM 0. 1389. DISPLAY_IDENTIFIER C_MFF_SP_MIN_EFPPWM_MIN_AD FORMAT "%7.2" /end CHARACTERISTIC
/begin CHARACTERISTIC c_n_max_efppwm_i_ad "Maximum engine speed for allowing I-part adaptation" VALUE 0xa080bf7c _REC_VAL_20_u1 8160. _CNV_A_R_LINEAR_____10_CM 0. 8160. DISPLAY_IDENTIFIER C_N_MAX_EFPPWM_I_AD FORMAT "%4.0" /end CHARACTERISTIC
/begin CHARACTERISTIC c_n_min_efppwm_i_ad "Minimum engine speed for allowing I-part adaptation" VALUE 0xa080bf95 _REC_VAL_20_u1 8160. _CNV_A_R_LINEAR_____10_CM 0. 8160. DISPLAY_IDENTIFIER C_N_MIN_EFPPWM_I_AD FORMAT "%4.0" /end CHARACTERISTIC
/begin CHARACTERISTIC c_n_max_efppwm_min_ad "Maximum engine speed for allowing minimum EFPPWM adaptation" VALUE 0xa080bf7d _REC_VAL_20_u1 8160. _CNV_A_R_LINEAR_____10_CM 0. 8160. DISPLAY_IDENTIFIER C_N_MAX_EFPPWM_MIN_AD FORMAT "%4.0" /end CHARACTERISTIC
/begin CHARACTERISTIC c_n_min_efppwm_min_ad "Minimum engine speed for allowing minimum EFPPWM adaptation" VALUE 0xa080bf96 _REC_VAL_20_u1 8160. _CNV_A_R_LINEAR_____10_CM 0. 8160. DISPLAY_IDENTIFIER C_N_MIN_EFPPWM_MIN_AD FORMAT "%4.0" /end CHARACTERISTIC
/begin CHARACTERISTIC c_t_ast_efppwm_min_ad "Time after engine start to allow minimum EFPPWM adaptation" VALUE 0xa080c124 _REC_VAL_20_u2 6553.5 _CNV_A_R_LINEAR_____4_CM 0. 6553.5 DISPLAY_IDENTIFIER C_T_AST_EFPPWM_MIN_AD FORMAT "%6.1" /end CHARACTERISTIC
/begin CHARACTERISTIC c_efppwm_min_ad_tol "Maximum value for the EFPPWM_MIN adaptation" VALUE 0xa080bc8c _REC_VAL_20_u2 99.99847412109381 _CNV_A_R_LINEAR_____8_CM 0. 99.99847412109381 DISPLAY_IDENTIFIER C_EFPPWM_MIN_AD_TOL /end CHARACTERISTIC
/begin CHARACTERISTIC c_efppwm_min_ad_ini "Initial value for the EFPPWM_MIN adaptation" VALUE 0xa080bc8a _REC_VAL_20_u2 99.99847412109381 _CNV_A_R_LINEAR_____8_CM 0. 99.99847412109381 DISPLAY_IDENTIFIER C_EFPPWM_MIN_AD_INI /end CHARACTERISTIC
/begin CHARACTERISTIC c_efppwm_deac "Minimum EFPPWM at ACR_TEST" VALUE 0xa080bc66 _REC_VAL_20_u2 99.99847412109381 _CNV_A_R_LINEAR_____8_CM 0. 99.99847412109381 DISPLAY_IDENTIFIER C_EFPPWM_DEAC /end CHARACTERISTIC
/begin CHARACTERISTIC c_efppwm_acr_test_inc "Increment for the actuator test" VALUE 0xa080bc62 _REC_VAL_20_u2 99.99847412109381 _CNV_A_R_LINEAR_____8_CM 0. 99.99847412109381 DISPLAY_IDENTIFIER C_EFPPWM_ACR_TEST_INC /end CHARACTERISTIC
/begin MEASUREMENT efppwm "Pump speed of the electrical fuel pump as PWM signal" UWORD _CNV_A_R_LINEAR_____8_CM 1 100. 0. 99.99847412109381 DISPLAY_IDENTIFIER EFPPWM ECU_ADDRESS 0xd000a418 /end MEASUREMENT
/begin MEASUREMENT lv_efp "Logical variable for electrical fuel pump active" UBYTE _CNV_S_2_RANGE__0___1_CM 1 100. 0. 1. DISPLAY_IDENTIFIER LV_EFP ECU_ADDRESS 0xd00088bd BIT_MASK 0x1 /end MEASUREMENT
/begin MEASUREMENT state_efp "States of electrical fuel pump function" UBYTE _CNV_S_7_RANGE_STAT_181_CM 1 100. 0. 6. DISPLAY_IDENTIFIER STATE_EFP ECU_ADDRESS 0xd00088bc /end MEASUREMENT
/begin CHARACTERISTIC c_fup_rho_fuel_efp "Densitiy of the fuel" VALUE 0xa080bd88 _REC_VAL_20_u2 825.3604943923095 _CNV_A_R_LINEAR_____182_CM 74.6395056076906 900. DISPLAY_IDENTIFIER C_FUP_RHO_FUEL_EFP FORMAT "%7.2" /end CHARACTERISTIC
/begin AXIS_PTS ldp_vff_efp_req_ip_efppwm_bas "" 0xa0809124 vff_efp_req _REC_AXS_20_u2 255. _CNV_A_R_LINEAR_____176_CM 8 0. 255. FORMAT "%7.3" /end AXIS_PTS
/begin AXIS_PTS ldp_tfu_efp_ip_fac_efppwm_bas "" 0xa0808e6c tfu_efp _REC_AXS_20_u1 190.5 _CNV_A_R_LINEAR_____17_CM 6 -48. 142.5 FORMAT "%6.2" /end AXIS_PTS
/begin AXIS_PTS ldp_fup_efp_sp_ip_fac_efppwm "" 0xa0808714 fup_efp_sp _REC_AXS_20_u2 173888. _CNV_A_R_LINEAR_____173_CM 8 0. 173888. FORMAT "%8.1" /end AXIS_PTS
/begin MEASUREMENT lv_efppwm_min_vld "Logical variable showing valid minimum of EFPPWM" UBYTE _CNV_S_2_RANGE__0___1_CM 1 100. 0. 1. DISPLAY_IDENTIFIER LV_EFPPWM_MIN_VLD ECU_ADDRESS 0xd00088bf BIT_MASK 0x1 /end MEASUREMENT
/begin MEASUREMENT lv_fup_efp_lim "Logical variable indicating VFF limitation for the EFP" UBYTE _CNV_S_2_RANGE__0___1_CM 1 100. 0. 1. DISPLAY_IDENTIFIER LV_FUP_EFP_LIM ECU_ADDRESS 0xd0000b2f BIT_MASK 0x1 /end MEASUREMENT
/begin MEASUREMENT vff_efp_req "Requested amount of fuel from the pump" UWORD _CNV_A_R_LINEAR_____176_CM 1 100. 0. 255. DISPLAY_IDENTIFIER VFF_EFP_REQ ECU_ADDRESS 0xd000a420 FORMAT "%7.3" /end MEASUREMENT
/begin MEASUREMENT vff_efp_cor "volume fuel flow for correction of the EFP volume fuel flow" UWORD _CNV_A_R_LINEAR_____176_CM 1 100. 0. 255. DISPLAY_IDENTIFIER VFF_EFP_COR ECU_ADDRESS 0xd0000b14 FORMAT "%7.3" /end MEASUREMENT
/begin CHARACTERISTIC c_ctr_seg_efppwm_min_ad_max "Maximum segment counter for the minimum EFPPWM adaptation" VALUE 0xa080bbc4 _REC_VAL_20_u2 65535. _CNV_A_R_LINEAR_____0_CM 0. 65535. DISPLAY_IDENTIFIER C_CTR_SEG_EFPPWM_MIN_AD_MAX FORMAT "%5.0" /end CHARACTERISTIC
/begin CHARACTERISTIC c_ctr_fup_sp_lim_vff_efp_cor "counter for duration of the limitation for VFF_EFP" VALUE 0xa080bb98 _REC_VAL_20_u2 65535. _CNV_A_R_LINEAR_____0_CM 0. 65535. DISPLAY_IDENTIFIER C_CTR_FUP_SP_LIM_VFF_EFP_COR FORMAT "%5.0" /end CHARACTERISTIC
/begin CHARACTERISTIC c_fup_sp_dif_lim_vff_efp_cor "Fuel pressure setpoint difference threshold for activation of the VFF_EFP correction" VALUE 0xa080bd90 _REC_VAL_20_u2 347776. _CNV_A_R_LINEAR_____171_CM 0. 347776. DISPLAY_IDENTIFIER C_FUP_SP_DIF_LIM_VFF_EFP_COR FORMAT "%6.0" /end CHARACTERISTIC
/begin CHARACTERISTIC c_vff_efp_cor_grd_dec "decrement gradient limitation for VFF_EFP_COR" VALUE 0xa080c442 _REC_VAL_20_u2 255. _CNV_A_R_LINEAR_____176_CM 0. 255. DISPLAY_IDENTIFIER C_VFF_EFP_COR_GRD_DEC FORMAT "%7.3" /end CHARACTERISTIC
/begin CHARACTERISTIC c_vff_efp_req_lih "EFP volume fuel flow value for limp home of the fuel low pressure system" VALUE 0xa080c444 _REC_VAL_20_u2 255. _CNV_A_R_LINEAR_____176_CM 0. 255. DISPLAY_IDENTIFIER C_VFF_EFP_REQ_LIH FORMAT "%7.3" /end CHARACTERISTIC
/begin CHARACTERISTIC c_vff_dif_lim_vff_efp_cor "constant for manual VFF difference for VFF_EFP correction" VALUE 0xa080c43e _REC_VAL_20_u2 255. _CNV_A_R_LINEAR_____176_CM 0. 255. DISPLAY_IDENTIFIER C_VFF_DIF_LIM_VFF_EFP_COR FORMAT "%7.3" /end CHARACTERISTIC
/begin CHARACTERISTIC lc_vff_dif_lim_vff_efp_cor_man "logical constant for switch to manual VFF_DIF for VFF_EFP correction" VALUE 0xa080c621 _REC_VAL_20_u1 1. _CNV_A_R_LINEAR_____0_CM 0. 1. DISPLAY_IDENTIFIER LC_VFF_DIF_LIM_VFF_EFP_COR_MAN FORMAT "%1.0" /end CHARACTERISTIC
/begin CHARACTERISTIC ip_efppwm_i "I-part of the controller" CURVE 0xa080a200 _REC_CUR_20_u2_u2 99.99847412 _CNV_A_R_LINEAR_____178_CM -50. 49.99847412 DISPLAY_IDENTIFIER IP_EFPPWM_I FORMAT "%7.3"
 /begin AXIS_DESCR COM_AXIS fup_efp_dif _CNV_A_R_LINEAR_____179_CM 8 -86945.3266803998 86942.6733196002 FORMAT "%9.2" AXIS_PTS_REF ldp_fup_efp_dif_ip_efppwm_i /end AXIS_DESCR
/end CHARACTERISTIC
/begin AXIS_PTS ldp_fup_efp_dif_ip_efppwm_i "" 0xa08086ec fup_efp_dif _REC_AXS_20_u2 173888. _CNV_A_R_LINEAR_____179_CM 8 -86945.3266803998 86942.6733196002 FORMAT "%9.2" /end AXIS_PTS
/begin CHARACTERISTIC ip_efppwm_i_vcv_lih "I-part of the controller in case of VCV open limphome" CURVE 0xa080a210 _REC_CUR_20_u2_u2 99.99847412 _CNV_A_R_LINEAR_____178_CM -50. 49.99847412 DISPLAY_IDENTIFIER IP_EFPPWM_I_VCV_LIH FORMAT "%7.3"
 /begin AXIS_DESCR COM_AXIS online_dummy _CNV_A_R_LINEAR_____183_CM 8 -173890.6533608 173885.3466392 FORMAT "%9.2" AXIS_PTS_REF ldp_fup_dif_ip_efppwm_i_vcv_lih /end AXIS_DESCR
/end CHARACTERISTIC
/begin AXIS_PTS ldp_fup_dif_ip_efppwm_i_vcv_lih "" 0xa08086b0 online_dummy _REC_AXS_20_u2 347776. _CNV_A_R_LINEAR_____183_CM 8 -173890.6533608 173885.3466392 FORMAT "%9.2" /end AXIS_PTS
/begin AXIS_PTS ldp_fup_dif_ip_efppwm_p_vcv_lih "" 0xa08086c4 online_dummy _REC_AXS_20_u2 347776. _CNV_A_R_LINEAR_____183_CM 8 -173890.6533608 173885.3466392 FORMAT "%9.2" /end AXIS_PTS
/begin CHARACTERISTIC ip_efppwm_p_vcv_lih "P-part of the controller in case of VCV open limphome" CURVE 0xa080a230 _REC_CUR_20_u2_u2 99.99847412 _CNV_A_R_LINEAR_____178_CM -50. 49.99847412 DISPLAY_IDENTIFIER IP_EFPPWM_P_VCV_LIH FORMAT "%7.3"
 /begin AXIS_DESCR COM_AXIS online_dummy _CNV_A_R_LINEAR_____183_CM 8 -173890.6533608 173885.3466392 FORMAT "%9.2" AXIS_PTS_REF ldp_fup_dif_ip_efppwm_p_vcv_lih /end AXIS_DESCR
/end CHARACTERISTIC
/begin CHARACTERISTIC ip_fup_efp_sp_cor_vcv_open "Correction of EFP in case of VCV open lih" CURVE 0xa080acdc _REC_CUR_20_u2_u1 173888. _CNV_A_R_LINEAR_____179_CM -86945.3266803998 86942.6733196002 DISPLAY_IDENTIFIER IP_FUP_EFP_SP_COR_VCV_OPEN FORMAT "%9.2"
 /begin AXIS_DESCR COM_AXIS tfu _CNV_A_R_LINEAR_____17_CM 8 -48. 142.5 FORMAT "%6.2" AXIS_PTS_REF ldp_tfu_ip_fup_efp_sp_cor_vcv /end AXIS_DESCR
/end CHARACTERISTIC
/begin AXIS_PTS ldp_fup_efp_dif_ip_efppwm_p "" 0xa0808700 fup_efp_dif _REC_AXS_20_u2 173888. _CNV_A_R_LINEAR_____179_CM 8 -86945.3266803998 86942.6733196002 FORMAT "%9.2" /end AXIS_PTS
/begin AXIS_PTS ldp_tfu_ip_fup_efp_sp_cor_vcv "" 0xa0808e84 tfu _REC_AXS_20_u1 190.5 _CNV_A_R_LINEAR_____17_CM 8 -48. 142.5 FORMAT "%6.2" /end AXIS_PTS
/begin CHARACTERISTIC c_efppwm_lih_add "Additive EFPPWM in case of limp home." VALUE 0xa080bc7c _REC_VAL_20_s2 99.99847412109381 _CNV_A_R_LINEAR_____113_CM -50. 49.9984741210938 DISPLAY_IDENTIFIER C_EFPPWM_LIH_ADD FORMAT "%7.3" /end CHARACTERISTIC
/begin CHARACTERISTIC c_efppwm_i_max_lih_hom_vcv_open "Max. value for the I-part of the controller in case of VCV open limphome" VALUE 0xa080bc76 _REC_VAL_20_s2 99.99847412109381 _CNV_A_R_LINEAR_____113_CM -50. 49.9984741210938 DISPLAY_IDENTIFIER C_EFPPWM_I_MAX_LIH_HOM_VCV_OPEN FORMAT "%7.3" /end CHARACTERISTIC
/begin CHARACTERISTIC c_efppwm_i_min_lih_hom_vcv_open "Min. value for the I-part of the controller in case of VCV open limphome" VALUE 0xa080bc7a _REC_VAL_20_s2 99.99847412109381 _CNV_A_R_LINEAR_____113_CM -50. 49.9984741210938 DISPLAY_IDENTIFIER C_EFPPWM_I_MIN_LIH_HOM_VCV_OPEN FORMAT "%7.3" /end CHARACTERISTIC
/begin CHARACTERISTIC c_efppwm_max "Max. electrical fuel pump speed" VALUE 0xa080bc80 _REC_VAL_20_u2 99.99847412109381 _CNV_A_R_LINEAR_____8_CM 0. 99.99847412109381 DISPLAY_IDENTIFIER C_EFPPWM_MAX /end CHARACTERISTIC
/begin CHARACTERISTIC c_efppwm_min_lih_hom_vcv_open "Min. electrical fuel pump speed in case of VCV open limphome" VALUE 0xa080bc90 _REC_VAL_20_u2 99.99847412109381 _CNV_A_R_LINEAR_____8_CM 0. 99.99847412109381 DISPLAY_IDENTIFIER C_EFPPWM_MIN_LIH_HOM_VCV_OPEN /end CHARACTERISTIC
/begin CHARACTERISTIC c_fup_efp_grd_max "Fuel pressure gradient for freezing EFPPWM during PUC" VALUE 0xa080bd5a _REC_VAL_20_s2 173888. _CNV_A_R_LINEAR_____177_CM -86945.3266803998 86942.6733196002 DISPLAY_IDENTIFIER C_FUP_EFP_GRD_MAX FORMAT "%9.2" /end CHARACTERISTIC
/begin CHARACTERISTIC c_fup_efp_sp_max_efppwm_min_ad "Maximum FUP EFP setpoint for the minimum adaptation of EFPPWM" VALUE 0xa080bd6c _REC_VAL_20_u2 173888. _CNV_A_R_LINEAR_____173_CM 0. 173888. DISPLAY_IDENTIFIER C_FUP_EFP_SP_MAX_EFPPWM_MIN_AD FORMAT "%8.1" /end CHARACTERISTIC
/begin CHARACTERISTIC c_fup_efp_sp_min_efppwm_min_ad "Minimum FUP EFP setpoint for the minimum adaptation of EFPPWM" VALUE 0xa080bd6e _REC_VAL_20_u2 173888. _CNV_A_R_LINEAR_____173_CM 0. 173888. DISPLAY_IDENTIFIER C_FUP_EFP_SP_MIN_EFPPWM_MIN_AD FORMAT "%8.1" /end CHARACTERISTIC
/begin MEASUREMENT state_vls_eol "Status of lambda sensor EOL diagnosis confused wired" UBYTE _CNV_S_14_STATE_VLS__221_CM 1 100. 0. 24. DISPLAY_IDENTIFIER STATE_VLS_EOL ECU_ADDRESS 0xd0008f24 /end MEASUREMENT
/begin CHARACTERISTIC c_tco_min_vls_eol "TCO threshold for VLS EOL diagnosis" VALUE 0xa080c2dd _REC_VAL_20_u1 190.5 _CNV_A_R_LINEAR_____17_CM -48. 142.5 DISPLAY_IDENTIFIER C_TCO_MIN_VLS_EOL FORMAT "%5.1" /end CHARACTERISTIC
/begin CHARACTERISTIC c_teg_cat_down_eol "TEG_CAT_DOWN threshold for VLS EOL diagnosis" VALUE 0xa080c2f8 _REC_VAL_20_u2 1507.3 _CNV_A_R_LINEAR_____222_CM -48. 1459.3 DISPLAY_IDENTIFIER C_TEG_CAT_DOWN_EOL FORMAT "%7.2" /end CHARACTERISTIC
/begin CHARACTERISTIC c_maf_int_min_vls_eol "MAF integral threshold for lambda sensor EOL diagnos confused wired" VALUE 0xa080be30 _REC_VAL_20_u2 1820.4167 _CNV_A_R_LINEAR_____223_CM 0. 1820.4167 DISPLAY_IDENTIFIER C_MAF_INT_MIN_VLS_EOL FORMAT "%9.4" /end CHARACTERISTIC
/begin CHARACTERISTIC c_lamb_sp_vls_eol_afr "Lambda setpoint AFR for lambda sensor EOL diagnos confused wired" VALUE 0xa080bdf8 _REC_VAL_20_u2 31.9990234375 _CNV_A_R_LINEAR_____129_CM 0. 31.9990234375 DISPLAY_IDENTIFIER C_LAMB_SP_VLS_EOL_AFR FORMAT "%7.4" /end CHARACTERISTIC
/begin CHARACTERISTIC c_lamb_sp_vls_eol_afl "Lambda setpoint AFL for lambda sensor EOL diagnos confused wired" VALUE 0xa080bdf6 _REC_VAL_20_u2 31.9990234375 _CNV_A_R_LINEAR_____129_CM 0. 31.9990234375 DISPLAY_IDENTIFIER C_LAMB_SP_VLS_EOL_AFL FORMAT "%7.4" /end CHARACTERISTIC
/begin CHARACTERISTIC c_vls_afr_eol "Rich VLS threshold for lambda sensor EOL diagnosis" VALUE 0xa080c44e _REC_VAL_20_u2 4.995 _CNV_A_R_LINEAR_____224_CM 0. 4.995 DISPLAY_IDENTIFIER C_VLS_AFR_EOL FORMAT "%5.3" /end CHARACTERISTIC
/begin CHARACTERISTIC c_vls_afl_eol "Lean VLS threshold for lambda sensor EOL diagnosis" VALUE 0xa080c44c _REC_VAL_20_u2 4.995 _CNV_A_R_LINEAR_____224_CM 0. 4.995 DISPLAY_IDENTIFIER C_VLS_AFL_EOL FORMAT "%5.3" /end CHARACTERISTIC
/begin MEASUREMENT maf_int_min_vls_eol "MAF integral for Lambda sensor EOL diagnosis confused wrong wired" UWORD _CNV_A_R_LINEAR_____223_CM 1 100. 0. 1820.4167 DISPLAY_IDENTIFIER MAF_INT_MIN_VLS_EOL ECU_ADDRESS 0xd000abd8 FORMAT "%9.4" /end MEASUREMENT
/begin MEASUREMENT lv_act_vls_eol "Activation bit for lambda sensor EOL diagnos confused wired" UBYTE _CNV_S_2_RANGE__0___1_CM 1 100. 0. 1. DISPLAY_IDENTIFIER LV_ACT_VLS_EOL ECU_ADDRESS 0xd0008f25 BIT_MASK 0x1 /end MEASUREMENT
/begin CHARACTERISTIC c_lamb_ls_up_afr_eol "Rich lambda threshold for lambda sensor EOL diagnosis" VALUE 0xa080bdd0 _REC_VAL_20_u2 31.9990234375 _CNV_A_R_LINEAR_____129_CM 0. 31.9990234375 DISPLAY_IDENTIFIER C_LAMB_LS_UP_AFR_EOL FORMAT "%7.4" /end CHARACTERISTIC
/begin CHARACTERISTIC c_lamb_ls_up_afl_eol "Lean lambda threshold for lambda sensor EOL diagnosis" VALUE 0xa080bdce _REC_VAL_20_u2 31.9990234375 _CNV_A_R_LINEAR_____129_CM 0. 31.9990234375 DISPLAY_IDENTIFIER C_LAMB_LS_UP_AFL_EOL FORMAT "%7.4" /end CHARACTERISTIC
/begin MEASUREMENT lamb_sp_vls_eol[0] "Lambda setpoint for lambda sensor EOL diagnosis confused wired" UWORD _CNV_A_R_LINEAR_____129_CM 1 100. 0. 31.9990234375 DISPLAY_IDENTIFIER LAMB_SP_VLS_EOL[1] ECU_ADDRESS 0xd000abd4 FORMAT "%7.4" /end MEASUREMENT
/begin MEASUREMENT lamb_sp_vls_eol[1] "Lambda setpoint for lambda sensor EOL diagnosis confused wired" UWORD _CNV_A_R_LINEAR_____129_CM 1 100. 0. 31.9990234375 DISPLAY_IDENTIFIER LAMB_SP_VLS_EOL[2] ECU_ADDRESS 0xd000abd6 FORMAT "%7.4" /end MEASUREMENT
/begin MEASUREMENT vls_down_afl_eol[0] "Frozen VLS value for Lambda sensor EOL diagnosis confused wrong wired" UWORD _CNV_A_R_LINEAR_____224_CM 1 100. 0. 4.995 DISPLAY_IDENTIFIER VLS_DOWN_AFL_EOL[1] ECU_ADDRESS 0xd000abde FORMAT "%5.3" /end MEASUREMENT
/begin MEASUREMENT vls_down_afl_eol[1] "Frozen VLS value for Lambda sensor EOL diagnosis confused wrong wired" UWORD _CNV_A_R_LINEAR_____224_CM 1 100. 0. 4.995 DISPLAY_IDENTIFIER VLS_DOWN_AFL_EOL[2] ECU_ADDRESS 0xd000abe0 FORMAT "%5.3" /end MEASUREMENT
/begin MEASUREMENT vls_down_afr_eol[0] "Frozen VLS value for Lambda sensor EOL diagnosis confused wrong wired" UWORD _CNV_A_R_LINEAR_____224_CM 1 100. 0. 4.995 DISPLAY_IDENTIFIER VLS_DOWN_AFR_EOL[1] ECU_ADDRESS 0xd000abda FORMAT "%5.3" /end MEASUREMENT
/begin MEASUREMENT vls_down_afr_eol[1] "Frozen VLS value for Lambda sensor EOL diagnosis confused wrong wired" UWORD _CNV_A_R_LINEAR_____224_CM 1 100. 0. 4.995 DISPLAY_IDENTIFIER VLS_DOWN_AFR_EOL[2] ECU_ADDRESS 0xd000abdc FORMAT "%5.3" /end MEASUREMENT
/begin MEASUREMENT lamb_ls_up_afl_eol[0] "Frozen VLS value for Lambda sensor EOL diagnosis confused wrong wired" UWORD _CNV_A_R_LINEAR_____129_CM 1 100. 0. 31.9990234375 DISPLAY_IDENTIFIER LAMB_LS_UP_AFL_EOL[1] ECU_ADDRESS 0xd000abe6 FORMAT "%7.4" /end MEASUREMENT
/begin MEASUREMENT lamb_ls_up_afl_eol[1] "Frozen VLS value for Lambda sensor EOL diagnosis confused wrong wired" UWORD _CNV_A_R_LINEAR_____129_CM 1 100. 0. 31.9990234375 DISPLAY_IDENTIFIER LAMB_LS_UP_AFL_EOL[2] ECU_ADDRESS 0xd000abe8 FORMAT "%7.4" /end MEASUREMENT
/begin MEASUREMENT lamb_ls_up_afr_eol[0] "Frozen VLS value for Lambda sensor EOL diagnosis confused wrong wired" UWORD _CNV_A_R_LINEAR_____129_CM 1 100. 0. 31.9990234375 DISPLAY_IDENTIFIER LAMB_LS_UP_AFR_EOL[1] ECU_ADDRESS 0xd000abe2 FORMAT "%7.4" /end MEASUREMENT
/begin MEASUREMENT lamb_ls_up_afr_eol[1] "Frozen VLS value for Lambda sensor EOL diagnosis confused wrong wired" UWORD _CNV_A_R_LINEAR_____129_CM 1 100. 0. 31.9990234375 DISPLAY_IDENTIFIER LAMB_LS_UP_AFR_EOL[2] ECU_ADDRESS 0xd000abe4 FORMAT "%7.4" /end MEASUREMENT
/begin MEASUREMENT lv_vls_eol_shift_rep_inh "Bit to prevent endless loop of lambda shifts" UBYTE _CNV_S_2_RANGE__0___1_CM 1 100. 0. 1. DISPLAY_IDENTIFIER LV_VLS_EOL_SHIFT_REP_INH ECU_ADDRESS 0xd0001343 BIT_MASK 0x1 /end MEASUREMENT
/begin CHARACTERISTIC c_t_wait_vls_eol_opm_swi "Time threshold waiting for operation mode switch" VALUE 0xa080c2a6 _REC_VAL_20_u2 1310.7 _CNV_A_R_LINEAR_____110_CM 0. 1310.7 DISPLAY_IDENTIFIER C_T_WAIT_VLS_EOL_OPM_SWI FORMAT "%7.2" /end CHARACTERISTIC
/begin MEASUREMENT t_wait_vls_eol_opm_swi "Time waiting for operation mode switch" UWORD _CNV_A_R_LINEAR_____110_CM 1 100. 0. 1310.7 DISPLAY_IDENTIFIER T_WAIT_VLS_EOL_OPM_SWI ECU_ADDRESS 0xd000133c FORMAT "%7.2" /end MEASUREMENT
/begin MEASUREMENT lamb_sp_ext_adj_1 "bank selective external lambda setpoint (EOL test)" UWORD _CNV_A_R_LINEAR_____129_CM 1 100. 0. 31.9990234375 DISPLAY_IDENTIFIER LAMB_SP_EXT_ADJ_1 ECU_ADDRESS 0xd000abec FORMAT "%7.4" /end MEASUREMENT
/begin MEASUREMENT lamb_sp_ext_adj_2 "bank selective external lambda setpoint (EOL test)" UWORD _CNV_A_R_LINEAR_____129_CM 1 100. 0. 31.9990234375 DISPLAY_IDENTIFIER LAMB_SP_EXT_ADJ_2 ECU_ADDRESS 0xd000abee FORMAT "%7.4" /end MEASUREMENT
/begin MEASUREMENT lv_lamb_sp_ext_adj_1 "FL<g to activate bank selective external lambda setpoint (EOL test)" UBYTE _CNV_S_2_RANGE__0___1_CM 1 100. 0. 1. DISPLAY_IDENTIFIER LV_LAMB_SP_EXT_ADJ_1 ECU_ADDRESS 0xd0008f28 BIT_MASK 0x1 /end MEASUREMENT
/begin MEASUREMENT lv_lamb_sp_ext_adj_2 "FL<g to activate bank selective external lambda setpoint (EOL test)" UBYTE _CNV_S_2_RANGE__0___1_CM 1 100. 0. 1. DISPLAY_IDENTIFIER LV_LAMB_SP_EXT_ADJ_2 ECU_ADDRESS 0xd0008f29 BIT_MASK 0x1 /end MEASUREMENT
/begin CHARACTERISTIC c_n_grd_hys "Hysteresis for N_GRD Filtering" VALUE 0xa080bf32 _REC_VAL_20_s1 8160. _CNV_A_R_LINEAR_____30_CM -4096. 4064. DISPLAY_IDENTIFIER C_N_GRD_HYS FORMAT "%5.0" /end CHARACTERISTIC
/begin CHARACTERISTIC c_tqi_max_pas "Passive value indicated engine torque when engine speed limitation is inactive" VALUE 0xa080c3a4 _REC_VAL_20_u2 1023.96875 _CNV_A_R_LINEAR_____31_CM 0. 1023.96875 DISPLAY_IDENTIFIER C_TQI_MAX_PAS FORMAT "%7.2" /end CHARACTERISTIC
/begin MEASUREMENT lv_n_max_req_fcut "Logical variable fuel cut-off of all cylinder requested for engine speed limitation" UBYTE _CNV_S_2_RANGE__0___1_CM 1 100. 0. 1. DISPLAY_IDENTIFIER LV_N_MAX_REQ_FCUT ECU_ADDRESS 0xd00089cd BIT_MASK 0x1 /end MEASUREMENT
/begin MEASUREMENT n_dif_max_lim "Engine speed difference as an input for PI-controller" SWORD _CNV_A_R_LINEAR_____14_CM 1 100. -8160. 8160. DISPLAY_IDENTIFIER N_DIF_MAX_LIM ECU_ADDRESS 0xd00014a6 FORMAT "%4.0" /end MEASUREMENT
/begin MEASUREMENT n_pred_max_lim "Predicted engine speed " UWORD _CNV_A_R_LINEAR_____14_CM 1 100. 0. 8160. DISPLAY_IDENTIFIER N_PRED_MAX_LIM ECU_ADDRESS 0xd00014a4 FORMAT "%4.0" /end MEASUREMENT
/begin MEASUREMENT tq_n_max_dif "Torque output of N_MAX-PI-Controller" SWORD _CNV_A_R_LINEAR_____31_CM 1 100. -1024. 1023.96875 DISPLAY_IDENTIFIER TQ_N_MAX_DIF ECU_ADDRESS 0xd00014ac FORMAT "%6.2" /end MEASUREMENT
/begin MEASUREMENT tq_n_max_dif_i "Torque output of N_MAX-I-Controller" SLONG _CNV_A_R_LINEAR_____235_CM 1 100. -1024. 1023.99999952 DISPLAY_IDENTIFIER TQ_N_MAX_DIF_I ECU_ADDRESS 0xd00014b4 FORMAT "%11.7" /end MEASUREMENT
/begin MEASUREMENT tq_n_max_dif_p "Torque output of N_MAX-P-Controller" SWORD _CNV_A_R_LINEAR_____31_CM 1 100. -1024. 1023.96875 DISPLAY_IDENTIFIER TQ_N_MAX_DIF_P ECU_ADDRESS 0xd00014ae FORMAT "%6.2" /end MEASUREMENT
/begin MEASUREMENT tq_n_max_inp_i "Torque input for N_MAX I-controller" SWORD _CNV_A_R_LINEAR_____236_CM 1 100. -4. 3.99987793 DISPLAY_IDENTIFIER TQ_N_MAX_INP_I ECU_ADDRESS 0xd00014a8 FORMAT "%5.4" /end MEASUREMENT
/begin MEASUREMENT tqi_n_max "Indicated engine torque setpoint  for N_MAX-limitation" SWORD _CNV_A_R_LINEAR_____31_CM 1 100. -1024. 1023.96875 DISPLAY_IDENTIFIER TQI_N_MAX ECU_ADDRESS 0xd000a61c FORMAT "%8.2" /end MEASUREMENT
/begin MEASUREMENT tqi_n_max_ref "Reference indicated engine  torque on which controller output is applied" SWORD _CNV_A_R_LINEAR_____31_CM 1 100. -1024. 1023.96875 DISPLAY_IDENTIFIER TQI_N_MAX_REF ECU_ADDRESS 0xd00014aa FORMAT "%8.2" /end MEASUREMENT
/begin MEASUREMENT n_grd_fil "Filtered engine speed gradient for predicted engine speed" SBYTE _CNV_A_R_LINEAR_____237_CM 1 100. -4096. 4064. DISPLAY_IDENTIFIER N_GRD_FIL ECU_ADDRESS 0xd00014b8 FORMAT "%4.0" /end MEASUREMENT
/begin CHARACTERISTIC c_crlc_n_grd_fil_1 "N_GRD_FIL low pass filter constant if LV_N_MAX = 0" VALUE 0xa080bafe _REC_VAL_20_u2 0.9999847412109381 _CNV_A_R_LINEAR_____89_CM 0. 0.9999847412109381 DISPLAY_IDENTIFIER C_CRLC_N_GRD_FIL_1 FORMAT "%7.5" /end CHARACTERISTIC
/begin CHARACTERISTIC c_crlc_n_grd_fil_2 "N_GRD_FIL low pass filter constant if LV_N_MAX = 1" VALUE 0xa080bb00 _REC_VAL_20_u2 0.9999847412109381 _CNV_A_R_LINEAR_____89_CM 0. 0.9999847412109381 DISPLAY_IDENTIFIER C_CRLC_N_GRD_FIL_2 FORMAT "%7.5" /end CHARACTERISTIC
/begin CHARACTERISTIC c_tqi_n_max_inc "Maximum increment for the output when limiting increasing rate" VALUE 0xa080c3aa _REC_VAL_20_u2 1023.96875 _CNV_A_R_LINEAR_____31_CM 0. 1023.96875 DISPLAY_IDENTIFIER C_TQI_N_MAX_INC FORMAT "%7.2" /end CHARACTERISTIC
/begin CHARACTERISTIC id_fac_n_max_i_at__gear "I-control parameter for N_MAX-controller automatic transmission" CURVE 0xa0809958 _REC_CUR_20_u2_u1 7.9998779296875 _CNV_A_R_LINEAR_____238_CM 0. 7.9998779296875 DISPLAY_IDENTIFIER ID_FAC_N_MAX_I_AT__GEAR FORMAT "%6.4"
 /begin AXIS_DESCR COM_AXIS gear _CNV_A_R_LINEAR_____0_CM 9 0. 255. FORMAT "%3.0" AXIS_PTS_REF ldpm_gear /end AXIS_DESCR
/end CHARACTERISTIC
/begin CHARACTERISTIC id_fac_n_max_p_mt__gear "P-control parameter for N_MAX-controller manual transmission" CURVE 0xa080998c _REC_CUR_20_u1_u1 7.96875 _CNV_A_R_LINEAR_____239_CM 0. 7.96875 DISPLAY_IDENTIFIER ID_FAC_N_MAX_P_MT__GEAR FORMAT "%4.2"
 /begin AXIS_DESCR COM_AXIS gear _CNV_A_R_LINEAR_____0_CM 9 0. 255. FORMAT "%3.0" AXIS_PTS_REF ldpm_gear /end AXIS_DESCR
/end CHARACTERISTIC
/begin CHARACTERISTIC id_fac_n_max_i_mt__gear "I-control parameter for N_MAX-controller manual transmission" CURVE 0xa080996c _REC_CUR_20_u2_u1 7.9998779296875 _CNV_A_R_LINEAR_____238_CM 0. 7.9998779296875 DISPLAY_IDENTIFIER ID_FAC_N_MAX_I_MT__GEAR FORMAT "%6.4"
 /begin AXIS_DESCR COM_AXIS gear _CNV_A_R_LINEAR_____0_CM 9 0. 255. FORMAT "%3.0" AXIS_PTS_REF ldpm_gear /end AXIS_DESCR
/end CHARACTERISTIC
/begin CHARACTERISTIC id_fac_n_max_p_at__gear "P-control parameter for N_MAX-controller automatic transmission" CURVE 0xa0809980 _REC_CUR_20_u1_u1 7.96875 _CNV_A_R_LINEAR_____239_CM 0. 7.96875 DISPLAY_IDENTIFIER ID_FAC_N_MAX_P_AT__GEAR FORMAT "%4.2"
 /begin AXIS_DESCR COM_AXIS gear _CNV_A_R_LINEAR_____0_CM 9 0. 255. FORMAT "%3.0" AXIS_PTS_REF ldpm_gear /end AXIS_DESCR
/end CHARACTERISTIC
/begin CHARACTERISTIC id_t_n_max_pred_mt__gear "Prediction time for predicted engine speed for manual transmission" CURVE 0xa0809eb4 _REC_CUR_20_u1_u1 7.96875 _CNV_A_R_LINEAR_____191_CM 0. 7.96875 DISPLAY_IDENTIFIER ID_T_N_MAX_PRED_MT__GEAR FORMAT "%4.2"
 /begin AXIS_DESCR COM_AXIS gear _CNV_A_R_LINEAR_____0_CM 9 0. 255. FORMAT "%3.0" AXIS_PTS_REF ldpm_gear /end AXIS_DESCR
/end CHARACTERISTIC
/begin CHARACTERISTIC ip_n_grd_thd__n_32 "Engine speed gradient threshold for filtering of basic engine speed gradient" CURVE 0xa080b07c _REC_CUR_20_u1_u1 8160. _CNV_A_R_LINEAR_____240_CM -4096. 4064. DISPLAY_IDENTIFIER IP_N_GRD_THD__N_32 FORMAT "%5.0"
 /begin AXIS_DESCR COM_AXIS n_32 _CNV_A_R_LINEAR_____10_CM 8 0. 8160. FORMAT "%4.0" AXIS_PTS_REF ldp_n_32_n_grd_thd /end AXIS_DESCR
/end CHARACTERISTIC
/begin MEASUREMENT n_grd_fil_fil "Low pass filtered engine speed gradient for predicted engine speed" SBYTE _CNV_A_R_LINEAR_____237_CM 1 100. -4096. 4064. DISPLAY_IDENTIFIER N_GRD_FIL_FIL ECU_ADDRESS 0xd00014b9 FORMAT "%4.0" /end MEASUREMENT
/begin MEASUREMENT tqi_n_max_1 "Intermitted indicated engine torque after considering PI-controller output" SWORD _CNV_A_R_LINEAR_____31_CM 1 100. -1024. 1023.96875 DISPLAY_IDENTIFIER TQI_N_MAX_1 ECU_ADDRESS 0xd00014b0 FORMAT "%8.2" /end MEASUREMENT
/begin MEASUREMENT tqi_n_max_2 "Intermitted indicated engine torque after considering PI-controller output" SWORD _CNV_A_R_LINEAR_____31_CM 1 100. -1024. 1023.96875 DISPLAY_IDENTIFIER TQI_N_MAX_2 ECU_ADDRESS 0xd00014b2 FORMAT "%8.2" /end MEASUREMENT
/begin MEASUREMENT lv_n_max "Logical variable engine speed limitation active" UBYTE _CNV_S_2_RANGE__0___1_CM 1 100. 0. 1. DISPLAY_IDENTIFIER LV_N_MAX ECU_ADDRESS 0xd00089cc BIT_MASK 0x1 /end MEASUREMENT
/begin AXIS_PTS ldp_n_32_n_grd_thd "" 0xa0808a74 n_32 _REC_AXS_20_u1 8160. _CNV_A_R_LINEAR_____10_CM 8 0. 8160. FORMAT "%4.0" /end AXIS_PTS
/begin AXIS_PTS ldpm_gear "" 0xa0809418 gear _REC_AXS_20_u1 255. _CNV_A_R_LINEAR_____0_CM 9 0. 255. FORMAT "%3.0" /end AXIS_PTS
/begin CHARACTERISTIC id_fac_tqi_n_max_ref "Factor on TQI_N_MAX_REF value to init. I-controller" CURVE 0xa0809998 _REC_CUR_20_u1_u1 0.99609375 _CNV_A_R_LINEAR_____185_CM 0. 0.99609375 DISPLAY_IDENTIFIER ID_FAC_TQI_N_MAX_REF FORMAT "%5.3"
 /begin AXIS_DESCR COM_AXIS gear _CNV_A_R_LINEAR_____0_CM 9 0. 255. FORMAT "%3.0" AXIS_PTS_REF ldpm_gear /end AXIS_DESCR
/end CHARACTERISTIC
/begin CHARACTERISTIC c_add_n_max_fcut "Additive threshold to maximum engine speed for activation fuel cut-off all cylinders" VALUE 0xa080ba7e _REC_VAL_20_u2 8160. _CNV_A_R_LINEAR_____14_CM 0. 8160. DISPLAY_IDENTIFIER C_ADD_N_MAX_FCUT FORMAT "%4.0" /end CHARACTERISTIC
/begin CHARACTERISTIC lc_n_pred_max_lim_swi_amt "Switch to chose the way of N_PRED_MAX_LIM calculation for AMT" VALUE 0xa080c5b8 _REC_VAL_20_u1 1. _CNV_A_R_LINEAR_____0_CM 0. 1. DISPLAY_IDENTIFIER LC_N_PRED_MAX_LIM_SWI_AMT FORMAT "%1.0" /end CHARACTERISTIC
/begin CHARACTERISTIC id_t_n_max_pred_at__gear "Prediction time for predicted engine speed for automatic transmission" CURVE 0xa0809e9c _REC_CUR_20_u1_u1 7.96875 _CNV_A_R_LINEAR_____191_CM 0. 7.96875 DISPLAY_IDENTIFIER ID_T_N_MAX_PRED_AT__GEAR FORMAT "%4.2"
 /begin AXIS_DESCR COM_AXIS gear _CNV_A_R_LINEAR_____0_CM 9 0. 255. FORMAT "%3.0" AXIS_PTS_REF ldpm_gear /end AXIS_DESCR
/end CHARACTERISTIC
/begin CHARACTERISTIC id_t_n_max_pred_at_man "Prediction time for predicted engine speed for AT in manual mode 'M'" CURVE 0xa0809ea8 _REC_CUR_20_u1_u1 7.96875 _CNV_A_R_LINEAR_____191_CM 0. 7.96875 DISPLAY_IDENTIFIER ID_T_N_MAX_PRED_AT_MAN FORMAT "%4.2"
 /begin AXIS_DESCR COM_AXIS gear _CNV_A_R_LINEAR_____0_CM 9 0. 255. FORMAT "%3.0" AXIS_PTS_REF ldpm_gear /end AXIS_DESCR
/end CHARACTERISTIC
/begin MEASUREMENT n_max "highest engine speed reached" UWORD _CNV_A_R_LINEAR_____14_CM 1 100. 1. 8160. DISPLAY_IDENTIFIER N_MAX ECU_ADDRESS 0xd000a628 FORMAT "%4.0" /end MEASUREMENT
/begin MEASUREMENT trt_n_max "total running time in case of maximum engine speed reached" ULONG _CNV_A_R_LINEAR_____152_CM 1 100. 0. 119304.6471 DISPLAY_IDENTIFIER TRT_N_MAX ECU_ADDRESS 0xd000b934 FORMAT "%12.5" /end MEASUREMENT
/begin CHARACTERISTIC c_n_lim_min "Engine speed threshold for overrevving event" VALUE 0xa080bf58 _REC_VAL_20_u2 8160. _CNV_A_R_LINEAR_____14_CM 0. 8160. DISPLAY_IDENTIFIER C_N_LIM_MIN FORMAT "%4.0" /end CHARACTERISTIC
/begin MEASUREMENT ctr_n_max "event frequency counter" UBYTE _CNV_A_R_LINEAR_____0_CM 1 100. 0. 255. DISPLAY_IDENTIFIER CTR_N_MAX ECU_ADDRESS 0xd00089d4 FORMAT "%3.0" /end MEASUREMENT
/begin MEASUREMENT ctr_km_n_max "km counter at highest event" UWORD _CNV_A_R_LINEAR_____58_CM 1 100. 0. 655350. DISPLAY_IDENTIFIER CTR_KM_N_MAX ECU_ADDRESS 0xd000a62a FORMAT "%7.0" /end MEASUREMENT
/begin MEASUREMENT n_grd_n_max "engine speed gradient at highest event" SBYTE _CNV_A_R_LINEAR_____10_CM 1 100. -4096. 4064. DISPLAY_IDENTIFIER N_GRD_N_MAX ECU_ADDRESS 0xd00089d9 FORMAT "%5.0" /end MEASUREMENT
/begin MEASUREMENT vs_n_max "vehicle speed at highest event" UBYTE _CNV_A_R_LINEAR_____6_CM 1 100. 0. 255. DISPLAY_IDENTIFIER VS_N_MAX ECU_ADDRESS 0xd00089d5 FORMAT "%3.0" /end MEASUREMENT
/begin MEASUREMENT pv_av_n_max "pedal value at highest event" UBYTE _CNV_A_R_LINEAR_____5_CM 1 100. 0. 99.609375 DISPLAY_IDENTIFIER PV_AV_N_MAX ECU_ADDRESS 0xd00089d6 FORMAT "%4.1" /end MEASUREMENT
/begin MEASUREMENT gear_ef_n_max "gear ratio at highest event" UBYTE _CNV_A_R_LINEAR_____0_CM 1 100. 0. 255. DISPLAY_IDENTIFIER GEAR_EF_N_MAX ECU_ADDRESS 0xd00089d7 FORMAT "%3.0" /end MEASUREMENT
/begin MEASUREMENT lv_cs_n_max "clutch switch detection at highest event" UBYTE _CNV_S_2_RANGE__0___1_CM 1 100. 0. 1. DISPLAY_IDENTIFIER LV_CS_N_MAX ECU_ADDRESS 0xd00089da BIT_MASK 0x1 /end MEASUREMENT
/begin MEASUREMENT t_sum_n_max "time sum of all events maximum engine speed reached" UWORD _CNV_A_R_LINEAR_____4_CM 1 100. 0. 6553.5 DISPLAY_IDENTIFIER T_SUM_N_MAX ECU_ADDRESS 0xd000a62c FORMAT "%6.1" /end MEASUREMENT
/begin MEASUREMENT t_n_max "time sum at highest event" UWORD _CNV_A_R_LINEAR_____4_CM 1 100. 0. 6553.5 DISPLAY_IDENTIFIER T_N_MAX ECU_ADDRESS 0xd000a62e FORMAT "%6.1" /end MEASUREMENT
/begin MEASUREMENT nr_pat_scc_n_max "selected index off fuel cut off pattern at highest event" UBYTE _CNV_A_R_LINEAR_____0_CM 1 100. 0. 255. DISPLAY_IDENTIFIER NR_PAT_SCC_N_MAX ECU_ADDRESS 0xd00089d8 FORMAT "%3.0" /end MEASUREMENT
/begin CHARACTERISTIC lc_ad_clr_lam "Logical constant for initializing LAMBDA nvmy data" VALUE 0xa080c524 _REC_VAL_20_u1 1. _CNV_A_R_LINEAR_____0_CM 0. 1. DISPLAY_IDENTIFIER LC_AD_CLR_LAM FORMAT "%2.0" /end CHARACTERISTIC
/begin CHARACTERISTIC lc_ad_clr_thro "Logical constant for initializing THRO nvmy data" VALUE 0xa080c530 _REC_VAL_20_u1 1. _CNV_A_R_LINEAR_____0_CM 0. 1. DISPLAY_IDENTIFIER LC_AD_CLR_THRO FORMAT "%2.0" /end CHARACTERISTIC
/begin CHARACTERISTIC lc_ad_clr_mis "Logical constant for initializing MISFIRE nvmy data" VALUE 0xa080c526 _REC_VAL_20_u1 1. _CNV_A_R_LINEAR_____0_CM 0. 1. DISPLAY_IDENTIFIER LC_AD_CLR_MIS FORMAT "%2.0" /end CHARACTERISTIC
/begin CHARACTERISTIC lc_ad_clr_ivvt "Logical constant for initializing IVVT nvmy data" VALUE 0xa080c522 _REC_VAL_20_u1 1. _CNV_A_R_LINEAR_____0_CM 0. 1. DISPLAY_IDENTIFIER LC_AD_CLR_IVVT FORMAT "%2.0" /end CHARACTERISTIC
/begin CHARACTERISTIC lc_ad_clr_ati "Logical constant for initializing ATI nvmy data" VALUE 0xa080c514 _REC_VAL_20_u1 1. _CNV_A_R_LINEAR_____0_CM 0. 1. DISPLAY_IDENTIFIER LC_AD_CLR_ATI FORMAT "%2.0" /end CHARACTERISTIC
/begin CHARACTERISTIC lc_ad_clr_toil "Logical constant for initializing TOIL nvmy data" VALUE 0xa080c531 _REC_VAL_20_u1 1. _CNV_A_R_LINEAR_____0_CM 0. 1. DISPLAY_IDENTIFIER LC_AD_CLR_TOIL FORMAT "%2.0" /end CHARACTERISTIC
/begin CHARACTERISTIC lc_ad_clr_n_sp_is "Logical constant for initializing N_SP_IS nvmy data" VALUE 0xa080c528 _REC_VAL_20_u1 1. _CNV_A_R_LINEAR_____0_CM 0. 1. DISPLAY_IDENTIFIER LC_AD_CLR_N_SP_IS FORMAT "%2.0" /end CHARACTERISTIC
/begin CHARACTERISTIC lc_ad_clr_ron "Logical constant for initializing RON nvmy data" VALUE 0xa080c52d _REC_VAL_20_u1 1. _CNV_A_R_LINEAR_____0_CM 0. 1. DISPLAY_IDENTIFIER LC_AD_CLR_RON FORMAT "%2.0" /end CHARACTERISTIC
/begin CHARACTERISTIC lc_ad_clr_tecu "Logical constant for initializing TECU nvmy data" VALUE 0xa080c52f _REC_VAL_20_u1 1. _CNV_A_R_LINEAR_____0_CM 0. 1. DISPLAY_IDENTIFIER LC_AD_CLR_TECU FORMAT "%2.0" /end CHARACTERISTIC
/begin CHARACTERISTIC lc_ad_clr_var "Logical constant for initializing VAR nvmy data" VALUE 0xa080c535 _REC_VAL_20_u1 1. _CNV_A_R_LINEAR_____0_CM 0. 1. DISPLAY_IDENTIFIER LC_AD_CLR_VAR FORMAT "%2.0" /end CHARACTERISTIC
/begin CHARACTERISTIC lc_ad_clr_dmtl "Logical constant for initializing DMTL nvmy data" VALUE 0xa080c519 _REC_VAL_20_u1 1. _CNV_A_R_LINEAR_____0_CM 0. 1. DISPLAY_IDENTIFIER LC_AD_CLR_DMTL FORMAT "%2.0" /end CHARACTERISTIC
/begin CHARACTERISTIC lc_ad_clr_sof "Logical constant for initializing the sound flap / sport switch" VALUE 0xa080c52e _REC_VAL_20_u1 1. _CNV_A_R_LINEAR_____0_CM 0. 1. DISPLAY_IDENTIFIER LC_AD_CLR_SOF FORMAT "%2.0" /end CHARACTERISTIC
/begin CHARACTERISTIC lc_ad_clr_n_max "Logical constant for initializing the N_MAX nvmy data" VALUE 0xa080c527 _REC_VAL_20_u1 1. _CNV_A_R_LINEAR_____0_CM 0. 1. DISPLAY_IDENTIFIER LC_AD_CLR_N_MAX FORMAT "%2.0" /end CHARACTERISTIC
/begin CHARACTERISTIC lc_ad_clr_lif "Logical constant for initializing LIF" VALUE 0xa080c525 _REC_VAL_20_u1 1. _CNV_A_R_LINEAR_____0_CM 0. 1. DISPLAY_IDENTIFIER LC_AD_CLR_LIF FORMAT "%2.0" /end CHARACTERISTIC
/begin CHARACTERISTIC lc_ad_clr_tqi_lim "Logical constant for initializing TQI_LIM" VALUE 0xa080c533 _REC_VAL_20_u1 1. _CNV_A_R_LINEAR_____0_CM 0. 1. DISPLAY_IDENTIFIER LC_AD_CLR_TQI_LIM FORMAT "%2.0" /end CHARACTERISTIC
/begin CHARACTERISTIC lc_ad_clr "Logical constant for initializing AD" VALUE 0xa080c512 _REC_VAL_20_u1 1. _CNV_A_R_LINEAR_____0_CM 0. 1. DISPLAY_IDENTIFIER LC_AD_CLR FORMAT "%2.0" /end CHARACTERISTIC
/begin CHARACTERISTIC lc_ad_clr_obd2 "Logical constant for initializing OBDII" VALUE 0xa080c52a _REC_VAL_20_u1 1. _CNV_A_R_LINEAR_____0_CM 0. 1. DISPLAY_IDENTIFIER LC_AD_CLR_OBD2 FORMAT "%2.0" /end CHARACTERISTIC
/begin CHARACTERISTIC lc_ad_clr_cru "Logical constant for initializing CRU" VALUE 0xa080c518 _REC_VAL_20_u1 1. _CNV_A_R_LINEAR_____0_CM 0. 1. DISPLAY_IDENTIFIER LC_AD_CLR_CRU FORMAT "%2.0" /end CHARACTERISTIC
/begin MEASUREMENT lv_nvmy_rd_failed "Reading from NVMY failed due to TRL or CHK error" UBYTE _CNV_S_2_RANGE__0___1_CM 1 100. 0. 1. DISPLAY_IDENTIFIER LV_NVMY_RD_FAILED ECU_ADDRESS 0xd0008a34 BIT_MASK 0x1 /end MEASUREMENT
/begin CHARACTERISTIC lc_ad_clr_can "Logical constant for initializing CAN nvmy data" VALUE 0xa080c516 _REC_VAL_20_u1 1. _CNV_A_R_LINEAR_____0_CM 0. 1. DISPLAY_IDENTIFIER LC_AD_CLR_CAN FORMAT "%2.0" /end CHARACTERISTIC
/begin CHARACTERISTIC lc_ad_clr_pste "Logical constant for initializing PSTE nvmy data" VALUE 0xa080c52c _REC_VAL_20_u1 1. _CNV_A_R_LINEAR_____0_CM 0. 1. DISPLAY_IDENTIFIER LC_AD_CLR_PSTE FORMAT "%2.0" /end CHARACTERISTIC
/begin CHARACTERISTIC lc_ad_clr_toil_max "Logical constant for initializing TOIL_MAX nvmy data" VALUE 0xa080c532 _REC_VAL_20_u1 1. _CNV_A_R_LINEAR_____0_CM 0. 1. DISPLAY_IDENTIFIER LC_AD_CLR_TOIL_MAX FORMAT "%2.0" /end CHARACTERISTIC
/begin CHARACTERISTIC lc_ad_clr_nox "Logical constant for initializing NOx nvmy data" VALUE 0xa080c529 _REC_VAL_20_u1 1. _CNV_A_R_LINEAR_____0_CM 0. 1. DISPLAY_IDENTIFIER LC_AD_CLR_NOX FORMAT "%2.0" /end CHARACTERISTIC
/begin CHARACTERISTIC lc_ad_clr_ente "Logical constant for initializing ENTE nvmy data" VALUE 0xa080c51f _REC_VAL_20_u1 1. _CNV_A_R_LINEAR_____0_CM 0. 1. DISPLAY_IDENTIFIER LC_AD_CLR_ENTE FORMAT "%2.0" /end CHARACTERISTIC
/begin CHARACTERISTIC lc_ad_clr_enrd "Logical constant for initializing NOx nvmy data" VALUE 0xa080c51d _REC_VAL_20_u1 1. _CNV_A_R_LINEAR_____0_CM 0. 1. DISPLAY_IDENTIFIER LC_AD_CLR_ENRD FORMAT "%2.0" /end CHARACTERISTIC
/begin MEASUREMENT lv_nvmy_cus_wrg "0: reading of customer adaptation block in the E2PROM was successful // 1: not sucessful" UBYTE _CNV_S_2_RANGE__0___1_CM 1 100. 0. 1. DISPLAY_IDENTIFIER LV_NVMY_CUS_WRG ECU_ADDRESS 0xd0008798 BIT_MASK 0x1 /end MEASUREMENT
/begin CHARACTERISTIC lc_ad_clr_ensd "Logical constant for initializing ENSD nvmy data" VALUE 0xa080c51e _REC_VAL_20_u1 1. _CNV_A_R_LINEAR_____0_CM 0. 1. DISPLAY_IDENTIFIER LC_AD_CLR_ENSD FORMAT "%2.0" /end CHARACTERISTIC
/begin CHARACTERISTIC lc_ad_clr_extd "Logical constant for initializing the EXTD nvmy data" VALUE 0xa080c520 _REC_VAL_20_u1 1. _CNV_A_R_LINEAR_____0_CM 0. 1. DISPLAY_IDENTIFIER LC_AD_CLR_EXTD FORMAT "%2.0" /end CHARACTERISTIC
/begin CHARACTERISTIC lc_ad_clr_bal "Logical constant for initializing BAL nvmy data" VALUE 0xa080c515 _REC_VAL_20_u1 1. _CNV_A_R_LINEAR_____0_CM 0. 1. DISPLAY_IDENTIFIER LC_AD_CLR_BAL FORMAT "%2.0" /end CHARACTERISTIC
/begin CHARACTERISTIC lc_ad_clr_ccp "Logical constant for initializing CCP nvmy data" VALUE 0xa080c517 _REC_VAL_20_u1 1. _CNV_A_R_LINEAR_____0_CM 0. 1. DISPLAY_IDENTIFIER LC_AD_CLR_CCP FORMAT "%2.0" /end CHARACTERISTIC
/begin CHARACTERISTIC lc_ad_clr_tqlo "Logical constant for initializing TQLO nvmy data" VALUE 0xa080c534 _REC_VAL_20_u1 1. _CNV_A_R_LINEAR_____0_CM 0. 1. DISPLAY_IDENTIFIER LC_AD_CLR_TQLO FORMAT "%2.0" /end CHARACTERISTIC
/begin CHARACTERISTIC lc_ad_clr_pow "Logical constant for initializing POW nvmy data" VALUE 0xa080c52b _REC_VAL_20_u1 1. _CNV_A_R_LINEAR_____0_CM 0. 1. DISPLAY_IDENTIFIER LC_AD_CLR_POW FORMAT "%2.0" /end CHARACTERISTIC
/begin CHARACTERISTIC lc_ad_clr_laco "Logical constant for initializing LACO nvmy data" VALUE 0xa080c523 _REC_VAL_20_u1 1. _CNV_A_R_LINEAR_____0_CM 0. 1. DISPLAY_IDENTIFIER LC_AD_CLR_LACO FORMAT "%2.0" /end CHARACTERISTIC
/begin CHARACTERISTIC lc_ad_clr_egcp "Logical constant for initializing EGCP nvmy data" VALUE 0xa080c51b _REC_VAL_20_u1 1. _CNV_A_R_LINEAR_____0_CM 0. 1. DISPLAY_IDENTIFIER LC_AD_CLR_EGCP FORMAT "%2.0" /end CHARACTERISTIC
/begin CHARACTERISTIC lc_ad_clr_egr "Logical constant for initializing EGR nvmy data" VALUE 0xa080c51c _REC_VAL_20_u1 1. _CNV_A_R_LINEAR_____0_CM 0. 1. DISPLAY_IDENTIFIER LC_AD_CLR_EGR FORMAT "%2.0" /end CHARACTERISTIC
/begin CHARACTERISTIC lc_ad_clr_ecm2 "Logical constant for initializing EGR nvmy data" VALUE 0xa080c51a _REC_VAL_20_u1 1. _CNV_A_R_LINEAR_____0_CM 0. 1. DISPLAY_IDENTIFIER LC_AD_CLR_ECM2 FORMAT "%2.0" /end CHARACTERISTIC
/begin CHARACTERISTIC lc_ad_clr_alter "Logical constant for initializing ALTER nvmy data" VALUE 0xa080c513 _REC_VAL_20_u1 1. _CNV_A_R_LINEAR_____0_CM 0. 1. DISPLAY_IDENTIFIER LC_AD_CLR_ALTER FORMAT "%2.0" /end CHARACTERISTIC
/begin MEASUREMENT pwl_lock_cdn "power latch extension by project specific configuration:" UWORD _CNV_A_R_LINEAR_____0_CM 1 100. 0. 65535. DISPLAY_IDENTIFIER PWL_LOCK_CDN ECU_ADDRESS 0xd000a6fe /end MEASUREMENT
/begin MEASUREMENT t_pwl "incrementing timer during PWL phase active" UWORD _CNV_A_R_LINEAR_____4_CM 1 100. 0. 6553.5 DISPLAY_IDENTIFIER T_PWL ECU_ADDRESS 0xd000a6fc FORMAT "%6.1" /end MEASUREMENT
/begin MEASUREMENT lv_pwl_act "power latch phase active" UBYTE _CNV_S_2_RANGE__0___1_CM 1 100. 0. 1. DISPLAY_IDENTIFIER LV_PWL_ACT ECU_ADDRESS 0xd0001600 BIT_MASK 0x1 /end MEASUREMENT
/begin MEASUREMENT lv_inh_pwl_tran_es_el "flag active in shut down phase: IGK on is not accepted without reset" UBYTE _CNV_S_2_RANGE__0___1_CM 1 100. 0. 1. DISPLAY_IDENTIFIER LV_INH_PWL_TRAN_ES_EL ECU_ADDRESS 0xd0008afc BIT_MASK 0x1 /end MEASUREMENT
/begin CHARACTERISTIC c_t_min_pwl "minimum power latch time for ECU switch off" VALUE 0xa080c232 _REC_VAL_20_u2 6553.5 _CNV_A_R_LINEAR_____4_CM 0. 6553.5 DISPLAY_IDENTIFIER C_T_MIN_PWL FORMAT "%6.1" /end CHARACTERISTIC
/begin CHARACTERISTIC c_t_max_pwl "maximum power latch time for ECU switch off" VALUE 0xa080c1fa _REC_VAL_20_u2 6553.5 _CNV_A_R_LINEAR_____4_CM 0. 6553.5 DISPLAY_IDENTIFIER C_T_MAX_PWL FORMAT "%6.1" /end CHARACTERISTIC
/begin MEASUREMENT lv_rly_st "Starter relay" UBYTE _CNV_S_2_RANGE__0___1_CM 1 100. 0. 1. DISPLAY_IDENTIFIER LV_RLY_ST ECU_ADDRESS 0xd0008d08 BIT_MASK 0x1 /end MEASUREMENT
/begin CHARACTERISTIC c_vb_min_bsd_diag "Battery voltage threshold of power management diagnosis" VALUE 0xa080c427 _REC_VAL_20_u1 26. _CNV_A_R_LINEAR_____37_CM 0. 26. DISPLAY_IDENTIFIER C_VB_MIN_BSD_DIAG FORMAT "%4.1" /end CHARACTERISTIC
/begin CHARACTERISTIC lc_alter_bsd_prot_2 "logical constant: software swich to choose BSD protocol" VALUE 0xa080c537 _REC_VAL_20_u1 1. _CNV_A_R_LINEAR_____0_CM 0. 1. DISPLAY_IDENTIFIER LC_ALTER_BSD_PROT_2 FORMAT "%1.0" /end CHARACTERISTIC
/begin CHARACTERISTIC c_t_wr_per_alter_tbl_0 "calibratible time period for write register 0 (alternator powermanagement)" VALUE 0xa080c2a8 _REC_VAL_20_u1 10.2 _CNV_A_R_LINEAR_____261_CM 0. 10.2 DISPLAY_IDENTIFIER C_T_WR_PER_ALTER_TBL_0 FORMAT "%5.2" /end CHARACTERISTIC
/begin CHARACTERISTIC c_t_wr_per_alter_tbl_1 "calibratible time period for write register 1 (alternator powermanagement)" VALUE 0xa080c2a9 _REC_VAL_20_u1 10.2 _CNV_A_R_LINEAR_____261_CM 0. 10.2 DISPLAY_IDENTIFIER C_T_WR_PER_ALTER_TBL_1 FORMAT "%5.2" /end CHARACTERISTIC
/begin CHARACTERISTIC c_t_rd_per_alter_tbl_2 "calibratible time period for reading register 2 (alternator powermanagement)" VALUE 0xa080c260 _REC_VAL_20_u1 10.2 _CNV_A_R_LINEAR_____261_CM 0. 10.2 DISPLAY_IDENTIFIER C_T_RD_PER_ALTER_TBL_2 FORMAT "%5.2" /end CHARACTERISTIC
/begin CHARACTERISTIC c_t_rd_per_alter_tbl_5 "calibratible time period for reading register 5 (alternator powermanagement)" VALUE 0xa080c261 _REC_VAL_20_u1 10.2 _CNV_A_R_LINEAR_____261_CM 0. 10.2 DISPLAY_IDENTIFIER C_T_RD_PER_ALTER_TBL_5 FORMAT "%5.2" /end CHARACTERISTIC
/begin CHARACTERISTIC c_t_fil_cur_exct_alter "calibratible filter time for exciting current  (alternator powermanagement)" VALUE 0xa080c1c8 _REC_VAL_20_u1 2.55 _CNV_A_R_LINEAR_____3_CM 0. 2.55 DISPLAY_IDENTIFIER C_T_FIL_CUR_EXCT_ALTER FORMAT "%4.2" /end CHARACTERISTIC
/begin MEASUREMENT lv_alter_bsd_prot_2 "condition for BSD protocol controller type 2" UBYTE _CNV_S_2_RANGE__0___1_CM 1 100. 0. 1. DISPLAY_IDENTIFIER LV_ALTER_BSD_PROT_2 ECU_ADDRESS 0xd0008638 BIT_MASK 0x1 /end MEASUREMENT
/begin MEASUREMENT lv_alter_if_act "condition alternator interface activ" UBYTE _CNV_S_2_RANGE__0___1_CM 1 100. 0. 1. DISPLAY_IDENTIFIER LV_ALTER_IF_ACT ECU_ADDRESS 0xd0008636 BIT_MASK 0x1 /end MEASUREMENT
/begin MEASUREMENT lv_alter_eve_rd "condition: eo-read" UBYTE _CNV_S_2_RANGE__0___1_CM 1 100. 0. 1. DISPLAY_IDENTIFIER LV_ALTER_EVE_RD ECU_ADDRESS 0xd0008639 BIT_MASK 0x1 /end MEASUREMENT
/begin MEASUREMENT lv_alter_eve_wr "condition: eo-write" UBYTE _CNV_S_2_RANGE__0___1_CM 1 100. 0. 1. DISPLAY_IDENTIFIER LV_ALTER_EVE_WR ECU_ADDRESS 0xd000863a BIT_MASK 0x1 /end MEASUREMENT
/begin MEASUREMENT bsd_alter_rd.t_load_resp_alter_0 "actual value from alternator load response time" ULONG _CNV_A_R_LINEAR_____36_CM 1 100. 0. 15. DISPLAY_IDENTIFIER T_LOAD_RESP_ALTER_0 ECU_ADDRESS 0xd000862c FORMAT "%2.0" BIT_MASK 0xC0 /end MEASUREMENT
/begin MEASUREMENT bsd_alter_rd.v_alter "received voltage alternator" ULONG _CNV_A_R_LINEAR_____401_CM 1 100. 10.6 16.9 DISPLAY_IDENTIFIER V_ALTER ECU_ADDRESS 0xd000862c FORMAT "%4.1" BIT_MASK 0x3F /end MEASUREMENT
/begin MEASUREMENT bsd_alter_rd.t_load_resp_alter_1 "actual value from alternator load response time" ULONG _CNV_A_R_LINEAR_____36_CM 1 100. 0. 15. DISPLAY_IDENTIFIER T_LOAD_RESP_ALTER_1 ECU_ADDRESS 0xd000862c FORMAT "%2.0" BIT_MASK 0xE000 /end MEASUREMENT
/begin MEASUREMENT bsd_alter_rd.lv_load_resp_alter_cnd_1 "alternator load response condition for register 1 activ" ULONG _CNV_S_2_RANGE______76_CM 1 100. 0. 1. DISPLAY_IDENTIFIER LV_LOAD_RESP_ALTER_CND_1 ECU_ADDRESS 0xd000862c BIT_MASK 0x1000 /end MEASUREMENT
/begin MEASUREMENT bsd_alter_rd.lv_load_resp_alter_thd_act "shut of the load response threshold for alternator (copy of SP)" ULONG _CNV_S_2_RANGE______76_CM 1 100. 0. 1. DISPLAY_IDENTIFIER LV_LOAD_RESP_ALTER_THD_ACT ECU_ADDRESS 0xd000862c BIT_MASK 0x100 /end MEASUREMENT
/begin MEASUREMENT bsd_alter_rd.lv_alter_err_temp "(excess) temperature fault alternator" ULONG _CNV_S_2_RANGE______76_CM 1 100. 0. 1. DISPLAY_IDENTIFIER LV_ALTER_ERR_TEMP ECU_ADDRESS 0xd000862e BIT_MASK 0x80 /end MEASUREMENT
/begin MEASUREMENT bsd_alter_rd.lv_alter_err_mec "mechanical fault alternator" ULONG _CNV_S_2_RANGE______76_CM 1 100. 0. 1. DISPLAY_IDENTIFIER LV_ALTER_ERR_MEC ECU_ADDRESS 0xd000862e BIT_MASK 0x40 /end MEASUREMENT
/begin MEASUREMENT bsd_alter_rd.lv_alter_err_el "electrical fault alternator" ULONG _CNV_S_2_RANGE______76_CM 1 100. 0. 1. DISPLAY_IDENTIFIER LV_ALTER_ERR_EL ECU_ADDRESS 0xd000862e BIT_MASK 0x20 /end MEASUREMENT
/begin MEASUREMENT bsd_alter_rd.pow_rel_alter "occupancy of alternator" ULONG _CNV_A_R_LINEAR_____402_CM 1 100. 0. 96.875 DISPLAY_IDENTIFIER POW_REL_ALTER ECU_ADDRESS 0xd000862e FORMAT "%4.1" BIT_MASK 0x1F /end MEASUREMENT
/begin MEASUREMENT bsd_alter_rd.pow_rel_alter_l_res "DF rough value (occupancy factor) from alternator" UBYTE _CNV_S_4_STATE_POW__403_CM 1 100. 0. 3. DISPLAY_IDENTIFIER POW_REL_ALTER_L_RES ECU_ADDRESS 0xd000862f BIT_MASK 0xC0 /end MEASUREMENT
/begin MEASUREMENT bsd_alter_rd.cur_alter_exct "actual value exciting current  alternator" ULONG _CNV_A_R_LINEAR_____404_CM 1 100. 0. 7.75 DISPLAY_IDENTIFIER CUR_ALTER_EXCT ECU_ADDRESS 0xd000862e FORMAT "%3.1" BIT_MASK 0x3F00 /end MEASUREMENT
/begin MEASUREMENT bsd_alter_rd.temp_alter_mc "chip temperature alternator" ULONG _CNV_A_R_LINEAR_____405_CM 1 100. -32. 216. DISPLAY_IDENTIFIER TEMP_ALTER_MC ECU_ADDRESS 0xd0008630 FORMAT "%4.0" BIT_MASK 0x3E00 /end MEASUREMENT
/begin MEASUREMENT bsd_alter_rd.alter_cod_0 "manufacturer identifier" ULONG _CNV_A_R_LINEAR_____0_CM 1 100. 0. 7. DISPLAY_IDENTIFIER ALTER_COD_0 ECU_ADDRESS 0xd0008632 FORMAT "%3.0" BIT_MASK 0xE0 /end MEASUREMENT
/begin MEASUREMENT bsd_alter_rd.alter_cod_1 "type identifier alternator" ULONG _CNV_A_R_LINEAR_____0_CM 1 100. 0. 31. DISPLAY_IDENTIFIER ALTER_COD_1 ECU_ADDRESS 0xd0008632 FORMAT "%3.0" BIT_MASK 0x1F /end MEASUREMENT
/begin MEASUREMENT bsd_alter_rd.alter_cod_2 "controller version alternator" ULONG _CNV_A_R_LINEAR_____0_CM 1 100. 0. 3. DISPLAY_IDENTIFIER ALTER_COD_2 ECU_ADDRESS 0xd0008632 FORMAT "%3.0" BIT_MASK 0xC000 /end MEASUREMENT
/begin MEASUREMENT bsd_alter_rd.v_alter_nom "nominal voltage alternator" ULONG _CNV_A_R_LINEAR_____406_CM 1 100. 0. 3. DISPLAY_IDENTIFIER V_ALTER_NOM ECU_ADDRESS 0xd0008632 FORMAT "%2.0" BIT_MASK 0x3000 /end MEASUREMENT
/begin MEASUREMENT bsd_alter_rd.alter_cod_3 "chip version  alternator" ULONG _CNV_A_R_LINEAR_____0_CM 1 100. 0. 15. DISPLAY_IDENTIFIER ALTER_COD_3 ECU_ADDRESS 0xd0008632 FORMAT "%3.0" BIT_MASK 0xF00 /end MEASUREMENT
/begin MEASUREMENT bsd_alter_wr.t_load_resp_alter_sp_0 "actual value from alternator load response time" ULONG _CNV_A_R_LINEAR_____36_CM 1 100. 0. 15. DISPLAY_IDENTIFIER T_LOAD_RESP_ALTER_SP_0 ECU_ADDRESS 0xd000861c FORMAT "%2.0" BIT_MASK 0xC0 /end MEASUREMENT
/begin MEASUREMENT bsd_alter_wr.v_alter_sp "received voltage alternator" ULONG _CNV_A_R_LINEAR_____401_CM 1 100. 10.6 16.9 DISPLAY_IDENTIFIER V_ALTER_SP ECU_ADDRESS 0xd000861c FORMAT "%4.1" BIT_MASK 0x3F /end MEASUREMENT
/begin MEASUREMENT bsd_alter_wr.t_load_resp_alter_sp_1 "actual value from alternator load response time" ULONG _CNV_A_R_LINEAR_____36_CM 1 100. 0. 15. DISPLAY_IDENTIFIER T_LOAD_RESP_ALTER_SP_1 ECU_ADDRESS 0xd000861c FORMAT "%2.0" BIT_MASK 0xE000 /end MEASUREMENT
/begin MEASUREMENT bsd_alter_wr.lv_load_resp_alter_cnd_1 "actual value exciting current  alternator" ULONG _CNV_S_2_RANGE______76_CM 1 100. 0. 1. DISPLAY_IDENTIFIER LV_LOAD_RESP_ALTER_CND_1 ECU_ADDRESS 0xd000861c BIT_MASK 0x1000 /end MEASUREMENT
/begin MEASUREMENT bsd_alter_wr.lv_load_resp_alter_thd_act_sp "shut of the load response threshold for alternator" ULONG _CNV_S_2_RANGE______76_CM 1 100. 0. 1. DISPLAY_IDENTIFIER LV_LOAD_RESP_ALTER_THD_ACT_SP ECU_ADDRESS 0xd000861c BIT_MASK 0x100 /end MEASUREMENT
/begin MEASUREMENT bsd_alter_wr.cur_alter_exct_lim_sp "actual value exciting current  alternator" ULONG _CNV_A_R_LINEAR_____407_CM 1 100. 0. 7.75 DISPLAY_IDENTIFIER CUR_ALTER_EXCT_LIM_SP ECU_ADDRESS 0xd000861e FORMAT "%3.1" BIT_MASK 0x3E00 /end MEASUREMENT
/begin MEASUREMENT lf_alter_eve_wr "Logical field for eo-write operation" UBYTE _CNV_A_R_LINEAR_____0_CM 1 100. 0. 255. DISPLAY_IDENTIFIER LF_ALTER_EVE_WR ECU_ADDRESS 0xd00034a9 FORMAT "%3.0" /end MEASUREMENT
/begin MEASUREMENT nr_alter_eve_wr "Number of eo-write event" UBYTE _CNV_A_R_LINEAR_____0_CM 1 100. 0. 255. DISPLAY_IDENTIFIER NR_ALTER_EVE_WR ECU_ADDRESS 0xd00034aa FORMAT "%3.0" /end MEASUREMENT
/begin MEASUREMENT ctr_alter_eve_wr "eo-write counter" UBYTE _CNV_A_R_LINEAR_____0_CM 1 100. 0. 255. DISPLAY_IDENTIFIER CTR_ALTER_EVE_WR ECU_ADDRESS 0xd00034ac FORMAT "%3.0" /end MEASUREMENT
/begin MEASUREMENT state_alter_value_wr "State for selection of eo-write value" UBYTE _CNV_A_R_LINEAR_____0_CM 1 100. 0. 255. DISPLAY_IDENTIFIER STATE_ALTER_VALUE_WR ECU_ADDRESS 0xd00034ab FORMAT "%3.0" /end MEASUREMENT
/begin AXIS_PTS ldp_idx_lf_alter_eve_wr "Map for selection of eo-write event" 0xa08087c0 lf_alter_eve_wr _REC_AXS_20_u1 127. _CNV_A_R_LINEAR_____0_CM 32 0. 127. FORMAT "%3.0" /end AXIS_PTS
/begin AXIS_PTS ldp_idx_nr_alter_eve_wr "Map for selection of eo-write value" 0xa08087e4 nr_alter_eve_wr _REC_AXS_20_u1 7. _CNV_A_R_LINEAR_____0_CM 8 0. 7. FORMAT "%3.0" /end AXIS_PTS
/begin AXIS_PTS ldp_idx_ctr_alter_eve_wr "Map for selection of eo-write value" 0xa08087b6 ctr_alter_eve_wr _REC_AXS_20_u1 2. _CNV_A_R_LINEAR_____0_CM 3 0. 2. FORMAT "%3.0" /end AXIS_PTS
/begin CHARACTERISTIC id_nr_alter_eve_wr "Map for selection of eo-write event" CURVE 0xa0809d64 _REC_CUR_20_u1_u1 7. _CNV_A_R_LINEAR_____0_CM 0. 7. DISPLAY_IDENTIFIER ID_NR_ALTER_EVE_WR FORMAT "%3.0"
 /begin AXIS_DESCR COM_AXIS lf_alter_eve_wr _CNV_A_R_LINEAR_____0_CM 32 0. 127. FORMAT "%3.0" AXIS_PTS_REF ldp_idx_lf_alter_eve_wr /end AXIS_DESCR
/end CHARACTERISTIC
/begin CHARACTERISTIC id_state_alter_value_wr "Map for selection of eo-write event" MAP 0xa0809dd8 _REC_MAP_20_u1_u1_u1 3. _CNV_A_R_LINEAR_____0_CM 0. 3. DISPLAY_IDENTIFIER ID_STATE_ALTER_VALUE_WR FORMAT "%3.0"
 /begin AXIS_DESCR COM_AXIS nr_alter_eve_wr _CNV_A_R_LINEAR_____0_CM 8 0. 7. FORMAT "%3.0" AXIS_PTS_REF ldp_idx_nr_alter_eve_wr /end AXIS_DESCR
 /begin AXIS_DESCR COM_AXIS ctr_alter_eve_wr _CNV_A_R_LINEAR_____0_CM 3 0. 2. FORMAT "%3.0" AXIS_PTS_REF ldp_idx_ctr_alter_eve_wr /end AXIS_DESCR
/end CHARACTERISTIC
/begin MEASUREMENT lv_exc_t_load_resp_alter_sp_0 "Indicates B_chtlrgen condition" UBYTE _CNV_S_2_RANGE__0___1_CM 1 100. 0. 1. DISPLAY_IDENTIFIER LV_EXC_T_LOAD_RESP_ALTER_SP_0 ECU_ADDRESS 0xd000863c BIT_MASK 0x1 /end MEASUREMENT
/begin MEASUREMENT lv_exc_cur_alter_exct_lim_sp "Indicates B_chexc condition" UBYTE _CNV_S_2_RANGE__0___1_CM 1 100. 0. 1. DISPLAY_IDENTIFIER LV_EXC_CUR_ALTER_EXCT_LIM_SP ECU_ADDRESS 0xd000863d BIT_MASK 0x1 /end MEASUREMENT
/begin MEASUREMENT lv_exc_v_alter_sp "Indicates B_chugen condition" UBYTE _CNV_S_2_RANGE__0___1_CM 1 100. 0. 1. DISPLAY_IDENTIFIER LV_EXC_V_ALTER_SP ECU_ADDRESS 0xd000863b BIT_MASK 0x1 /end MEASUREMENT
/begin MEASUREMENT ctr_t_rd_per_alter_tbl_2 "Timer for reading register 2" UBYTE _CNV_A_R_LINEAR_____261_CM 1 100. 0. 10.2 DISPLAY_IDENTIFIER CTR_T_RD_PER_ALTER_TBL_2 ECU_ADDRESS 0xd00034a5 FORMAT "%5.2" /end MEASUREMENT
/begin MEASUREMENT ctr_t_rd_per_alter_tbl_5 "Timer for reading register 5" UBYTE _CNV_A_R_LINEAR_____261_CM 1 100. 0. 10.2 DISPLAY_IDENTIFIER CTR_T_RD_PER_ALTER_TBL_5 ECU_ADDRESS 0xd00034a6 FORMAT "%5.2" /end MEASUREMENT
/begin MEASUREMENT ctr_t_wr_per_alter_tbl_0 "Timer for write register 0" UBYTE _CNV_A_R_LINEAR_____261_CM 1 100. 0. 10.2 DISPLAY_IDENTIFIER CTR_T_WR_PER_ALTER_TBL_0 ECU_ADDRESS 0xd00034a7 FORMAT "%5.2" /end MEASUREMENT
/begin MEASUREMENT ctr_t_wr_per_alter_tbl_1 "Timer for write register 1" UBYTE _CNV_A_R_LINEAR_____261_CM 1 100. 0. 10.2 DISPLAY_IDENTIFIER CTR_T_WR_PER_ALTER_TBL_1 ECU_ADDRESS 0xd00034a8 FORMAT "%5.2" /end MEASUREMENT
/begin MEASUREMENT lv_step_bsd_alter "Request action on ablaufwr" UBYTE _CNV_S_2_RANGE__0___1_CM 1 100. 0. 1. DISPLAY_IDENTIFIER LV_STEP_BSD_ALTER ECU_ADDRESS 0xd0008644 BIT_MASK 0x1 /end MEASUREMENT
/begin MEASUREMENT lv_req_gen_rd_reg2 "Request read register 2" UBYTE _CNV_S_2_RANGE__0___1_CM 1 100. 0. 1. DISPLAY_IDENTIFIER LV_REQ_GEN_RD_REG2 ECU_ADDRESS 0xd0008642 BIT_MASK 0x1 /end MEASUREMENT
/begin MEASUREMENT lv_req_gen_rd_reg5 "Request read register 5" UBYTE _CNV_S_2_RANGE__0___1_CM 1 100. 0. 1. DISPLAY_IDENTIFIER LV_REQ_GEN_RD_REG5 ECU_ADDRESS 0xd0008643 BIT_MASK 0x1 /end MEASUREMENT
/begin MEASUREMENT lv_req_gen_wr_reg0 "Request write register 0" UBYTE _CNV_S_2_RANGE__0___1_CM 1 100. 0. 1. DISPLAY_IDENTIFIER LV_REQ_GEN_WR_REG0 ECU_ADDRESS 0xd000863f BIT_MASK 0x1 /end MEASUREMENT
/begin MEASUREMENT lv_req_gen_wr_reg1 "Request write register 1" UBYTE _CNV_S_2_RANGE__0___1_CM 1 100. 0. 1. DISPLAY_IDENTIFIER LV_REQ_GEN_WR_REG1 ECU_ADDRESS 0xd0008640 BIT_MASK 0x1 /end MEASUREMENT
/begin MEASUREMENT lv_req_gen_wr_reg3 "Request write register 3" UBYTE _CNV_S_2_RANGE__0___1_CM 1 100. 0. 1. DISPLAY_IDENTIFIER LV_REQ_GEN_WR_REG3 ECU_ADDRESS 0xd0008641 BIT_MASK 0x1 /end MEASUREMENT
/begin CHARACTERISTIC lc_pow_cord_inh "Configuration of alternator powermanagement" VALUE 0xa080c5d1 _REC_VAL_20_u1 1. _CNV_A_R_LINEAR_____0_CM 0. 1. DISPLAY_IDENTIFIER LC_POW_CORD_INH FORMAT "%1.0" /end CHARACTERISTIC
/begin MEASUREMENT lv_err_qoil_sens "" UBYTE _CNV_S_2_RANGE__0___1_CM 1 100. 0. 1. DISPLAY_IDENTIFIER LV_ERR_QOIL_SENS ECU_ADDRESS 0xd0007fbe BIT_MASK 0x1 /end MEASUREMENT
/begin MEASUREMENT lv_err_toil_level "Boolean for error currently present on TOENS sensor" UBYTE _CNV_S_2_RANGE__0___1_CM 1 100. 0. 1. DISPLAY_IDENTIFIER LV_ERR_TOIL_LEVEL ECU_ADDRESS 0xd0007f47 BIT_MASK 0x1 /end MEASUREMENT
/begin MEASUREMENT lv_err_toil "TOIL error flag" UBYTE _CNV_S_2_RANGE__0___1_CM 1 100. 0. 1. DISPLAY_IDENTIFIER LV_ERR_TOIL ECU_ADDRESS 0xd00086a0 BIT_MASK 0x1 /end MEASUREMENT
/begin MEASUREMENT lv_ecras "Indication of air flaps being closed (1)/open (0)" UBYTE _CNV_S_2_RANGE__0___1_CM 1 100. 0. 1. DISPLAY_IDENTIFIER LV_ECRAS ECU_ADDRESS 0xd000873e BIT_MASK 0x1 /end MEASUREMENT
/begin MEASUREMENT lv_ecras_up "SV label for B_LKLPS (from layer)" UBYTE _CNV_S_2_RANGE__0___1_CM 1 100. 0. 1. DISPLAY_IDENTIFIER LV_ECRAS_UP ECU_ADDRESS 0xd000873f BIT_MASK 0x1 /end MEASUREMENT
/begin MEASUREMENT lv_ecras_down "SV label for B_LKLPS1 (from layer)" UBYTE _CNV_S_2_RANGE__0___1_CM 1 100. 0. 1. DISPLAY_IDENTIFIER LV_ECRAS_DOWN ECU_ADDRESS 0xd0008740 BIT_MASK 0x1 /end MEASUREMENT
/begin AXIS_PTS ldp_alter_cod_0 "" 0xa08084f0 bsd_alter_rd.alter_cod_0 _REC_AXS_20_u1 7. _CNV_A_R_LINEAR_____0_CM 8 0. 7. FORMAT "%2.0" /end AXIS_PTS
/begin CHARACTERISTIC id_alter_exct_lim_sp "Setting of CUR_ALTER_EXCT_LIM_SP in dependence of  ALTER_COD_0" CURVE 0xa0809934 _REC_CUR_20_u1_u1 7.75 _CNV_A_R_LINEAR_____407_CM 0. 7.75 DISPLAY_IDENTIFIER ID_ALTER_EXCT_LIM_SP FORMAT "%3.1"
 /begin AXIS_DESCR COM_AXIS bsd_alter_rd.alter_cod_0 _CNV_A_R_LINEAR_____0_CM 8 0. 7. FORMAT "%2.0" AXIS_PTS_REF ldp_alter_cod_0 /end AXIS_DESCR
/end CHARACTERISTIC
/begin CHARACTERISTIC lc_alter_exct_lim_sp "logical constant: software swich to choose BSD" VALUE 0xa080c538 _REC_VAL_20_u1 1. _CNV_A_R_LINEAR_____0_CM 0. 1. DISPLAY_IDENTIFIER LC_ALTER_EXCT_LIM_SP FORMAT "%1.0" /end CHARACTERISTIC
/begin MEASUREMENT ozpermr_w "Signal Oelzustand" UWORD _CNV_A_R_LINEAR_____0_CM 1 100. 0. 65535. DISPLAY_IDENTIFIER OZPERMR_W ECU_ADDRESS 0xd000a3aa FORMAT "%5.0" /end MEASUREMENT
/begin MEASUREMENT ozstatus "Status of oil sensor" UWORD _CNV_A_R_LINEAR_____0_CM 1 100. 0. 65535. DISPLAY_IDENTIFIER OZSTATUS ECU_ADDRESS 0xd000a3ac FORMAT "%5.0" /end MEASUREMENT
/begin MEASUREMENT oztempr "Signal Oeltemperatur" UWORD _CNV_A_R_LINEAR_____0_CM 1 100. 0. 65535. DISPLAY_IDENTIFIER OZTEMPR ECU_ADDRESS 0xd000a3ae FORMAT "%5.0" /end MEASUREMENT
/begin MEASUREMENT oznivr "Signal Oelstand" UWORD _CNV_A_R_LINEAR_____0_CM 1 100. 0. 65535. DISPLAY_IDENTIFIER OZNIVR ECU_ADDRESS 0xd000a3a8 FORMAT "%5.0" /end MEASUREMENT
/begin CHARACTERISTIC c_tco_min_egr "Minimum temperature for EGR-control active" VALUE 0xa080c2d2 _REC_VAL_20_u1 190.5 _CNV_A_R_LINEAR_____17_CM -48. 142.5 DISPLAY_IDENTIFIER C_TCO_MIN_EGR FORMAT "%5.1" /end CHARACTERISTIC
/begin CHARACTERISTIC c_t_ast_egr "time delay for EGR active after start" VALUE 0xa080c126 _REC_VAL_20_u2 6553.5 _CNV_A_R_LINEAR_____4_CM 0. 6553.5 DISPLAY_IDENTIFIER C_T_AST_EGR FORMAT "%6.1" /end CHARACTERISTIC
/begin MEASUREMENT lv_acr_ctl_ena "logical value for EGR-control active" UBYTE _CNV_S_2_RANGE__0___1_CM 1 100. 0. 1. DISPLAY_IDENTIFIER LV_ACR_CTL_ENA ECU_ADDRESS 0xd0008888 BIT_MASK 0x1 /end MEASUREMENT
/begin CHARACTERISTIC lc_acr_ctl_ena "Logical constant for the activation of actuator position control " VALUE 0xa080c511 _REC_VAL_20_u1 1. _CNV_A_R_LINEAR_____0_CM 0. 1. DISPLAY_IDENTIFIER LC_ACR_CTL_ENA FORMAT "%1.0" /end CHARACTERISTIC
/begin CHARACTERISTIC c_n_32_swi_aeb_hom_afl "Engine speed threshold for switching active engine brackets in HOM_AFL mode" VALUE 0xa080bf0f _REC_VAL_20_u1 8160. _CNV_A_R_LINEAR_____10_CM 0. 8160. DISPLAY_IDENTIFIER C_N_32_SWI_AEB_HOM_AFL FORMAT "%4.0" /end CHARACTERISTIC
/begin CHARACTERISTIC c_n_32_swi_aeb_hom_afs "Engine speed threshold for switching active engine brackets in HOM_AFS mode" VALUE 0xa080bf10 _REC_VAL_20_u1 8160. _CNV_A_R_LINEAR_____10_CM 0. 8160. DISPLAY_IDENTIFIER C_N_32_SWI_AEB_HOM_AFS FORMAT "%4.0" /end CHARACTERISTIC
/begin CHARACTERISTIC c_n_32_swi_aeb_hys "Engine speed hysteresis for switching active engine brackets" VALUE 0xa080bf11 _REC_VAL_20_u1 8160. _CNV_A_R_LINEAR_____10_CM 0. 8160. DISPLAY_IDENTIFIER C_N_32_SWI_AEB_HYS FORMAT "%4.0" /end CHARACTERISTIC
/begin CHARACTERISTIC c_n_32_swi_aeb_s "Engine speed threshold for switching active engine brackets in S mode" VALUE 0xa080bf12 _REC_VAL_20_u1 8160. _CNV_A_R_LINEAR_____10_CM 0. 8160. DISPLAY_IDENTIFIER C_N_32_SWI_AEB_S FORMAT "%4.0" /end CHARACTERISTIC
/begin CHARACTERISTIC c_vs_swi_aeb_hom_afl "Vehicle speed threshold for switching active engine brackets in HOM_AFL mode" VALUE 0xa080c4fc _REC_VAL_20_u1 255. _CNV_A_R_LINEAR_____6_CM 0. 255. DISPLAY_IDENTIFIER C_VS_SWI_AEB_HOM_AFL FORMAT "%3.0" /end CHARACTERISTIC
/begin CHARACTERISTIC c_vs_swi_aeb_hom_afs "Vehicle speed threshold for switching active engine brackets in HOM_AFS mode" VALUE 0xa080c4fd _REC_VAL_20_u1 255. _CNV_A_R_LINEAR_____6_CM 0. 255. DISPLAY_IDENTIFIER C_VS_SWI_AEB_HOM_AFS FORMAT "%3.0" /end CHARACTERISTIC
/begin CHARACTERISTIC c_vs_swi_aeb_hys "Vehicle speed hysteresis for switching active engine brackets" VALUE 0xa080c4fe _REC_VAL_20_u1 255. _CNV_A_R_LINEAR_____6_CM 0. 255. DISPLAY_IDENTIFIER C_VS_SWI_AEB_HYS FORMAT "%3.0" /end CHARACTERISTIC
/begin CHARACTERISTIC c_vs_swi_aeb_s "Vehicle speed threshold for switching active engine brackets in S mode" VALUE 0xa080c4ff _REC_VAL_20_u1 255. _CNV_A_R_LINEAR_____6_CM 0. 255. DISPLAY_IDENTIFIER C_VS_SWI_AEB_S FORMAT "%3.0" /end CHARACTERISTIC
/begin MEASUREMENT lv_fup_prs_ctl_req " Logical variable requesting pressure control mode " UBYTE _CNV_S_2_RANGE__0___1_CM 1 100. 0. 1. DISPLAY_IDENTIFIER LV_FUP_PRS_CTL_REQ ECU_ADDRESS 0xd0008895 BIT_MASK 0x1 /end MEASUREMENT
/begin MEASUREMENT lv_fup_req_fpa_stop " Logical variable requesting I-part freeze of controller for pressure control " UBYTE _CNV_S_2_RANGE__0___1_CM 1 100. 0. 1. DISPLAY_IDENTIFIER LV_FUP_REQ_FPA_STOP ECU_ADDRESS 0xd0008896 BIT_MASK 0x1 /end MEASUREMENT
/begin MEASUREMENT lv_fuel_mass_ad_stop "Logical variable requesting adaptation stop of controller for demand control " UBYTE _CNV_S_2_RANGE__0___1_CM 1 100. 0. 1. DISPLAY_IDENTIFIER LV_FUEL_MASS_AD_STOP ECU_ADDRESS 0xd0008899 BIT_MASK 0x1 /end MEASUREMENT
/begin MEASUREMENT lv_vff_vcv_min "Logical variable indicating volume flow through VCV reaches limit " UBYTE _CNV_S_2_RANGE__0___1_CM 1 100. 0. 1. DISPLAY_IDENTIFIER LV_VFF_VCV_MIN ECU_ADDRESS 0xd0000d03 BIT_MASK 0x1 /end MEASUREMENT
/begin MEASUREMENT vff_mff_sp_fup_ctl "Volume fuel flow through the injectors " UWORD _CNV_A_R_LINEAR_____176_CM 1 100. 0. 255. DISPLAY_IDENTIFIER VFF_MFF_SP_FUP_CTL ECU_ADDRESS 0xd000a3ea FORMAT "%7.3" /end MEASUREMENT
/begin MEASUREMENT state_fup_ctl_tran "Transistion conditions for the STATE_FUP_CTL " UBYTE _CNV_S_4_RANGE_STAT_528_CM 1 100. 0. 3. DISPLAY_IDENTIFIER STATE_FUP_CTL_TRAN ECU_ADDRESS 0xd0000d00 /end MEASUREMENT
/begin MEASUREMENT state_fup_ctl " Operating state for the global fuel pressure regulation strategy" UBYTE _CNV_S_4_RANGE_STAT_529_CM 1 100. 0. 3. DISPLAY_IDENTIFIER STATE_FUP_CTL ECU_ADDRESS 0xd0008894 /end MEASUREMENT
/begin CHARACTERISTIC c_fup_ctl_mod "Request for operating state of the global fuel pressure regulation strategy" VALUE 0xa080bd4e _REC_VAL_20_u1 2. _CNV_S_3_RANGE_FUP__530_CM 0. 2. DISPLAY_IDENTIFIER C_FUP_CTL_MOD /end CHARACTERISTIC
/begin MEASUREMENT fpa_mff "Fuel flow through the regulator " UWORD _CNV_A_R_LINEAR_____176_CM 1 100. 0. 255. DISPLAY_IDENTIFIER FPA_MFF ECU_ADDRESS 0xd000a3e8 FORMAT "%7.3" /end MEASUREMENT
/begin MEASUREMENT lv_fuel_mass_ctl_stop "Logical variable requesting I-part freeze of controller for flow control " UBYTE _CNV_S_2_RANGE__0___1_CM 1 100. 0. 1. DISPLAY_IDENTIFIER LV_FUEL_MASS_CTL_STOP ECU_ADDRESS 0xd0008898 BIT_MASK 0x1 /end MEASUREMENT
/begin MEASUREMENT lv_fuel_mass_ctl_rst "Logical variable requesting I-part reset of controller for flow control" UBYTE _CNV_S_2_RANGE__0___1_CM 1 100. 0. 1. DISPLAY_IDENTIFIER LV_FUEL_MASS_CTL_RST ECU_ADDRESS 0xd000889a BIT_MASK 0x1 /end MEASUREMENT
/begin CHARACTERISTIC lc_fuel_mass_ctl_rst "Logical switch requesting I-part reset of controller for flow control at leaving pressure control" VALUE 0xa080c576 _REC_VAL_20_u1 1. _CNV_A_R_LINEAR_____0_CM 0. 1. DISPLAY_IDENTIFIER LC_FUEL_MASS_CTL_RST FORMAT "%1.0" /end CHARACTERISTIC
/begin CHARACTERISTIC lc_vff_swi "Logical switch selecting VFF_VCV or VFF_MFF_SP_FUP_CTL as input for structure Change" VALUE 0xa080c622 _REC_VAL_20_u1 1. _CNV_A_R_LINEAR_____0_CM 0. 1. DISPLAY_IDENTIFIER LC_VFF_SWI FORMAT "%1.0" /end CHARACTERISTIC
/begin CHARACTERISTIC lc_fpa_conf "Logical switch for PCV/VCV or 3-Way-VCV (1: PCV/VCV)" VALUE 0xa080c575 _REC_VAL_20_u1 1. _CNV_A_R_LINEAR_____0_CM 0. 1. DISPLAY_IDENTIFIER LC_FPA_CONF FORMAT "%1.0" /end CHARACTERISTIC
/begin MEASUREMENT lv_fup_req_fpa_rst " Logical variable requesting I-part reset of controller for pressure control " UBYTE _CNV_S_2_RANGE__0___1_CM 1 100. 0. 1. DISPLAY_IDENTIFIER LV_FUP_REQ_FPA_RST ECU_ADDRESS 0xd0008897 BIT_MASK 0x1 /end MEASUREMENT
/begin MEASUREMENT ctr_seg_fup_ofs_bol " Counter for 'forced' leaving of pressure control " UBYTE _CNV_A_R_LINEAR_____0_CM 1 100. 0. 255. DISPLAY_IDENTIFIER CTR_SEG_FUP_OFS_BOL ECU_ADDRESS 0xd0000d01 FORMAT "%3.0" /end MEASUREMENT
/begin MEASUREMENT ctr_seg_fup_ofs_tol "Counter for 'forced' leaving of flow control " UBYTE _CNV_A_R_LINEAR_____0_CM 1 100. 0. 255. DISPLAY_IDENTIFIER CTR_SEG_FUP_OFS_TOL ECU_ADDRESS 0xd0000d02 FORMAT "%3.0" /end MEASUREMENT
/begin CHARACTERISTIC c_ctr_seg_fup_ofs_tol_max "Max. value for the counter for 'forced' leaving of flow control " VALUE 0xa080bbc7 _REC_VAL_20_u1 255. _CNV_A_R_LINEAR_____0_CM 0. 255. DISPLAY_IDENTIFIER C_CTR_SEG_FUP_OFS_TOL_MAX FORMAT "%3.0" /end CHARACTERISTIC
/begin CHARACTERISTIC lc_fup_req_fpa_rst "Logical switch requesting I-part reset of controller for pressure control at leaving flow control" VALUE 0xa080c57a _REC_VAL_20_u1 1. _CNV_A_R_LINEAR_____0_CM 0. 1. DISPLAY_IDENTIFIER LC_FUP_REQ_FPA_RST FORMAT "%1.0" /end CHARACTERISTIC
/begin CHARACTERISTIC c_fup_ofs_bol "Offset to the FUP for the 'forced' leaving of pressure control" VALUE 0xa080bd82 _REC_VAL_20_s2 347776. _CNV_A_R_LINEAR_____525_CM -173890.6533608 173885.3466392 DISPLAY_IDENTIFIER C_FUP_OFS_BOL FORMAT "%9.2" /end CHARACTERISTIC
/begin CHARACTERISTIC c_fup_ofs_tol "Offset to the FUP for the 'forced' leaving of flow control" VALUE 0xa080bd86 _REC_VAL_20_s2 347776. _CNV_A_R_LINEAR_____525_CM -173890.6533608 173885.3466392 DISPLAY_IDENTIFIER C_FUP_OFS_TOL FORMAT "%9.2" /end CHARACTERISTIC
/begin CHARACTERISTIC c_fup_sp_dec_tol "Offset to the FUP for the 'forced' leaving of flow control" VALUE 0xa080bd8e _REC_VAL_20_u2 347776. _CNV_A_R_LINEAR_____171_CM 0. 347776. DISPLAY_IDENTIFIER C_FUP_SP_DEC_TOL FORMAT "%6.0" /end CHARACTERISTIC
/begin CHARACTERISTIC c_ctr_seg_fup_ofs_bol_max "Max. value for the counter for 'forced' leaving of pressure control " VALUE 0xa080bbc6 _REC_VAL_20_u1 255. _CNV_A_R_LINEAR_____0_CM 0. 255. DISPLAY_IDENTIFIER C_CTR_SEG_FUP_OFS_BOL_MAX FORMAT "%3.0" /end CHARACTERISTIC
/begin CHARACTERISTIC c_vff_vcv_min_tol_hys "Hysteresis to the upper switch limit" VALUE 0xa080c44a _REC_VAL_20_u2 255. _CNV_A_R_LINEAR_____176_CM 0. 255. DISPLAY_IDENTIFIER C_VFF_VCV_MIN_TOL_HYS FORMAT "%7.3" /end CHARACTERISTIC
/begin CHARACTERISTIC c_vff_vcv_min_bol_hys "Hysteresis to the lower switch limit" VALUE 0xa080c448 _REC_VAL_20_u2 255. _CNV_A_R_LINEAR_____176_CM 0. 255. DISPLAY_IDENTIFIER C_VFF_VCV_MIN_BOL_HYS FORMAT "%7.3" /end CHARACTERISTIC
/begin CHARACTERISTIC c_vff_swi_thd "Switch threshold selecting VFF_VCV or VFF_MFF_SP_FUP_CTL as input for struc. change" VALUE 0xa080c446 _REC_VAL_20_u2 255. _CNV_A_R_LINEAR_____176_CM 0. 255. DISPLAY_IDENTIFIER C_VFF_SWI_THD FORMAT "%7.3" /end CHARACTERISTIC
/begin CHARACTERISTIC c_fup_sp_man "Manual fuel pressure setpoint" VALUE 0xa080bd98 _REC_VAL_20_u2 347776. _CNV_A_R_LINEAR_____171_CM 0. 347776. DISPLAY_IDENTIFIER C_FUP_SP_MAN FORMAT "%6.0" /end CHARACTERISTIC
/begin CHARACTERISTIC c_fup_sp_pu_lim_inc "Gradient limitation for fuel pressure setpoint increment during PU/PUC" VALUE 0xa080bd9c _REC_VAL_20_u2 347776. _CNV_A_R_LINEAR_____171_CM 0. 347776. DISPLAY_IDENTIFIER C_FUP_SP_PU_LIM_INC FORMAT "%6.0" /end CHARACTERISTIC
/begin CHARACTERISTIC c_fup_sp_pu_lim_dec "Gradient limitation for fuel pressure setpoint decrement during PU/PUC" VALUE 0xa080bd9a _REC_VAL_20_u2 347776. _CNV_A_R_LINEAR_____171_CM 0. 347776. DISPLAY_IDENTIFIER C_FUP_SP_PU_LIM_DEC FORMAT "%6.0" /end CHARACTERISTIC
/begin CHARACTERISTIC c_fup_sp_lim_dec "Gradient limitation for fuel pressure setpoint decrement during normal operation" VALUE 0xa080bd94 _REC_VAL_20_u2 347776. _CNV_A_R_LINEAR_____171_CM 0. 347776. DISPLAY_IDENTIFIER C_FUP_SP_LIM_DEC FORMAT "%6.0" /end CHARACTERISTIC
/begin CHARACTERISTIC lc_fup_sp_man_act "Switch for manual FUP_SP" VALUE 0xa080c57b _REC_VAL_20_u1 1. _CNV_A_R_LINEAR_____0_CM 0. 1. DISPLAY_IDENTIFIER LC_FUP_SP_MAN_ACT FORMAT "%1.0" /end CHARACTERISTIC
/begin AXIS_PTS ldpm_n_1_fusl "" 0xa080957c n_32 _REC_AXS_20_u1 8160. _CNV_A_R_LINEAR_____10_CM 8 0. 8160. FORMAT "%4.0" /end AXIS_PTS
/begin AXIS_PTS ldpm_mff_sp_fup_ctl_1_fusl "" 0xa0809530 mff_sp_fup_ctl _REC_AXS_20_u2 1389. _CNV_A_R_LINEAR_____111_CM 10 0. 1389. FORMAT "%7.2" /end AXIS_PTS
/begin CHARACTERISTIC ip_fup_sp_s "Fuel pressure setpoint for stratified engine operation" MAP 0xa0814a54 _REC_MAP_20_u2_u1_u2 347776. _CNV_A_R_LINEAR_____171_CM 0. 347776. DISPLAY_IDENTIFIER IP_FUP_SP_S FORMAT "%6.0"
 /begin AXIS_DESCR COM_AXIS n_32 _CNV_A_R_LINEAR_____10_CM 8 0. 8160. FORMAT "%4.0" AXIS_PTS_REF ldpm_n_1_fusl /end AXIS_DESCR
 /begin AXIS_DESCR COM_AXIS mff_sp_fup_ctl _CNV_A_R_LINEAR_____111_CM 10 0. 1389. FORMAT "%7.2" AXIS_PTS_REF ldpm_mff_sp_fup_ctl_1_fusl /end AXIS_DESCR
/end CHARACTERISTIC
/begin CHARACTERISTIC ip_fup_sp_pu "Fuel pressure setpoint for PU and PUC engine operation" MAP 0xa08149b4 _REC_MAP_20_u2_u1_u2 347776. _CNV_A_R_LINEAR_____171_CM 0. 347776. DISPLAY_IDENTIFIER IP_FUP_SP_PU FORMAT "%6.0"
 /begin AXIS_DESCR COM_AXIS n_32 _CNV_A_R_LINEAR_____10_CM 8 0. 8160. FORMAT "%4.0" AXIS_PTS_REF ldpm_n_1_fusl /end AXIS_DESCR
 /begin AXIS_DESCR COM_AXIS mff_sp_fup_ctl _CNV_A_R_LINEAR_____111_CM 10 0. 1389. FORMAT "%7.2" AXIS_PTS_REF ldpm_mff_sp_fup_ctl_1_fusl /end AXIS_DESCR
/end CHARACTERISTIC
/begin MEASUREMENT fup_sp[0] "Fuel pressure setpoint" UWORD _CNV_A_R_LINEAR_____171_CM 1 100. 0. 347776. DISPLAY_IDENTIFIER FUP_SP[0] ECU_ADDRESS 0xd000a3ec FORMAT "%6.0" /end MEASUREMENT
/begin MEASUREMENT fup_sp[1] "Fuel pressure setpoint" UWORD _CNV_A_R_LINEAR_____171_CM 1 100. 0. 347776. DISPLAY_IDENTIFIER FUP_SP[1] ECU_ADDRESS 0xd000a3ee FORMAT "%6.0" /end MEASUREMENT
/begin MEASUREMENT fup_sp_grd_act "Indicator for gradient limitation out of start active" UBYTE _CNV_A_R_LINEAR_____0_CM 1 100. 0. 15. DISPLAY_IDENTIFIER FUP_SP_GRD_ACT ECU_ADDRESS 0xd0000d10 FORMAT "%3.0" /end MEASUREMENT
/begin MEASUREMENT fup_h_sp_s[0] "Fuel pressure setpoint for stratified mode, high range" UWORD _CNV_A_R_LINEAR_____171_CM 1 100. 0. 347776. DISPLAY_IDENTIFIER FUP_H_SP_S[0] ECU_ADDRESS 0xd000a3f0 FORMAT "%6.0" /end MEASUREMENT
/begin MEASUREMENT fup_h_sp_s[1] "Fuel pressure setpoint for stratified mode, high range" UWORD _CNV_A_R_LINEAR_____171_CM 1 100. 0. 347776. DISPLAY_IDENTIFIER FUP_H_SP_S[1] ECU_ADDRESS 0xd000a3f2 FORMAT "%6.0" /end MEASUREMENT
/begin MEASUREMENT lv_fup_sp_add "Logical variable indicating that the additional fuel pressure setpoint in the puc phase is enable" UBYTE _CNV_S_2_RANGE__0___1_CM 1 100. 0. 1. DISPLAY_IDENTIFIER LV_FUP_SP_ADD ECU_ADDRESS 0xd000889c BIT_MASK 0x1 /end MEASUREMENT
/begin CHARACTERISTIC c_fup_sp_st_lgrd_dec "Gradient limitation for fuel pressure setpoint decrement out of start" VALUE 0xa080bd9e _REC_VAL_20_u2 347776. _CNV_A_R_LINEAR_____171_CM 0. 347776. DISPLAY_IDENTIFIER C_FUP_SP_ST_LGRD_DEC FORMAT "%6.0" /end CHARACTERISTIC
/begin CHARACTERISTIC c_t_fup_sp_add_1 "time of counter number 1 for additional fuel pressure setpoint in the PUC phase" VALUE 0xa080c1ce _REC_VAL_20_u2 655.35 _CNV_A_R_LINEAR_____3_CM 0. 655.35 DISPLAY_IDENTIFIER C_T_FUP_SP_ADD_1 FORMAT "%6.2" /end CHARACTERISTIC
/begin CHARACTERISTIC c_t_fup_sp_add_2 "time of counter number 2 for additional fuel pressure setpoint in the PUC phase" VALUE 0xa080c1d0 _REC_VAL_20_u2 655.35 _CNV_A_R_LINEAR_____3_CM 0. 655.35 DISPLAY_IDENTIFIER C_T_FUP_SP_ADD_2 FORMAT "%6.2" /end CHARACTERISTIC
/begin CHARACTERISTIC c_fup_sp_add "additional fuel pressure setpoint in the PUC phase" VALUE 0xa080bd8a _REC_VAL_20_s2 347776. _CNV_A_R_LINEAR_____525_CM -173890.6533608 173885.3466392 DISPLAY_IDENTIFIER C_FUP_SP_ADD FORMAT "%11.2" /end CHARACTERISTIC
/begin CHARACTERISTIC c_fup_sp_lim_inc "Gradient limitation for fuel pressure setpoint increment during normal operation" VALUE 0xa080bd96 _REC_VAL_20_u2 347776. _CNV_A_R_LINEAR_____171_CM 0. 347776. DISPLAY_IDENTIFIER C_FUP_SP_LIM_INC FORMAT "%6.0" /end CHARACTERISTIC
/begin CHARACTERISTIC c_fup_sp_lih_vcv_open "FUP setpoint for VCV open limphome" VALUE 0xa080bd92 _REC_VAL_20_u2 347776. _CNV_A_R_LINEAR_____171_CM 0. 347776. DISPLAY_IDENTIFIER C_FUP_SP_LIH_VCV_OPEN FORMAT "%6.0" /end CHARACTERISTIC
/begin CHARACTERISTIC ip_fup_sp_hom "Fuel pressure setpoint for homogenous engine operation" MAP 0xa0814874 _REC_MAP_20_u2_u1_u2 347776. _CNV_A_R_LINEAR_____171_CM 0. 347776. DISPLAY_IDENTIFIER IP_FUP_SP_HOM FORMAT "%6.0"
 /begin AXIS_DESCR COM_AXIS n_32 _CNV_A_R_LINEAR_____10_CM 8 0. 8160. FORMAT "%4.0" AXIS_PTS_REF ldpm_n_1_fusl /end AXIS_DESCR
 /begin AXIS_DESCR COM_AXIS mff_sp_fup_ctl _CNV_A_R_LINEAR_____111_CM 10 0. 1389. FORMAT "%7.2" AXIS_PTS_REF ldpm_mff_sp_fup_ctl_1_fusl /end AXIS_DESCR
/end CHARACTERISTIC
/begin MEASUREMENT fup_sp_tmp[0] "Fuel pressure setpoint (before limitation)" UWORD _CNV_A_R_LINEAR_____171_CM 1 100. 0. 347776. DISPLAY_IDENTIFIER FUP_SP_TMP[0] ECU_ADDRESS 0xd000a3f4 FORMAT "%6.0" /end MEASUREMENT
/begin MEASUREMENT fup_sp_tmp[1] "Fuel pressure setpoint (before limitation)" UWORD _CNV_A_R_LINEAR_____171_CM 1 100. 0. 347776. DISPLAY_IDENTIFIER FUP_SP_TMP[1] ECU_ADDRESS 0xd000a3f6 FORMAT "%6.0" /end MEASUREMENT
/begin MEASUREMENT fup_h_sp_s_mv "Fuel pressure mean value setpoint for stratified mode, high range" UWORD _CNV_A_R_LINEAR_____171_CM 1 100. 0. 347776. DISPLAY_IDENTIFIER FUP_H_SP_S_MV ECU_ADDRESS 0xd000a3f8 FORMAT "%6.0" /end MEASUREMENT
/begin MEASUREMENT fup_sp_st "Fuel pressure for start" UWORD _CNV_A_R_LINEAR_____171_CM 1 100. 0. 347776. DISPLAY_IDENTIFIER FUP_SP_ST ECU_ADDRESS 0xd0000d08 FORMAT "%6.0" /end MEASUREMENT
/begin CHARACTERISTIC c_fup_sp_crlc_2 "Correlation constant for the FUP_SP" VALUE 0xa080bd8c _REC_VAL_20_u1 0.99609375 _CNV_A_R_LINEAR_____28_CM 0. 0.99609375 DISPLAY_IDENTIFIER C_FUP_SP_CRLC_2 FORMAT "%5.3" /end CHARACTERISTIC
/begin AXIS_PTS ldp_fup_sp_dif_ip_fac_fup_sp_2 "" 0xa0808758 online_dummy _REC_AXS_20_u2 347776. _CNV_A_R_LINEAR_____183_CM 8 -173890.6533608 173885.3466392 FORMAT "%9.2" /end AXIS_PTS
/begin CHARACTERISTIC ip_fac_fup_sp "Factor for the fuel pressure setpoint temp change influence to the FUP_SP" CURVE 0xa080a348 _REC_CUR_20_u2_u2 0.9999847412109381 _CNV_A_R_LINEAR_____89_CM 0. 0.9999847412109381 DISPLAY_IDENTIFIER IP_FAC_FUP_SP FORMAT "%7.5"
 /begin AXIS_DESCR COM_AXIS online_dummy _CNV_A_R_LINEAR_____183_CM 8 -173890.6533608 173885.3466392 FORMAT "%9.2" AXIS_PTS_REF ldp_fup_sp_dif_ip_fac_fup_sp_2 /end AXIS_DESCR
/end CHARACTERISTIC
/begin CHARACTERISTIC ip_fup_sp_mplh_opp "Fuel pressure setpoint for double injection mode" MAP 0xa0814914 _REC_MAP_20_u2_u1_u2 347776. _CNV_A_R_LINEAR_____171_CM 0. 347776. DISPLAY_IDENTIFIER IP_FUP_SP_MPLH_OPP FORMAT "%6.0"
 /begin AXIS_DESCR COM_AXIS n_32 _CNV_A_R_LINEAR_____10_CM 8 0. 8160. FORMAT "%4.0" AXIS_PTS_REF ldpm_n_1_fusl /end AXIS_DESCR
 /begin AXIS_DESCR COM_AXIS mff_sp_fup_ctl _CNV_A_R_LINEAR_____111_CM 10 0. 1389. FORMAT "%7.2" AXIS_PTS_REF ldpm_mff_sp_fup_ctl_1_fusl /end AXIS_DESCR
/end CHARACTERISTIC
/begin AXIS_PTS ldpm_tco_st_1_fusl "" 0xa0809812 tco_st _REC_AXS_20_u1 190.5 _CNV_A_R_LINEAR_____17_CM 6 -48. 142.5 FORMAT "%7.2" /end AXIS_PTS
/begin AXIS_PTS ldp_fup_ip_fup_sp_st "" 0xa0808748 online_dummy _REC_AXS_20_u2 347776. _CNV_A_R_LINEAR_____171_CM 6 0. 347776. FORMAT "%6.0" /end AXIS_PTS
/begin CHARACTERISTIC ip_fup_sp_st "Fuel pressure setpoint for the start" MAP 0xa0814af4 _REC_MAP_20_u2_u1_u2 347776. _CNV_A_R_LINEAR_____171_CM 0. 347776. DISPLAY_IDENTIFIER IP_FUP_SP_ST FORMAT "%6.0"
 /begin AXIS_DESCR COM_AXIS tco_st _CNV_A_R_LINEAR_____17_CM 6 -48. 142.5 FORMAT "%7.2" AXIS_PTS_REF ldpm_tco_st_1_fusl /end AXIS_DESCR
 /begin AXIS_DESCR COM_AXIS online_dummy _CNV_A_R_LINEAR_____171_CM 6 0. 347776. FORMAT "%6.0" AXIS_PTS_REF ldp_fup_ip_fup_sp_st /end AXIS_DESCR
/end CHARACTERISTIC
/begin MEASUREMENT fuel_mass_req "Requested fuel mass from the pump" UWORD _CNV_A_R_LINEAR_____180_CM 1 100. 0. 1389. DISPLAY_IDENTIFIER FUEL_MASS_REQ ECU_ADDRESS 0xd000a3e4 FORMAT "%7.2" /end MEASUREMENT
/begin MEASUREMENT fuel_mass_ad "Adaptive fuel mass" SWORD _CNV_A_R_LINEAR_____531_CM 1 100. -694.5 694.478806 DISPLAY_IDENTIFIER FUEL_MASS_AD ECU_ADDRESS 0xd000a3dc FORMAT "%7.2" /end MEASUREMENT
/begin MEASUREMENT fuel_mass_ad_dif "Deviation of the fuel mass for the adaptation" SWORD _CNV_A_R_LINEAR_____531_CM 1 100. -694.5 694.478806 DISPLAY_IDENTIFIER FUEL_MASS_AD_DIF ECU_ADDRESS 0xd000a3de FORMAT "%7.2" /end MEASUREMENT
/begin MEASUREMENT fuel_mass_req_pctl "Requested fuel mass from the precontroller" SWORD _CNV_A_R_LINEAR_____531_CM 1 100. -694.5 694.478806 DISPLAY_IDENTIFIER FUEL_MASS_REQ_PCTL ECU_ADDRESS 0xd0000cbe FORMAT "%7.2" /end MEASUREMENT
/begin MEASUREMENT fac_clc_fuel_mass_fup "Factor for compressibility and density of gasoline and rail" UBYTE _CNV_A_R_LINEAR_____532_CM 1 100. 0. 510. DISPLAY_IDENTIFIER FAC_CLC_FUEL_MASS_FUP ECU_ADDRESS 0xd0008890 FORMAT "%3.0" /end MEASUREMENT
/begin MEASUREMENT fuel_mass_req_ctl "Controller output" SWORD _CNV_A_R_LINEAR_____531_CM 1 100. -694.5 694.478806 DISPLAY_IDENTIFIER FUEL_MASS_REQ_CTL ECU_ADDRESS 0xd0000cc0 FORMAT "%7.2" /end MEASUREMENT
/begin MEASUREMENT fup_dif_ctl "Deviation of measured fuel pressure and FUP_MDL or FUP_SP (depending on LC_USE_FUP_MDL_CTL)" SWORD _CNV_A_R_LINEAR_____525_CM 1 100. -173890.6533608 173885.3466392 DISPLAY_IDENTIFIER FUP_DIF_CTL ECU_ADDRESS 0xd0000cca FORMAT "%9.2" /end MEASUREMENT
/begin MEASUREMENT fuel_mass_req_p_ctl "P-part of the controller" SWORD _CNV_A_R_LINEAR_____531_CM 1 100. -694.5 694.478806 DISPLAY_IDENTIFIER FUEL_MASS_REQ_P_CTL ECU_ADDRESS 0xd0000cc2 FORMAT "%7.2" /end MEASUREMENT
/begin MEASUREMENT fuel_mass_req_i_ctl_mmv "Mean value of the I-part of the controller" SWORD _CNV_A_R_LINEAR_____531_CM 1 100. -694.5 694.478806 DISPLAY_IDENTIFIER FUEL_MASS_REQ_I_CTL_MMV ECU_ADDRESS 0xd0000cc4 FORMAT "%7.2" /end MEASUREMENT
/begin MEASUREMENT fup_dif_pctl[0] "Deviation of fuel pressure setpoint and FUP_MDL or FUP (depending on LC_USE_FUP_MDL_PCTL)" SWORD _CNV_A_R_LINEAR_____525_CM 1 100. -173890.6533608 173885.3466392 DISPLAY_IDENTIFIER FUP_DIF_PCTL[0] ECU_ADDRESS 0xd0000cc6 FORMAT "%9.2" /end MEASUREMENT
/begin MEASUREMENT fup_dif_pctl[1] "Deviation of fuel pressure setpoint and FUP_MDL or FUP (depending on LC_USE_FUP_MDL_PCTL)" SWORD _CNV_A_R_LINEAR_____525_CM 1 100. -173890.6533608 173885.3466392 DISPLAY_IDENTIFIER FUP_DIF_PCTL[1] ECU_ADDRESS 0xd0000cc8 FORMAT "%9.2" /end MEASUREMENT
/begin MEASUREMENT fuel_mass_req_pctl_tmp "Requested fuel mass from the precontroller (without the influence of the weighting factor)" SWORD _CNV_A_R_LINEAR_____531_CM 1 100. -694.5 694.478806 DISPLAY_IDENTIFIER FUEL_MASS_REQ_PCTL_TMP ECU_ADDRESS 0xd0000cbc FORMAT "%7.2" /end MEASUREMENT
/begin MEASUREMENT seg_ctr_fuel_mass_ad "Segment counter before adaptation is allowed" UWORD _CNV_A_R_LINEAR_____0_CM 1 100. 0. 65535. DISPLAY_IDENTIFIER SEG_CTR_FUEL_MASS_AD ECU_ADDRESS 0xd0000cce FORMAT "%5.0" /end MEASUREMENT
/begin CHARACTERISTIC ip_fuel_mass_req_p_ctl "P-part of the controller" CURVE 0xa080aca4 _REC_CUR_20_u2_u2 1388.978806 _CNV_A_R_LINEAR_____533_CM -694.5 694.478806 DISPLAY_IDENTIFIER IP_FUEL_MASS_REQ_P_CTL FORMAT "%7.2"
 /begin AXIS_DESCR COM_AXIS fup_dif_ctl _CNV_A_R_LINEAR_____183_CM 8 -173890.6533608 173885.3466392 FORMAT "%9.2" AXIS_PTS_REF ldpm_fup_dif_ctl_1_fusl /end AXIS_DESCR
/end CHARACTERISTIC
/begin CHARACTERISTIC ip_fuel_mass_req_i_ctl "I-part of the controller" CURVE 0xa080ac94 _REC_CUR_20_u2_u2 138.8978805541992 _CNV_A_R_LINEAR_____534_CM -69.45 69.4478805541992 DISPLAY_IDENTIFIER IP_FUEL_MASS_REQ_I_CTL FORMAT "%7.3"
 /begin AXIS_DESCR COM_AXIS fup_dif_ctl _CNV_A_R_LINEAR_____183_CM 8 -173890.6533608 173885.3466392 FORMAT "%9.2" AXIS_PTS_REF ldpm_fup_dif_ctl_1_fusl /end AXIS_DESCR
/end CHARACTERISTIC
/begin CHARACTERISTIC ip_fac_clc_fuel_mass_fup "Factor for compressibility and density of gasoline and rail" CURVE 0xa080a2a8 _REC_CUR_20_u1_u1 510. _CNV_A_R_LINEAR_____532_CM 0. 510. DISPLAY_IDENTIFIER IP_FAC_CLC_FUEL_MASS_FUP FORMAT "%3.0"
 /begin AXIS_DESCR COM_AXIS tfu _CNV_A_R_LINEAR_____17_CM 3 -48. 142.5 FORMAT "%6.2" AXIS_PTS_REF ldp_tfu_ip_fac_clc_fuel_mass /end AXIS_DESCR
/end CHARACTERISTIC
/begin AXIS_PTS ldp_fup_dif_pctl_ip_fac_fuel "" 0xa08086d8 online_dummy _REC_AXS_20_u2 347776. _CNV_A_R_LINEAR_____183_CM 8 -173890.6533608 173885.3466392 FORMAT "%9.2" /end AXIS_PTS
/begin AXIS_PTS ldpm_fup_dif_ctl_1_fusl "" 0xa0809404 fup_dif_ctl _REC_AXS_20_u2 347776. _CNV_A_R_LINEAR_____183_CM 8 -173890.6533608 173885.3466392 FORMAT "%9.2" /end AXIS_PTS
/begin AXIS_PTS ldp_tfu_ip_fac_clc_fuel_mass "" 0xa0808e74 tfu _REC_AXS_20_u1 190.5 _CNV_A_R_LINEAR_____17_CM 3 -48. 142.5 FORMAT "%6.2" /end AXIS_PTS
/begin CHARACTERISTIC c_fuel_mass_req_i_ctl_mmv_crlc "Filter constant for moving mean value calculation of the I-part" VALUE 0xa080bd4a _REC_VAL_20_u1 0.99609375 _CNV_A_R_LINEAR_____28_CM 0. 0.99609375 DISPLAY_IDENTIFIER C_FUEL_MASS_REQ_I_CTL_MMV_CRLC FORMAT "%5.3" /end CHARACTERISTIC
/begin CHARACTERISTIC lc_fuel_mass_req_ctl_clr "Switch for enabling CTL/AD part reset at fast pressure decrease" VALUE 0xa080c577 _REC_VAL_20_u1 1. _CNV_A_R_LINEAR_____0_CM 0. 1. DISPLAY_IDENTIFIER LC_FUEL_MASS_REQ_CTL_CLR FORMAT "%1.0" /end CHARACTERISTIC
/begin CHARACTERISTIC lc_use_fuel_mass_req_ctl "Switch for using the controller output for the fuel mass requested calculation" VALUE 0xa080c612 _REC_VAL_20_u1 1. _CNV_A_R_LINEAR_____0_CM 0. 1. DISPLAY_IDENTIFIER LC_USE_FUEL_MASS_REQ_CTL FORMAT "%1.0" /end CHARACTERISTIC
/begin CHARACTERISTIC c_n_fuel_mass_ad_min "Minimum engine speed threshold for allowing adaptive fuel mass" VALUE 0xa080bf31 _REC_VAL_20_u1 8160. _CNV_A_R_LINEAR_____10_CM 0. 8160. DISPLAY_IDENTIFIER C_N_FUEL_MASS_AD_MIN FORMAT "%4.0" /end CHARACTERISTIC
/begin CHARACTERISTIC c_n_fuel_mass_ad_max "Maximum engine speed threshold for allowing adaptive fuel mass" VALUE 0xa080bf30 _REC_VAL_20_u1 8160. _CNV_A_R_LINEAR_____10_CM 0. 8160. DISPLAY_IDENTIFIER C_N_FUEL_MASS_AD_MAX FORMAT "%4.0" /end CHARACTERISTIC
/begin CHARACTERISTIC c_fuel_mass_ad_max "Maximum adaptive fuel mass" VALUE 0xa080bd42 _REC_VAL_20_s2 1388.978806 _CNV_A_R_LINEAR_____531_CM -694.5 694.478806 DISPLAY_IDENTIFIER C_FUEL_MASS_AD_MAX FORMAT "%7.2" /end CHARACTERISTIC
/begin CHARACTERISTIC c_fuel_mass_ad_min "Minimum adaptive fuel mass" VALUE 0xa080bd44 _REC_VAL_20_s2 1388.978806 _CNV_A_R_LINEAR_____531_CM -694.5 694.478806 DISPLAY_IDENTIFIER C_FUEL_MASS_AD_MIN FORMAT "%7.2" /end CHARACTERISTIC
/begin CHARACTERISTIC lc_ad_clr_fuel_mass_ad "Switch for resetting the fuel adaptation" VALUE 0xa080c521 _REC_VAL_20_u1 1. _CNV_A_R_LINEAR_____0_CM 0. 1. DISPLAY_IDENTIFIER LC_AD_CLR_FUEL_MASS_AD FORMAT "%1.0" /end CHARACTERISTIC
/begin CHARACTERISTIC c_fuel_mass_req_i_ctl_max "Maximum I-part of the controller" VALUE 0xa080bd46 _REC_VAL_20_s2 1388.978806 _CNV_A_R_LINEAR_____531_CM -694.5 694.478806 DISPLAY_IDENTIFIER C_FUEL_MASS_REQ_I_CTL_MAX FORMAT "%7.2" /end CHARACTERISTIC
/begin CHARACTERISTIC c_fuel_mass_req_i_ctl_min "Minimum I-part of the controller" VALUE 0xa080bd48 _REC_VAL_20_s2 1388.978806 _CNV_A_R_LINEAR_____531_CM -694.5 694.478806 DISPLAY_IDENTIFIER C_FUEL_MASS_REQ_I_CTL_MIN FORMAT "%7.2" /end CHARACTERISTIC
/begin MEASUREMENT fac_fuel_mass_req_pctl "weighting factor for the precontroller" UWORD _CNV_A_R_LINEAR_____89_CM 1 100. 0. 0.9999847412109381 DISPLAY_IDENTIFIER FAC_FUEL_MASS_REQ_PCTL ECU_ADDRESS 0xd0000ccc FORMAT "%7.5" /end MEASUREMENT
/begin CHARACTERISTIC c_seg_ctr_fuel_mass_ad_max "Number of segments with stable conditions before an adaptation occurs" VALUE 0xa080c0b4 _REC_VAL_20_u2 65535. _CNV_A_R_LINEAR_____0_CM 0. 65535. DISPLAY_IDENTIFIER C_SEG_CTR_FUEL_MASS_AD_MAX FORMAT "%5.0" /end CHARACTERISTIC
/begin AXIS_PTS ldpm_n_32_fusl_1 "" 0xa080961c n_32 _REC_AXS_20_u1 8160. _CNV_A_R_LINEAR_____10_CM 8 0. 8160. FORMAT "%4.0" /end AXIS_PTS
/begin CHARACTERISTIC ip_fac_fuel_mass_req_ctl "Weighting factor for the controller" CURVE 0xa080a330 _REC_CUR_20_u1_u1 3.984375 _CNV_A_R_LINEAR_____266_CM 0. 3.984375 DISPLAY_IDENTIFIER IP_FAC_FUEL_MASS_REQ_CTL FORMAT "%8.6"
 /begin AXIS_DESCR COM_AXIS n_32 _CNV_A_R_LINEAR_____10_CM 8 0. 8160. FORMAT "%4.0" AXIS_PTS_REF ldpm_n_32_fusl_1 /end AXIS_DESCR
/end CHARACTERISTIC
/begin CHARACTERISTIC c_dly_fup_sp "Delay of the FUP_SP in calculation cycles" VALUE 0xa080bc4c _REC_VAL_20_u1 5. _CNV_A_R_LINEAR_____0_CM 1. 6. DISPLAY_IDENTIFIER C_DLY_FUP_SP FORMAT "%1.0" /end CHARACTERISTIC
/begin MEASUREMENT lv_fuel_add_act "Logical variable indicating that additional fuel mass is added to precontrol" UBYTE _CNV_S_2_RANGE__0___1_CM 1 100. 0. 1. DISPLAY_IDENTIFIER LV_FUEL_ADD_ACT ECU_ADDRESS 0xd0000cf0 BIT_MASK 0x1 /end MEASUREMENT
/begin CHARACTERISTIC c_pv_grd_thd_fuel_add "Pedal value gradient threshold for adding fuel mass" VALUE 0xa080c092 _REC_VAL_20_u1 2490.234 _CNV_A_R_LINEAR_____535_CM -1250. 1240.234 DISPLAY_IDENTIFIER C_PV_GRD_THD_FUEL_ADD FORMAT "%6.1" /end CHARACTERISTIC
/begin CHARACTERISTIC ip_fuel_mass_req_add "Additve fuel mass for the precontroller" CURVE 0xa080ac84 _REC_CUR_20_u2_u1 1389. _CNV_A_R_LINEAR_____180_CM 0. 1389. DISPLAY_IDENTIFIER IP_FUEL_MASS_REQ_ADD FORMAT "%7.2"
 /begin AXIS_DESCR COM_AXIS n_32 _CNV_A_R_LINEAR_____10_CM 8 0. 8160. FORMAT "%4.0" AXIS_PTS_REF ldp_n_32_ip_fuel_mass_req_add /end AXIS_DESCR
/end CHARACTERISTIC
/begin CHARACTERISTIC c_pv_thd_fuel_add "Pedal value threshold for adding fuel mass" VALUE 0xa080c094 _REC_VAL_20_u1 99.609375 _CNV_A_R_LINEAR_____5_CM 0. 99.609375 DISPLAY_IDENTIFIER C_PV_THD_FUEL_ADD FORMAT "%9.6" /end CHARACTERISTIC
/begin CHARACTERISTIC c_ctr_cyc_fuel_add "Number of segments where adding additional fuel mass to precontrol is active" VALUE 0xa080bb3e _REC_VAL_20_u2 65535. _CNV_A_R_LINEAR_____0_CM 0. 65535. DISPLAY_IDENTIFIER C_CTR_CYC_FUEL_ADD FORMAT "%5.0" /end CHARACTERISTIC
/begin MEASUREMENT fuel_mass_req_i_ctl_h_res "I-part of the controller" SLONG _CNV_A_R_LINEAR_____536_CM 1 100. -694.5 694.499999676598 DISPLAY_IDENTIFIER FUEL_MASS_REQ_I_CTL_H_RES ECU_ADDRESS 0xd000add8 FORMAT "%12.7" /end MEASUREMENT
/begin AXIS_PTS ldp_n_32_ip_fuel_mass_req_add "" 0xa0808a10 n_32 _REC_AXS_20_u1 8160. _CNV_A_R_LINEAR_____10_CM 8 0. 8160. FORMAT "%4.0" /end AXIS_PTS
/begin AXIS_PTS ldp_n_32_ip_fac_n_fuel_req_pctl "" 0xa08089f8 n_32 _REC_AXS_20_u1 8160. _CNV_A_R_LINEAR_____10_CM 8 0. 8160. FORMAT "%4.0" /end AXIS_PTS
/begin CHARACTERISTIC ip_fac_fuel_mass_req_pctl "Weighting factor for the precontroller" CURVE 0xa080a338 _REC_CUR_20_u2_u2 0.9999847412109381 _CNV_A_R_LINEAR_____89_CM 0. 0.9999847412109381 DISPLAY_IDENTIFIER IP_FAC_FUEL_MASS_REQ_PCTL FORMAT "%7.5"
 /begin AXIS_DESCR COM_AXIS online_dummy _CNV_A_R_LINEAR_____183_CM 8 -173890.6533608 173885.3466392 FORMAT "%9.2" AXIS_PTS_REF ldp_fup_dif_pctl_ip_fac_fuel /end AXIS_DESCR
/end CHARACTERISTIC
/begin CHARACTERISTIC ip_fac_n_mass_fuel_req_pctl "factor for the precontroller depending on engine speed" CURVE 0xa080a3ac _REC_CUR_20_u1_u1 9.960000000000001 _CNV_A_R_LINEAR_____537_CM 0. 9.960000000000001 DISPLAY_IDENTIFIER IP_FAC_N_MASS_FUEL_REQ_PCTL FORMAT "%4.3"
 /begin AXIS_DESCR COM_AXIS n_32 _CNV_A_R_LINEAR_____10_CM 8 0. 8160. FORMAT "%4.0" AXIS_PTS_REF ldp_n_32_ip_fac_n_fuel_req_pctl /end AXIS_DESCR
/end CHARACTERISTIC
/begin CHARACTERISTIC c_clc_fuel_pump_ctl "Amount of segments of calculation recurrency of high pressure pump control" VALUE 0xa080baac _REC_VAL_20_u2 1.99996948242188 _CNV_A_R_LINEAR_____9_CM 0. 1.99996948242188 DISPLAY_IDENTIFIER C_CLC_FUEL_PUMP_CTL FORMAT "%7.5" /end CHARACTERISTIC
/begin MEASUREMENT fup_dif[0] "Deviation of fuel pressure setpoint and measured fuel pressure" SWORD _CNV_A_R_LINEAR_____525_CM 1 100. -173890.6533608 173885.3466392 DISPLAY_IDENTIFIER FUP_DIF[0] ECU_ADDRESS 0xd000a3e0 FORMAT "%9.2" /end MEASUREMENT
/begin MEASUREMENT fup_dif[1] "Deviation of fuel pressure setpoint and measured fuel pressure" SWORD _CNV_A_R_LINEAR_____525_CM 1 100. -173890.6533608 173885.3466392 DISPLAY_IDENTIFIER FUP_DIF[1] ECU_ADDRESS 0xd000a3e2 FORMAT "%9.2" /end MEASUREMENT
/begin MEASUREMENT fup_dif_mmv "Deviation of fuel pressure setpoint and measured fuel pressure moving mean value" SWORD _CNV_A_R_LINEAR_____525_CM 1 100. -173890.6533608 173885.3466392 DISPLAY_IDENTIFIER FUP_DIF_MMV ECU_ADDRESS 0xd000a3e6 FORMAT "%9.2" /end MEASUREMENT
/begin CHARACTERISTIC c_fuel_mass_ad_cor_crlc "Filter constant for the fuel mass adaptation" VALUE 0xa080bd40 _REC_VAL_20_u1 0.99609375 _CNV_A_R_LINEAR_____28_CM 0. 0.99609375 DISPLAY_IDENTIFIER C_FUEL_MASS_AD_COR_CRLC FORMAT "%5.3" /end CHARACTERISTIC
/begin CHARACTERISTIC c_crlc_fup_dif_mmv "Filter constant for the fuel pressure difference" VALUE 0xa080baec _REC_VAL_20_u1 0.99609375 _CNV_A_R_LINEAR_____28_CM 0. 0.99609375 DISPLAY_IDENTIFIER C_CRLC_FUP_DIF_MMV FORMAT "%5.3" /end CHARACTERISTIC
/begin MEASUREMENT cur_cns_cwp "current consumption cooling water pump" UBYTE _CNV_A_R_LINEAR_____542_CM 1 100. 0. 127.5 DISPLAY_IDENTIFIER CUR_CNS_CWP ECU_ADDRESS 0xd0008721 FORMAT "%4.1" /end MEASUREMENT
/begin MEASUREMENT lv_cwp_block_deac "cooling water pump blocking not activ" UBYTE _CNV_S_2_RANGE__0___1_CM 1 100. 0. 1. DISPLAY_IDENTIFIER LV_CWP_BLOCK_DEAC ECU_ADDRESS 0xd0008729 BIT_MASK 0x1 /end MEASUREMENT
/begin MEASUREMENT lv_cwp_temp_high "" UBYTE _CNV_S_2_RANGE__0___1_CM 1 100. 0. 1. DISPLAY_IDENTIFIER LV_CWP_TEMP_HIGH ECU_ADDRESS 0xd0008725 BIT_MASK 0x1 /end MEASUREMENT
/begin MEASUREMENT lv_cwp_vcc_plaus "" UBYTE _CNV_S_2_RANGE__0___1_CM 1 100. 0. 1. DISPLAY_IDENTIFIER LV_CWP_VCC_PLAUS ECU_ADDRESS 0xd0008728 BIT_MASK 0x1 /end MEASUREMENT
/begin MEASUREMENT lv_n_mon_cwp_deac "rpm monitoring cooling water pump deactivated" UBYTE _CNV_S_2_RANGE__0___1_CM 1 100. 0. 1. DISPLAY_IDENTIFIER LV_N_MON_CWP_DEAC ECU_ADDRESS 0xd0008724 BIT_MASK 0x1 /end MEASUREMENT
/begin MEASUREMENT v_cwp "voltage EWP" UBYTE _CNV_A_R_LINEAR_____425_CM 1 100. 0. 25.5 DISPLAY_IDENTIFIER V_CWP ECU_ADDRESS 0xd000871f FORMAT "%4.1" /end MEASUREMENT
/begin MEASUREMENT temp_el_cwp "electronic temperature coolant water pump" UBYTE _CNV_A_R_ENSD_LINEA_399_CM 1 100. -50. 205. DISPLAY_IDENTIFIER TEMP_EL_CWP ECU_ADDRESS 0xd0008720 FORMAT "%5.0" /end MEASUREMENT
/begin MEASUREMENT n_rel_cwp "actual water pump speed" UBYTE _CNV_A_R_LINEAR_____0_CM 1 100. 0. 255. DISPLAY_IDENTIFIER N_REL_CWP ECU_ADDRESS 0xd000871e FORMAT "%3.0" /end MEASUREMENT
/begin MEASUREMENT lv_cwp_pre_lock "" UBYTE _CNV_S_2_RANGE__0___1_CM 1 100. 0. 1. DISPLAY_IDENTIFIER LV_CWP_PRE_LOCK ECU_ADDRESS 0xd0008727 BIT_MASK 0x1 /end MEASUREMENT
/begin MEASUREMENT lv_cwp_lock "CWP blocked / Current consumption too high" UBYTE _CNV_S_2_RANGE__0___1_CM 1 100. 0. 1. DISPLAY_IDENTIFIER LV_CWP_LOCK ECU_ADDRESS 0xd0008726 BIT_MASK 0x1 /end MEASUREMENT
/begin MEASUREMENT lf_pow_cwp_cod "Register 5 Bit 0...4 / CWP power  HW version (200W or 350/400W)" UBYTE _CNV_A_R_LINEAR_____0_CM 1 100. 0. 255. DISPLAY_IDENTIFIER LF_POW_CWP_COD ECU_ADDRESS 0xd0008722 FORMAT "%3.0" /end MEASUREMENT
/begin MEASUREMENT lf_cwp_info_cod "Register 5 Bit 5...7 <<5 / Supplier information (Pierburg / SiemensVDO)" UBYTE _CNV_A_R_LINEAR_____0_CM 1 100. 0. 255. DISPLAY_IDENTIFIER LF_CWP_INFO_COD ECU_ADDRESS 0xd0008723 FORMAT "%3.0" /end MEASUREMENT
/begin MEASUREMENT lv_cwp_hw_lih_in_chk "Register 6 Bit 2 / Supply voltage to CWP (HW PIN) connected correctly - LIH stategy in case of BSD com. error" UBYTE _CNV_S_2_RANGE__0___1_CM 1 100. 0. 1. DISPLAY_IDENTIFIER LV_CWP_HW_LIH_IN_CHK ECU_ADDRESS 0xd000872b BIT_MASK 0x1 /end MEASUREMENT
/begin CHARACTERISTIC lc_rly_main_man_req "Activation of manual switching of main relay" VALUE 0xa080c5de _REC_VAL_20_u1 1. _CNV_A_R_LINEAR_____0_CM 0. 1. DISPLAY_IDENTIFIER LC_RLY_MAIN_MAN_REQ FORMAT "%1.0" /end CHARACTERISTIC
/begin CHARACTERISTIC lc_rly_main_man_adj "Switching main relay" VALUE 0xa080c5dd _REC_VAL_20_u1 1. _CNV_A_R_LINEAR_____0_CM 0. 1. DISPLAY_IDENTIFIER LC_RLY_MAIN_MAN_ADJ FORMAT "%1.0" /end CHARACTERISTIC
/begin MEASUREMENT lv_rly_main "Main relay control command state" UBYTE _CNV_S_2_RANGE__0___1_CM 1 100. 0. 1. DISPLAY_IDENTIFIER LV_RLY_MAIN ECU_ADDRESS 0xd0008d0c BIT_MASK 0x1 /end MEASUREMENT
/begin MEASUREMENT lv_rly_main_sys "System depending main relay control command state" UBYTE _CNV_S_2_RANGE__0___1_CM 1 100. 0. 1. DISPLAY_IDENTIFIER LV_RLY_MAIN_SYS ECU_ADDRESS 0xd0001610 BIT_MASK 0x1 /end MEASUREMENT
/begin CHARACTERISTIC c_t_ast_min_rly_crcv_heat "Minimal time after start for CRCV_HEAT activation (default: 60s)" VALUE 0xa080c136 _REC_VAL_20_u2 6553.5 _CNV_A_R_LINEAR_____4_CM 0. 6553.5 DISPLAY_IDENTIFIER C_T_AST_MIN_RLY_CRCV_HEAT FORMAT "%6.1" /end CHARACTERISTIC
/begin CHARACTERISTIC c_tia_max_rly_crcv_heat "Maximal intake air temperature for CRCV_HEAT activation (default: 0°C)" VALUE 0xa080c32a _REC_VAL_20_u1 190.5 _CNV_A_R_LINEAR_____17_CM -48. 142.5 DISPLAY_IDENTIFIER C_TIA_MAX_RLY_CRCV_HEAT FORMAT "%6.2" /end CHARACTERISTIC
/begin CHARACTERISTIC c_tia_hys_rly_crcv_heat "Intake air temperature hysteresis between activation and deactivation of CRCV_HEAT (default: 3°C)" VALUE 0xa080c328 _REC_VAL_20_u1 190.5 _CNV_A_R_LINEAR_____17_CM -48. 142.5 DISPLAY_IDENTIFIER C_TIA_HYS_RLY_CRCV_HEAT FORMAT "%6.2" /end CHARACTERISTIC
/begin MEASUREMENT lv_rly_crcv_heat "Crankcase ventilation heater relay (1: activated, 0: deactivated)" UBYTE _CNV_S_2_RANGE__0___1_CM 1 100. 0. 1. DISPLAY_IDENTIFIER LV_RLY_CRCV_HEAT ECU_ADDRESS 0xd0008d20 BIT_MASK 0x1 /end MEASUREMENT
/begin MEASUREMENT lv_fup_req_fpa_stop_req "Logical variable for request of 'freezing' the  I-part of the pressure controller" UBYTE _CNV_S_2_RANGE__0___1_CM 1 100. 0. 1. DISPLAY_IDENTIFIER LV_FUP_REQ_FPA_STOP_REQ ECU_ADDRESS 0xd00088cc BIT_MASK 0x1 /end MEASUREMENT
/begin MEASUREMENT lv_fup_req_fpa_rst_req "Logical variable for reseting P and I-part of the pressure controller" UBYTE _CNV_S_2_RANGE__0___1_CM 1 100. 0. 1. DISPLAY_IDENTIFIER LV_FUP_REQ_FPA_RST_REQ ECU_ADDRESS 0xd00088cd BIT_MASK 0x1 /end MEASUREMENT
/begin MEASUREMENT state_pwm_vcv "State diagram for the VCV control" UBYTE _CNV_S_6_RANGE_STAT_922_CM 1 100. 0. 5. DISPLAY_IDENTIFIER STATE_PWM_VCV ECU_ADDRESS 0xd00088c9 /end MEASUREMENT
/begin MEASUREMENT lv_fup_lih_req "Limp home mode for HPP requested" UBYTE _CNV_S_2_RANGE__0___1_CM 1 100. 0. 1. DISPLAY_IDENTIFIER LV_FUP_LIH_REQ ECU_ADDRESS 0xd00088cb BIT_MASK 0x1 /end MEASUREMENT
/begin MEASUREMENT lv_fuel_mass_ctl_stop_req "Logical variable for requesting 'freezing'the I-part of the controller" UBYTE _CNV_S_2_RANGE__0___1_CM 1 100. 0. 1. DISPLAY_IDENTIFIER LV_FUEL_MASS_CTL_STOP_REQ ECU_ADDRESS 0xd00088cf BIT_MASK 0x1 /end MEASUREMENT
/begin MEASUREMENT lv_fuel_mass_ctl_rst_req "Logical variable for reseting P and I-part of the controller" UBYTE _CNV_S_2_RANGE__0___1_CM 1 100. 0. 1. DISPLAY_IDENTIFIER LV_FUEL_MASS_CTL_RST_REQ ECU_ADDRESS 0xd00088ce BIT_MASK 0x1 /end MEASUREMENT
/begin MEASUREMENT fpapwm "Global fuel pressure regulation" UWORD _CNV_A_R_LINEAR_____8_CM 1 100. 0. 99.99847412109381 DISPLAY_IDENTIFIER FPAPWM ECU_ADDRESS 0xd000a424 /end MEASUREMENT
/begin MEASUREMENT vff_vcv "Requested volume fuel flow through the VCV" UWORD _CNV_A_R_LINEAR_____176_CM 1 100. 0. 255. DISPLAY_IDENTIFIER VFF_VCV ECU_ADDRESS 0xd000a426 FORMAT "%7.3" /end MEASUREMENT
/begin MEASUREMENT vff_vcv_min "Adapted minimum volume fuel flow through the VCV" UWORD _CNV_A_R_LINEAR_____176_CM 1 100. 0. 255. DISPLAY_IDENTIFIER VFF_VCV_MIN ECU_ADDRESS 0xd000a428 FORMAT "%7.3" /end MEASUREMENT
/begin MEASUREMENT state_fpa "State diagram for the regulator control" UBYTE _CNV_S_6_RANGE_STAT_923_CM 1 100. 0. 5. DISPLAY_IDENTIFIER STATE_FPA ECU_ADDRESS 0xd00088c8 /end MEASUREMENT
/begin MEASUREMENT state_vff_vcv_min "Minimum VCV adaptation state" UBYTE _CNV_S_5_RANGE_STAT_924_CM 1 100. 0. 4. DISPLAY_IDENTIFIER STATE_VFF_VCV_MIN ECU_ADDRESS 0xd00088ca /end MEASUREMENT
/begin MEASUREMENT lv_fup_lih_l_prs_ctl_req "Logical variable requesting fuel low pressure control limphome" UBYTE _CNV_S_2_RANGE__0___1_CM 1 100. 0. 1. DISPLAY_IDENTIFIER LV_FUP_LIH_L_PRS_CTL_REQ ECU_ADDRESS 0xd00088d0 BIT_MASK 0x1 /end MEASUREMENT
/begin MEASUREMENT lv_fup_lih_hom_vcv_open_req "Logical variable requesting limphome for VCV open" UBYTE _CNV_S_2_RANGE__0___1_CM 1 100. 0. 1. DISPLAY_IDENTIFIER LV_FUP_LIH_HOM_VCV_OPEN_REQ ECU_ADDRESS 0xd00088d1 BIT_MASK 0x1 /end MEASUREMENT
/begin MEASUREMENT lv_fup_lih_hom_req "Logical variable indicating LIH mode for HPP requested" UBYTE _CNV_S_2_RANGE__0___1_CM 1 100. 0. 1. DISPLAY_IDENTIFIER LV_FUP_LIH_HOM_REQ ECU_ADDRESS 0xd00088d2 BIT_MASK 0x1 /end MEASUREMENT
/begin CHARACTERISTIC c_fup_lih_vcv_open "fuel pressure threshold for switching to VCV open limphome mode" VALUE 0xa080bd7a _REC_VAL_20_u2 347776. _CNV_A_R_LINEAR_____171_CM 0. 347776. DISPLAY_IDENTIFIER C_FUP_LIH_VCV_OPEN FORMAT "%6.0" /end CHARACTERISTIC
/begin CHARACTERISTIC c_t_fup_lih_hom_vcv_open_req "Timer for activation of the VCV open limphome" VALUE 0xa080c1ca _REC_VAL_20_u2 655.35 _CNV_A_R_LINEAR_____3_CM 0. 655.35 DISPLAY_IDENTIFIER C_T_FUP_LIH_HOM_VCV_OPEN_REQ FORMAT "%6.2" /end CHARACTERISTIC
/begin CHARACTERISTIC c_t_err_sym_h_prs_sys_2 "Timer for activation of the low pressure control limphome because of fuel pressure BOL error" VALUE 0xa080c1b0 _REC_VAL_20_u2 655.35 _CNV_A_R_LINEAR_____3_CM 0. 655.35 DISPLAY_IDENTIFIER C_T_ERR_SYM_H_PRS_SYS_2 FORMAT "%6.2" /end CHARACTERISTIC
/begin CHARACTERISTIC c_t_fup_lih_l_prs_ctl_req "timer for freeze the controller in FUP_LIH_L_PRS_CTL" VALUE 0xa080c1cc _REC_VAL_20_u2 655.35 _CNV_A_R_LINEAR_____3_CM 0. 655.35 DISPLAY_IDENTIFIER C_T_FUP_LIH_L_PRS_CTL_REQ FORMAT "%6.2" /end CHARACTERISTIC
/begin CHARACTERISTIC lc_t_fup_lih_l_prs_ctl_req "Switch for enabling of the timer for freeze the controller in FUP_LIH_L_PRS_CTL" VALUE 0xa080c5f9 _REC_VAL_20_u1 1. _CNV_A_R_LINEAR_____0_CM 0. 1. DISPLAY_IDENTIFIER LC_T_FUP_LIH_L_PRS_CTL_REQ FORMAT "%1.0" /end CHARACTERISTIC
/begin CHARACTERISTIC lc_rly_hpdi_man_req "Activation of manual switching of HPDI relay" VALUE 0xa080c5dc _REC_VAL_20_u1 1. _CNV_A_R_LINEAR_____0_CM 0. 1. DISPLAY_IDENTIFIER LC_RLY_HPDI_MAN_REQ FORMAT "%1.0" /end CHARACTERISTIC
/begin CHARACTERISTIC lc_rly_hpdi_man_adj "Switching HPDI relay" VALUE 0xa080c5db _REC_VAL_20_u1 1. _CNV_A_R_LINEAR_____0_CM 0. 1. DISPLAY_IDENTIFIER LC_RLY_HPDI_MAN_ADJ FORMAT "%1.0" /end CHARACTERISTIC
/begin MEASUREMENT lv_rly_hpdi "HPDI relay control command state" UBYTE _CNV_S_2_RANGE__0___1_CM 1 100. 0. 1. DISPLAY_IDENTIFIER LV_RLY_HPDI ECU_ADDRESS 0xd0008d10 BIT_MASK 0x1 /end MEASUREMENT
/begin MEASUREMENT lv_rly_hpdi_sys "System depending HPDI relay control command state" UBYTE _CNV_S_2_RANGE__0___1_CM 1 100. 0. 1. DISPLAY_IDENTIFIER LV_RLY_HPDI_SYS ECU_ADDRESS 0xd000160c BIT_MASK 0x1 /end MEASUREMENT
/begin MEASUREMENT ecraspwm "pwm for electrical radiator shutter" UBYTE _CNV_A_R_LINEAR_____5_CM 1 100. 0. 99.609375 DISPLAY_IDENTIFIER ECRASPWM ECU_ADDRESS 0xd0008d24 FORMAT "%9.6" /end MEASUREMENT
/begin MEASUREMENT state_ecras_sys "State of ECRAS system" UWORD _CNV_A_R_LINEAR_____0_CM 1 100. 0. 65535. DISPLAY_IDENTIFIER STATE_ECRAS_SYS ECU_ADDRESS 0xd000a908 FORMAT "%5.0" /end MEASUREMENT
/begin MEASUREMENT lv_ecras_up_1 "Bit used to determine ECRASPWM (input for ID)" UBYTE _CNV_S_2_RANGE______76_CM 1 100. 0. 1. DISPLAY_IDENTIFIER LV_ECRAS_UP_1 ECU_ADDRESS 0xd0008d25 BIT_MASK 0x1 /end MEASUREMENT
/begin MEASUREMENT lv_ecras_down_1 "Bit used to determine ECRASPWM (input for ID)d" UBYTE _CNV_S_2_RANGE______76_CM 1 100. 0. 1. DISPLAY_IDENTIFIER LV_ECRAS_DOWN_1 ECU_ADDRESS 0xd0008d26 BIT_MASK 0x1 /end MEASUREMENT
/begin MEASUREMENT lv_ecras_eol "Bit for determining ECRASPWM during ECRAS system test (EOL)" UBYTE _CNV_S_2_RANGE______76_CM 1 100. 0. 1. DISPLAY_IDENTIFIER LV_ECRAS_EOL ECU_ADDRESS 0xd0000afb BIT_MASK 0x1 /end MEASUREMENT
/begin MEASUREMENT lv_ecras_eol_end "Bit indicating finished ECRAS system test (EOL)" UBYTE _CNV_S_2_RANGE______76_CM 1 100. 0. 1. DISPLAY_IDENTIFIER LV_ECRAS_EOL_END ECU_ADDRESS 0xd0000afc BIT_MASK 0x1 /end MEASUREMENT
/begin MEASUREMENT lv_ecras_eol_inh "Bit indicating inhibition of ECRAS EOL (if =1 EOL stopped)" UBYTE _CNV_S_2_RANGE______76_CM 1 100. 0. 1. DISPLAY_IDENTIFIER LV_ECRAS_EOL_INH ECU_ADDRESS 0xd0008d27 BIT_MASK 0x1 /end MEASUREMENT
/begin MEASUREMENT lv_err_ecras_eol "Bit indicating ECRAS error during EOL ECRAS system test" UBYTE _CNV_S_2_RANGE______76_CM 1 100. 0. 1. DISPLAY_IDENTIFIER LV_ERR_ECRAS_EOL ECU_ADDRESS 0xd0008d28 BIT_MASK 0x1 /end MEASUREMENT
/begin MEASUREMENT t_ecras_up_det "Timer indicating time until learning stopped (if no variant recognised)" UBYTE _CNV_A_R_LINEAR_____4_CM 1 100. 0. 25.5 DISPLAY_IDENTIFIER T_ECRAS_UP_DET ECU_ADDRESS 0xd0000af8 FORMAT "%4.1" /end MEASUREMENT
/begin MEASUREMENT t_wait_ecras_eol "Timer for switch ECRAS control output" UBYTE _CNV_A_R_LINEAR_____4_CM 1 100. 0. 25.5 DISPLAY_IDENTIFIER T_WAIT_ECRAS_EOL ECU_ADDRESS 0xd0000afa FORMAT "%4.1" /end MEASUREMENT
/begin MEASUREMENT ctr_ecras_eol "Counter for stopping ECRAS system test (EOL)" UBYTE _CNV_A_R_LINEAR_____0_CM 1 100. 0. 255. DISPLAY_IDENTIFIER CTR_ECRAS_EOL ECU_ADDRESS 0xd0000af9 FORMAT "%3.0" /end MEASUREMENT
/begin CHARACTERISTIC c_ecraspwm_10 "ECRASPWM for diagnosis mode of ECRAS control unit(10% PWM)" VALUE 0xa080bc54 _REC_VAL_20_u1 99.609375 _CNV_A_R_LINEAR_____5_CM 0. 99.609375 DISPLAY_IDENTIFIER C_ECRASPWM_10 FORMAT "%4.1" /end CHARACTERISTIC
/begin CHARACTERISTIC c_ecraspwm_90 "ECRASPWM for learning of ECRAS DOWN (90% PWM)" VALUE 0xa080bc55 _REC_VAL_20_u1 99.609375 _CNV_A_R_LINEAR_____5_CM 0. 99.609375 DISPLAY_IDENTIFIER C_ECRASPWM_90 FORMAT "%4.1" /end CHARACTERISTIC
/begin CHARACTERISTIC c_ecraspwm_man "Manually given ECRASPWM" VALUE 0xa080bc5a _REC_VAL_20_u1 99.609375 _CNV_A_R_LINEAR_____5_CM 0. 99.609375 DISPLAY_IDENTIFIER C_ECRASPWM_MAN FORMAT "%4.1" /end CHARACTERISTIC
/begin CHARACTERISTIC c_ecraspwm_diag "PWM for radiator shutter for diagnosis readyness" VALUE 0xa080bc56 _REC_VAL_20_u1 99.609375 _CNV_A_R_LINEAR_____5_CM 0. 99.609375 DISPLAY_IDENTIFIER C_ECRASPWM_DIAG FORMAT "%4.1" /end CHARACTERISTIC
/begin CHARACTERISTIC lc_ecraspwm_man "Switch for manual setting of ECRASPWM" VALUE 0xa080c54e _REC_VAL_20_u1 1. _CNV_S_2_RANGE__0___1_CM 0. 1. DISPLAY_IDENTIFIER LC_ECRASPWM_MAN /end CHARACTERISTIC
/begin CHARACTERISTIC c_ctr_ecras_eol "Counter threshold for stopping ECRAS system test(EOL)" VALUE 0xa080bb87 _REC_VAL_20_u1 255. _CNV_A_R_LINEAR_____0_CM 0. 255. DISPLAY_IDENTIFIER C_CTR_ECRAS_EOL FORMAT "%3.0" /end CHARACTERISTIC
/begin CHARACTERISTIC c_t_ecras_up_det "time threshold for learning ECRAS_UP" VALUE 0xa080c19a _REC_VAL_20_u1 25.5 _CNV_A_R_LINEAR_____4_CM 0. 25.5 DISPLAY_IDENTIFIER C_T_ECRAS_UP_DET FORMAT "%4.1" /end CHARACTERISTIC
/begin CHARACTERISTIC c_t_wait_ecras_eol "Timer threshold for switch ECRAS control output" VALUE 0xa080c2a5 _REC_VAL_20_u1 25.5 _CNV_A_R_LINEAR_____4_CM 0. 25.5 DISPLAY_IDENTIFIER C_T_WAIT_ECRAS_EOL FORMAT "%4.1" /end CHARACTERISTIC
/begin CHARACTERISTIC id_ecraspwm "Map for determining ECRASPWM" MAP 0xa0809952 _REC_MAP_20_u1_u1_u1 99.609375 _CNV_A_R_LINEAR_____5_CM 0. 99.609375 DISPLAY_IDENTIFIER ID_ECRASPWM FORMAT "%4.1"
 /begin AXIS_DESCR COM_AXIS lv_ecras_up_1 _CNV_A_R_LINEAR_____0_CM 2 0. 1. FORMAT "%1.0" AXIS_PTS_REF ldp_lv_ecras_up_1 /end AXIS_DESCR
 /begin AXIS_DESCR COM_AXIS lv_ecras_down_1 _CNV_A_R_LINEAR_____0_CM 2 0. 1. FORMAT "%1.0" AXIS_PTS_REF ldp_lv_ecras_down_1 /end AXIS_DESCR
/end CHARACTERISTIC
/begin AXIS_PTS ldp_lv_ecras_up_1 "" 0xa080881a lv_ecras_up_1 _REC_AXS_20_u1 1. _CNV_A_R_LINEAR_____0_CM 2 0. 1. FORMAT "%1.0" /end AXIS_PTS
/begin AXIS_PTS ldp_lv_ecras_down_1 "" 0xa0808816 lv_ecras_down_1 _REC_AXS_20_u1 1. _CNV_A_R_LINEAR_____0_CM 2 0. 1. FORMAT "%1.0" /end AXIS_PTS
/begin COMPU_METHOD _CNV_A_R_LINEAR_____0_CM "" RAT_FUNC "%6.3" "-" COEFFS 0 1. 0. 0 0 1 /end COMPU_METHOD
/begin COMPU_METHOD _CNV_S_2_RANGE__0___1_CM "" TAB_VERB "%6.3" "-" COMPU_TAB_REF _CNV_S_2_RANGE__0___1 /end COMPU_METHOD
/begin COMPU_VTAB _CNV_S_2_RANGE__0___1 "" TAB_VERB 2 0 "0" 1 "1" /end COMPU_VTAB
/begin COMPU_METHOD _CNV_A_R_LINEAR_____2_CM "" RAT_FUNC "%6.3" "V" COEFFS 0 204.8 0. 0 0 1 /end COMPU_METHOD
/begin COMPU_METHOD _CNV_A_R_LINEAR_____3_CM "" RAT_FUNC "%6.3" "s" COEFFS 0 100. 0. 0 0 1 /end COMPU_METHOD
/begin COMPU_METHOD _CNV_A_R_LINEAR_____4_CM "" RAT_FUNC "%6.3" "s" COEFFS 0 10. 0. 0 0 1 /end COMPU_METHOD
/begin COMPU_METHOD _CNV_A_R_LINEAR_____5_CM "" RAT_FUNC "%6.3" "%" COEFFS 0 2.56 0. 0 0 1 /end COMPU_METHOD
/begin COMPU_METHOD _CNV_A_R_LINEAR_____6_CM "" RAT_FUNC "%6.3" "km/h" COEFFS 0 1. 0. 0 0 1 /end COMPU_METHOD
/begin COMPU_METHOD _CNV_A_R_LINEAR_____8_CM "" RAT_FUNC "%6.3" "%" COEFFS 0 655.3599999999997 0. 0 0 1 /end COMPU_METHOD
/begin COMPU_METHOD _CNV_A_R_LINEAR_____9_CM "" RAT_FUNC "%6.3" "-" COEFFS 0 32767.99999999992 0. 0 0 1 /end COMPU_METHOD
/begin COMPU_METHOD _CNV_A_R_LINEAR_____10_CM "" RAT_FUNC "%6.3" "rpm" COEFFS 0 3.125e-002 0. 0 0 1 /end COMPU_METHOD
/begin COMPU_METHOD _CNV_A_R_LINEAR_____11_CM "" RAT_FUNC "%6.3" "-" COEFFS 0 16383.99999935999 -1.280019205296412e-006 0 0 1 /end COMPU_METHOD
/begin COMPU_METHOD _CNV_A_R_LINEAR_____14_CM "" RAT_FUNC "%6.3" "rpm" COEFFS 0 1. 0. 0 0 1 /end COMPU_METHOD
/begin COMPU_METHOD _CNV_A_R_LINEAR_____17_CM "" RAT_FUNC "%6.3" "°C" COEFFS 0 1.333333333333333 64. 0 0 1 /end COMPU_METHOD
/begin COMPU_METHOD _CNV_A_R_LINEAR_____24_CM "" RAT_FUNC "%6.3" "-" COEFFS 0 16384. 0. 0 0 1 /end COMPU_METHOD
/begin COMPU_METHOD _CNV_A_R_LINEAR_____25_CM "" RAT_FUNC "%6.3" "°C" COEFFS 0 1.333333333333333 0. 0 0 1 /end COMPU_METHOD
/begin COMPU_METHOD _CNV_A_R_LINEAR_____26_CM "" RAT_FUNC "%6.3" "°C" COEFFS 0 1. 40. 0 0 1 /end COMPU_METHOD
/begin COMPU_METHOD _CNV_A_R_LINEAR_____28_CM "" RAT_FUNC "%6.3" "-" COEFFS 0 256. 0. 0 0 1 /end COMPU_METHOD
/begin COMPU_METHOD _CNV_A_R_LINEAR_____30_CM "" RAT_FUNC "%6.3" "rpm/s" COEFFS 0 3.125e-002 0. 0 0 1 /end COMPU_METHOD
/begin COMPU_METHOD _CNV_A_R_LINEAR_____31_CM "" RAT_FUNC "%6.3" "Nm" COEFFS 0 32. 0. 0 0 1 /end COMPU_METHOD
/begin COMPU_METHOD _CNV_A_R_LINEAR_____36_CM "" RAT_FUNC "%6.3" "s" COEFFS 0 1. 0. 0 0 1 /end COMPU_METHOD
/begin COMPU_METHOD _CNV_A_R_LINEAR_____37_CM "" RAT_FUNC "%6.3" "V" COEFFS 0 9.807692307692308 0. 0 0 1 /end COMPU_METHOD
/begin COMPU_METHOD _CNV_A_R_LINEAR_____58_CM "" RAT_FUNC "%6.3" "km" COEFFS 0 0.1 0. 0 0 1 /end COMPU_METHOD
/begin COMPU_METHOD _CNV_A_R_LINEAR_____74_CM "" RAT_FUNC "%6.3" "A" COEFFS 0 10. 0. 0 0 1 /end COMPU_METHOD
/begin COMPU_METHOD _CNV_S_2_RANGE______76_CM "" TAB_VERB "%6.3" "" COMPU_TAB_REF _CNV_S_2_RANGE______76 /end COMPU_METHOD
/begin COMPU_VTAB _CNV_S_2_RANGE______76 "" TAB_VERB 2 0 "0" 1 "1" /end COMPU_VTAB
/begin COMPU_METHOD _CNV_A_R_LINEAR_____77_CM "" RAT_FUNC "%6.3" "V" COEFFS 0 10. -50. 0 0 1 /end COMPU_METHOD
/begin COMPU_METHOD _CNV_A_R_LINEAR_____78_CM "" RAT_FUNC "%6.3" "rpm" COEFFS 0 2.e-002 0. 0 0 1 /end COMPU_METHOD
/begin COMPU_METHOD _CNV_A_R_LINEAR_____89_CM "" RAT_FUNC "%6.3" "-" COEFFS 0 65535.99999999996 0. 0 0 1 /end COMPU_METHOD
/begin COMPU_METHOD _CNV_A_R_LINEAR_____110_CM "" RAT_FUNC "%6.3" "s" COEFFS 0 50. 0. 0 0 1 /end COMPU_METHOD
/begin COMPU_METHOD _CNV_A_R_LINEAR_____111_CM "" RAT_FUNC "%6.3" "mg/stk" COEFFS 0 47.18142548596112 0. 0 0 1 /end COMPU_METHOD
/begin COMPU_METHOD _CNV_A_R_LINEAR_____113_CM "" RAT_FUNC "%6.3" "%" COEFFS 0 655.3599999999997 -1.455191522836685e-011 0 0 1 /end COMPU_METHOD
/begin COMPU_METHOD _CNV_A_R_LINEAR_____129_CM "" RAT_FUNC "%6.3" "-" COEFFS 0 1024. 0. 0 0 1 /end COMPU_METHOD
/begin COMPU_METHOD _CNV_A_R_LINEAR_____152_CM "" RAT_FUNC "%6.3" "h" COEFFS 0 35999.99999497086 0. 0 0 1 /end COMPU_METHOD
/begin COMPU_METHOD _CNV_A_R_LINEAR_____171_CM "" RAT_FUNC "%6.3" "hPa" COEFFS 0 0.1884402603974972 0. 0 0 1 /end COMPU_METHOD
/begin COMPU_METHOD _CNV_A_R_LINEAR_____173_CM "" RAT_FUNC "%6.3" "hPa" COEFFS 0 0.3768805207949945 0. 0 0 1 /end COMPU_METHOD
/begin COMPU_METHOD _CNV_A_R_LINEAR_____174_CM "" RAT_FUNC "%6.3" "l/h" COEFFS 0 1. 0. 0 0 1 /end COMPU_METHOD
/begin COMPU_METHOD _CNV_S_11_RANGE_STAT_175_CM "" TAB_VERB "%6.3" "-" COMPU_TAB_REF _CNV_S_11_RANGE_STAT_175 /end COMPU_METHOD
/begin COMPU_VTAB _CNV_S_11_RANGE_STAT_175 "" TAB_VERB 11 0 "OFF_DLY" 1 "ACR_TEST" 2 "LIH" 3 "CRASH2OFF" 4 "ON2OFF_DLY" 5 "ON2EXT_ADJ" 6 "CRASH" 7 "OFF_DLY2ON" 8 "EXT_ADJ2OFF" 9 "OFF_DLY2OFF" 10 "ACR_TEST2OFF" /end COMPU_VTAB
/begin COMPU_METHOD _CNV_A_R_LINEAR_____176_CM "" RAT_FUNC "%6.3" "l/h" COEFFS 0 257. 0. 0 0 1 /end COMPU_METHOD
/begin COMPU_METHOD _CNV_A_R_LINEAR_____177_CM "" RAT_FUNC "%6.3" "hPa/10ms" COEFFS 0 0.3768805207949945 0. 0 0 1 /end COMPU_METHOD
/begin COMPU_METHOD _CNV_A_R_LINEAR_____178_CM "" RAT_FUNC "%6.3" "%" COEFFS 0 655.3600000071681 32768.00000035841 0 0 1 /end COMPU_METHOD
/begin COMPU_METHOD _CNV_A_R_LINEAR_____179_CM "" RAT_FUNC "%6.3" "hPa" COEFFS 0 0.3768805207949945 32768. 0 0 1 /end COMPU_METHOD
/begin COMPU_METHOD _CNV_A_R_LINEAR_____180_CM "" RAT_FUNC "%6.3" "mg" COEFFS 0 47.18142548596112 0. 0 0 1 /end COMPU_METHOD
/begin COMPU_METHOD _CNV_S_7_RANGE_STAT_181_CM "" TAB_VERB "%6.3" "-" COMPU_TAB_REF _CNV_S_7_RANGE_STAT_181 /end COMPU_METHOD
/begin COMPU_VTAB _CNV_S_7_RANGE_STAT_181 "" TAB_VERB 7 0 "EFP_OFF" 1 "EFP_ACR_TEST" 2 "EFP_ON" 3 "EFP_OFF_DLY" 4 "EFP_EXT_ADJ" 5 "EFP_CRASH" 6 "EFP_LIH" /end COMPU_VTAB
/begin COMPU_METHOD _CNV_A_R_LINEAR_____182_CM "" RAT_FUNC "%6.3" "mg/cm³" COEFFS 0 72.81666666666666 -2.728484105318785e-012 0 0 1 /end COMPU_METHOD
/begin COMPU_METHOD _CNV_A_R_LINEAR_____183_CM "" RAT_FUNC "%6.3" "hPa" COEFFS 0 0.1884402603974972 32768.00000000008 0 0 1 /end COMPU_METHOD
/begin COMPU_METHOD _CNV_A_R_LINEAR_____185_CM "" RAT_FUNC "%6.3" "" COEFFS 0 256. 0. 0 0 1 /end COMPU_METHOD
/begin COMPU_METHOD _CNV_A_R_LINEAR_____191_CM "" RAT_FUNC "%6.3" "s" COEFFS 0 32. 0. 0 0 1 /end COMPU_METHOD
/begin COMPU_METHOD _CNV_S_14_STATE_VLS__221_CM "" TAB_VERB "%6.3" "" COMPU_TAB_REF _CNV_S_14_STATE_VLS__221 /end COMPU_METHOD
/begin COMPU_VTAB _CNV_S_14_STATE_VLS__221 "" TAB_VERB 14 0 "OFF" 1 "STEP_1" 2 "STEP_2" 3 "WAIT" 4 "TIMEOUT" 16 "FINISHED" 17 "ERR_UP" 18 "ERR_DOWN" 19 "ERR_UP_DOWN" 20 "ERR_UP_1" 21 "ERR_UP_2" 22 "ERR_DOWN_1" 23 "ERR_DOWN_2" 24 "NO_RESULT" /end COMPU_VTAB
/begin COMPU_METHOD _CNV_A_R_LINEAR_____222_CM "" RAT_FUNC "%6.3" "°C" COEFFS 0 43.47840509520334 2086.96344456976 0 0 1 /end COMPU_METHOD
/begin COMPU_METHOD _CNV_A_R_LINEAR_____223_CM "" RAT_FUNC "%6.3" "g" COEFFS 0 35.99999934081027 0. 0 0 1 /end COMPU_METHOD
/begin COMPU_METHOD _CNV_A_R_LINEAR_____224_CM "" RAT_FUNC "%6.3" "V" COEFFS 0 204.8048048048048 0. 0 0 1 /end COMPU_METHOD
/begin COMPU_METHOD _CNV_A_R_LINEAR_____235_CM "" RAT_FUNC "%6.3" "Nm" COEFFS 0 2097152.000003239 3.316402435302734e-003 0 0 1 /end COMPU_METHOD
/begin COMPU_METHOD _CNV_A_R_LINEAR_____236_CM "" RAT_FUNC "%6.3" "Nm" COEFFS 0 8191.999999679995 -1.280019205296412e-006 0 0 1 /end COMPU_METHOD
/begin COMPU_METHOD _CNV_A_R_LINEAR_____237_CM "" RAT_FUNC "%6.3" "1/min/s" COEFFS 0 3.125e-002 0. 0 0 1 /end COMPU_METHOD
/begin COMPU_METHOD _CNV_A_R_LINEAR_____238_CM "" RAT_FUNC "%6.3" "Nm/rpm" COEFFS 0 8192. 0. 0 0 1 /end COMPU_METHOD
/begin COMPU_METHOD _CNV_A_R_LINEAR_____239_CM "" RAT_FUNC "%6.3" "Nm/rpm" COEFFS 0 32. 0. 0 0 1 /end COMPU_METHOD
/begin COMPU_METHOD _CNV_A_R_LINEAR_____240_CM "" RAT_FUNC "%6.3" "rpm" COEFFS 0 3.125e-002 128. 0 0 1 /end COMPU_METHOD
/begin COMPU_METHOD _CNV_A_R_LINEAR_____261_CM "" RAT_FUNC "%6.3" "s" COEFFS 0 25. 0. 0 0 1 /end COMPU_METHOD
/begin COMPU_METHOD _CNV_A_R_LINEAR_____266_CM "" RAT_FUNC "%6.3" "-" COEFFS 0 64. 0. 0 0 1 /end COMPU_METHOD
/begin COMPU_METHOD _CNV_A_R_ENSD_LINEA_399_CM "" RAT_FUNC "%6.3" "°C" COEFFS 0 1. 50. 0 0 1 /end COMPU_METHOD
/begin COMPU_METHOD _CNV_A_R_LINEAR_____401_CM "" RAT_FUNC "%6.3" "V" COEFFS 0 10. -106. 0 0 1 /end COMPU_METHOD
/begin COMPU_METHOD _CNV_A_R_LINEAR_____402_CM "" RAT_FUNC "%6.3" "%" COEFFS 0 0.32 0. 0 0 1 /end COMPU_METHOD
/begin COMPU_METHOD _CNV_S_4_STATE_POW__403_CM "" TAB_VERB "%6.3" "-" COMPU_TAB_REF _CNV_S_4_STATE_POW__403 /end COMPU_METHOD
/begin COMPU_VTAB _CNV_S_4_STATE_POW__403 "" TAB_VERB 4 0 "DF<50%" 1 "50%<DF<75%" 2 "75%<DF<100%" 3 "100%" /end COMPU_VTAB
/begin COMPU_METHOD _CNV_A_R_LINEAR_____404_CM "" RAT_FUNC "%6.3" "A" COEFFS 0 8. 0. 0 0 1 /end COMPU_METHOD
/begin COMPU_METHOD _CNV_A_R_LINEAR_____405_CM "" RAT_FUNC "%6.3" "°C" COEFFS 0 0.125 4. 0 0 1 /end COMPU_METHOD
/begin COMPU_METHOD _CNV_A_R_LINEAR_____406_CM "" RAT_FUNC "%6.3" "V" COEFFS 0 1. 0. 0 0 1 /end COMPU_METHOD
/begin COMPU_METHOD _CNV_A_R_LINEAR_____407_CM "" RAT_FUNC "%6.3" "A" COEFFS 0 4. 0. 0 0 1 /end COMPU_METHOD
/begin COMPU_METHOD _CNV_A_R_LINEAR_____425_CM "" RAT_FUNC "%6.3" "V" COEFFS 0 10. 0. 0 0 1 /end COMPU_METHOD
/begin COMPU_METHOD _CNV_A_R_LINEAR_____525_CM "" RAT_FUNC "%6.3" "hPa" COEFFS 0 0.1884402603974972 8.003553375601769e-011 0 0 1 /end COMPU_METHOD
/begin COMPU_METHOD _CNV_S_4_RANGE_STAT_528_CM "" TAB_VERB "%6.3" "-" COMPU_TAB_REF _CNV_S_4_RANGE_STAT_528 /end COMPU_METHOD
/begin COMPU_VTAB _CNV_S_4_RANGE_STAT_528 "" TAB_VERB 4 0 "FLOW_REQ" 1 "FLOW2PRS_REQ" 2 "PRS_REQ" 3 "PRS2FLOW_REQ" /end COMPU_VTAB
/begin COMPU_METHOD _CNV_S_4_RANGE_STAT_529_CM "" TAB_VERB "%6.3" "-" COMPU_TAB_REF _CNV_S_4_RANGE_STAT_529 /end COMPU_METHOD
/begin COMPU_VTAB _CNV_S_4_RANGE_STAT_529 "" TAB_VERB 4 0 "FLOW_CONTROL" 1 "FLOW2PRS" 2 "PRESSURE_CONTROL" 3 "PRS2FLOW" /end COMPU_VTAB
/begin COMPU_METHOD _CNV_S_3_RANGE_FUP__530_CM "" TAB_VERB "%6.3" "-" COMPU_TAB_REF _CNV_S_3_RANGE_FUP__530 /end COMPU_METHOD
/begin COMPU_VTAB _CNV_S_3_RANGE_FUP__530 "" TAB_VERB 3 0 "AUTOMATIC" 1 "FLOW_CONTROL" 2 "PRESSURE_CONTROL" /end COMPU_VTAB
/begin COMPU_METHOD _CNV_A_R_LINEAR_____531_CM "" RAT_FUNC "%6.3" "mg" COEFFS 0 47.18214541280769 -1.080506262951531e-005 0 0 1 /end COMPU_METHOD
/begin COMPU_METHOD _CNV_A_R_LINEAR_____532_CM "" RAT_FUNC "%6.3" "hPa/mg" COEFFS 0 0.5 0. 0 0 1 /end COMPU_METHOD
/begin COMPU_METHOD _CNV_A_R_LINEAR_____533_CM "" RAT_FUNC "%6.3" "mg" COEFFS 0 47.18214541280769 32767.99998919494 0 0 1 /end COMPU_METHOD
/begin COMPU_METHOD _CNV_A_R_LINEAR_____534_CM "" RAT_FUNC "%6.3" "mg" COEFFS 0 471.8214542836573 32768. 0 0 1 /end COMPU_METHOD
/begin COMPU_METHOD _CNV_A_R_LINEAR_____535_CM "" RAT_FUNC "%6.3" "%/s" COEFFS 0 0.1024000154202376 128.000019275297 0 0 1 /end COMPU_METHOD
/begin COMPU_METHOD _CNV_A_R_LINEAR_____536_CM "" RAT_FUNC "%6.3" "mg" COEFFS 0 3092129.082793377 4.76837158203125e-007 0 0 1 /end COMPU_METHOD
/begin COMPU_METHOD _CNV_A_R_LINEAR_____537_CM "" RAT_FUNC "%6.3" "-" COEFFS 0 25.60240963855421 0. 0 0 1 /end COMPU_METHOD
/begin COMPU_METHOD _CNV_A_R_LINEAR_____542_CM "" RAT_FUNC "%6.3" "A" COEFFS 0 2. 0. 0 0 1 /end COMPU_METHOD
/begin COMPU_METHOD _CNV_S_6_RANGE_STAT_922_CM "" TAB_VERB "%6.3" "-" COMPU_TAB_REF _CNV_S_6_RANGE_STAT_922 /end COMPU_METHOD
/begin COMPU_VTAB _CNV_S_6_RANGE_STAT_922 "" TAB_VERB 6 0 "VCV_TEST" 1 "START" 2 "MFP_CTL" 3 "VCV_CLOSE" 4 "VCV_CRASH" 5 "MFP_MAX" /end COMPU_VTAB
/begin COMPU_METHOD _CNV_S_6_RANGE_STAT_923_CM "" TAB_VERB "%6.3" "-" COMPU_TAB_REF _CNV_S_6_RANGE_STAT_923 /end COMPU_METHOD
/begin COMPU_VTAB _CNV_S_6_RANGE_STAT_923 "" TAB_VERB 6 0 "FPA_OPEN" 1 "FPA_CLOSE" 2 "FPA_LGRD" 3 "FPA_CTL" 4 "FPA_MAN" 5 "FPA_CRASH" /end COMPU_VTAB
/begin COMPU_METHOD _CNV_S_5_RANGE_STAT_924_CM "" TAB_VERB "%6.3" "-" COMPU_TAB_REF _CNV_S_5_RANGE_STAT_924 /end COMPU_METHOD
/begin COMPU_VTAB _CNV_S_5_RANGE_STAT_924 "" TAB_VERB 5 0 "PASSIVE" 1 "READY" 2 "START" 3 "ACTIVE" 4 "END" /end COMPU_VTAB
/begin RECORD_LAYOUT _REC_VAL_20_u1 FNC_VALUES 1 UBYTE COLUMN_DIR DIRECT /end RECORD_LAYOUT
/begin RECORD_LAYOUT _REC_VAL_20_u2 FNC_VALUES 1 UWORD COLUMN_DIR DIRECT /end RECORD_LAYOUT
/begin RECORD_LAYOUT _REC_AXS_20_u1 NO_AXIS_PTS_X 1 UBYTE AXIS_PTS_X 2 UBYTE INDEX_INCR DIRECT /end RECORD_LAYOUT
/begin RECORD_LAYOUT _REC_MAP_20_u2_u1_u1 FNC_VALUES 1 UWORD COLUMN_DIR DIRECT /end RECORD_LAYOUT
/begin RECORD_LAYOUT _REC_CUR_20_u1_u1 FNC_VALUES 1 UBYTE COLUMN_DIR DIRECT /end RECORD_LAYOUT
/begin RECORD_LAYOUT _REC_VAL_20_s2 FNC_VALUES 1 SWORD COLUMN_DIR DIRECT /end RECORD_LAYOUT
/begin RECORD_LAYOUT _REC_MAP_20_u2_u2_u1 FNC_VALUES 1 UWORD COLUMN_DIR DIRECT /end RECORD_LAYOUT
/begin RECORD_LAYOUT _REC_AXS_20_u2 NO_AXIS_PTS_X 1 UWORD AXIS_PTS_X 2 UWORD INDEX_INCR DIRECT /end RECORD_LAYOUT
/begin RECORD_LAYOUT _REC_CUR_20_u2_u1 FNC_VALUES 1 UWORD COLUMN_DIR DIRECT /end RECORD_LAYOUT
/begin RECORD_LAYOUT _REC_CUR_20_u2_u2 FNC_VALUES 1 UWORD COLUMN_DIR DIRECT /end RECORD_LAYOUT
/begin RECORD_LAYOUT _REC_VAL_20_s1 FNC_VALUES 1 SBYTE COLUMN_DIR DIRECT /end RECORD_LAYOUT
/begin RECORD_LAYOUT _REC_MAP_20_u2_u1_u2 FNC_VALUES 1 UWORD COLUMN_DIR DIRECT /end RECORD_LAYOUT
/begin RECORD_LAYOUT _REC_MAP_20_u1_u1_u1 FNC_VALUES 1 UBYTE COLUMN_DIR DIRECT /end RECORD_LAYOUT
/begin FUNCTION EOL_End_of_line_test "_End of line test"
 /begin SUB_FUNCTION EOL_End_of_line_test_Lambda_sensors_confused_wrong_wired EOL_Lambda_setpoint_for_external_adjustment /end SUB_FUNCTION
/end FUNCTION
/begin FUNCTION EOL_End_of_line_test_Lambda_sensors_confused_wrong_wired "_End of line test Lambda sensors confused wrong wired"
 /begin DEF_CHARACTERISTIC c_tco_min_vls_eol c_teg_cat_down_eol c_maf_int_min_vls_eol c_lamb_sp_vls_eol_afr c_lamb_sp_vls_eol_afl c_vls_afr_eol c_vls_afl_eol c_lamb_ls_up_afr_eol c_lamb_ls_up_afl_eol c_t_wait_vls_eol_opm_swi /end DEF_CHARACTERISTIC
 /begin OUT_MEASUREMENT state_vls_eol maf_int_min_vls_eol lv_act_vls_eol lamb_sp_vls_eol[0] lamb_sp_vls_eol[1] vls_down_afl_eol[0] vls_down_afl_eol[1] vls_down_afr_eol[0] vls_down_afr_eol[1] lamb_ls_up_afl_eol[0] lamb_ls_up_afl_eol[1] lamb_ls_up_afr_eol[0] lamb_ls_up_afr_eol[1] lv_vls_eol_shift_rep_inh t_wait_vls_eol_opm_swi /end OUT_MEASUREMENT
/end FUNCTION
/begin FUNCTION EOL_Lambda_setpoint_for_external_adjustment "_Lambda setpoint for external adjustment"
 /begin OUT_MEASUREMENT lamb_sp_ext_adj_1 lamb_sp_ext_adj_2 lv_lamb_sp_ext_adj_1 lv_lamb_sp_ext_adj_2 /end OUT_MEASUREMENT
/end FUNCTION
/begin FUNCTION C_Y_Byp_Sim "" /begin SUB_FUNCTION Bypass_Simulation /end SUB_FUNCTION /end FUNCTION
/begin FUNCTION Bypass_Simulation "Bypass_Simulation" /end FUNCTION
/begin FUNCTION C_0_BGO "C_0_BGO" /begin SUB_FUNCTION BGO_Non_volatile_datas /end SUB_FUNCTION /end FUNCTION
/begin FUNCTION BGO_Non_volatile_datas "_Non volatile datas"
 /begin DEF_CHARACTERISTIC lc_ad_clr_lam lc_ad_clr_thro lc_ad_clr_mis lc_ad_clr_ivvt lc_ad_clr_ati lc_ad_clr_toil lc_ad_clr_n_sp_is lc_ad_clr_ron lc_ad_clr_tecu lc_ad_clr_var lc_ad_clr_dmtl lc_ad_clr_sof lc_ad_clr_n_max lc_ad_clr_lif lc_ad_clr_tqi_lim lc_ad_clr lc_ad_clr_obd2 lc_ad_clr_cru lc_ad_clr_can lc_ad_clr_pste lc_ad_clr_toil_max lc_ad_clr_nox lc_ad_clr_ente lc_ad_clr_enrd lc_ad_clr_ensd lc_ad_clr_extd lc_ad_clr_bal lc_ad_clr_ccp lc_ad_clr_tqlo lc_ad_clr_pow lc_ad_clr_laco lc_ad_clr_egcp lc_ad_clr_egr lc_ad_clr_ecm2 lc_ad_clr_alter /end DEF_CHARACTERISTIC
 /begin OUT_MEASUREMENT lv_nvmy_rd_failed lv_nvmy_cus_wrg /end OUT_MEASUREMENT
/end FUNCTION
/begin FUNCTION C_9_AUX "C_9_AUX"
 /begin SUB_FUNCTION AUX_Blocking_of_the_air_conditioner_compressor AUX_Engine_speed_limitation_controller AUX_Electrical_fuel_pump_control AUX_Fuel_pressure_control AUX_Disa AUX_Exhaust_gas_recirculation AUX_Determination_of_secondary_air_mass_flow AUX_Power_Management AUX_Coil_substitute_temperature AUX_Exhaust_flap_actuation AUX_IVVT_application_Incidences AUX_Starter_Relay_Control AUX_E_box_cooling_fan AUX_Application_incidences_for_Electrical_fuel_pump_Interface AUX_Sound_Flap_Control AUX_Electronically_controlled_radiator_shutter AUX_Variable_Intake_Manifold AUX_QLT_SENSOR AUX_Electrical_controlled_Water_Pump AUX_PWL_Manager AUX_Main_Relay_Control AUX_HPDI_Relay_Control AUX_Fuel_pressure_setpoint_calculation AUX_Fuel_supply_general AUX_Application_incidences_fuel_pressure_control AUX_Fuel_pressure_actuator_temperature AUX_High_pressure_pump_control_VCV AUX_Application_incidences_high_pressure_pump_control AUX_Crankcase_ventilation_heater_control AUX_Electr_fuel_pump_control AUX_Ele_fuel_pump_control_AI AUX_Fuel_pres_sp_low_pres_pump AUX_Active_engine_bracket AUX_Alternator_profile /end SUB_FUNCTION
/end FUNCTION
/begin FUNCTION AUX_Blocking_of_the_air_conditioner_compressor "_Blocking of the air conditioner compressor"
 /begin DEF_CHARACTERISTIC c_vs_max_accin c_accin_dly_1 c_accin_dly_1_lock_fl c_accin_dly_4 c_pvs_fl_accin c_accin_dly_5 c_tco_max_accin_hys ip_t_acc_dly_on__n_32 ip_t_acc_dly_off__n_32 c_tco_max_accin c_toil_max_accin c_toil_max_accin_hys c_temp_gb_max_accin c_temp_gb_max_accin_hys /end DEF_CHARACTERISTIC
 /begin OUT_MEASUREMENT lv_accout_rly_ena lv_accout_rly t_acc t_acc_dly /end OUT_MEASUREMENT
/end FUNCTION
/begin FUNCTION AUX_Engine_speed_limitation_controller "_Engine speed limitation controller"
 /begin DEF_CHARACTERISTIC c_n_grd_hys c_tqi_max_pas c_crlc_n_grd_fil_1 c_crlc_n_grd_fil_2 c_tqi_n_max_inc id_fac_n_max_i_at__gear id_fac_n_max_p_mt__gear id_fac_n_max_i_mt__gear id_fac_n_max_p_at__gear id_t_n_max_pred_mt__gear ip_n_grd_thd__n_32 id_fac_tqi_n_max_ref c_add_n_max_fcut lc_n_pred_max_lim_swi_amt id_t_n_max_pred_at__gear id_t_n_max_pred_at_man c_n_lim_min /end DEF_CHARACTERISTIC
 /begin OUT_MEASUREMENT lv_n_max_req_fcut n_dif_max_lim n_pred_max_lim tq_n_max_dif tq_n_max_dif_i tq_n_max_dif_p tq_n_max_inp_i tqi_n_max tqi_n_max_ref n_grd_fil n_grd_fil_fil tqi_n_max_1 tqi_n_max_2 lv_n_max n_max trt_n_max ctr_n_max ctr_km_n_max n_grd_n_max vs_n_max pv_av_n_max gear_ef_n_max lv_cs_n_max t_sum_n_max t_n_max nr_pat_scc_n_max /end OUT_MEASUREMENT
/end FUNCTION
/begin FUNCTION AUX_Electrical_fuel_pump_control "_Electrical fuel pump control" /end FUNCTION
/begin FUNCTION AUX_Fuel_pressure_control "_Fuel pressure control"
 /begin DEF_CHARACTERISTIC ip_fuel_mass_req_p_ctl ip_fuel_mass_req_i_ctl ip_fac_clc_fuel_mass_fup ldp_fup_dif_pctl_ip_fac_fuel ldpm_fup_dif_ctl_1_fusl ldp_tfu_ip_fac_clc_fuel_mass c_fuel_mass_req_i_ctl_mmv_crlc lc_fuel_mass_req_ctl_clr lc_use_fuel_mass_req_ctl c_n_fuel_mass_ad_min c_n_fuel_mass_ad_max c_fuel_mass_ad_max c_fuel_mass_ad_min lc_ad_clr_fuel_mass_ad c_fuel_mass_req_i_ctl_max c_fuel_mass_req_i_ctl_min c_seg_ctr_fuel_mass_ad_max ldpm_n_32_fusl_1 ip_fac_fuel_mass_req_ctl c_dly_fup_sp c_pv_grd_thd_fuel_add ip_fuel_mass_req_add c_pv_thd_fuel_add c_ctr_cyc_fuel_add ldp_n_32_ip_fuel_mass_req_add ldp_n_32_ip_fac_n_fuel_req_pctl ip_fac_fuel_mass_req_pctl ip_fac_n_mass_fuel_req_pctl c_clc_fuel_pump_ctl c_fuel_mass_ad_cor_crlc c_crlc_fup_dif_mmv /end DEF_CHARACTERISTIC
 /begin OUT_MEASUREMENT fuel_mass_req fuel_mass_ad fuel_mass_ad_dif fuel_mass_req_pctl fac_clc_fuel_mass_fup fuel_mass_req_ctl fup_dif_ctl fuel_mass_req_p_ctl fuel_mass_req_i_ctl_mmv fup_dif_pctl[0] fup_dif_pctl[1] fuel_mass_req_pctl_tmp seg_ctr_fuel_mass_ad fac_fuel_mass_req_pctl lv_fuel_add_act fuel_mass_req_i_ctl_h_res fup_dif[0] fup_dif[1] fup_dif_mmv /end OUT_MEASUREMENT
/end FUNCTION
/begin FUNCTION AUX_Disa "_Disa" /end FUNCTION
/begin FUNCTION AUX_Exhaust_gas_recirculation "_Exhaust gas recirculation" /begin DEF_CHARACTERISTIC c_tco_min_egr c_t_ast_egr lc_acr_ctl_ena /end DEF_CHARACTERISTIC /begin OUT_MEASUREMENT lv_acr_ctl_ena /end OUT_MEASUREMENT /end FUNCTION
/begin FUNCTION AUX_Determination_of_secondary_air_mass_flow "_Determination of secondary air mass flow" /end FUNCTION
/begin FUNCTION AUX_Power_Management "_Power Management"
 /begin DEF_CHARACTERISTIC c_vb_min_bsd_diag lc_alter_bsd_prot_2 c_t_wr_per_alter_tbl_0 c_t_wr_per_alter_tbl_1 c_t_rd_per_alter_tbl_2 c_t_rd_per_alter_tbl_5 c_t_fil_cur_exct_alter ldp_idx_lf_alter_eve_wr ldp_idx_nr_alter_eve_wr ldp_idx_ctr_alter_eve_wr id_nr_alter_eve_wr id_state_alter_value_wr lc_pow_cord_inh ldp_alter_cod_0 id_alter_exct_lim_sp lc_alter_exct_lim_sp /end DEF_CHARACTERISTIC
 /begin OUT_MEASUREMENT lv_alter_bsd_prot_2 lv_alter_if_act lv_alter_eve_rd lv_alter_eve_wr bsd_alter_rd.t_load_resp_alter_0 bsd_alter_rd.v_alter bsd_alter_rd.t_load_resp_alter_1 bsd_alter_rd.lv_load_resp_alter_cnd_1 bsd_alter_rd.lv_load_resp_alter_thd_act bsd_alter_rd.lv_alter_err_temp bsd_alter_rd.lv_alter_err_mec bsd_alter_rd.lv_alter_err_el bsd_alter_rd.pow_rel_alter bsd_alter_rd.pow_rel_alter_l_res bsd_alter_rd.cur_alter_exct bsd_alter_rd.temp_alter_mc bsd_alter_rd.alter_cod_0 bsd_alter_rd.alter_cod_1 bsd_alter_rd.alter_cod_2 bsd_alter_rd.v_alter_nom bsd_alter_rd.alter_cod_3 bsd_alter_wr.t_load_resp_alter_sp_0 bsd_alter_wr.v_alter_sp bsd_alter_wr.t_load_resp_alter_sp_1 bsd_alter_wr.lv_load_resp_alter_cnd_1 bsd_alter_wr.lv_load_resp_alter_thd_act_sp bsd_alter_wr.cur_alter_exct_lim_sp lf_alter_eve_wr nr_alter_eve_wr ctr_alter_eve_wr state_alter_value_wr lv_exc_t_load_resp_alter_sp_0 lv_exc_cur_alter_exct_lim_sp lv_exc_v_alter_sp ctr_t_rd_per_alter_tbl_2 ctr_t_rd_per_alter_tbl_5 ctr_t_wr_per_alter_tbl_0 ctr_t_wr_per_alter_tbl_1 lv_step_bsd_alter lv_req_gen_rd_reg2 lv_req_gen_rd_reg5 lv_req_gen_wr_reg0 lv_req_gen_wr_reg1 lv_req_gen_wr_reg3 /end OUT_MEASUREMENT
/end FUNCTION
/begin FUNCTION AUX_Coil_substitute_temperature "_Coil substitute temperature" /end FUNCTION
/begin FUNCTION AUX_Exhaust_flap_actuation "_Exhaust flap actuation"
 /begin DEF_CHARACTERISTIC c_vs_min_ef_at c_vs_min_ef_mt c_t_ef_ast id_fac_tq_ef_thd_ctop_open_mt id_fac_tq_ef_thd_ctop_open_at id_fac_tq_ef_thd_ctop_close_at id_fac_tq_ef_thd_ctop_close_mt ip_t_dly_ef lc_ef_conf c_n_ef_hys c_fac_tq_ef_thd_hys lc_state_ch_ef lc_state_vs_min_ef_at lc_state_vs_min_ef_mt lc_state_ef_ast /end DEF_CHARACTERISTIC
 /begin OUT_MEASUREMENT lv_ef fac_tq_ef_thd fac_tq_ef_thd_ctop n_ef t_dly_ef /end OUT_MEASUREMENT
/end FUNCTION
/begin FUNCTION AUX_IVVT_application_Incidences "_IVVT application Incidences" /end FUNCTION
/begin FUNCTION AUX_Starter_Relay_Control "_Starter Relay Control" /begin OUT_MEASUREMENT lv_rly_st /end OUT_MEASUREMENT /end FUNCTION
/begin FUNCTION AUX_E_box_cooling_fan "_E-box cooling fan"
 /begin DEF_CHARACTERISTIC c_tecu_thd_ebox_cfa c_tecu_hys_ebox_cfa c_tia_thd_ebox_cfa c_tia_hys_ebox_cfa c_t_max_ebox_cfa_act c_n_thd_ebox_cfa_act /end DEF_CHARACTERISTIC
 /begin OUT_MEASUREMENT lv_ebox_cfa /end OUT_MEASUREMENT
/end FUNCTION
/begin FUNCTION AUX_Application_incidences_for_Electrical_fuel_pump_Interface "_Application incidences for Electrical fuel pump Interface"
 /begin OUT_MEASUREMENT state_efp_ctl state_efp_ctl_ecu state_veh_cns_fct cur_eng_efp lv_efp_on_ext_adj_can lv_efp_off_ext_adj_can vb_efp n_efp_av state_diag_efp state_efp_can v_eng_efp /end OUT_MEASUREMENT
/end FUNCTION
/begin FUNCTION AUX_Sound_Flap_Control "_Sound Flap Control"
 /begin DEF_CHARACTERISTIC c_v_sof_swi_on_bol c_v_sof_swi_on_tol c_v_sof_swi_amt_on_tol lc_var_sof_swi lc_var_sof_swi_amt lc_conf_city_ena c_vs_min_sof_mt c_vs_min_sof_at c_t_sof_ast c_n_sof_hys c_fac_tq_sof_thd_hys ip_t_dly_sof id_fac_tq_sof_thd_ctop_open_mt id_fac_tq_sof_thd_ctop_open_at id_fac_tq_sof_thd_ctop_close_mt id_fac_tq_sof_thd_ctop_close_at lc_state_vs_min_sof_mt lc_state_vs_min_sof_at lc_state_sof_ast /end DEF_CHARACTERISTIC
 /begin OUT_MEASUREMENT lv_sof_swi_req lv_sof_swi lv_sof_swi_amt lv_sof_swi_amt_req lv_sof fac_tq_sof_thd fac_tq_sof_thd_ctop n_sof t_dly_sof /end OUT_MEASUREMENT
/end FUNCTION
/begin FUNCTION AUX_Electronically_controlled_radiator_shutter "_Electronically controlled radiator shutter"
 /begin DEF_CHARACTERISTIC c_ecraspwm_10 c_ecraspwm_90 c_ecraspwm_man c_ecraspwm_diag lc_ecraspwm_man c_ctr_ecras_eol c_t_ecras_up_det c_t_wait_ecras_eol id_ecraspwm ldp_lv_ecras_up_1 ldp_lv_ecras_down_1 /end DEF_CHARACTERISTIC
 /begin OUT_MEASUREMENT lv_ecras lv_ecras_up lv_ecras_down ecraspwm state_ecras_sys lv_ecras_up_1 lv_ecras_down_1 lv_ecras_eol lv_ecras_eol_end lv_ecras_eol_inh lv_err_ecras_eol t_ecras_up_det t_wait_ecras_eol ctr_ecras_eol /end OUT_MEASUREMENT
/end FUNCTION
/begin FUNCTION AUX_Variable_Intake_Manifold "_Variable Intake Manifold" /end FUNCTION
/begin FUNCTION AUX_QLT_SENSOR "_QLT_SENSOR"
 /begin OUT_MEASUREMENT lv_err_qoil_sens lv_err_toil_level lv_err_toil ozpermr_w ozstatus oztempr oznivr /end OUT_MEASUREMENT
/end FUNCTION
/begin FUNCTION AUX_Electrical_controlled_Water_Pump "_Electrical controlled Water Pump"
 /begin OUT_MEASUREMENT cur_cns_cwp lv_cwp_block_deac lv_cwp_temp_high lv_cwp_vcc_plaus lv_n_mon_cwp_deac v_cwp temp_el_cwp n_rel_cwp lv_cwp_pre_lock lv_cwp_lock lf_pow_cwp_cod lf_cwp_info_cod lv_cwp_hw_lih_in_chk /end OUT_MEASUREMENT
/end FUNCTION
/begin FUNCTION AUX_PWL_Manager "_PWL Manager" /begin DEF_CHARACTERISTIC c_t_min_pwl c_t_max_pwl /end DEF_CHARACTERISTIC /begin OUT_MEASUREMENT pwl_lock_cdn t_pwl lv_pwl_act lv_inh_pwl_tran_es_el /end OUT_MEASUREMENT /end FUNCTION
/begin FUNCTION AUX_Main_Relay_Control "_Main Relay Control" /begin DEF_CHARACTERISTIC lc_rly_main_man_req lc_rly_main_man_adj /end DEF_CHARACTERISTIC /begin OUT_MEASUREMENT lv_rly_main lv_rly_main_sys /end OUT_MEASUREMENT /end FUNCTION
/begin FUNCTION AUX_HPDI_Relay_Control "_HPDI Relay Control" /begin DEF_CHARACTERISTIC lc_rly_hpdi_man_req lc_rly_hpdi_man_adj /end DEF_CHARACTERISTIC /begin OUT_MEASUREMENT lv_rly_hpdi lv_rly_hpdi_sys /end OUT_MEASUREMENT /end FUNCTION
/begin FUNCTION AUX_Fuel_pressure_setpoint_calculation "_Fuel pressure setpoint calculation"
 /begin DEF_CHARACTERISTIC c_fup_sp_man c_fup_sp_pu_lim_inc c_fup_sp_pu_lim_dec c_fup_sp_lim_dec lc_fup_sp_man_act ldpm_n_1_fusl ldpm_mff_sp_fup_ctl_1_fusl ip_fup_sp_s ip_fup_sp_pu c_fup_sp_st_lgrd_dec c_t_fup_sp_add_1 c_t_fup_sp_add_2 c_fup_sp_add c_fup_sp_lim_inc c_fup_sp_lih_vcv_open ip_fup_sp_hom c_fup_sp_crlc_2 ldp_fup_sp_dif_ip_fac_fup_sp_2 ip_fac_fup_sp ip_fup_sp_mplh_opp ldpm_tco_st_1_fusl ldp_fup_ip_fup_sp_st ip_fup_sp_st /end DEF_CHARACTERISTIC
 /begin OUT_MEASUREMENT fup_sp[0] fup_sp[1] fup_sp_grd_act fup_h_sp_s[0] fup_h_sp_s[1] lv_fup_sp_add fup_sp_tmp[0] fup_sp_tmp[1] fup_h_sp_s_mv fup_sp_st /end OUT_MEASUREMENT
/end FUNCTION
/begin FUNCTION AUX_Fuel_supply_general "_Fuel supply general"
 /begin DEF_CHARACTERISTIC c_fup_ctl_mod lc_fuel_mass_ctl_rst lc_vff_swi lc_fpa_conf c_ctr_seg_fup_ofs_tol_max lc_fup_req_fpa_rst c_fup_ofs_bol c_fup_ofs_tol c_fup_sp_dec_tol c_ctr_seg_fup_ofs_bol_max c_vff_vcv_min_tol_hys c_vff_vcv_min_bol_hys c_vff_swi_thd /end DEF_CHARACTERISTIC
 /begin OUT_MEASUREMENT lv_fup_prs_ctl_req lv_fup_req_fpa_stop lv_fuel_mass_ad_stop lv_vff_vcv_min vff_mff_sp_fup_ctl state_fup_ctl_tran state_fup_ctl fpa_mff lv_fuel_mass_ctl_stop lv_fuel_mass_ctl_rst lv_fup_req_fpa_rst ctr_seg_fup_ofs_bol ctr_seg_fup_ofs_tol /end OUT_MEASUREMENT
/end FUNCTION
/begin FUNCTION AUX_Application_incidences_fuel_pressure_control "_Application incidences fuel pressure control" /end FUNCTION
/begin FUNCTION AUX_Fuel_pressure_actuator_temperature "_Fuel pressure actuator temperature" /end FUNCTION
/begin FUNCTION AUX_High_pressure_pump_control_VCV "_High pressure pump control" /end FUNCTION
/begin FUNCTION AUX_Application_incidences_high_pressure_pump_control "_Application incidences high pressure pump control"
 /begin DEF_CHARACTERISTIC c_fup_lih_vcv_open c_t_fup_lih_hom_vcv_open_req c_t_err_sym_h_prs_sys_2 c_t_fup_lih_l_prs_ctl_req lc_t_fup_lih_l_prs_ctl_req /end DEF_CHARACTERISTIC
 /begin OUT_MEASUREMENT lv_fup_req_fpa_stop_req lv_fup_req_fpa_rst_req state_pwm_vcv lv_fup_lih_req lv_fuel_mass_ctl_stop_req lv_fuel_mass_ctl_rst_req fpapwm vff_vcv vff_vcv_min state_fpa state_vff_vcv_min lv_fup_lih_l_prs_ctl_req lv_fup_lih_hom_vcv_open_req lv_fup_lih_hom_req /end OUT_MEASUREMENT
/end FUNCTION
/begin FUNCTION AUX_Crankcase_ventilation_heater_control "_Crankcase ventilation heater control"
 /begin DEF_CHARACTERISTIC c_t_ast_min_rly_crcv_heat c_tia_max_rly_crcv_heat c_tia_hys_rly_crcv_heat /end DEF_CHARACTERISTIC
 /begin OUT_MEASUREMENT lv_rly_crcv_heat /end OUT_MEASUREMENT
/end FUNCTION
/begin FUNCTION AUX_Electr_fuel_pump_control "_Electr_fuel_pump_control"
 /begin DEF_CHARACTERISTIC ip_efppwm_bas_l_pow ip_fac_efppwm_bas_l_pow ip_efppwm_p c_efppwm_min_1 c_efppwm_min_2 c_efppwm_crash c_efppwm_i_min c_efppwm_i_max c_efppwm_i_ad_min c_efppwm_i_ad_max c_efppwm_man_act lc_fup_efp_avl lc_efppwm_i_ad_clr c_tco_max_efppwm_ad c_tco_min_efppwm_ad c_fup_efp_dif_max_efppwm_ad c_efppwm_min_cor c_crlc_efppwm_i_ad c_ctr_seg_efppwm_i_ad_max c_mff_sp_max_efppwm_i_ad c_mff_sp_min_efppwm_i_ad c_mff_sp_max_efppwm_min_ad c_mff_sp_min_efppwm_min_ad c_n_max_efppwm_i_ad c_n_min_efppwm_i_ad c_n_max_efppwm_min_ad c_n_min_efppwm_min_ad c_t_ast_efppwm_min_ad c_efppwm_min_ad_tol c_efppwm_min_ad_ini c_efppwm_deac c_efppwm_acr_test_inc c_fup_rho_fuel_efp ldp_vff_efp_req_ip_efppwm_bas ldp_tfu_efp_ip_fac_efppwm_bas ldp_fup_efp_sp_ip_fac_efppwm c_ctr_seg_efppwm_min_ad_max c_ctr_fup_sp_lim_vff_efp_cor c_fup_sp_dif_lim_vff_efp_cor c_vff_efp_cor_grd_dec c_vff_efp_req_lih c_vff_dif_lim_vff_efp_cor lc_vff_dif_lim_vff_efp_cor_man ip_efppwm_i ldp_fup_efp_dif_ip_efppwm_i ip_efppwm_i_vcv_lih ldp_fup_dif_ip_efppwm_i_vcv_lih ldp_fup_dif_ip_efppwm_p_vcv_lih ip_efppwm_p_vcv_lih ip_fup_efp_sp_cor_vcv_open ldp_fup_efp_dif_ip_efppwm_p ldp_tfu_ip_fup_efp_sp_cor_vcv c_efppwm_lih_add c_efppwm_i_max_lih_hom_vcv_open c_efppwm_i_min_lih_hom_vcv_open c_efppwm_max c_efppwm_min_lih_hom_vcv_open c_fup_efp_grd_max c_fup_efp_sp_max_efppwm_min_ad c_fup_efp_sp_min_efppwm_min_ad /end DEF_CHARACTERISTIC
 /begin OUT_MEASUREMENT efppwm_min_ad efppwm_bas efppwm_i efppwm_i_tmp efppwm_i_ad efppwm_i_ad_dif efppwm_p fup_efp_dif vff_efp_clc fup_efp_grd lv_efppwm_ctl_stop lv_efppwm_ctl_rst lv_efppwm_ad_stop lv_efppwm_min_ad_act ctr_seg_efppwm_min_ad ctr_seg_efppwm_i_ad lv_efppwm_i_ad_vld efppwm lv_efp state_efp lv_efppwm_min_vld lv_fup_efp_lim vff_efp_req vff_efp_cor /end OUT_MEASUREMENT
/end FUNCTION
/begin FUNCTION AUX_Ele_fuel_pump_control_AI "_Ele_fuel_pump_control_AI"
 /begin DEF_CHARACTERISTIC c_vff_efp_add lc_efppwm_man_act c_fup_efp_st_h_min c_fup_efp_mem_l_dif c_tco_mem_fup_efp_l_tol c_tia_fup_efp_l_hys c_t_efp /end DEF_CHARACTERISTIC
 /begin OUT_MEASUREMENT vff_efp_add state_efp_tran t_efp lv_pump_pre_run_stop lv_err_fup_efp_lih fup_efp_stop_h fup_efp_st_h tco_mem_fup_efp_h t_efp_mem_h fup_efp_stop_l fup_efp_tmp_l fup_efp_tmp_h fup_efp_st_l tco_mem_fup_efp_l tco_tmp_l tco_tmp_h t_efp_mem_l t_efp_act_l t_efp_act_h /end OUT_MEASUREMENT
/end FUNCTION
/begin FUNCTION AUX_Fuel_pres_sp_low_pres_pump "_Fuel_pres_sp_low_pres_pump"
 /begin DEF_CHARACTERISTIC c_fup_efp_sp_man c_fup_efp_sp_ext_req c_fup_efp_sp_hpp_lih c_fup_efp_sp_lim_inc c_fup_efp_sp_lim_dec lc_fup_efp_sp_man_act c_fup_efp_sp_puc c_fup_efp_sp_pwl ldp_mff_sp_fup_ctl_ip_efp_sp ldp_n_32_ip_fup_efp_sp ip_fup_efp_sp ldp_tfu_ip_fup_efp_sp ip_fup_efp_sp_min ldpm_mff_sp_fup_ctl_fusl ldp_tco_st_ip_t_fup_efp_sp_hst ip_fup_efp_sp_hst ip_t_fup_efp_sp_hst /end DEF_CHARACTERISTIC
 /begin OUT_MEASUREMENT fup_efp_sp fup_efp_sp_tmp /end OUT_MEASUREMENT
/end FUNCTION
/begin FUNCTION AUX_Active_engine_bracket "_Active engine bracket"
 /begin DEF_CHARACTERISTIC c_n_32_swi_aeb_hom_afl c_n_32_swi_aeb_hom_afs c_n_32_swi_aeb_hys c_n_32_swi_aeb_s c_vs_swi_aeb_hom_afl c_vs_swi_aeb_hom_afs c_vs_swi_aeb_hys c_vs_swi_aeb_s /end DEF_CHARACTERISTIC
/end FUNCTION
/end MODULE
/end PROJECT
/* -------------------------------------------------------------------------
Visu-IT! - Data Declaration System (DDS)
Quality FE<0> NCE<0> E<873> W<4750>
Quantity Maps <3338> Parameter<8338> Axes<2726> Online<21301>
------------------------------------------------------------------------- */
