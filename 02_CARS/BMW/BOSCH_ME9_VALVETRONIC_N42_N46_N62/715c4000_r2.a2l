ASAP2_VERSION 1 3
/begin PROJECT _715C4000_r2 "basisme9"
/begin HEADER "" VERSION "_715C4000_r2" PROJECT_NO _715C4000_r2 /end HEADER
/begin MODULE DIM ""
/begin MOD_COMMON "" BYTE_ORDER MSB_FIRST ALIGNMENT_BYTE 1 ALIGNMENT_WORD 2 ALIGNMENT_LONG 2 ALIGNMENT_FLOAT32_IEEE 4 /end MOD_COMMON
/begin CHARACTERISTIC AIMV "Anzahl Geschwindigkeitsimpulse pro km f¸r Normierung v-Signal" VALUE 0xFC6594 KwWU32 460799999892.71161 aimv_ul_b4p608e11 107.28836062068315 460800000000.00000 FORMAT "%19.6" /end CHARACTERISTIC
/begin CHARACTERISTIC APPTBATINI "Enable Applikation Initwert Batterietemperatur" VALUE 0xFC96E0 KwWU8 255.0 dez 0.00 255.0 FORMAT "%5.1" /end CHARACTERISTIC
/begin CHARACTERISTIC BATTHTAUVG "Zeitkonstante Batterie hinten bei VFZG>" VALUE 0xFC96F0 KwWR32 1.000000000000000 fak_r32_1 0.00 1.000000000000000 FORMAT "%43.41" /end CHARACTERISTIC
/begin CHARACTERISTIC BATTHTAUVK "Zeitkonstante Batterie hinten bei VFZG<" VALUE 0xFC96F4 KwWR32 1.000000000000000 fak_r32_1 0.00 1.000000000000000 FORMAT "%43.41" /end CHARACTERISTIC
/begin CHARACTERISTIC BATTORT0 "Batterieeinbauort No1" VALUE 0xFC96E1 KwWU8 255.0 dez 0.00 255.0 FORMAT "%5.1" /end CHARACTERISTIC
/begin CHARACTERISTIC BATTORT2 "Batterieeinbauort No2" VALUE 0xFC96E2 KwWU8 255.0 dez 0.00 255.0 FORMAT "%5.1" /end CHARACTERISTIC
/begin CHARACTERISTIC BATTVTAUVG "Zeitkonstante Batterie vorne bei VFZG>" VALUE 0xFC96F8 KwWR32 1.000000000000000 fak_r32_1 0.00 1.000000000000000 FORMAT "%43.41" /end CHARACTERISTIC
/begin CHARACTERISTIC BATTVTAUVK "Zeitkonstante Batterie bei VFZG<Zeitkonstante Batterie bei VFZG>" VALUE 0xFC96FC KwWR32 1.000000000000000 fak_r32_1 0.00 1.000000000000000 FORMAT "%43.41" /end CHARACTERISTIC
/begin CHARACTERISTIC BATT_ALFAH "Alphatau-Wert Batterie hinten" VALUE 0xFC9700 KwWR32 0.999990000000000 fak_r32_1 0.000010000000000 1.000000000000000 FORMAT "%43.41" /end CHARACTERISTIC
/begin CHARACTERISTIC BATT_ALFAV "Alphatau-Wert Batterie vorne" VALUE 0xFC9704 KwWR32 0.999990000000000 fak_r32_1 0.000010000000000 1.000000000000000 FORMAT "%43.41" /end CHARACTERISTIC
/begin CHARACTERISTIC BATT_BETAV "Beta-Wert Batterie vorne" VALUE 0xFC9708 KwWR32 0.999990000000000 fak_r32_1 0.000010000000000 1.000000000000000 FORMAT "%43.41" /end CHARACTERISTIC
/begin CHARACTERISTIC BATVFZGTAU "VFZG-Umschaltschwelle TAU Batterie" VALUE 0xFC96E3 KwWU8 318.8 vfzg_ub_q1p25 0.00 318.8 FORMAT "%5.1" /end CHARACTERISTIC
/begin CHARACTERISTIC B_APP_LLAH "" VALUE 0xFC99EF KwWU8 255.0 dez 0.00 255.0 FORMAT "%5.1" /end CHARACTERISTIC
/begin CHARACTERISTIC CFRA "Codewort Adaption Regelhub in LR" VALUE 0xFC6A88 KwUb 255.0 dez 0.00 255.0 FORMAT "%5.1" /end CHARACTERISTIC
/begin CHARACTERISTIC CNFKUPPL "Konfigurationsflag f¸r die Auswertung des Kuplg.schalters in der LLR" VALUE 0xFC6C14 KwUb 255.0 dez 0.00 255.0 FORMAT "%5.1" /end CHARACTERISTIC
/begin CHARACTERISTIC CWBATTCOD "" VALUE 0xFC96E4 KwWU8 1.000 DEZ 0.00 1.000 FORMAT "%5.3" /end CHARACTERISTIC
/begin CHARACTERISTIC CWDLRIKL "" VALUE 0xFC643C KwUb 255.0 dez 0.00 255.0 FORMAT "%5.1" /end CHARACTERISTIC
/begin CHARACTERISTIC CWKTM "Codewort zur Steuerung KTM" VALUE 0xFC52AC KwWU16 65535.00 default 0.00 65535.00 FORMAT "%8.2" /end CHARACTERISTIC
/begin CHARACTERISTIC CWLAKH "" VALUE 0xFCE60C KwUb 255.0 dez 0.00 255.0 FORMAT "%5.1" /end CHARACTERISTIC
/begin CHARACTERISTIC CWLAMBTS "Codewort: Lambda Bauteileschutz" VALUE 0xFCDC3C KwUb 255.0 dez 0.00 255.0 FORMAT "%5.1" /end CHARACTERISTIC
/begin CHARACTERISTIC CWLAMKH "Codewort Lambdakoordination bei Kat-heizen" VALUE 0xFC5456 KwUb 255.0 dez 0.00 255.0 FORMAT "%5.1" /end CHARACTERISTIC
/begin CHARACTERISTIC CWLLRMR "Codewort f¸r LLR-Momentenreserve" VALUE 0xFC6DA0 KwUb 255.0 dez 0.00 255.0 FORMAT "%5.1" /end CHARACTERISTIC
/begin CHARACTERISTIC CW_KRRA "Codewort zur Umschaltung der Fr¸hverstellung" VALUE 0xFC67E9 KwUb 255.0 dez 0.00 255.0 FORMAT "%5.1" /end CHARACTERISTIC
/begin CHARACTERISTIC DANTGESWNV "Schwelle Aktivierung D-Anteil (Geschwindigkeit) im unverst‰rkten Bereich" VALUE 0xFC64EE KwSw 1599.976 relDK_q0p02441 -800.0000 799.9756 FORMAT "%8.4" /end CHARACTERISTIC
/begin CHARACTERISTIC DANTGESWV "Schwelle Aktivierung D-Anteil (Geschwindigkeit) im verst‰rkten Bereich" VALUE 0xFC64F0 KwSw 1599.976 relDK_q0p02441 -800.0000 799.9756 FORMAT "%8.4" /end CHARACTERISTIC
/begin CHARACTERISTIC DANTSCHWNV "Schwelle Aktivierung D-Anteil (Abweichung) im unverst‰rkten Bereich" VALUE 0xFC64F2 KwSw 1599.976 relDK_q0p02441 -800.0000 799.9756 FORMAT "%8.4" /end CHARACTERISTIC
/begin CHARACTERISTIC DANTSCHWV "Schwelle Aktivierung D-Anteil (Abweichung) im verst‰rkten Bereich" VALUE 0xFC64F4 KwSw 1599.976 relDK_q0p02441 -800.0000 799.9756 FORMAT "%8.4" /end CHARACTERISTIC
/begin CHARACTERISTIC DFMODE "DF-Mode-Schalter themermisch/elektrisch" VALUE 0xFC99EA KwWU8 255.0 dez 0.00 255.0 FORMAT "%5.1" /end CHARACTERISTIC
/begin CHARACTERISTIC DFRMN "Min. Lambda-Abweichung f¸r Bestimmung Station‰rbedingung und ‹K-Adaption" VALUE 0xFC6ABC KwSw 1.999969 fak_sw_b1 -1.000000 0.9999695 FORMAT "%8.6" /end CHARACTERISTIC
/begin CHARACTERISTIC DFRSPS "Hub des Lambda-Regelfaktors (Sollwert)" VALUE 0xFC6ABE KwSw 1.999969 fak_sw_b1 -1.000000 0.9999695 FORMAT "%8.6" /end CHARACTERISTIC
/begin CHARACTERISTIC DFS_MAX "DF-Auslastung Maximalschwelle" VALUE 0xFC99EB KwWU8 99.61 PCENT 0.00 99.61 FORMAT "%5.2" /end CHARACTERISTIC
/begin CHARACTERISTIC DFS_MIN "DF-Auslastung Minimalschwelle" VALUE 0xFC99EC KwWU8 99.61 PCENT 0.00 99.61 FORMAT "%5.2" /end CHARACTERISTIC
/begin CHARACTERISTIC DFS_MITT "DF-Auslastung Mittelschwelle" VALUE 0xFC99ED KwWU8 99.61 PCENT 0.00 99.61 FORMAT "%5.2" /end CHARACTERISTIC
/begin CHARACTERISTIC DKLAGERT "zul‰ssige Fehlerzeit f¸r DK-Soll-/Istvergleich" VALUE 0xFC643D KwUb 5.100 t20msxs_ub_b5p1 0.00 5.100 FORMAT "%5.3" /end CHARACTERISTIC
/begin CHARACTERISTIC DLBTS "Delta Lambdasoll f¸r Bauteileschutz" CURVE 0xFCDDD0 KlAUbSstUbWSb 1.000 fak_sb_b1 -1.000 0.00 FORMAT "%5.3"
 /begin AXIS_DESCR STD_AXIS detazwbs rel_ub_b127p5 8 0.00 127.5 FORMAT "%5.1" DEPOSIT ABSOLUTE /end AXIS_DESCR
/end CHARACTERISTIC
/begin CHARACTERISTIC DLRDWDKSS1 "DLR, obere Grenze zur Parameterumschaltung" VALUE 0xFC64F6 KwSw 99.99847 relDK_q0p00152 -50.00000 49.99847 FORMAT "%8.5" /end CHARACTERISTIC
/begin CHARACTERISTIC DLRDWDKSS2 "DLR, untere Grenze zur Parameterumschaltung" VALUE 0xFC64F8 KwSw 99.99847 relDK_q0p00152 -50.00000 49.99847 FORMAT "%8.5" /end CHARACTERISTIC
/begin CHARACTERISTIC DLRHAFTMN "min. notwendiger I-Anteil im Haftreibunsfall" VALUE 0xFCE346 KwSw 100.0000 rel_q0p1957 -100.0000 0.00 FORMAT "%8.4" /end CHARACTERISTIC
/begin CHARACTERISTIC DLRHAFTST "max. Sollwertgradient zur Aktivierung der Haftreibunsroutine" VALUE 0xFCE348 KwSw 99.99847 relDK_q0p00152 -50.00000 49.99847 FORMAT "%8.5" /end CHARACTERISTIC
/begin CHARACTERISTIC DLRIAMAXA "maximal zul‰ssiger I-Anteil" VALUE 0xFC64FA KwUw 100.0000 rel_q0p1957 0.00 100.0000 FORMAT "%8.4" /end CHARACTERISTIC
/begin CHARACTERISTIC DLRIKLPAR "DLR, I-Klein Parameter" VALUE 0xFC643E KwUb 15.94 relDK_q0p0625 0.00 15.94 FORMAT "%5.2" /end CHARACTERISTIC
/begin CHARACTERISTIC DLRININI "I-Anteil bei Inititialisierung der NLP-Funktion" VALUE 0xFC64FC KwUw 100.0000 relDK_q0p1957 0.00 100.0000 FORMAT "%8.4" /end CHARACTERISTIC
/begin CHARACTERISTIC DLRKDONLP0 "DLR, D-Parameter ¸ber NLP" VALUE 0xFC643F KwUb 1020. relDK_q4 0.00 1020. FORMAT "%5.0" /end CHARACTERISTIC
/begin CHARACTERISTIC DLRKDUNLP0 "DLR, D-Parameter unter NLP (schwach)" VALUE 0xFC6440 KwUb 1020. relDK_q4 0.00 1020. FORMAT "%5.0" /end CHARACTERISTIC
/begin CHARACTERISTIC DLRKDUNLP1 "DLR, D-Parameter unter NLP (mittel)" VALUE 0xFC6441 KwUb 1020. relDK_q4 0.00 1020. FORMAT "%5.0" /end CHARACTERISTIC
/begin CHARACTERISTIC DLRKDUNLP2 "DLR, D-Parameter unter NLP (stark)" VALUE 0xFC6442 KwUb 1020. relDK_q4 0.00 1020. FORMAT "%5.0" /end CHARACTERISTIC
/begin CHARACTERISTIC DLRKDUNLP3 "DLR, D-Parameter unter NLP (unverst‰rktes Poti)" VALUE 0xFC6443 KwUb 1020. relDK_q4 0.00 1020. FORMAT "%5.0" /end CHARACTERISTIC
/begin CHARACTERISTIC DLRKIONLP0 "I-Anteil als f(abs(dwdkdlr_w)), ¸ber NLP" VAL_BLK 0xFC6444 KwbUb 15.94 relDK_q0p0625 0.00 15.94 FORMAT "%5.2" NUMBER 32 /end CHARACTERISTIC
/begin CHARACTERISTIC DLRKIUNLP0 "I-Anteil als f(abs(dwdkdlr_w)), unter NLP (schwach)" VAL_BLK 0xFC6464 KwbUb 15.94 relDK_q0p0625 0.00 15.94 FORMAT "%5.2" NUMBER 32 /end CHARACTERISTIC
/begin CHARACTERISTIC DLRKIUNLP1 "I-Anteil als f(abs(dwdkdlr_w)), unter NLP (mittel)" VAL_BLK 0xFC6484 KwbUb 15.94 relDK_q0p0625 0.00 15.94 FORMAT "%5.2" NUMBER 32 /end CHARACTERISTIC
/begin CHARACTERISTIC DLRKIUNLP2 "I-Anteil als f(abs(dwdkdlr_w)), unter NLP (stark)" VAL_BLK 0xFC64A4 KwbUb 15.94 relDK_q0p0625 0.00 15.94 FORMAT "%5.2" NUMBER 32 /end CHARACTERISTIC
/begin CHARACTERISTIC DLRKIUNLP3 "I-Anteil als f(abs(dwdkdlr_w)), unter NLP (stark)" VAL_BLK 0xFC64C4 KwbUb 15.94 relDK_q0p0625 0.00 15.94 FORMAT "%5.2" NUMBER 32 /end CHARACTERISTIC
/begin CHARACTERISTIC DLRKPONLP0 "DLR, P-Parameter ¸ber NLP" VALUE 0xFC64E4 KwUb 255.0 relDK_q1 0.00 255.0 FORMAT "%5.1" /end CHARACTERISTIC
/begin CHARACTERISTIC DLRKPUNLP0 "DLR, P-Parameter unter NLP (schwach)" VALUE 0xFC64E5 KwUb 255.0 relDK_q1 0.00 255.0 FORMAT "%5.1" /end CHARACTERISTIC
/begin CHARACTERISTIC DLRKPUNLP1 "DLR, P-Parameter unter NLP (mittel)" VALUE 0xFC64E6 KwUb 255.0 relDK_q1 0.00 255.0 FORMAT "%5.1" /end CHARACTERISTIC
/begin CHARACTERISTIC DLRKPUNLP2 "DLR, P-Parameter unter NLP (stark)" VALUE 0xFC64E7 KwUb 255.0 relDK_q1 0.00 255.0 FORMAT "%5.1" /end CHARACTERISTIC
/begin CHARACTERISTIC DLRKPUNLP3 "DLR, P-Parameter unter NLP (unverst‰rktes Poti)" VALUE 0xFC64E8 KwUb 255.0 relDK_q1 0.00 255.0 FORMAT "%5.1" /end CHARACTERISTIC
/begin CHARACTERISTIC DLRKREIS "DLR, Faktor Kreisverst‰rkung" VALUE 0xFCE33E KwUb 1.992 fak_ub_b2 0.00 1.992 FORMAT "%5.3" /end CHARACTERISTIC
/begin CHARACTERISTIC DLRKREISST "DLR, Faktor Kreisverst‰rkung zur Zeit des Motorstarts" VALUE 0xFCE33F KwUb 1.992 fak_ub_b2 0.00 1.992 FORMAT "%5.3" /end CHARACTERISTIC
/begin CHARACTERISTIC DLRNLPD "Unsch‰rfebereich f¸r DK-Notluftposition" VALUE 0xFC64FE KwUw 100.0000 relDK_uw_b100 0.00 100.0000 FORMAT "%8.4" /end CHARACTERISTIC
/begin CHARACTERISTIC DLRPID0T "Fehlerzeit f¸r DLR-Stellbereich im Anschlag zur erweiterten Stellertauscherkenng" VALUE 0xFC6500 KwUw 655.3500 t10msxs_uw_b655p35 0.00 655.3500 FORMAT "%8.4" /end CHARACTERISTIC
/begin CHARACTERISTIC DLRPID1T "zul‰ssige Fehlerzeit 1 f¸r DLR-Stellbereich am Anschlag" VALUE 0xFC6502 KwUw 655.3500 t10msxs_uw_b655p35 0.00 655.3500 FORMAT "%8.4" /end CHARACTERISTIC
/begin CHARACTERISTIC DLRPID2T "zul‰ssige Fehlerzeit 2 f¸r DLR-Stellbereich am Anschlag" VALUE 0xFC6504 KwUw 655.3500 t10msxs_uw_b655p35 0.00 655.3500 FORMAT "%8.4" /end CHARACTERISTIC
/begin CHARACTERISTIC DLRPIDMAX "max. zul‰ssiges PWM-Tastverh‰ltnis f¸r DLR" VALUE 0xFC6506 KwUw 99.99847 rel_uw_b100 0.00 99.99847 FORMAT "%8.5" /end CHARACTERISTIC
/begin CHARACTERISTIC DLRPIDMIN "min. zul‰ssiges PWM-Tastverh‰ltnis f¸r DLR" VALUE 0xFC6508 KwUw 99.99847 rel_uw_b100 0.00 99.99847 FORMAT "%8.5" /end CHARACTERISTIC
/begin CHARACTERISTIC DLRUBSOLL "DLR, Batterie Normalspannung" VALUE 0xFCE340 KwUb 24.02 spg_ubatt 0.00 24.02 FORMAT "%5.2" /end CHARACTERISTIC
/begin CHARACTERISTIC DLRUMABAND "Unsicherheitsband bei Sprung aus UMA-Bereich" VALUE 0xFC650A KwUw 4.882813 relDK_q0p02441 0.00 4.882813 FORMAT "%8.6" /end CHARACTERISTIC
/begin CHARACTERISTIC DLRUMAIINI "Vorladewert I-Anteil bei Sprung aus UMA-Bereich" VALUE 0xFC650C KwSw 12824.85 relDK_q0p1957 -6412.524 6412.329 FORMAT "%8.3" /end CHARACTERISTIC
/begin CHARACTERISTIC DMLLRIMXN "Sicherheitskonzept: obere Begrenzung f¸r dmllri" CURVE 0xFC6C98 GklWUb 99.61 rel_ub_b99p6 0.00 99.61 FORMAT "%5.2"
 /begin AXIS_DESCR COM_AXIS nmot nmot_ub_q40 6 0.00 10200. FORMAT "%5.0" AXIS_PTS_REF SNM06LLUB /end AXIS_DESCR
/end CHARACTERISTIC
/begin CHARACTERISTIC DMLLRMN "Untere Begrenzung f¸r dmllr_w" VALUE 0xFC6D70 KwSw 199.9969 rel_sw_b100 -100.0000 99.99695 FORMAT "%8.4" /end CHARACTERISTIC
/begin CHARACTERISTIC DMLLRMXN "Sicherheitskonzept: obere Begrenzung f¸r dmllr" CURVE 0xFC6CA0 GklWUb 99.61 rel_ub_b99p6 0.00 99.61 FORMAT "%5.2"
 /begin AXIS_DESCR COM_AXIS nmot nmot_ub_q40 6 0.00 10200. FORMAT "%5.0" AXIS_PTS_REF SNM06LLUB /end AXIS_DESCR
/end CHARACTERISTIC
/begin CHARACTERISTIC DMLLRZMN "untere Begrenzung f¸r dmllrz_w" VALUE 0xFC6D72 KwSw 199.9969 rel_sw_b100 -100.0000 99.99695 FORMAT "%8.4" /end CHARACTERISTIC
/begin CHARACTERISTIC DMLLRZMXN "obere Begrenzung f¸r dmllrz_w" CURVE 0xFC6CA8 GklWUb 99.61 rel_ub_b99p6 0.00 99.61 FORMAT "%5.2"
 /begin AXIS_DESCR COM_AXIS nmot nmot_ub_q40 6 0.00 10200. FORMAT "%5.0" AXIS_PTS_REF SNM06LLUB /end AXIS_DESCR
/end CHARACTERISTIC
/begin CHARACTERISTIC DMRESFS "LLR: Abbaugeschwindigkeit der erhˆhten Drehmomentreserve" VALUE 0xFC6DA1 KwUb 4.845 relgrad_20ms_qn0p019 -4.845 0.00 FORMAT "%5.3" /end CHARACTERISTIC
/begin CHARACTERISTIC DMRESLL "LLR: Abbaugeschwindigkeit der erhˆhten Drehmomentreserve" VALUE 0xFC6DA2 KwUb 4.845 relgrad_20ms_qn0p019 -4.845 0.00 FORMAT "%5.3" /end CHARACTERISTIC
/begin CHARACTERISTIC DMRESLW "Momentenreserve bei Servolenkung" CURVE 0xFC6E0E KlAUwSstSwWUw 24.99765 rel_q0p09726 0.00 24.99765 FORMAT "%8.5"
 /begin AXIS_DESCR STD_AXIS lws_w lws_q0p04375 7 -1433.600 1433.556 FORMAT "%8.3" DEPOSIT ABSOLUTE /end AXIS_DESCR
/end CHARACTERISTIC
/begin CHARACTERISTIC DNLLR "Drehzahlband oberhalb nstat f¸r LLR-Freigabe" VALUE 0xFC6C15 KwUb 2550. nmot_ub_q10 0.00 2550. FORMAT "%5.0" /end CHARACTERISTIC
/begin CHARACTERISTIC DNLLRES "LLR: Unterdrehzahlschwelle zur Erhˆhung der Momentenreserve im LL" VALUE 0xFC6DA3 KwSb 2550. nmotd_sb_q10 -1280. 1270. FORMAT "%5.0" /end CHARACTERISTIC
/begin CHARACTERISTIC DNMNI "Kleinstmˆglicher Wert f¸r dn beim I-Anteil" VALUE 0xFC6CAE KwSb 2550. nmotd_sb_q10 -1280. 1270. FORMAT "%5.0" /end CHARACTERISTIC
/begin CHARACTERISTIC DNSNFX "Offset zur Bestimmung der oberen Grenze f¸r die Solldrehzahlnachf¸hrung" VALUE 0xFC6C5A KwUb 2550. nmot_ub_q10 0.00 2550. FORMAT "%5.0" /end CHARACTERISTIC
/begin CHARACTERISTIC DTANSKOR "Ansaugluftmodelloffset Aussentemperatur" VALUE 0xFC96E5 KwWS8 255.0 temp_q1 -128.0 127.0 FORMAT "%5.1" /end CHARACTERISTIC
/begin CHARACTERISTIC DTBTS "Temperaturhysterese f¸r Bauteileschutz" VALUE 0xFCDDE2 KwUw 1279.980 temp_uw_q0p0195 0.00 1279.980 FORMAT "%8.3" /end CHARACTERISTIC
/begin CHARACTERISTIC DVEEST "Zeit f¸r Heilungsversuch der DV-E-Endstufe" VALUE 0xFC64E9 KwUb 2.550 t10msxs_ub_b2p55 0.00 2.550 FORMAT "%5.3" /end CHARACTERISTIC
/begin CHARACTERISTIC DVNG "LLR: D-Verst‰rkung abh. von ngfil bei stehendem Fahrzeug" CURVE 0xFC6CB0 GklWUb 0.1245 rel_ub_bn0p125 -0.1245 0.00 FORMAT "%6.4"
 /begin AXIS_DESCR COM_AXIS ngfil nmotg_sb_q100 6 -12800. 12700. FORMAT "%5.0" AXIS_PTS_REF SNG06LLSB /end AXIS_DESCR
/end CHARACTERISTIC
/begin CHARACTERISTIC DVNGV "LLR: D-Verst‰rkung abh. von ngfil bei roolendem Fahrzeug" CURVE 0xFC6CB8 GklWUb 0.9961 fak_ub_b1 0.00 0.9961
 /begin AXIS_DESCR COM_AXIS ngfil nmotg_sb_q100 6 -12800. 12700. FORMAT "%5.0" AXIS_PTS_REF SNG06LLSB /end AXIS_DESCR
/end CHARACTERISTIC
/begin CHARACTERISTIC DVZNG "LLR: D-Z¸ndungsanteil abh. vom ngfil bei stehendem Fzg." CURVE 0xFC6CC0 GklWUb 0.1245 rel_ub_bn0p125 -0.1245 0.00 FORMAT "%6.4"
 /begin AXIS_DESCR COM_AXIS ngfil nmotg_sb_q100 6 -12800. 12700. FORMAT "%5.0" AXIS_PTS_REF SNG06LLSB /end AXIS_DESCR
/end CHARACTERISTIC
/begin CHARACTERISTIC DVZNGT "" CURVE 0xFC6CC8 GklWUb 0.1245 rel_ub_bn0p125 -0.1245 0.00 FORMAT "%6.4"
 /begin AXIS_DESCR COM_AXIS ngfil nmotg_sb_q100 6 -12800. 12700. FORMAT "%5.0" AXIS_PTS_REF SNG06LLTSB /end AXIS_DESCR
/end CHARACTERISTIC
/begin CHARACTERISTIC DVZNGV "LLR: D-Z¸ndungsanteil abh. vom ngfil bei rollendem Fzg." CURVE 0xFC6CD0 GklWUb 0.9961 fak_ub_b1 0.00 0.9961
 /begin AXIS_DESCR COM_AXIS ngfil nmotg_sb_q100 6 -12800. 12700. FORMAT "%5.0" AXIS_PTS_REF SNG06LLSB /end AXIS_DESCR
/end CHARACTERISTIC
/begin CHARACTERISTIC DVZNGVT "" CURVE 0xFC6CD8 GklWUb 0.9961 fak_ub_b1 0.00 0.9961
 /begin AXIS_DESCR COM_AXIS ngfil nmotg_sb_q100 6 -12800. 12700. FORMAT "%5.0" AXIS_PTS_REF SNG06LLTSB /end AXIS_DESCR
/end CHARACTERISTIC
/begin CHARACTERISTIC DWDKSBAMX "max. Soll-/Ist-DK-Winkel-Abweichung als f(dwdks)" CURVE 0xFC650E KlAUwSstUwWUw 100.0000 relDK_uw_b100 0.00 100.0000 FORMAT "%8.4"
 /begin AXIS_DESCR STD_AXIS gwdk_kge relDK_q0p00152 5 0.00 99.99847 FORMAT "%8.5" DEPOSIT ABSOLUTE /end AXIS_DESCR
/end CHARACTERISTIC
/begin CHARACTERISTIC DWDKSIKLS "Schwelle zur Aktivierung des I-Kleinanteils" VALUE 0xFC6524 KwSw 1599.976 relDK_q0p02441 -800.0000 799.9756 FORMAT "%8.4" /end CHARACTERISTIC
/begin CHARACTERISTIC DWEKSN "delta Winkel Ersatz-Klopfsensor" CURVE 0xFC67C8 KlAxU8SstxU8WU8 191.3 zw_ub_qn0p75 -191.3 0.00 FORMAT "%5.1"
 /begin AXIS_DESCR STD_AXIS nmot nmot_ub_q40 8 0.00 10200. FORMAT "%5.0" DEPOSIT ABSOLUTE /end AXIS_DESCR
/end CHARACTERISTIC
/begin CHARACTERISTIC DWKRMSN "delta Winkel KR Abstand zur gemittelten Sp‰tverstellung" CURVE 0xFCEC14 KlAUbSstUbWUb 191.3 zw_ub_qn0p75 -191.3 0.00 FORMAT "%5.1"
 /begin AXIS_DESCR STD_AXIS nmot nmot_ub_q40 16 0.00 10200. FORMAT "%5.0" DEPOSIT ABSOLUTE /end AXIS_DESCR
/end CHARACTERISTIC
/begin CHARACTERISTIC ENAPPLGOFF "Enable Generatorauschaltsteuerung" VALUE 0xFC9A8A KwWU8 255.0 dez 0.00 255.0 FORMAT "%5.1" /end CHARACTERISTIC
/begin CHARACTERISTIC ENAPPLRESP "Enable Handsteuerung Loadresponse" VALUE 0xFC9A8B KwWU8 255.0 dez 0.00 255.0 FORMAT "%5.1" /end CHARACTERISTIC
/begin CHARACTERISTIC ETADZW "ZW-Wirkungsgrad in Abh‰ngigkeit von delta ZW" CURVE 0xFC52B4 FklWUb 127.5 rel_ub_b127p5 0.00 127.5 FORMAT "%5.1"
 /begin AXIS_DESCR FIX_AXIS dzwg zw_sb_q0p75 128 0.00 95.25 FORMAT "%5.2" FIX_AXIS_PAR 0 0 128 /end AXIS_DESCR
/end CHARACTERISTIC
/begin CHARACTERISTIC FBSTABGM "Faktor Bauteileschutz abh‰ngig von model. Abgastemperatur" CURVE 0xFC5444 KlAUwSstUwWUw 1.999969 fak_uw_b2 0.00 1.999969 FORMAT "%8.6"
 /begin AXIS_DESCR STD_AXIS tabgm_w temp_uw_q0p0195_o50 4 -50.00000 1229.980 FORMAT "%8.3" DEPOSIT ABSOLUTE /end AXIS_DESCR
/end CHARACTERISTIC
/begin CHARACTERISTIC FDDN "LLR: Gewichtungsfaktor f¸r D-Verst‰rkung" CURVE 0xFC6CE0 GklWUb 0.9961 fak_ub_b1 0.00 0.9961
 /begin AXIS_DESCR COM_AXIS dns nmotd_sb_q10 6 -1280. 1270. FORMAT "%5.0" AXIS_PTS_REF SNS06LLSB /end AXIS_DESCR
/end CHARACTERISTIC
/begin CHARACTERISTIC FDDZN "LLR: Gewichtungsfaktor f¸r D-Z¸ndungsanteil" CURVE 0xFC6CE8 GklWUb 0.9961 fak_ub_b1 0.00 0.9961
 /begin AXIS_DESCR COM_AXIS dns nmotd_sb_q10 6 -1280. 1270. FORMAT "%5.0" AXIS_PTS_REF SNS06LLSB /end AXIS_DESCR
/end CHARACTERISTIC
/begin CHARACTERISTIC FDDZNT "" CURVE 0xFC6CF0 GklWUb 0.9961 fak_ub_b1 0.00 0.9961
 /begin AXIS_DESCR COM_AXIS dns nmotd_sb_q10 6 -1280. 1270. FORMAT "%5.0" AXIS_PTS_REF SNS06LLTSB /end AXIS_DESCR
/end CHARACTERISTIC
/begin CHARACTERISTIC FFRITMS "Faktor f¸r I-Dynamik des Lambdareglers in Abh‰ngigkeit von tmst" CURVE 0xFCEF20 KlAUbSstUbWUb 0.9961 fak_ub_b1 0.00 0.9961
 /begin AXIS_DESCR STD_AXIS tmst temp_ub_q0p75_o48 4 -48.00 143.3 FORMAT "%5.1" DEPOSIT ABSOLUTE /end AXIS_DESCR
/end CHARACTERISTIC
/begin CHARACTERISTIC FHOGNMN "" VALUE 0xFC9A8C KwWU8 3.984 fak_ub_b4 0.00 3.984 FORMAT "%5.3" /end CHARACTERISTIC
/begin CHARACTERISTIC FKVAUM "Umrechnungsfaktor Einspritzzeit in Kraftstoffverbrauch" VALUE 0xFCC432 KwWU16 312.5000 tefuel_uw_b312p5 0.00 312.5000 FORMAT "%8.4" /end CHARACTERISTIC
/begin CHARACTERISTIC FLRFKATE "Gewichtung des Adaptionswertes fkatei aus %TEB zur Anpassung der Reglerparameter" CURVE 0xFC6AC0 KlAUbSstSbWUb 1.992 fak_ub_b2 0.00 1.992 FORMAT "%5.3"
 /begin AXIS_DESCR STD_AXIS fkatei fak_sb_b1 5 -1.000 0.9922 FORMAT "%5.3" DEPOSIT ABSOLUTE /end AXIS_DESCR
/end CHARACTERISTIC
/begin CHARACTERISTIC FLRM "Faktor f¸r I-Dynamik des Lambdareglers in Abh‰ngigkeit von tmot" CURVE 0xFC6A8C KlAUbSstUbWUb 3.984 fak_ub_b4 0.00 3.984 FORMAT "%5.3"
 /begin AXIS_DESCR STD_AXIS tmot temp_ub_q0p75_o48 5 -48.00 143.3 FORMAT "%5.1" DEPOSIT ABSOLUTE /end AXIS_DESCR
/end CHARACTERISTIC
/begin CHARACTERISTIC FNSNF "Faktor f¸r Solldrehzahlnachf¸hrung" VALUE 0xFC6C5B KwUb 0.9961 rel_ub_b1p0 0.00 0.9961 /end CHARACTERISTIC
/begin CHARACTERISTIC FNSNFT "Faktor f¸r Solldrehzahlnachf¸hrung gedrosselt" VALUE 0xFC6C5C KwUb 0.9961 rel_ub_b1p0 0.00 0.9961 /end CHARACTERISTIC
/begin CHARACTERISTIC FNSSTM "Faktor zur Wichtung der Solldrehzahl im Start" CURVE 0xFCF274 KlAUbSstUbWUb 1.992 fak_ub_b2 0.00 1.992 FORMAT "%5.3"
 /begin AXIS_DESCR STD_AXIS tmot temp_ub_q0p75_o48 6 -48.00 143.3 FORMAT "%5.1" DEPOSIT ABSOLUTE /end AXIS_DESCR
/end CHARACTERISTIC
/begin CHARACTERISTIC FNSSTMT "Faktor zur Wichtung der Solldrehzahl im Start gedrosselt" CURVE 0xFCF284 KlAUbSstUbWUb 1.992 fak_ub_b2 0.00 1.992 FORMAT "%5.3"
 /begin AXIS_DESCR STD_AXIS tmot temp_ub_q0p75_o48 6 -48.00 143.3 FORMAT "%5.1" DEPOSIT ABSOLUTE /end AXIS_DESCR
/end CHARACTERISTIC
/begin CHARACTERISTIC FRIPDSL1 "Faktor zur Verstellung von fri und frp w‰hrend Phase1 in DSLSLR aktiv" VALUE 0xFC6A97 KwUb 3.984 fak_ub_b4 0.00 3.984 FORMAT "%5.3" /end CHARACTERISTIC
/begin CHARACTERISTIC FRIPDSL4 "Faktor zur Verstellung von fri und frp w‰hrend Phase 4 in DSLSLR aktiv" VALUE 0xFC6A98 KwUb 3.984 fak_ub_b4 0.00 3.984 FORMAT "%5.3" /end CHARACTERISTIC
/begin CHARACTERISTIC FRIPDTES "Faktor zur Verstellung von fri und frp w‰hrend DTEV aktiv" VALUE 0xFC6A99 KwUb 3.984 fak_ub_b4 0.00 3.984 FORMAT "%5.3" /end CHARACTERISTIC
/begin CHARACTERISTIC FRIPTES "Faktor zur Verstellung von fri und frp bei Fehler ""offenes TEV klemmt""" VALUE 0xFC6A9A KwUb 3.984 fak_ub_b4 0.00 3.984 FORMAT "%5.3" /end CHARACTERISTIC
/begin CHARACTERISTIC FRMAX "obere Regelbereichsgrenze" VALUE 0xFC6ACC KwUw 1.999969 fak_uw_b2 0.00 1.999969 FORMAT "%8.6" /end CHARACTERISTIC
/begin CHARACTERISTIC FRMINSLS "Minimaler Lambdaregelfaktor w‰hrend Phase 1 der Sekund‰rluftdiagnose" VALUE 0xFCF032 KwUw 1.999969 fak_uw_b2 0.00 1.999969 FORMAT "%8.6" /end CHARACTERISTIC
/begin CHARACTERISTIC FRMINSLSK "Minimaler Lambdaregelfaktor w‰hrend Phase 1 Kurtztest  Sekund‰rluftdiagnose" VALUE 0xFCF034 KwUw 1.999969 fak_uw_b2 0.00 1.999969 FORMAT "%8.6" /end CHARACTERISTIC
/begin CHARACTERISTIC FRTEMX "obere Regelbereichsgrenze bei Fehler ""offen klemmendes TEV""" VALUE 0xFC6ACE KwUw 1.999969 fak_uw_b2 0.00 1.999969 FORMAT "%8.6" /end CHARACTERISTIC
/begin CHARACTERISTIC FWVFZG "" VALUE 0xFC6C96 KwUw 511.9922 vfzg_uw_b512 0.00 511.9922 FORMAT "%8.4" /end CHARACTERISTIC
/begin CHARACTERISTIC GENLDDFMAX "Schwell Anzeige maximaler Auslastungsgrad Generator" VALUE 0xFC99EE KwWU8 99.61 PCENT 0.00 99.61 FORMAT "%5.2" /end CHARACTERISTIC
/begin CHARACTERISTIC GENLLAHAPP "" VALUE 0xFC99F0 KwWU8 255.0 dez 0.00 255.0 FORMAT "%5.1" /end CHARACTERISTIC
/begin CHARACTERISTIC ILMINUMG "integrierte Lufmassenschwelle Aussentemperaturmodell" VALUE 0xFC96E6 KwWU8 23.21 m_ub_b23p3 0.00 23.21 FORMAT "%5.2" /end CHARACTERISTIC
/begin CHARACTERISTIC IMLLASKH "imlpr-Schwelle f¸r ‹bergang auf Lambda-Abgas-Vorgabe" VALUE 0xFCE60D KwUb 0.9961 fak_ub_b1 0.00 0.9961 /end CHARACTERISTIC
/begin CHARACTERISTIC IVDN "LLR: I-Verst‰rkung bei stehendem Fahrzeug" CURVE 0xFC6CF8 GklWUb 0.9961 rel_ub_b1p0 0.00 0.9961
 /begin AXIS_DESCR COM_AXIS dn_w nmotd_sw_q0p25 8 -8192.000 8191.750 FORMAT "%8.3" AXIS_PTS_REF SDN08LLSW /end AXIS_DESCR
/end CHARACTERISTIC
/begin CHARACTERISTIC IVDNT "" CURVE 0xFC6D00 GklWUb 0.9961 rel_ub_b1p0 0.00 0.9961
 /begin AXIS_DESCR COM_AXIS dn_w nmotd_sw_q0p25 8 -8192.000 8191.750 FORMAT "%8.3" AXIS_PTS_REF SDN08LLTSW /end AXIS_DESCR
/end CHARACTERISTIC
/begin CHARACTERISTIC IVDNTV "" CURVE 0xFC6D08 GklWUb 0.9961 rel_ub_b1p0 0.00 0.9961
 /begin AXIS_DESCR COM_AXIS dn_w nmotd_sw_q0p25 8 -8192.000 8191.750 FORMAT "%8.3" AXIS_PTS_REF SDN08LLTSW /end AXIS_DESCR
/end CHARACTERISTIC
/begin CHARACTERISTIC IVDNV "LLR: I-Verst‰rkung bei rollendem Fahrzeug" CURVE 0xFC6D10 GklWUb 0.9961 rel_ub_b1p0 0.00 0.9961
 /begin AXIS_DESCR COM_AXIS dn_w nmotd_sw_q0p25 8 -8192.000 8191.750 FORMAT "%8.3" AXIS_PTS_REF SDN08LLSW /end AXIS_DESCR
/end CHARACTERISTIC
/begin CHARACTERISTIC KDLRIDDVE "Identifizierung des DLR-Parametersatzes zu DV-E-Typ" VALUE 0xFCE341 KwUb 255.0 dez 0.00 255.0 FORMAT "%5.1" /end CHARACTERISTIC
/begin CHARACTERISTIC KFFDLBTS "Faktor Delta Lambdasoll f¸r Bauteileschutz" MAP 0xFCDC40 GkfWUb 1.992 fak_ub_b2 0.00 1.992 FORMAT "%5.3"
 /begin AXIS_DESCR COM_AXIS rl rel_ub_q0p75 12 0.00 191.3 FORMAT "%5.1" AXIS_PTS_REF SRL12GKUB /end AXIS_DESCR
 /begin AXIS_DESCR COM_AXIS nmot nmot_ub_q40 16 0.00 10200. FORMAT "%5.0" AXIS_PTS_REF SNM16GKUB /end AXIS_DESCR
/end CHARACTERISTIC
/begin CHARACTERISTIC KFFRMIN "untere Regelbereichsgrenze" MAP 0xFCF036 KfAxUbAyUbSstxUbSstyUwWUw 1.999969 fak_uw_b2 0.00 1.999969 FORMAT "%8.6"
 /begin AXIS_DESCR STD_AXIS tmot temp_ub_q0p75_o48 5 -48.00 143.3 FORMAT "%5.1" DEPOSIT ABSOLUTE /end AXIS_DESCR
 /begin AXIS_DESCR STD_AXIS tnst_w t10msxs_uw_b655p35 5 0.00 655.3500 FORMAT "%8.4" DEPOSIT ABSOLUTE /end AXIS_DESCR
/end CHARACTERISTIC
/begin CHARACTERISTIC KFKTM "" MAP 0xFC50F4 KfAxU8AyU8SstxU16SstyU16WU16 1.992188 fak_ub_b2 0.00 1.992188 FORMAT "%8.6"
 /begin AXIS_DESCR STD_AXIS tabgmab temp_ub_q5_o50 6 -50.00 1225. FORMAT "%5.0" DEPOSIT ABSOLUTE /end AXIS_DESCR
 /begin AXIS_DESCR STD_AXIS tabst_w t1sxs_uw_q1 6 0.00 65535.00 FORMAT "%8.2" DEPOSIT ABSOLUTE /end AXIS_DESCR
/end CHARACTERISTIC
/begin CHARACTERISTIC KFKTM2 "" MAP 0xFC51BC KfAxU8AyU8SstxU8SstyU8WU8 1.992 fak_ub_b2 0.00 1.992 FORMAT "%5.3"
 /begin AXIS_DESCR STD_AXIS vfzg vfzg_ub_q1p25 6 0.00 318.8 FORMAT "%5.1" DEPOSIT ABSOLUTE /end AXIS_DESCR
 /begin AXIS_DESCR STD_AXIS taml rel_ub_b100 6 0.00 100.0 FORMAT "%5.1" DEPOSIT ABSOLUTE /end AXIS_DESCR
/end CHARACTERISTIC
/begin CHARACTERISTIC KFLAMFA "Kennfeld Lambda Fahrerwunsch" MAP 0xFCDDEC KfAxUbAyUbSstxUbSstyUbWUb 1.992 fak_ub_b2 0.00 1.992 FORMAT "%5.3"
 /begin AXIS_DESCR STD_AXIS nmot nmot_ub_q40 12 0.00 10200. FORMAT "%5.0" DEPOSIT ABSOLUTE /end AXIS_DESCR
 /begin AXIS_DESCR STD_AXIS rl rel_ub_q0p75 16 0.00 191.3 FORMAT "%5.1" DEPOSIT ABSOLUTE /end AXIS_DESCR
/end CHARACTERISTIC
/begin CHARACTERISTIC KFLANSKH "Kennfeld Lambda-Motor-Vorgabe bei Katheizen im Nachstart" MAP 0xFCE628 KfAxUbAyUbSstxUbSstyUwWUw 15.89990 fak_q0p000244 0.09985352 15.99976 FORMAT "%8.5"
 /begin AXIS_DESCR STD_AXIS tmst temp_ub_q0p75_o48 6 -48.00 143.3 FORMAT "%5.1" DEPOSIT ABSOLUTE /end AXIS_DESCR
 /begin AXIS_DESCR STD_AXIS anztib_w dez 12 0.00 65535.00 FORMAT "%8.2" DEPOSIT ABSOLUTE /end AXIS_DESCR
/end CHARACTERISTIC
/begin CHARACTERISTIC KFLASKH "Kennfeld Lambda-Abgas-Soll bei Katheizen" MAP 0xFCE6D8 KfAxUwAyUwSstxUwSstyUwWUw 15.99976 fak_q0p000244 0.00 15.99976 FORMAT "%8.5"
 /begin AXIS_DESCR STD_AXIS nmot_w nmot_uw_q0p25 8 0.00 16383.75 FORMAT "%8.2" DEPOSIT ABSOLUTE /end AXIS_DESCR
 /begin AXIS_DESCR STD_AXIS rl_w rel_uw_q0p0234 8 0.00 1535.977 FORMAT "%8.3" DEPOSIT ABSOLUTE /end AXIS_DESCR
/end CHARACTERISTIC
/begin CHARACTERISTIC KFLBTS "Lambdasoll f¸r Bauteileschutz" MAP 0xFCDD00 GkfWUb 1.992 fak_ub_b2 0.00 1.992 FORMAT "%5.3"
 /begin AXIS_DESCR COM_AXIS rl rel_ub_q0p75 12 0.00 191.3 FORMAT "%5.1" AXIS_PTS_REF SRL12GKUB /end AXIS_DESCR
 /begin AXIS_DESCR COM_AXIS nmot nmot_ub_q40 16 0.00 10200. FORMAT "%5.0" AXIS_PTS_REF SNM16GKUB /end AXIS_DESCR
/end CHARACTERISTIC
/begin CHARACTERISTIC KFLMSKHKST "" MAP 0xFCE77C KfAxUwAyUwSstxUwSstyUwWUw 15.99976 fak_q0p000244 0.00 15.99976 FORMAT "%8.5"
 /begin AXIS_DESCR STD_AXIS nmot_w nmot_uw_q0p25 8 0.00 16383.75 FORMAT "%8.2" DEPOSIT ABSOLUTE /end AXIS_DESCR
 /begin AXIS_DESCR STD_AXIS rl_w rel_uw_q0p0234 8 0.00 1535.977 FORMAT "%8.3" DEPOSIT ABSOLUTE /end AXIS_DESCR
/end CHARACTERISTIC
/begin CHARACTERISTIC KFLMSKHMAG "" MAP 0xFCE820 KfAxUwAyUwSstxUwSstyUwWUw 15.99976 fak_q0p000244 0.00 15.99976 FORMAT "%8.5"
 /begin AXIS_DESCR STD_AXIS nmot_w nmot_uw_q0p25 8 0.00 16383.75 FORMAT "%8.2" DEPOSIT ABSOLUTE /end AXIS_DESCR
 /begin AXIS_DESCR STD_AXIS rl_w rel_uw_q0p0234 8 0.00 1535.977 FORMAT "%8.3" DEPOSIT ABSOLUTE /end AXIS_DESCR
/end CHARACTERISTIC
/begin CHARACTERISTIC KFLMSKHSLP "" MAP 0xFCE8C4 KfAxUwAyUwSstxUwSstyUwWUw 15.99976 fak_q0p000244 0.00 15.99976 FORMAT "%8.5"
 /begin AXIS_DESCR STD_AXIS nmot_w nmot_uw_q0p25 8 0.00 16383.75 FORMAT "%8.2" DEPOSIT ABSOLUTE /end AXIS_DESCR
 /begin AXIS_DESCR STD_AXIS rl_w rel_uw_q0p0234 8 0.00 1535.977 FORMAT "%8.3" DEPOSIT ABSOLUTE /end AXIS_DESCR
/end CHARACTERISTIC
/begin CHARACTERISTIC KFLORESP "Kennfeld Loadresponse ueber Motordrehzahl und rel. Luftmasse" MAP 0xFC9A44 KfAxU8AyU8SstxU8SstyU8WU8 25.50 t100msxs_ub_b25p5 0.00 25.50 FORMAT "%5.2"
 /begin AXIS_DESCR STD_AXIS nmot nmot_ub_q40 6 0.00 10200. FORMAT "%5.0" DEPOSIT ABSOLUTE /end AXIS_DESCR
 /begin AXIS_DESCR STD_AXIS rl rel_ub_q0p75 6 0.00 191.3 FORMAT "%5.1" DEPOSIT ABSOLUTE /end AXIS_DESCR
/end CHARACTERISTIC
/begin CHARACTERISTIC KFMRES "LLR: Basis Momentenreserve im LL und ll-nahem Bereich" MAP 0xFC6DA4 GkfWUb 24.90 rel_ub_b24p9 0.00 24.90 FORMAT "%5.2"
 /begin AXIS_DESCR COM_AXIS dns nmotd_sb_q10 6 -1280. 1270. FORMAT "%5.0" AXIS_PTS_REF SNS06LLSB /end AXIS_DESCR
 /begin AXIS_DESCR COM_AXIS tans temp_ub_q0p75_o48 4 -48.00 143.3 FORMAT "%5.1" AXIS_PTS_REF STA04SAUB /end AXIS_DESCR
/end CHARACTERISTIC
/begin CHARACTERISTIC KFMRESFS "LLR: Basis Momentenreserve im LL und LL-nahem Bereich bei B_fs=1" MAP 0xFC6DBC GkfWUb 24.90 rel_ub_b24p9 0.00 24.90 FORMAT "%5.2"
 /begin AXIS_DESCR COM_AXIS dns nmotd_sb_q10 6 -1280. 1270. FORMAT "%5.0" AXIS_PTS_REF SNS06LLSB /end AXIS_DESCR
 /begin AXIS_DESCR COM_AXIS tans temp_ub_q0p75_o48 4 -48.00 143.3 FORMAT "%5.1" AXIS_PTS_REF STA04SAUB /end AXIS_DESCR
/end CHARACTERISTIC
/begin CHARACTERISTIC KFMRESFST "" MAP 0xFC6DD4 GkfWUb 24.90 rel_ub_b24p9 0.00 24.90 FORMAT "%5.2"
 /begin AXIS_DESCR COM_AXIS dns nmotd_sb_q10 6 -1280. 1270. FORMAT "%5.0" AXIS_PTS_REF SNS06LLSB /end AXIS_DESCR
 /begin AXIS_DESCR COM_AXIS tmot temp_ub_q0p75_o48 4 -48.00 143.3 FORMAT "%5.1" AXIS_PTS_REF STM04SAUB /end AXIS_DESCR
/end CHARACTERISTIC
/begin CHARACTERISTIC KFMREST "" MAP 0xFC6DEC GkfWUb 24.90 rel_ub_b24p9 0.00 24.90 FORMAT "%5.2"
 /begin AXIS_DESCR COM_AXIS dns nmotd_sb_q10 6 -1280. 1270. FORMAT "%5.0" AXIS_PTS_REF SNS06LLSB /end AXIS_DESCR
 /begin AXIS_DESCR COM_AXIS tmot temp_ub_q0p75_o48 4 -48.00 143.3 FORMAT "%5.1" AXIS_PTS_REF STM04SAUB /end AXIS_DESCR
/end CHARACTERISTIC
/begin CHARACTERISTIC KFRI "I - Kennfeld" MAP 0xFCEF2C GkfWUb 77.82 fak_ub_b77p81 0.00 77.82 FORMAT "%5.2"
 /begin AXIS_DESCR COM_AXIS nmot nmot_ub_q40 7 0.00 10200. FORMAT "%5.0" AXIS_PTS_REF SNM07LRUB /end AXIS_DESCR
 /begin AXIS_DESCR COM_AXIS rl rel_ub_q0p75 6 0.00 191.3 FORMAT "%5.1" AXIS_PTS_REF SRL06LRUB /end AXIS_DESCR
/end CHARACTERISTIC
/begin CHARACTERISTIC KFRI2 "LR-I-Kennfeld f¸r Bank 2" MAP 0xFCEF58 GkfWUb 77.82 fak_ub_b77p81 0.00 77.82 FORMAT "%5.2"
 /begin AXIS_DESCR COM_AXIS nmot nmot_ub_q40 7 0.00 10200. FORMAT "%5.0" AXIS_PTS_REF SNM07LRUB /end AXIS_DESCR
 /begin AXIS_DESCR COM_AXIS rl rel_ub_q0p75 6 0.00 191.3 FORMAT "%5.1" AXIS_PTS_REF SRL06LRUB /end AXIS_DESCR
/end CHARACTERISTIC
/begin CHARACTERISTIC KFRP "P - Kennfeld" MAP 0xFCEF84 GkfWUb 9.766 fak_ub_b12p45 0.00 9.766 FORMAT "%5.3"
 /begin AXIS_DESCR COM_AXIS nmot nmot_ub_q40 7 0.00 10200. FORMAT "%5.0" AXIS_PTS_REF SNM07LRUB /end AXIS_DESCR
 /begin AXIS_DESCR COM_AXIS rl rel_ub_q0p75 6 0.00 191.3 FORMAT "%5.1" AXIS_PTS_REF SRL06LRUB /end AXIS_DESCR
/end CHARACTERISTIC
/begin CHARACTERISTIC KFRP2 "LR-P-Kennfeld f¸r rechten Abgasstrang" MAP 0xFCEFB0 GkfWUb 9.766 fak_ub_b12p45 0.00 9.766 FORMAT "%5.3"
 /begin AXIS_DESCR COM_AXIS nmot nmot_ub_q40 7 0.00 10200. FORMAT "%5.0" AXIS_PTS_REF SNM07LRUB /end AXIS_DESCR
 /begin AXIS_DESCR COM_AXIS rl rel_ub_q0p75 6 0.00 191.3 FORMAT "%5.1" AXIS_PTS_REF SRL06LRUB /end AXIS_DESCR
/end CHARACTERISTIC
/begin CHARACTERISTIC KFRTV "TV - Kennfeld (Lambdaregelung Reglerumschaltverzˆgerung)" MAP 0xFCEFDC GkfWSb 2.550 t10msxs_sb_q0p01 -1.280 1.270 FORMAT "%5.3"
 /begin AXIS_DESCR COM_AXIS nmot nmot_ub_q40 7 0.00 10200. FORMAT "%5.0" AXIS_PTS_REF SNM07LRUB /end AXIS_DESCR
 /begin AXIS_DESCR COM_AXIS rl rel_ub_q0p75 6 0.00 191.3 FORMAT "%5.1" AXIS_PTS_REF SRL06LRUB /end AXIS_DESCR
/end CHARACTERISTIC
/begin CHARACTERISTIC KFRTV2 "TV - Kennfeld (Lambdaregelung Reglerumschaltverzˆgerung) Bank2" MAP 0xFCF008 GkfWSb 2.550 t10msxs_sb_q0p01 -1.280 1.270 FORMAT "%5.3"
 /begin AXIS_DESCR COM_AXIS nmot nmot_ub_q40 7 0.00 10200. FORMAT "%5.0" AXIS_PTS_REF SNM07LRUB /end AXIS_DESCR
 /begin AXIS_DESCR COM_AXIS rl rel_ub_q0p75 6 0.00 191.3 FORMAT "%5.1" AXIS_PTS_REF SRL06LRUB /end AXIS_DESCR
/end CHARACTERISTIC
/begin CHARACTERISTIC KFTMOKOR "" MAP 0xFC51F0 KfAxU8AyU8SstxU8SstyU8WU8 191.3 temp_ub_q0p75_o48 -48.00 143.3 FORMAT "%5.1"
 /begin AXIS_DESCR STD_AXIS tmot temp_ub_q0p75_o48 9 -48.00 143.3 FORMAT "%5.1" DEPOSIT ABSOLUTE /end AXIS_DESCR
 /begin AXIS_DESCR STD_AXIS nmot nmot_ub_q40 9 0.00 10200. FORMAT "%5.0" DEPOSIT ABSOLUTE /end AXIS_DESCR
/end CHARACTERISTIC
/begin CHARACTERISTIC KFZKTMTKR "Kennfeld f¸r Zeitkonstante PT1-Filterung tkrst" MAP 0xFC5158 KfAxU8AyU8SstxU16SstyU16WU16 6553.500 t100msxs_uw_b6553p5 0.00 6553.500 FORMAT "%8.3"
 /begin AXIS_DESCR STD_AXIS tnst_w t10msxs_uw_b655p35 6 0.00 655.3500 FORMAT "%8.4" DEPOSIT ABSOLUTE /end AXIS_DESCR
 /begin AXIS_DESCR STD_AXIS vsskrst fuel_ub_q1 6 0.00 65535. FORMAT "%5.0" DEPOSIT ABSOLUTE /end AXIS_DESCR
/end CHARACTERISTIC
/begin CHARACTERISTIC KFZLRESOF "" MAP 0xFC99F4 KfAxU8AyU8SstxU8SstyU16WU8 255.0 t1sxs_ub_q1 0.00 255.0 FORMAT "%5.1"
 /begin AXIS_DESCR STD_AXIS tmst temp_ub_q0p75_o48 6 -48.00 143.3 FORMAT "%5.1" DEPOSIT ABSOLUTE /end AXIS_DESCR
 /begin AXIS_DESCR STD_AXIS kmstand km_uw_q10 4 0.00 655350.0 FORMAT "%8.1" DEPOSIT ABSOLUTE /end AXIS_DESCR
/end CHARACTERISTIC
/begin CHARACTERISTIC KFZLRRESOFV "" MAP 0xFC9A1C KfAxU8AyU8SstxU8SstyU16WU8 255.0 t1sxs_ub_q1 0.00 255.0 FORMAT "%5.1"
 /begin AXIS_DESCR STD_AXIS tmst temp_ub_q0p75_o48 6 -48.00 143.3 FORMAT "%5.1" DEPOSIT ABSOLUTE /end AXIS_DESCR
 /begin AXIS_DESCR STD_AXIS kmstand km_uw_q10 4 0.00 655350.0 FORMAT "%8.1" DEPOSIT ABSOLUTE /end AXIS_DESCR
/end CHARACTERISTIC
/begin CHARACTERISTIC KFZWOBTS "optimaler Z¸ndwinkel Bauteileschutz" MAP 0xFC5334 GkfWSb 191.3 zw_sb_q0p75 -96.00 95.25 FORMAT "%5.2"
 /begin AXIS_DESCR COM_AXIS nmot_w nmot_uw_q0p25 16 0.00 16383.75 FORMAT "%8.2" AXIS_PTS_REF SNM16OPUW /end AXIS_DESCR
 /begin AXIS_DESCR COM_AXIS rl_w_kge rel_uw_q0p0234 16 0.00 1535.977 FORMAT "%8.3" AXIS_PTS_REF SRL16OPUW /end AXIS_DESCR
/end CHARACTERISTIC
/begin CHARACTERISTIC KLBATTLSTR "Geschwindigkeitsfaktor Batterieumgebungstemperatur" CURVE 0xFC9560 KlAxU8SstxR32WR32 65534.900000000001 fak_r32_1 0.100000000000000 65535.000000000000 FORMAT "%43.37"
 /begin AXIS_DESCR STD_AXIS vfzgf fak_r32_1 6 0.00 65535.000000000000 FORMAT "%43.37" DEPOSIT ABSOLUTE /end AXIS_DESCR
/end CHARACTERISTIC
/begin CHARACTERISTIC KLBTSVL "Rover" CURVE 0xFCDDC0 GklWUb 1.992 fak_ub_b2 0.00 1.992 FORMAT "%5.3"
 /begin AXIS_DESCR COM_AXIS nmot nmot_ub_q40 16 0.00 10200. FORMAT "%5.0" AXIS_PTS_REF SNM16GKUB /end AXIS_DESCR
/end CHARACTERISTIC
/begin CHARACTERISTIC KLEXPALH "Funktion EXP(-ALPHA*tabst_w) hinten" CURVE 0xFC9594 KlAxU8SstxR32WR32 1.000000000000000 fak_r32_1 0.00 1.000000000000000 FORMAT "%43.41"
 /begin AXIS_DESCR STD_AXIS tabst_fl fak_r32_1 11 0.00 65535.000000000000 FORMAT "%43.37" DEPOSIT ABSOLUTE /end AXIS_DESCR
/end CHARACTERISTIC
/begin CHARACTERISTIC KLEXPALV "Funktion EXP(-ALPHA*tabst_w)" CURVE 0xFC95F0 KlAxU8SstxR32WR32 1.000000000000000 fak_r32_1 0.00 1.000000000000000 FORMAT "%43.41"
 /begin AXIS_DESCR STD_AXIS tabst_fl fak_r32_1 11 0.00 65535.000000000000 FORMAT "%43.37" DEPOSIT ABSOLUTE /end AXIS_DESCR
/end CHARACTERISTIC
/begin CHARACTERISTIC KLEXPBETAV "Funktion EXP (-BETA*tabst_w)" CURVE 0xFC964C KlAxU8SstxR32WR32 1.000000000000000 fak_r32_1 0.00 1.000000000000000 FORMAT "%43.41"
 /begin AXIS_DESCR STD_AXIS tabst_fl fak_r32_1 11 0.00 65535.000000000000 FORMAT "%43.37" DEPOSIT ABSOLUTE /end AXIS_DESCR
/end CHARACTERISTIC
/begin CHARACTERISTIC KLGENLDST "Auslastungsgrad Generator" CURVE 0xFC99CE KlAxU8SstxU16WU16 100.0000 PCENT 0.00 100.0000 FORMAT "%8.4"
 /begin AXIS_DESCR STD_AXIS gentemp temp_uw_q0p75_o48 6 -48.00000 336.0000 FORMAT "%8.4" DEPOSIT ABSOLUTE /end AXIS_DESCR
/end CHARACTERISTIC
/begin CHARACTERISTIC KLLAKHFH "Umgebungsdruckkorrektur Lambda Katheizen" CURVE 0xFCE968 KlAUwSstUwWUw 1.999969 fak_uw_b2 0.00 1.999969 FORMAT "%8.6"
 /begin AXIS_DESCR STD_AXIS fho_w fak_uw_b4 4 0.00 3.999939 FORMAT "%8.6" DEPOSIT ABSOLUTE /end AXIS_DESCR
/end CHARACTERISTIC
/begin CHARACTERISTIC KLLORESPM "Motorabh‰ngiger Loadresponse-Faktor" CURVE 0xFC9A78 KlAxU8SstxU8WU8 3.984 fak_ub_b4 0.00 3.984 FORMAT "%5.3"
 /begin AXIS_DESCR STD_AXIS tmot temp_ub_q0p75_o48 6 -48.00 143.3 FORMAT "%5.1" DEPOSIT ABSOLUTE /end AXIS_DESCR
/end CHARACTERISTIC
/begin CHARACTERISTIC KLNWPOSN "NW_POS Drehzahlkorrektur variable Nockenwellverstellung" CURVE 0xFC6540 KlAxU8SstxU8WU8 25.50 sprzi_q0p1o12p8 -12.80 12.70 FORMAT "%5.2"
 /begin AXIS_DESCR STD_AXIS nmot nmot_ub_q40 6 0.00 10200. FORMAT "%5.0" DEPOSIT ABSOLUTE /end AXIS_DESCR
/end CHARACTERISTIC
/begin CHARACTERISTIC KLNWPOST "NW_POS Motortemperaturkorrektur variable Nockenwellenverstellung" CURVE 0xFC6550 KlAxU8SstxU8WU8 25.50 sprzi_q0p1o12p8 -12.80 12.70 FORMAT "%5.2"
 /begin AXIS_DESCR STD_AXIS tmot temp_ub_q0p75_o48 6 -48.00 143.3 FORMAT "%5.1" DEPOSIT ABSOLUTE /end AXIS_DESCR
/end CHARACTERISTIC
/begin CHARACTERISTIC KLZWBSVL "Rover" CURVE 0xFC5434 GklWSb 191.3 zw_sb_q0p75 -96.00 95.25 FORMAT "%5.2"
 /begin AXIS_DESCR COM_AXIS nmot_w nmot_uw_q0p25 16 0.00 16383.75 FORMAT "%8.2" AXIS_PTS_REF SNM16OPUW /end AXIS_DESCR
/end CHARACTERISTIC
/begin CHARACTERISTIC KNSNF "Sperrband f¸r Solldrehzahlnachf¸hrung" VALUE 0xFC6C5D KwUb 2550. nmot_ub_q10 0.00 2550. FORMAT "%5.0" /end CHARACTERISTIC
/begin CHARACTERISTIC KNSNFT "Sperrband f¸r Solldrehzahlnachf¸hrung gedrosselt" VALUE 0xFC6C5E KwUb 2550. nmot_ub_q10 0.00 2550. FORMAT "%5.0" /end CHARACTERISTIC
/begin CHARACTERISTIC KRAL1N "Klopfregeladaption Lastbereich 1" CURVE 0xFCEC38 KlAUbSstUbWUb 191.3 rel_ub_q0p75 0.00 191.3 FORMAT "%5.1"
 /begin AXIS_DESCR STD_AXIS nmot nmot_ub_q40 16 0.00 10200. FORMAT "%5.0" DEPOSIT ABSOLUTE /end AXIS_DESCR
/end CHARACTERISTIC
/begin CHARACTERISTIC KRAL2N "Klopfregeladaption Lastbereich 2" CURVE 0xFCEC5C KlAUbSstUbWUb 191.3 rel_ub_q0p75 0.00 191.3 FORMAT "%5.1"
 /begin AXIS_DESCR STD_AXIS nmot nmot_ub_q40 16 0.00 10200. FORMAT "%5.0" DEPOSIT ABSOLUTE /end AXIS_DESCR
/end CHARACTERISTIC
/begin CHARACTERISTIC KRALH "Klopfregeladaption Lasthysterese" VALUE 0xFCEC7D KwUb 191.3 rel_ub_q0p75 0.00 191.3 FORMAT "%5.1" /end CHARACTERISTIC
/begin CHARACTERISTIC KRAN1 "Klopfregeladaption Drehzahlbereich, St¸tzstelle 1" VALUE 0xFCEC7E KwUb 10200. nmot_ub_q40 0.00 10200. FORMAT "%5.0" /end CHARACTERISTIC
/begin CHARACTERISTIC KRAN2 "Klopfregeladaption Drehzahlbereich, St¸tzstelle 2" VALUE 0xFCEC7F KwUb 10200. nmot_ub_q40 0.00 10200. FORMAT "%5.0" /end CHARACTERISTIC
/begin CHARACTERISTIC KRAN3 "Klopfregeladaption Drehzahlbereich, St¸tzstelle 3" VALUE 0xFCEC80 KwUb 10200. nmot_ub_q40 0.00 10200. FORMAT "%5.0" /end CHARACTERISTIC
/begin CHARACTERISTIC KRAN4 "Klopfregeladaption Drehzahlbereich, St¸tzstelle 4" VALUE 0xFCEC81 KwUb 10200. nmot_ub_q40 0.00 10200. FORMAT "%5.0" /end CHARACTERISTIC
/begin CHARACTERISTIC KRANH "Klopfregeladaption Drehzahlhysterese" VALUE 0xFCEC82 KwUb 10200. nmot_ub_q40 0.00 10200. FORMAT "%5.0" /end CHARACTERISTIC
/begin CHARACTERISTIC KRDWA "Klopfregelung Differenz aktueller ZW zu Adaptionskennfeld" VALUE 0xFC67EA KwUb 191.3 zw_ub_q0p75 0.00 191.3 FORMAT "%5.1" /end CHARACTERISTIC
/begin CHARACTERISTIC KRDWKLA "Der SV-Lernbetrag f¸r die KR-Adaption nach einem erkannten Klopfereignis" VALUE 0xFC67EB KwSb 12.00 zw_ub_qn0p75 -6.000 6.000 FORMAT "%5.3" /end CHARACTERISTIC
/begin CHARACTERISTIC KRDWSA "Der FV-Lernbetrag f¸r die KR-Adaption wenn wkra-wkr > KRDWA" VALUE 0xFC67EC KwUb 6.000 zw_ub_q0p75 0.00 6.000 FORMAT "%5.3" /end CHARACTERISTIC
/begin CHARACTERISTIC KRDWSN "Klopfregelung delta - Winkel Sicherheit" CURVE 0xFCEC84 KlAUbSstUbWUb 191.3 zw_ub_qn0p75 -191.3 0.00 FORMAT "%5.1"
 /begin AXIS_DESCR STD_AXIS nmot nmot_ub_q40 16 0.00 10200. FORMAT "%5.0" DEPOSIT ABSOLUTE /end AXIS_DESCR
/end CHARACTERISTIC
/begin CHARACTERISTIC KRFKN "Sp‰tverstellung pro Klopfereignis" CURVE 0xFCECA8 KlAUbSstUbWUb 191.3 zw_ub_qn0p75 -191.3 0.00 FORMAT "%5.1"
 /begin AXIS_DESCR STD_AXIS nmot nmot_ub_q40 16 0.00 10200. FORMAT "%5.0" DEPOSIT ABSOLUTE /end AXIS_DESCR
/end CHARACTERISTIC
/begin CHARACTERISTIC KRLMDY "Lesen bei Lastbereichswechsel: immer oder nur bei Dynamik" VALUE 0xFC67ED KwUb 1.000 dez 0.00 1.000 FORMAT "%5.3" /end CHARACTERISTIC
/begin CHARACTERISTIC KRMXN "maximale Sp‰tverstellung" CURVE 0xFCECCC KlAUbSstUbWUb 190.5 zw_ub_qn0p75 -191.3 -0.7500 FORMAT "%5.1"
 /begin AXIS_DESCR STD_AXIS nmot nmot_ub_q40 16 0.00 10200. FORMAT "%5.0" DEPOSIT ABSOLUTE /end AXIS_DESCR
/end CHARACTERISTIC
/begin CHARACTERISTIC KRNMDY "Lesen bei Drehzahlbereichswechsel: immer oder nur bei Dynamik" VALUE 0xFC67EE KwUb 1.000 dez 0.00 1.000 FORMAT "%5.3" /end CHARACTERISTIC
/begin CHARACTERISTIC KRVFLN "Anz. Z¸nd./Zyl., bzw. Zeitangabe von Fr¸hverst. zu Fr¸hverst. (Stufenbreite-KR)" MAP 0xFCECF0 KfAxUbAyUbSstxUbSstyUbWUb 254.0 dez 1.000 255.0 FORMAT "%5.1"
 /begin AXIS_DESCR STD_AXIS nmot nmot_ub_q40 16 0.00 10200. FORMAT "%5.0" DEPOSIT ABSOLUTE /end AXIS_DESCR
 /begin AXIS_DESCR STD_AXIS rl rel_ub_q0p75 12 0.00 191.3 FORMAT "%5.1" DEPOSIT ABSOLUTE /end AXIS_DESCR
/end CHARACTERISTIC
/begin CHARACTERISTIC KRVFSLN "Anzahl Z¸ndungen/Zyl., oder Zeitangabe f¸r schnelle Fr¸hverstellung der KR" MAP 0xFCEDD0 KfAxUbAyUbSstxUbSstyUbWUb 254.0 dez 1.000 255.0 FORMAT "%5.1"
 /begin AXIS_DESCR STD_AXIS nmot nmot_ub_q40 16 0.00 10200. FORMAT "%5.0" DEPOSIT ABSOLUTE /end AXIS_DESCR
 /begin AXIS_DESCR STD_AXIS rl rel_ub_q0p75 12 0.00 191.3 FORMAT "%5.1" DEPOSIT ABSOLUTE /end AXIS_DESCR
/end CHARACTERISTIC
/begin CHARACTERISTIC LADEKENNL "Batterieladespannungskennlinie" CURVE 0xFC96A8 KlAxU8SstxR32WR32 16.000000000000000 fak_r32_1 0.00 16.000000000000000 FORMAT "%43.40"
 /begin AXIS_DESCR STD_AXIS t_battabst fak_r32_1 6 -1.000000000000E+037 1.000000000000E+037 FORMAT "%43.4" DEPOSIT ABSOLUTE /end AXIS_DESCR
/end CHARACTERISTIC
/begin CHARACTERISTIC LAMFAVL "Lambdawunsch Vollast" CURVE 0xFCDECC KlAUbSstUbWUb 1.992 fak_ub_b2 0.00 1.992 FORMAT "%5.3"
 /begin AXIS_DESCR STD_AXIS nmot nmot_ub_q40 16 0.00 10200. FORMAT "%5.0" DEPOSIT ABSOLUTE /end AXIS_DESCR
/end CHARACTERISTIC
/begin CHARACTERISTIC LAMFLGSL "Lambda Motorlaufgrenze  fett bei Sekund‰rlufteinblasung" CURVE 0xFCDEF0 KlAUbSstUbWUb 1.992 fak_ub_b2 0.00 1.992 FORMAT "%5.3"
 /begin AXIS_DESCR STD_AXIS imlatm m_ub_b23p3 6 0.00 23.21 FORMAT "%5.2" DEPOSIT ABSOLUTE /end AXIS_DESCR
/end CHARACTERISTIC
/begin CHARACTERISTIC LAMLGFTM "Lambda Motorlaufgrenze fett" CURVE 0xFCDF00 GklWUb 1.992 fak_ub_b2 0.00 1.992 FORMAT "%5.3"
 /begin AXIS_DESCR COM_AXIS tmot temp_ub_q0p75_o48 12 -48.00 143.3 FORMAT "%5.1" AXIS_PTS_REF STM12ESUB /end AXIS_DESCR
/end CHARACTERISTIC
/begin CHARACTERISTIC LAMLGMTM "Laufgrenze ""mager""" CURVE 0xFCDF0C GklWUb 1.992 fak_ub_b2 0.00 1.992 FORMAT "%5.3"
 /begin AXIS_DESCR COM_AXIS tmot temp_ub_q0p75_o48 12 -48.00 143.3 FORMAT "%5.1" AXIS_PTS_REF STM12ESUB /end AXIS_DESCR
/end CHARACTERISTIC
/begin CHARACTERISTIC LAMSOSOF "Lambdasonde Soll Obergrenze f¸r 1.0-Fenster" VALUE 0xFC5458 KwUw 15.99976 fak_uw_b16 0.00 15.99976 FORMAT "%8.5" /end CHARACTERISTIC
/begin CHARACTERISTIC LAMSOSUF "Lambdasonde Soll Untergrenze f¸r 1.0-Fenster" VALUE 0xFC545A KwUw 15.99976 fak_uw_b16 0.00 15.99976 FORMAT "%8.5" /end CHARACTERISTIC
/begin CHARACTERISTIC LASDSLA "Lambda-Abgas-Soll bei Sekund‰rluftadaption/Kurztest" CURVE 0xFCE97A KlAUwSstUwWUw 15.99976 fak_q0p000244 0.00 15.99976 FORMAT "%8.5"
 /begin AXIS_DESCR STD_AXIS ml_w m_uw_b6553p5 4 0.00 6553.500 FORMAT "%8.3" DEPOSIT ABSOLUTE /end AXIS_DESCR
/end CHARACTERISTIC
/begin CHARACTERISTIC LASOAB "Lambdasollwert bei Bankabschaltung" VALUE 0xFC5457 KwUb 1.992 fak_ub_b2 0.00 1.992 FORMAT "%5.3" /end CHARACTERISTIC
/begin CHARACTERISTIC LASTMOT "Motortemp.-Korrektur von Lambda-Abgas-Soll" CURVE 0xFCE610 KlAUbSstUbWUb 1.992 fak_ub_b2 0.00 1.992 FORMAT "%5.3"
 /begin AXIS_DESCR STD_AXIS tmot temp_ub_q0p75_o48 4 -48.00 143.3 FORMAT "%5.1" DEPOSIT ABSOLUTE /end AXIS_DESCR
/end CHARACTERISTIC
/begin CHARACTERISTIC LBATTMAX "maximale Batterieladespannung Licht aus" VALUE 0xFC970C KwWR32 16.000000000000000 fak_r32_1 0.00 16.000000000000000 FORMAT "%43.40" /end CHARACTERISTIC
/begin CHARACTERISTIC LBATTMIN "minmale Batterieladespannung Licht an" VALUE 0xFC9710 KwWR32 16.000000000000000 fak_r32_1 0.00 16.000000000000000 FORMAT "%43.40" /end CHARACTERISTIC
/begin CHARACTERISTIC LIMN "Untere Integratorbegrenzung bei stehendem Fahrzeug" VALUE 0xFC6D18 KwUb 24.90 rel_ub_bn24p9 -24.90 0.00 FORMAT "%5.2" /end CHARACTERISTIC
/begin CHARACTERISTIC LIMNDLLR "Untere Integratorbegrenzung bei Diagnose Leerlaufregelung" VALUE 0xFC6D19 KwUb 24.90 rel_ub_bn24p9 -24.90 0.00 FORMAT "%5.2" /end CHARACTERISTIC
/begin CHARACTERISTIC LIMNDTES "Untere Integratorbegrenzung bei DTES" VALUE 0xFC6D1A KwUb 24.90 rel_ub_bn24p9 -24.90 0.00 FORMAT "%5.2" /end CHARACTERISTIC
/begin CHARACTERISTIC LIMNV "Untere Integratorbegrenzung bei rollendem Fahrzeug" VALUE 0xFC6D1B KwUb 24.90 rel_ub_bn24p9 -24.90 0.00 FORMAT "%5.2" /end CHARACTERISTIC
/begin CHARACTERISTIC LIMX "Obere Integratorbegrenzung bei stehendem Fahrzeug" VALUE 0xFC6D1C KwUb 24.90 rel_ub_b24p9 0.00 24.90 FORMAT "%5.2" /end CHARACTERISTIC
/begin CHARACTERISTIC LIMXV "Obere Integratorbegrenzung bei rollendem Fahrzeug" VALUE 0xFC6D1D KwUb 24.90 rel_ub_b24p9 0.00 24.90 FORMAT "%5.2" /end CHARACTERISTIC
/begin CHARACTERISTIC LISTM "Wert des Leerlaufintegrators im Start" CURVE 0xFCF2CC GklWUb 24.90 rel_ub_b24p9 0.00 24.90 FORMAT "%5.2"
 /begin AXIS_DESCR COM_AXIS tmot temp_ub_q0p75_o48 6 -48.00 143.3 FORMAT "%5.1" AXIS_PTS_REF STM06LLUB /end AXIS_DESCR
/end CHARACTERISTIC
/begin CHARACTERISTIC LISTMT "" CURVE 0xFCF2D4 GklWUb 24.90 rel_ub_b24p9 0.00 24.90 FORMAT "%5.2"
 /begin AXIS_DESCR COM_AXIS tmot temp_ub_q0p75_o48 6 -48.00 143.3 FORMAT "%5.1" AXIS_PTS_REF STM06LLTUB /end AXIS_DESCR
/end CHARACTERISTIC
/begin CHARACTERISTIC LKRALL "Bedingung  Leerlaufadaption aktiv" VALUE 0xFC67E4 KwWU8 191.3 rel_ub_q0p75 0.00 191.3 FORMAT "%5.1" /end CHARACTERISTIC
/begin CHARACTERISTIC LKRN "Lastschwelle Klopfregelung" CURVE 0xFCEEB0 KlAUbSstUbWUb 191.3 rel_ub_q0p75 0.00 191.3 FORMAT "%5.1"
 /begin AXIS_DESCR STD_AXIS nmot nmot_ub_q40 16 0.00 10200. FORMAT "%5.0" DEPOSIT ABSOLUTE /end AXIS_DESCR
/end CHARACTERISTIC
/begin CHARACTERISTIC LLRICNF "Configurationsbyte f¸r LLR Integrator" VALUE 0xFC6D1E KwUb 255.0 dez 0.00 255.0 FORMAT "%5.1" /end CHARACTERISTIC
/begin CHARACTERISTIC LMSTMOT "Motortemp.-Korrektur von Lambda-Motor-Soll" CURVE 0xFCE61C KlAUbSstUbWUb 1.992 fak_ub_b2 0.00 1.992 FORMAT "%5.3"
 /begin AXIS_DESCR STD_AXIS tmot temp_ub_q0p75_o48 4 -48.00 143.3 FORMAT "%5.1" DEPOSIT ABSOLUTE /end AXIS_DESCR
/end CHARACTERISTIC
/begin CHARACTERISTIC LRESPAPP "Load-Response Applikation" VALUE 0xFC9A8D KwWU8 25.50 t100msxs_ub_b25p5 0.00 25.50 FORMAT "%5.2" /end CHARACTERISTIC
/begin CHARACTERISTIC MCOBATTORT "Codierung Hand Batterieeinbauort" VALUE 0xFC96E7 KwWU8 2.000 dez 0.00 2.000 FORMAT "%5.3" /end CHARACTERISTIC
/begin CHARACTERISTIC MINHUBTDNS "" VALUE 0xFC6C58 KwWU16 65.53500 hub_uw_q0p001 0.00 65.53500 FORMAT "%8.5" /end CHARACTERISTIC
/begin CHARACTERISTIC MKRSTFAK "Kennlinie Umrechnung Kraftstoff Sollvolumen Faktot Abk¸hlung" CURVE 0xFC5298 KlAxU8SstxU8WU8 1.992 fak_ub_b2 0.00 1.992 FORMAT "%5.3"
 /begin AXIS_DESCR STD_AXIS vsskrst fuel_ub_q1 9 0.00 255.0 FORMAT "%5.1" DEPOSIT ABSOLUTE /end AXIS_DESCR
/end CHARACTERISTIC
/begin CHARACTERISTIC MRESFSM "LLR: Erhˆhte Momentenreserve im LL nach einlegen der Fahrstufe" CURVE 0xFC6E04 GklWUb 24.90 rel_ub_b24p9 0.00 24.90 FORMAT "%5.2"
 /begin AXIS_DESCR COM_AXIS tmot temp_ub_q0p75_o48 4 -48.00 143.3 FORMAT "%5.1" AXIS_PTS_REF STM04SAUB /end AXIS_DESCR
/end CHARACTERISTIC
/begin CHARACTERISTIC MRESLLM "LLR: Erhˆhte Momentenreserve im LL nach Drehzahleinbruch" CURVE 0xFC6E08 GklWUb 24.90 rel_ub_b24p9 0.00 24.90 FORMAT "%5.2"
 /begin AXIS_DESCR COM_AXIS tmot temp_ub_q0p75_o48 4 -48.00 143.3 FORMAT "%5.1" AXIS_PTS_REF STM04SAUB /end AXIS_DESCR
/end CHARACTERISTIC
/begin CHARACTERISTIC MRESTEV "Momentenreserve bei TEV-Drehzahlcheck" VALUE 0xFC6E0C KwSb 24.90 rel_sb_q0p0976 -12.50 12.40 FORMAT "%5.2" /end CHARACTERISTIC
/begin CHARACTERISTIC NDSU "Differenzdrehzahl f¸r Integratorreset" VALUE 0xFC6D74 KwSw 8191.750 nmotd_sw_q0p25 0.00 8191.750 FORMAT "%8.3" /end CHARACTERISTIC
/begin CHARACTERISTIC NFHZ "Solldrehzahl bei eingeschalteter Frontscheibenheizung" VALUE 0xFC6C5F KwUb 2550. nmot_ub_q10 0.00 2550. FORMAT "%5.0" /end CHARACTERISTIC
/begin CHARACTERISTIC NFHZFS "Solldrehzahl bei eingeschalteter Frontscheibenheizung und B_fs=1" VALUE 0xFC6C60 KwUb 2550. nmot_ub_q10 0.00 2550. FORMAT "%5.0" /end CHARACTERISTIC
/begin CHARACTERISTIC NFKRAS "Drehzahlschwelle f¸r Schreibfreigabe Klopfregeladaption" VALUE 0xFC67EF KwUb 10200. nmot_ub_q40 0.00 10200. FORMAT "%5.0" /end CHARACTERISTIC
/begin CHARACTERISTIC NFSACVMN "Einstellbare Solldrehzahl bei AC und FS Minimum" VALUE 0xFCF264 KwSb 2550. nmotd_sb_q10 -1280. 1270. FORMAT "%5.0" /end CHARACTERISTIC
/begin CHARACTERISTIC NFSACVMX "Einstellbare Solldrehzahl bei AC und FS Maximum" VALUE 0xFCF265 KwSb 2550. nmotd_sb_q10 -1280. 1270. FORMAT "%5.0" /end CHARACTERISTIC
/begin CHARACTERISTIC NFSM "Solldrehzahl Fahrstufenschalter ein" CURVE 0xFCF294 GklWUb 2550. nmot_ub_q10 0.00 2550. FORMAT "%5.0"
 /begin AXIS_DESCR COM_AXIS tmot temp_ub_q0p75_o48 6 -48.00 143.3 FORMAT "%5.1" AXIS_PTS_REF STM06LLUB /end AXIS_DESCR
/end CHARACTERISTIC
/begin CHARACTERISTIC NFSMHZ "Solldrehzahl Fahrstufenschalter ein bei Heizleistungsteigerung" CURVE 0xFCF29C GklWUb 2550. nmot_ub_q10 0.00 2550. FORMAT "%5.0"
 /begin AXIS_DESCR COM_AXIS tmot temp_ub_q0p75_o48 6 -48.00 143.3 FORMAT "%5.1" AXIS_PTS_REF STM06LLUB /end AXIS_DESCR
/end CHARACTERISTIC
/begin CHARACTERISTIC NFSMVMN "Einstellbare Solldrehzahl Minimum bei FS" VALUE 0xFCF266 KwSb 2550. nmotd_sb_q10 -1280. 1270. FORMAT "%5.0" /end CHARACTERISTIC
/begin CHARACTERISTIC NFSMVMX "Einstellbare Solldrehzahl Maximum bei FS" VALUE 0xFCF267 KwSb 2550. nmotd_sb_q10 -1280. 1270. FORMAT "%5.0" /end CHARACTERISTIC
/begin CHARACTERISTIC NGNSNF "Drehzahlgradientenschwelle zur Auslˆsung der Drehzahlnachf¸hrung" VALUE 0xFC6C61 KwUb 25500. nmotg_ub_q100 0.00 25500. FORMAT "%5.0" /end CHARACTERISTIC
/begin CHARACTERISTIC NINJO "Drehzahlschwelle f¸r Laufzeitreduzierung Einspritzung" VALUE 0xFCE34A KwUb 10200. nmot_ub_q40 0.00 10200. FORMAT "%5.0" /end CHARACTERISTIC
/begin CHARACTERISTIC NKRF "Drehzahlschwelle f¸r Klopfregelfreigabe" VALUE 0xFC67F0 KwUb 10200. nmot_ub_q40 0.00 10200. FORMAT "%5.0" /end CHARACTERISTIC
/begin CHARACTERISTIC NLLM "Solldrehzahl" CURVE 0xFCF2A4 GklWUb 2550. nmot_ub_q10 0.00 2550. FORMAT "%5.0"
 /begin AXIS_DESCR COM_AXIS tmot temp_ub_q0p75_o48 6 -48.00 143.3 FORMAT "%5.1" AXIS_PTS_REF STM06LLUB /end AXIS_DESCR
/end CHARACTERISTIC
/begin CHARACTERISTIC NLLMHZ "Solldrehzahl bei Heizleistungssteigerung" CURVE 0xFCF2AC GklWUb 2550. nmot_ub_q10 0.00 2550. FORMAT "%5.0"
 /begin AXIS_DESCR COM_AXIS tmot temp_ub_q0p75_o48 6 -48.00 143.3 FORMAT "%5.1" AXIS_PTS_REF STM06LLUB /end AXIS_DESCR
/end CHARACTERISTIC
/begin CHARACTERISTIC NLLMVMN "Einstellbare LL-Solldrehzal Minimum" VALUE 0xFCF268 KwSb 2550. nmotd_sb_q10 -1280. 1270. FORMAT "%5.0" /end CHARACTERISTIC
/begin CHARACTERISTIC NLLMVMX "Einstellbare LL-Solldrehzal Maximum" VALUE 0xFCF269 KwSb 2550. nmotd_sb_q10 -1280. 1270. FORMAT "%5.0" /end CHARACTERISTIC
/begin CHARACTERISTIC NMINUMG "Drehzahlschwelle Aussentemperaturmodell" VALUE 0xFC96E8 KwWU8 10200. nmot_ub_q40 0.00 10200. FORMAT "%5.0" /end CHARACTERISTIC
/begin CHARACTERISTIC NMXGENOF "Motordrehzahlschwelle f¸r Generatorzuschaltung" VALUE 0xFC9A8E KwWU8 10200. nmot_ub_q40 0.00 10200. FORMAT "%5.0" /end CHARACTERISTIC
/begin CHARACTERISTIC NSAC "Solldrehzahl bei Klimaanlage ein (S_AC = 1)" VALUE 0xFC6C62 KwUb 2550. nmot_ub_q10 0.00 2550. FORMAT "%5.0" /end CHARACTERISTIC
/begin CHARACTERISTIC NSACFS "Solldrehzahl bei Klimaanlage ein (S_AC = 1) und eingelegter Fahrstufe (S_fs=1)" VALUE 0xFC6C63 KwUb 2550. nmot_ub_q10 0.00 2550. FORMAT "%5.0" /end CHARACTERISTIC
/begin CHARACTERISTIC NSACMVMN "Einstellbare LL-Solldrehzal Minimum bei AC" VALUE 0xFCF26A KwSb 2550. nmotd_sb_q10 -1280. 1270. FORMAT "%5.0" /end CHARACTERISTIC
/begin CHARACTERISTIC NSACMVMX "Einstellbare LL-Solldrehzal Maximum bei AC" VALUE 0xFCF26B KwSb 2550. nmotd_sb_q10 -1280. 1270. FORMAT "%5.0" /end CHARACTERISTIC
/begin CHARACTERISTIC NSFSHLS "Solldrehzahlanhebung bei Heizleistungssteigerung und B_fs = 1" VALUE 0xFC6C64 KwUb 2550. nmot_ub_q10 0.00 2550. FORMAT "%5.0" /end CHARACTERISTIC
/begin CHARACTERISTIC NSFSR "" VALUE 0xFC6C65 KwUb 2550. nmot_ub_q10 0.00 2550. FORMAT "%5.0" /end CHARACTERISTIC
/begin CHARACTERISTIC NSHLS "Solldrehzahlanhebung bei Heizleistungssteigerung" VALUE 0xFC6C66 KwUb 2550. nmot_ub_q10 0.00 2550. FORMAT "%5.0" /end CHARACTERISTIC
/begin CHARACTERISTIC NSKAT "" VALUE 0xFC6C67 KwUb 2550. nmot_ub_q10 0.00 2550. FORMAT "%5.0" /end CHARACTERISTIC
/begin CHARACTERISTIC NSLBVMN "Einstellbare LL-Solldrehzal Minimum bei Unterspannung" VALUE 0xFCF26C KwSb 2550. nmotd_sb_q10 -1280. 1270. FORMAT "%5.0" /end CHARACTERISTIC
/begin CHARACTERISTIC NSLBVMX "Einstellbare LL-Solldrehzal Maximum bei Unterspannung" VALUE 0xFCF26D KwSb 2550. nmotd_sb_q10 -1280. 1270. FORMAT "%5.0" /end CHARACTERISTIC
/begin CHARACTERISTIC NSLPP "Solldrehzahl abh‰ngig vom Pumpendruck der Servolenkung" CURVE 0xFCF2B4 KlAUbSstUbWUb 2550. nmot_ub_q10 0.00 2550. FORMAT "%5.0"
 /begin AXIS_DESCR STD_AXIS psl dez 4 0.00 255.0 FORMAT "%5.1" DEPOSIT ABSOLUTE /end AXIS_DESCR
/end CHARACTERISTIC
/begin CHARACTERISTIC NSLPPFS "Solldrehzahl abh‰ngig vom Pumpendruck der Servolenkung bei B_fs=1" CURVE 0xFCF2C0 KlAUbSstUbWUb 2550. nmot_ub_q10 0.00 2550. FORMAT "%5.0"
 /begin AXIS_DESCR STD_AXIS psl dez 4 0.00 255.0 FORMAT "%5.1" DEPOSIT ABSOLUTE /end AXIS_DESCR
/end CHARACTERISTIC
/begin CHARACTERISTIC NSMNEGS "Soll-Drehzahlschwelle f¸r Getriebesteuerung B_nsmin" VALUE 0xFC6C68 KwUb 2550. nmot_ub_q10 0.00 2550. FORMAT "%5.0" /end CHARACTERISTIC
/begin CHARACTERISTIC NSMNGD "" VALUE 0xFC6C69 KwUb 2550. nmot_ub_q10 0.00 2550. FORMAT "%5.0" /end CHARACTERISTIC
/begin CHARACTERISTIC NSMNGDFS "" VALUE 0xFC6C6A KwUb 2550. nmot_ub_q10 0.00 2550. FORMAT "%5.0" /end CHARACTERISTIC
/begin CHARACTERISTIC NSMNTD "" VALUE 0xFC6C6B KwUb 2550. nmot_ub_q10 0.00 2550. FORMAT "%5.0" /end CHARACTERISTIC
/begin CHARACTERISTIC NSMNTDFS "" VALUE 0xFC6C6C KwUb 2550. nmot_ub_q10 0.00 2550. FORMAT "%5.0" /end CHARACTERISTIC
/begin CHARACTERISTIC NSNOT "Solldrehzahlanhebung bei B_nnot=1" VALUE 0xFC6C6D KwUb 2550. nmot_ub_q10 0.00 2550. FORMAT "%5.0" /end CHARACTERISTIC
/begin CHARACTERISTIC NSNOT1 "Solldrehzahlanhebung bei Notlauf" VALUE 0xFC6C6E KwUb 2550. nmot_ub_q10 0.00 2550. FORMAT "%5.0" /end CHARACTERISTIC
/begin CHARACTERISTIC NSNOT1FS "Solldrehzahlanhebung bei Notlauf und Fahrstufe EIN" VALUE 0xFC6C6F KwUb 2550. nmot_ub_q10 0.00 2550. FORMAT "%5.0" /end CHARACTERISTIC
/begin CHARACTERISTIC NSNOTFS "Solldrehzahlanhebung bei B_nnot=1 und Fahrstufe" VALUE 0xFC6C70 KwUb 2550. nmot_ub_q10 0.00 2550. FORMAT "%5.0" /end CHARACTERISTIC
/begin CHARACTERISTIC NSOELH "Solldrehzahl bei hoher ÷ltemperatur" VALUE 0xFC6C71 KwUb 2550. nmot_ub_q10 0.00 2550. FORMAT "%5.0" /end CHARACTERISTIC
/begin CHARACTERISTIC NSOELHFS "Solldrehzahl bei hoher ÷ltemperatur und Fahrstufe eingelegt" VALUE 0xFC6C72 KwUb 2550. nmot_ub_q10 0.00 2550. FORMAT "%5.0" /end CHARACTERISTIC
/begin CHARACTERISTIC NSUBO "nsoll bei Batterieladebilanz zu niedrig" VALUE 0xFC99F1 KwWU8 2550. nmot_ub_q10 0.00 2550. FORMAT "%5.0" /end CHARACTERISTIC
/begin CHARACTERISTIC NSUBU "nsoll bei Batterieladebilanz iO" VALUE 0xFC99F2 KwWU8 2550. nmot_ub_q10 0.00 2550. FORMAT "%5.0" /end CHARACTERISTIC
/begin CHARACTERISTIC NTEB "Angehobene Solldrehzahl bei stark beladenem AKF" VALUE 0xFC6C73 KwUb 2550. nmot_ub_q10 0.00 2550. FORMAT "%5.0" /end CHARACTERISTIC
/begin CHARACTERISTIC NTEBFS "Angehobene Solldrehzahl bei stark beladenem AKF und B_fs=1" VALUE 0xFC6C74 KwUb 2550. nmot_ub_q10 0.00 2550. FORMAT "%5.0" /end CHARACTERISTIC
/begin CHARACTERISTIC NW0FLANKE "Flankenkorrektur Einlass Bank 1" VAL_BLK 0xFC655E KwbUw 6554. sprzi_q0p1 0.00 6554. FORMAT "%4.0" NUMBER 4 /end CHARACTERISTIC
/begin CHARACTERISTIC NW1FLANKE "" VAL_BLK 0xFC6566 KwbUw 6554. sprzi_q0p1 0.00 6554. FORMAT "%4.0" NUMBER 4 /end CHARACTERISTIC
/begin CHARACTERISTIC NW2FLANKE "" VAL_BLK 0xFC656E KwbUw 6554. sprzi_q0p1 0.00 6554. FORMAT "%4.0" NUMBER 4 /end CHARACTERISTIC
/begin CHARACTERISTIC NW3FLANKE "" VAL_BLK 0xFC6576 KwbUw 6554. sprzi_q0p1 0.00 6554. FORMAT "%4.0" NUMBER 4 /end CHARACTERISTIC
/begin CHARACTERISTIC NWSEGOFFS "Vanos Segmentoffset zur Flankenidentifikation" VAL_BLK 0xFC657E KwbUw 180. sprzi_q0p1 0.00 180. FORMAT "%4.0" NUMBER 4 /end CHARACTERISTIC
/begin CHARACTERISTIC OFTUMGCAN "Offset Umgebungstemperatur CAN" VALUE 0xFC96E9 KwWS8 255.0 temp_q1 -128.0 127.0 FORMAT "%5.1" /end CHARACTERISTIC
/begin CHARACTERISTIC OFULADE "" VALUE 0xFC9714 KwWR32 16.000000000000000 fak_r32_1 0.00 16.000000000000000 FORMAT "%43.40" /end CHARACTERISTIC
/begin CHARACTERISTIC OUINIGEN "Initialisierungswert Offset Generatorspannung (%00000!)" VALUE 0xFC6536 KwUb 255.0 default 0.00 255.0 FORMAT "%5.1" /end CHARACTERISTIC
/begin CHARACTERISTIC PLBATTUMG "Plausibilisierung-Schwelle Batterieumgebungstemperatur" VALUE 0xFC9718 KwWR32 2.000000000000E+037 fak_r32_1 -1.000000000000E+037 1.000000000000E+037 FORMAT "%43.4" /end CHARACTERISTIC
/begin CHARACTERISTIC PVDN "LLR: P-Verst‰rkung bei stehendem Fahrzeug" CURVE 0xFC6D20 GklWUb 0.7782 rel_ub_b0p78 0.00 0.7782
 /begin AXIS_DESCR COM_AXIS dn_w nmotd_sw_q0p25 8 -8192.000 8191.750 FORMAT "%8.3" AXIS_PTS_REF SDN08LLSW /end AXIS_DESCR
/end CHARACTERISTIC
/begin CHARACTERISTIC PVDNT "" CURVE 0xFC6D28 GklWUb 0.7782 rel_ub_b0p78 0.00 0.7782
 /begin AXIS_DESCR COM_AXIS dn_w nmotd_sw_q0p25 8 -8192.000 8191.750 FORMAT "%8.3" AXIS_PTS_REF SDN08LLTSW /end AXIS_DESCR
/end CHARACTERISTIC
/begin CHARACTERISTIC PVDNTV "" CURVE 0xFC6D30 GklWUb 0.7782 rel_ub_b0p78 0.00 0.7782
 /begin AXIS_DESCR COM_AXIS dn_w nmotd_sw_q0p25 8 -8192.000 8191.750 FORMAT "%8.3" AXIS_PTS_REF SDN08LLTSW /end AXIS_DESCR
/end CHARACTERISTIC
/begin CHARACTERISTIC PVDNV "LLR: P-Verst‰rkung bei rollendem Fahrzeug" CURVE 0xFC6D38 GklWUb 0.7782 rel_ub_b0p78 0.00 0.7782
 /begin AXIS_DESCR COM_AXIS dn_w nmotd_sw_q0p25 8 -8192.000 8191.750 FORMAT "%8.3" AXIS_PTS_REF SDN08LLSW /end AXIS_DESCR
/end CHARACTERISTIC
/begin CHARACTERISTIC PVDNVZ "LLR: P-Z¸ndungsanteilverst‰rkung bei rollendem Fzg." CURVE 0xFC6D40 GklWUb 0.7782 rel_ub_b0p78 0.00 0.7782
 /begin AXIS_DESCR COM_AXIS dn_w nmotd_sw_q0p25 8 -8192.000 8191.750 FORMAT "%8.3" AXIS_PTS_REF SDN08LLSW /end AXIS_DESCR
/end CHARACTERISTIC
/begin CHARACTERISTIC PVDNVZT "" CURVE 0xFC6D48 GklWUb 0.7782 rel_ub_b0p78 0.00 0.7782
 /begin AXIS_DESCR COM_AXIS dn_w nmotd_sw_q0p25 8 -8192.000 8191.750 FORMAT "%8.3" AXIS_PTS_REF SDN08LLTSW /end AXIS_DESCR
/end CHARACTERISTIC
/begin CHARACTERISTIC PVDNZ "LLR: P-Z¸ndungsanteilverst‰rkung bei stehendem Fzg." CURVE 0xFC6D50 GklWUb 0.7782 rel_ub_b0p78 0.00 0.7782
 /begin AXIS_DESCR COM_AXIS dn_w nmotd_sw_q0p25 8 -8192.000 8191.750 FORMAT "%8.3" AXIS_PTS_REF SDN08LLSW /end AXIS_DESCR
/end CHARACTERISTIC
/begin CHARACTERISTIC PVDNZT "" CURVE 0xFC6D58 GklWUb 0.7782 rel_ub_b0p78 0.00 0.7782
 /begin AXIS_DESCR COM_AXIS dn_w nmotd_sw_q0p25 8 -8192.000 8191.750 FORMAT "%8.3" AXIS_PTS_REF SDN08LLTSW /end AXIS_DESCR
/end CHARACTERISTIC
/begin CHARACTERISTIC QKORRDF "Umquantisierung f¸r DF-Signal auf 0,39%" VALUE 0xFC6537 KwUb 255.0 default 0.00 255.0 FORMAT "%5.1" /end CHARACTERISTIC
/begin CHARACTERISTIC QKORRLR "Umquantisierung f¸r Load Responsewert auf 0,1sec" VALUE 0xFC6538 KwUb 255.0 default 0.00 255.0 FORMAT "%5.1" /end CHARACTERISTIC
/begin CHARACTERISTIC QUFRMN "minimaler fri-Quotient f¸r Station‰rbedingung Lambdaregler" VALUE 0xFC6AD0 KwUw 1.999969 fak_uw_b2 0.00 1.999969 FORMAT "%8.6" /end CHARACTERISTIC
/begin CHARACTERISTIC QUFRMX "maximaler fri-Quotient f¸r Station‰rbedingung Lambdaregler" VALUE 0xFC6AD2 KwUw 1.999969 fak_uw_b2 0.00 1.999969 FORMAT "%8.6" /end CHARACTERISTIC
/begin CHARACTERISTIC RLMXGENOF "relative Luftf¸llungschwelle f¸r Generatorzuschaltung" VALUE 0xFC9A8F KwWU8 191.3 rel_ub_q0p75 0.00 191.3 FORMAT "%5.1" /end CHARACTERISTIC
/begin AXIS_PTS SDN08LLSW "" 0xFC6D76 dn_w SstASwSstSw 16383.75 nmotd_sw_q0p25 8 -8192.000 8191.750 FORMAT "%8.3" DEPOSIT ABSOLUTE /end AXIS_PTS
/begin AXIS_PTS SDN08LLTSW "" 0xFC6D88 dn_w SstASwSstSw 16383.75 nmotd_sw_q0p25 8 -8192.000 8191.750 FORMAT "%8.3" DEPOSIT ABSOLUTE /end AXIS_PTS
/begin CHARACTERISTIC SENE1 "Sensorersatz f¸r Klopfsensor 1" VALUE 0xFC67E5 KwWU8 255.0 dezsub1 1.000 256.0 FORMAT "%5.1" /end CHARACTERISTIC
/begin CHARACTERISTIC SENE2 "Sensorersatz f¸r Klopfsensor 2" VALUE 0xFC67E6 KwWU8 255.0 dezsub1 1.000 256.0 FORMAT "%5.1" /end CHARACTERISTIC
/begin CHARACTERISTIC SENE3 "Sensorersatz f¸r Klopfsensor 3" VALUE 0xFC67E7 KwWU8 255.0 dezsub1 1.000 256.0 FORMAT "%5.1" /end CHARACTERISTIC
/begin CHARACTERISTIC SENE4 "Sensorersatz f¸r Klopfsensor 4" VALUE 0xFC67E8 KwWU8 255.0 dezsub1 1.000 256.0 FORMAT "%5.1" /end CHARACTERISTIC
/begin AXIS_PTS SNG06LLSB "St¸tzstellenverteilung Drehzahlgradient, 6 Sst." 0xFC0F90 ngfil SstAUbSstSb 25500. nmotg_sb_q100 6 -12800. 12700. FORMAT "%5.0" DEPOSIT ABSOLUTE /end AXIS_PTS
/begin AXIS_PTS SNG06LLTSB "" 0xFC0F98 ngfil SstAUbSstSb 25500. nmotg_sb_q100 6 -12800. 12700. FORMAT "%5.0" DEPOSIT ABSOLUTE /end AXIS_PTS
/begin AXIS_PTS SNM06LLUB "S¸tzstellenverteilung f¸r Motordrehzahl" 0xFC0FA8 nmot SstAUbSstUb 10200. nmot_ub_q40 6 0.00 10200. FORMAT "%5.0" DEPOSIT ABSOLUTE /end AXIS_PTS
/begin AXIS_PTS SNM07LRUB "7 Drehzahlst¸tzstellen f¸r ?" 0xFC0FB0 nmot SstAUbSstUb 10200. nmot_ub_q40 7 0.00 10200. FORMAT "%5.0" DEPOSIT ABSOLUTE /end AXIS_PTS
/begin AXIS_PTS SNM16GKUB "St¸tzstellenverteilung Gemischkontrolle 16 nmot St¸tzstellen" 0xFCC864 nmot SstAUbSstUb 10200. nmot_ub_q40 16 0.00 10200. FORMAT "%5.0" DEPOSIT ABSOLUTE /end AXIS_PTS
/begin AXIS_PTS SNM16OPUW "St¸tzstellenverteilung Drehzahl" 0xFC113C nmot_w SstAUwSstUw 16383.75 nmot_uw_q0p25 16 0.00 16383.75 FORMAT "%8.2" DEPOSIT ABSOLUTE /end AXIS_PTS
/begin AXIS_PTS SNS06LLSB "St¸tzstellenvert., Solldrehzahlabw., 06 Sst., LL-Regel." 0xFC6C78 dns SstAUbSstSb 2550. nmotd_sb_q10 6 -1280. 1270. FORMAT "%5.0" DEPOSIT ABSOLUTE /end AXIS_PTS
/begin AXIS_PTS SNS06LLTSB "" 0xFC6C80 dns SstAUbSstSb 2550. nmotd_sb_q10 6 -1280. 1270. FORMAT "%5.0" DEPOSIT ABSOLUTE /end AXIS_PTS
/begin AXIS_PTS SRL06LRUB "6 F¸llungsst¸tzstellen f¸r ?" 0xFC1090 rl SstAUbSstUb 191.3 rel_ub_q0p75 6 0.00 191.3 FORMAT "%5.1" DEPOSIT ABSOLUTE /end AXIS_PTS
/begin AXIS_PTS SRL12GKUB "12 F¸llungsst¸tzstellen f¸r ?" 0xFCC894 rl SstAUbSstUb 191.3 rel_ub_q0p75 12 0.00 191.3 FORMAT "%5.1" DEPOSIT ABSOLUTE /end AXIS_PTS
/begin AXIS_PTS SRL16OPUW "St¸tzstellenverteilung relative Luftf¸llung" 0xFC7C16 rl_w_kge SstAUwSstUw 1535.977 rel_uw_q0p0234 16 0.00 1535.977 FORMAT "%8.3" DEPOSIT ABSOLUTE /end AXIS_PTS
/begin AXIS_PTS STA04SAUB "" 0xFC10F0 tans SstAUbSstUb 191.3 temp_ub_q0p75_o48 4 -48.00 143.3 FORMAT "%5.1" DEPOSIT ABSOLUTE /end AXIS_PTS
/begin CHARACTERISTIC STKRLDY "St¸tzstellengrenzwert f¸r KR-Adaption bei Lastdynamik" VALUE 0xFC67F1 KwUb 255.0 dez 0.00 255.0 FORMAT "%5.1" /end CHARACTERISTIC
/begin CHARACTERISTIC STKRNDY "St¸tzstellengrenzwert f¸r KR-Adaption bei Drehzahldynamik" VALUE 0xFC67F2 KwUb 255.0 dez 0.00 255.0 FORMAT "%5.1" /end CHARACTERISTIC
/begin AXIS_PTS STM04SAUB "St¸tzstellenverteilung Motortemperatur, 4 Sst." 0xFC1100 tmot SstAUbSstUb 191.3 temp_ub_q0p75_o48 4 -48.00 143.3 FORMAT "%5.1" DEPOSIT ABSOLUTE /end AXIS_PTS
/begin AXIS_PTS STM06LLTUB "" 0xFCC8C4 tmot SstAUbSstUb 191.3 temp_ub_q0p75_o48 6 -48.00 143.3 FORMAT "%5.1" DEPOSIT ABSOLUTE /end AXIS_PTS
/begin AXIS_PTS STM06LLUB "St¸tzstellenverteilung Motortemperatur, 6 Sst." 0xFCC8CC tmot SstAUbSstUb 191.3 temp_ub_q0p75_o48 6 -48.00 143.3 FORMAT "%5.1" DEPOSIT ABSOLUTE /end AXIS_PTS
/begin AXIS_PTS STM12ESUB "SST-Verteilung f¸r die Motortemperatur tmot" 0xFCC90C tmot SstAUbSstUb 191.3 temp_ub_q0p75_o48 12 -48.00 143.3 FORMAT "%5.1" DEPOSIT ABSOLUTE /end AXIS_PTS
/begin CHARACTERISTIC S_LORESLL "Schalter Kennlinienausschaltzeit" VALUE 0xFC9A90 KwWU8 1.000 default 0.00 1.000 FORMAT "%5.3" /end CHARACTERISTIC
/begin CHARACTERISTIC S_RDGENTYP "Schalter APK zum Auslesen Generator Hersteller und Typ" VALUE 0xFC6539 KwUb 255.0 dez 0.00 255.0 FORMAT "%5.1" /end CHARACTERISTIC
/begin CHARACTERISTIC TABGBTS "Abgastemperaturschwelle f¸r Bauteileschutz" VALUE 0xFCDDE4 KwUw 1279.980 temp_uw_q0p0195_o50 -50.00000 1229.980 FORMAT "%8.3" /end CHARACTERISTIC
/begin CHARACTERISTIC TABKOR "Kennlinie Korrektur tkrststart ¸ber Abstellzeit" CURVE 0xFC5256 KlAxU8SstxU16WU16 1.992188 fak_ub_b2 0.00 1.992188 FORMAT "%8.6"
 /begin AXIS_DESCR STD_AXIS tabst_w t1sxs_uw_q1 9 0.00 65535.00 FORMAT "%8.2" DEPOSIT ABSOLUTE /end AXIS_DESCR
/end CHARACTERISTIC
/begin CHARACTERISTIC TABSTGNMN "" VALUE 0xFC9A86 KwWU16 65535.00 t1sxs_uw_q1 0.00 65535.00 FORMAT "%8.2" /end CHARACTERISTIC
/begin CHARACTERISTIC TABSTGNMX "" VALUE 0xFC9A88 KwWU16 65535.00 t1sxs_uw_q1 0.00 65535.00 FORMAT "%8.2" /end CHARACTERISTIC
/begin CHARACTERISTIC TATMGENOF "Motordrehzahlschwelle  Katalysatortemperatur" VALUE 0xFC9A91 KwWU8 1275. temp_ub_q5_o50 -50.00 1225. FORMAT "%5.0" /end CHARACTERISTIC
/begin CHARACTERISTIC TBATINIMAN "Applikation INITWERT Batterietemperatur" VALUE 0xFC96EA KwWU8 191.3 temp_ub_q0p75_o48 -48.00 143.3 FORMAT "%5.1" /end CHARACTERISTIC
/begin CHARACTERISTIC TBATTFTAUV "Zeitkonstante 5*Tau Batterievorne" VALUE 0xFC96DC KwWU16 65535.00 t1sxs_uw_q1 0.00 65535.00 FORMAT "%8.2" /end CHARACTERISTIC
/begin CHARACTERISTIC TBATTTAUFH "Zeitkonstante Batterie 5*Tau hinten" VALUE 0xFC971C KwWR32 65535.000000000000 fak_r32_1 0.00 65535.000000000000 FORMAT "%43.37" /end CHARACTERISTIC
/begin CHARACTERISTIC TDKLAGDE "Zeitdelta f¸r Fehlerz‰hlerlˆschung bei DK-Soll-/Istvergleich" VALUE 0xFC64EA KwUb 5.100 t20msxs_ub_b5p1 0.00 5.100 FORMAT "%5.3" /end CHARACTERISTIC
/begin CHARACTERISTIC TDLRHAFTMX "Verweildauer f¸r Aktivierung der Haftreibungsroutine" VALUE 0xFCE342 KwUb 12.75 t50msxs_q0p05 0.00 12.75 FORMAT "%5.2" /end CHARACTERISTIC
/begin CHARACTERISTIC TDLRPIDC "Zeitdelta zur Fehlerzeitdecrementierung bei DLR-Stellbereichs¸berwachung" VALUE 0xFC6526 KwUw 655.3500 t10msxs_uw_b655p35 0.00 655.3500 FORMAT "%8.4" /end CHARACTERISTIC
/begin CHARACTERISTIC TDMRESLL "Sperrzeit f¸r die erhˆhte Momentenreserve nach dem Start" VALUE 0xFCF2DA KwUb 51.00 t200msxs_ub_b51 0.00 51.00 FORMAT "%5.2" /end CHARACTERISTIC
/begin CHARACTERISTIC TEEMRDYMAX "Max. Wert Zeitz‰hler f¸r EEPROM-Spiegel-Bereitschaft" VALUE 0xFCE34B KwUb 25.30 t100msxs_ub_b25p5 0.2000 25.50 FORMAT "%5.2" /end CHARACTERISTIC
/begin CHARACTERISTIC TFWLMKHKST "" VALUE 0xFCE625 KwUb 25.4996 zk100msxs_ub_b25p5 0.100392 25.6000 FORMAT "%7.4" /end CHARACTERISTIC
/begin CHARACTERISTIC TGENIDLE "Idlezeit f¸r Generatorschnittstelle bis zum n‰chsten Initialisierungsversuch" VALUE 0xFC653E KwUw 3276.750 t50msxs_q0p05 0.00 3276.750 FORMAT "%8.3" /end CHARACTERISTIC
/begin CHARACTERISTIC TGENOFVL "Generatorsabschaltzeit bei Vollastbeschleunigung" VALUE 0xFC9A92 KwWU8 255.0 t1sxs_ub_q1 0.00 255.0 FORMAT "%5.1" /end CHARACTERISTIC
/begin CHARACTERISTIC TKAKOR "Kennlinie Korrektur" CURVE 0xFC527C KlAxU8SstxS16WS16 383.2500 temp_sb_q0p75 -192.0000 191.2500 FORMAT "%8.4"
 /begin AXIS_DESCR STD_AXIS tkakor_in temp_sb_q0p75 6 -192.0000 191.2500 FORMAT "%8.4" DEPOSIT ABSOLUTE /end AXIS_DESCR
/end CHARACTERISTIC
/begin CHARACTERISTIC TKATBTS "Kat-Temperaturschwelle f¸r Bauteileschutz" VALUE 0xFCDDE6 KwUw 1279.980 temp_uw_q0p0195_o50 -50.00000 1229.980 FORMAT "%8.3" /end CHARACTERISTIC
/begin CHARACTERISTIC TKRSTINT "Initialisierung tkrstab" VALUE 0xFC52AE KwWU8 191.3 temp_ub_q0p75_o48 -48.00 143.3 FORMAT "%5.1" /end CHARACTERISTIC
/begin CHARACTERISTIC TKWPERIOD "" VALUE 0xFC65A2 KwWS16 6553.500 t_q0p1ms -3276.800 3276.700 FORMAT "%8.3" /end CHARACTERISTIC
/begin CHARACTERISTIC TLAFA "Vezˆgerungszeit bis Lambda Fahrerwunsch aktiv" VALUE 0xFCDEED KwUb 25.50 t100msxs_ub_b25p5 0.00 25.50 FORMAT "%5.2" /end CHARACTERISTIC
/begin CHARACTERISTIC TLORESPST "Startloadresponse" VALUE 0xFC9A93 KwWU8 25.50 t100msxs_ub_b25p5 0.00 25.50 FORMAT "%5.2" /end CHARACTERISTIC
/begin CHARACTERISTIC TMKR "Motortemperaturschwelle f¸r Klopfregelung aktiv" VALUE 0xFCEED1 KwUb 191.3 temp_ub_q0p75_o48 -48.00 143.3 FORMAT "%5.1" /end CHARACTERISTIC
/begin CHARACTERISTIC TMKRA "Motortemperaturschwelle f¸r adaptive Klopfregelung" VALUE 0xFCEED2 KwUb 191.3 temp_ub_q0p75_o48 -48.00 143.3 FORMAT "%5.1" /end CHARACTERISTIC
/begin CHARACTERISTIC TMLLRNS "Motortemperaturschwelle f¸r Solldrehzahlverstellung ¸ber Tester" VALUE 0xFCF26E KwUb 191.3 temp_ub_q0p75_o48 -48.00 143.3 FORMAT "%5.1" /end CHARACTERISTIC
/begin CHARACTERISTIC TMNV "Temperaturschwelle f¸r DS2-Nsoll-Verstellung bei FS=0" VALUE 0xFCF26F KwUb 191.3 temp_ub_q0p75_o48 -48.00 143.3 FORMAT "%5.1" /end CHARACTERISTIC
/begin CHARACTERISTIC TMNVFS "Temperaturschwelle f¸r DS2-Nsoll-Verstellung bei FS=1" VALUE 0xFCF270 KwUb 191.3 temp_ub_q0p75_o48 -48.00 143.3 FORMAT "%5.1" /end CHARACTERISTIC
/begin CHARACTERISTIC TMOTABGNMN "" VALUE 0xFC9A94 KwWU8 191.3 temp_ub_q0p75_o48 -48.00 143.3 FORMAT "%5.1" /end CHARACTERISTIC
/begin CHARACTERISTIC TMSTLMS "" VALUE 0xFCE626 KwUb 191.3 temp_ub_q0p75_o48 -48.00 143.3 FORMAT "%5.1" /end CHARACTERISTIC
/begin CHARACTERISTIC TMVL "Motortemperaturschwelle f¸r Vollasterkennung" VALUE 0xFCDEEE KwUb 191.3 temp_ub_q0p75_o48 -48.00 143.3 FORMAT "%5.1" /end CHARACTERISTIC
/begin CHARACTERISTIC TNNSTART "Zeittriggerschwelle nach Motorstart" VALUE 0xFC99E8 KwWU16 655.3500 t10msxs_uw_b655p35 0.00 655.3500 FORMAT "%8.4" /end CHARACTERISTIC
/begin CHARACTERISTIC TOGVERZOEG "Zaehler zum Ausblenden neg. Flanken der Einschwingphase" VALUE 0xFC6592 KwWU8 255.0 dez 0.00 255.0 FORMAT "%5.1" /end CHARACTERISTIC
/begin CHARACTERISTIC TOG_TK_MAX "Maximale Abkuehlzeit TOG" VALUE 0xFC6586 KwWU16 6553.500 t_q0p1ms 0.00 6553.500 FORMAT "%8.3" /end CHARACTERISTIC
/begin CHARACTERISTIC TOG_TK_MIN "Minimale Abkuehlzeit TOG" VALUE 0xFC6588 KwWU16 6553.500 t_q0p1ms 0.00 6553.500 FORMAT "%8.3" /end CHARACTERISTIC
/begin CHARACTERISTIC TOG_TR_MAX "Maximale Referenzzeit TOG" VALUE 0xFC658A KwWU16 6553.500 t_q0p1ms 0.00 6553.500 FORMAT "%8.3" /end CHARACTERISTIC
/begin CHARACTERISTIC TOG_TR_MIN "Minimale Referenzzeit TOG" VALUE 0xFC658C KwWU16 6553.500 t_q0p1ms 0.00 6553.500 FORMAT "%8.3" /end CHARACTERISTIC
/begin CHARACTERISTIC TOG_TV_MAX "Maximale Oeltemperaturzeit TOG" VALUE 0xFC658E KwWU16 6553.500 t_q0p1ms 0.00 6553.500 FORMAT "%8.3" /end CHARACTERISTIC
/begin CHARACTERISTIC TOG_TV_MIN "Minimale Oeltemperaturzeit TOG" VALUE 0xFC6590 KwWU16 6553.500 t_q0p1ms 0.00 6553.500 FORMAT "%8.3" /end CHARACTERISTIC
/begin CHARACTERISTIC TOG_VERS "TOG Version" VALUE 0xFC6593 KwWU8 2.000 dez 0.00 2.000 FORMAT "%5.3" /end CHARACTERISTIC
/begin CHARACTERISTIC TPWRSV "Wartezeit bis DV-E Powersave aktiv wird" VALUE 0xFC6528 KwUw 655.3500 t10msxs_uw_b655p35 0.00 655.3500 FORMAT "%8.4" /end CHARACTERISTIC
/begin CHARACTERISTIC TSPERN "Sperrzeit P-Sprung nach Sondensprung" CURVE 0xFC6A9C KlAUbSstUbWUb 2.550 t10msxs_ub_b2p55 0.00 2.550 FORMAT "%5.3"
 /begin AXIS_DESCR STD_AXIS nmot nmot_ub_q40 7 0.00 10200. FORMAT "%5.0" DEPOSIT ABSOLUTE /end AXIS_DESCR
/end CHARACTERISTIC
/begin CHARACTERISTIC TSPERN2 "Sperrzeit P-Sprung nach Sondensprung, Bank 2" CURVE 0xFC6AAC KlAUbSstUbWUb 2.550 t10msxs_ub_b2p55 0.00 2.550 FORMAT "%5.3"
 /begin AXIS_DESCR STD_AXIS nmot nmot_ub_q40 7 0.00 10200. FORMAT "%5.0" DEPOSIT ABSOLUTE /end AXIS_DESCR
/end CHARACTERISTIC
/begin CHARACTERISTIC TUMGGNMN "" VALUE 0xFC9A95 KwWU8 191.3 temp_ub_q0p75_o48 -48.00 143.3 FORMAT "%5.1" /end CHARACTERISTIC
/begin CHARACTERISTIC TUMGGNMX "" VALUE 0xFC9A96 KwWU8 191.3 temp_ub_q0p75_o48 -48.00 143.3 FORMAT "%5.1" /end CHARACTERISTIC
/begin CHARACTERISTIC TUMGINI "Initialisierungswert Aussentemperaturmodell" VALUE 0xFC96EB KwWS8 255.0 temp_q1 -128.0 127.0 FORMAT "%5.1" /end CHARACTERISTIC
/begin CHARACTERISTIC TUMGTAU "Zeitkonstante 5*Tau Aussentemperatur" VALUE 0xFC96DE KwWU16 65535.00 t1sxs_uw_q1 0.00 65535.00 FORMAT "%8.2" /end CHARACTERISTIC
/begin CHARACTERISTIC TVDK "Verzˆgerungszeit nach Schlieﬂen der Drosselklappe" VALUE 0xFC6C16 KwUb 5.100 t20msxs_ub_b5p1 0.00 5.100 FORMAT "%5.3" /end CHARACTERISTIC
/begin CHARACTERISTIC TVKUPPL "Verzˆgerungszeit f¸r die Information des Kupplungsschalter" VALUE 0xFC6C17 KwUb 5.100 t20msxs_ub_b5p1 0.00 5.100 FORMAT "%5.3" /end CHARACTERISTIC
/begin CHARACTERISTIC TVLISTUM "Verbotszeit f¸r negativen Integratoranteil nach Start" CURVE 0xFC6D60 KlAUbSstUbWUb 5.100 t20msxs_ub_b5p1 0.00 5.100 FORMAT "%5.3"
 /begin AXIS_DESCR STD_AXIS tmot temp_ub_q0p75_o48 3 -48.00 143.3 FORMAT "%5.1" DEPOSIT ABSOLUTE /end AXIS_DESCR
/end CHARACTERISTIC
/begin CHARACTERISTIC TVLISTUMT "" CURVE 0xFC6D68 KlAUbSstUbWUb 5.100 t20msxs_ub_b5p1 0.00 5.100 FORMAT "%5.3"
 /begin AXIS_DESCR STD_AXIS tmot temp_ub_q0p75_o48 3 -48.00 143.3 FORMAT "%5.1" DEPOSIT ABSOLUTE /end AXIS_DESCR
/end CHARACTERISTIC
/begin CHARACTERISTIC TVLLRI "Verzˆgerungszeit f¸r Freigabe I-Anteil nach Start" CURVE 0xFC6C18 KlAUbSstUbWUb 5.100 t20msxs_ub_b5p1 0.00 5.100 FORMAT "%5.3"
 /begin AXIS_DESCR STD_AXIS tmot temp_ub_q0p75_o48 6 -48.00 143.3 FORMAT "%5.1" DEPOSIT ABSOLUTE /end AXIS_DESCR
/end CHARACTERISTIC
/begin CHARACTERISTIC TVLLRIT "" CURVE 0xFC6C28 KlAUbSstUbWUb 5.100 t20msxs_ub_b5p1 0.00 5.100 FORMAT "%5.3"
 /begin AXIS_DESCR STD_AXIS tmot temp_ub_q0p75_o48 6 -48.00 143.3 FORMAT "%5.1" DEPOSIT ABSOLUTE /end AXIS_DESCR
/end CHARACTERISTIC
/begin CHARACTERISTIC TVLLRMRTEV "Verzˆgerungszeit MD-Reserve Wegnahme nach TEV-Drehzahlpr¸." VALUE 0xFC6E0D KwUb 51.00 t200msxs_ub_b51 0.00 51.00 FORMAT "%5.2" /end CHARACTERISTIC
/begin CHARACTERISTIC TVLLRPD "Maximale Verzˆgerungszeit f¸r Freigabe PD-Anteil nach Start" CURVE 0xFC6C38 KlAUbSstUbWUb 5.100 t20msxs_ub_b5p1 0.00 5.100 FORMAT "%5.3"
 /begin AXIS_DESCR STD_AXIS tmot temp_ub_q0p75_o48 6 -48.00 143.3 FORMAT "%5.1" DEPOSIT ABSOLUTE /end AXIS_DESCR
/end CHARACTERISTIC
/begin CHARACTERISTIC TVLLRPDT "" CURVE 0xFC6C48 KlAUbSstUbWUb 5.100 t20msxs_ub_b5p1 0.00 5.100 FORMAT "%5.3"
 /begin AXIS_DESCR STD_AXIS tmot temp_ub_q0p75_o48 6 -48.00 143.3 FORMAT "%5.1" DEPOSIT ABSOLUTE /end AXIS_DESCR
/end CHARACTERISTIC
/begin CHARACTERISTIC TVLOFHYST "Hysterese Generatorvollastabschaltung" VALUE 0xFC9A97 KwWU8 255.0 t1sxs_ub_q1 0.00 255.0 FORMAT "%5.1" /end CHARACTERISTIC
/begin CHARACTERISTIC TVRESFS "Haltezeit f¸r die erhˆhte Momentenrerserve nach Einlegen der Fahrstufe" VALUE 0xFCF2DB KwUb 51.00 t200msxs_ub_b51 0.00 51.00 FORMAT "%5.2" /end CHARACTERISTIC
/begin CHARACTERISTIC TVRESLL "Haltezeit f¸r die erhˆhte Momentenrerserve nach Drehzahleinbruch" VALUE 0xFCF2DC KwUb 51.00 t200msxs_ub_b51 0.00 51.00 FORMAT "%5.2" /end CHARACTERISTIC
/begin CHARACTERISTIC TWDKNL "Zeit nach nmot = 0 und Kl.15 AUS bis Nachlauf gestartet wird" VALUE 0xFCE343 KwUb 25.50 t100msxs_ub_b25p5 0.00 25.50 FORMAT "%5.2" /end CHARACTERISTIC
/begin CHARACTERISTIC UBATTNORM "Batterienormspannung" VALUE 0xFC9720 KwWR32 2.000000000000E+037 fak_r32_1 -1.000000000000E+037 1.000000000000E+037 FORMAT "%43.4" /end CHARACTERISTIC
/begin CHARACTERISTIC UDKNLPTOL "zul‰ssige Potispannungs-Toleranz des NLP" VALUE 0xFC652A KwUw 80.08377 spg_uw_q0p001222 0.00 80.08377 FORMAT "%8.5" /end CHARACTERISTIC
/begin CHARACTERISTIC UGENTYP "typische Generator-Sollspannung (default = 13,8V)" VALUE 0xFC653A KwUb 25.50 spg_ugen 10.60 36.10 FORMAT "%5.2" /end CHARACTERISTIC
/begin CHARACTERISTIC UGMN "Minimaler Sollspannungswert Generator (normalerweise 10,7V)" VALUE 0xFC653B KwUb 25.50 spg_ugen 10.60 36.10 FORMAT "%5.2" /end CHARACTERISTIC
/begin CHARACTERISTIC UGMX "Maximalwert Generatorsollspannung" VALUE 0xFC653C KwUb 25.50 spg_ugen 10.60 36.10 FORMAT "%5.2" /end CHARACTERISTIC
/begin CHARACTERISTIC ULADE_TAU "Batterieladespannungs Zeitkonstante" VALUE 0xFC9724 KwWR32 1.000000000000000 fak_r32_1 0.00 1.000000000000000 FORMAT "%43.41" /end CHARACTERISTIC
/begin CHARACTERISTIC USR "Regelschwelle f¸r Regelung vor Kat" VALUE 0xFC6ABB KwUb 1.330 spg_ub_q0p0052_o0p2 -0.2000 1.130 FORMAT "%5.3" /end CHARACTERISTIC
/begin CHARACTERISTIC VGENOFMN "Geschwindigkeitgeneratorabschaltschwelle bei Vollastbeschleunigung" VALUE 0xFC9A98 KwWU8 318.8 vfzg_ub_q1p25 0.00 318.8 FORMAT "%5.1" /end CHARACTERISTIC
/begin CHARACTERISTIC VGENOGMX "Geschwindigkeitgeneratorzuschaltschwelle bei Vollastbeschleunigung" VALUE 0xFC9A99 KwWU8 318.8 vfzg_ub_q1p25 0.00 318.8 FORMAT "%5.1" /end CHARACTERISTIC
/begin CHARACTERISTIC VLLR "Fahrzeuggeschwindigkeitsschwelle f¸r Leerlaufregelung" VALUE 0xFC6C55 KwUb 318.8 vfzg_ub_q1p25 0.00 318.8 FORMAT "%5.1" /end CHARACTERISTIC
/begin CHARACTERISTIC VMINUMG "Fahrzeuggeschwindigkeitsschwelle Aussentemperaturmodell" VALUE 0xFC96EC KwWU8 318.8 vfzg_ub_q1p25 0.00 318.8 FORMAT "%5.1" /end CHARACTERISTIC
/begin CHARACTERISTIC VS100ZWKR "Zylinderindividuelle ZW-Verstellung durch VS100" VAL_BLK 0xFC67DC KwbWS8 190.5 zw_sb_qn0p75 -95.25 95.25 FORMAT "%5.2" NUMBER 8 /end CHARACTERISTIC
/begin CHARACTERISTIC VZLORESOFV "Geschwindigkeitsschwelle f¸r Generatorzuschaltung" VALUE 0xFC9A9A KwWU8 318.8 vfzg_ub_q1p25 0.00 318.8 FORMAT "%5.1" /end CHARACTERISTIC
/begin CHARACTERISTIC WDKBEWS "Schwelle zur DK-Bewegungserkennung (I-Klein)" VALUE 0xFC652C KwSw 1599.976 relDK_q0p02441 -800.0000 799.9756 FORMAT "%8.4" /end CHARACTERISTIC
/begin CHARACTERISTIC WDKNLPTOL "zul‰ssige DK-Winkel-Toleranz des NLP" VALUE 0xFC652E KwUw 100.0000 relDK_uw_b100 0.00 100.0000 FORMAT "%8.4" /end CHARACTERISTIC
/begin CHARACTERISTIC WDKREIB "Haftreibungsanteil der DK f¸r I-Klein" VALUE 0xFC64EB KwUb 0.9961 fak_ub_b1 0.00 0.9961 /end CHARACTERISTIC
/begin CHARACTERISTIC WDKSAPNOL "DK-Sollwert bei Applikationshilfe DK-Notluftfahren" VALUE 0xFC6530 KwUw 99.99847 relDK_q0p00152 0.00 99.99847 FORMAT "%8.5" /end CHARACTERISTIC
/begin CHARACTERISTIC WDKSTFEIN "Schwelle zur Stationarit‰tserkennung (verst‰rkter Bereich)" VALUE 0xFC6532 KwSw 1599.976 relDK_q0p02441 -800.0000 799.9756 FORMAT "%8.4" /end CHARACTERISTIC
/begin CHARACTERISTIC WDKSTGROB "Schwelle zur Stationarit‰tserkennung (unverst‰rkter Bereich)" VALUE 0xFC6534 KwSw 1599.976 relDK_q0p02441 -800.0000 799.9756 FORMAT "%8.4" /end CHARACTERISTIC
/begin CHARACTERISTIC ZDFR "Abregelfaktor Tiefpaﬂ f¸r Adaption Regelhub von fr" VALUE 0xFC6AD4 KwUw 0.9999847 fak_uw_b1 0.00 0.9999847 FORMAT "%9.7" /end CHARACTERISTIC
/begin CHARACTERISTIC ZDLBTS "Zeitkonstante Delta Lambda Bauteileschutz" VALUE 0xFCDDE8 KwUw 6553.50000 zk100msxs_uw_b6553 0.100001526 6553.60000 FORMAT "%10.5" /end CHARACTERISTIC
/begin CHARACTERISTIC ZFLASKH "Zeitkonstante f¸r ‹bergang auf Lambda-Abgas-Vorgabe" VALUE 0xFCE627 KwUb 25.4996 zk100msxs_ub_b25p5 0.100392 25.6000 FORMAT "%7.4" /end CHARACTERISTIC
/begin CHARACTERISTIC ZKLLRD "Zeitkonstante f¸r die Abregelung des D-Anteils" VALUE 0xFC6D9A KwUw 1309.9800107 zk20msxs_uw_b1310 0.019989318685 1310.0000000 FORMAT "%12.7" /end CHARACTERISTIC
/begin CHARACTERISTIC ZKLLRDZ "Zeitkonstante zum Abregeln des D-Z¸ndungsanteils" VALUE 0xFC6D9C KwUw 1309.9800107 zk20msxs_uw_b1310 0.019989318685 1310.0000000 FORMAT "%12.7" /end CHARACTERISTIC
/begin CHARACTERISTIC ZKNS "Zeitkonstante f¸r Solldrehzahl bei Umschaltung" VALUE 0xFC6C87 KwUb 5.08000 zk20msxs_ub_b5p1 0.0200000 5.10000 FORMAT "%7.5" /end CHARACTERISTIC
/begin CHARACTERISTIC ZKTMTKA "Zeitkonstante PT1-Filterung Lufttemperaturanteil" VALUE 0xFC52AF KwWU8 25.40 t100msxs_ub_b25p5 0.1000 25.50 FORMAT "%5.2" /end CHARACTERISTIC
/begin CHARACTERISTIC ZKTMTMOT "Zeitkonstante PT1-Filterung K¸hlwassertemperaturanteil" VALUE 0xFC52B0 KwWU8 25.40 t100msxs_ub_b25p5 0.1000 25.50 FORMAT "%5.2" /end CHARACTERISTIC
/begin CHARACTERISTIC ZKTMVFZLU "Zeitkonstante PT1-Filterung Lufttemperaturanteil K¸hlung" VALUE 0xFC52B1 KwWU8 25.40 t100msxs_ub_b25p5 0.1000 25.50 FORMAT "%5.2" /end CHARACTERISTIC
/begin CHARACTERISTIC ZKUBDLR "DLR, Zeitkonstante f¸r Filterung von Ubatt" VALUE 0xFCE344 KwUb 0.4980 fak_ub_b0p5 0.00 0.4980 /end CHARACTERISTIC
/begin CHARACTERISTIC ZKWDKSPT1 "Zeitkonstante f¸r Pr‰diktion DK-Winkel aus Sollwert" VALUE 0xFC64EC KwUb 0.6973 fak_q0p00273 0.00 0.6973 /end CHARACTERISTIC
/begin CHARACTERISTIC ZLIBG "Filterzeitkonstante f¸r die Nachf¸hrung der Integratorgrenzen" VALUE 0xFC6D6F KwUb 5.08000 zk20msxs_ub_b5p1 0.0200000 5.10000 FORMAT "%7.5" /end CHARACTERISTIC
/begin CHARACTERISTIC ZLRFRI "Zeitkonstante zum Aufregeln des tmst abh‰ngigen Gewichtungsfaktor FFRITMS" VALUE 0xFCF07A KwUw 6553.4999985 zk100msxs_uw_b655 0.10000152590 6553.6000000 FORMAT "%12.7" /end CHARACTERISTIC
/begin CHARACTERISTIC ZNSM "Zeitkonstante f¸r Solldrehzahlabregelung" CURVE 0xFC6C88 GklWUb 5.08000 zk20msxs_ub_b5p1 0.0200000 5.10000 FORMAT "%7.5"
 /begin AXIS_DESCR COM_AXIS tmot temp_ub_q0p75_o48 6 -48.00 143.3 FORMAT "%5.1" AXIS_PTS_REF STM06LLUB /end AXIS_DESCR
/end CHARACTERISTIC
/begin CHARACTERISTIC ZNSMT "Zeitkonstante f¸r Solldrehzahlabregelung gedrosselt" CURVE 0xFC6C90 GklWUb 5.08000 zk20msxs_ub_b5p1 0.0200000 5.10000 FORMAT "%7.5"
 /begin AXIS_DESCR COM_AXIS tmot temp_ub_q0p75_o48 6 -48.00 143.3 FORMAT "%5.1" AXIS_PTS_REF STM06LLTUB /end AXIS_DESCR
/end CHARACTERISTIC
/begin CHARACTERISTIC ZNSUB "Zeitkonstante f¸r Mindestsolldrehzahl bei Unterspannung" VALUE 0xFCF2C9 KwUb 50.9992 zk200msxs_ub_b51p2 0.200784 51.2000 FORMAT "%7.4" /end CHARACTERISTIC
/begin MEASUREMENT abbwevz "Abbruchwinkel Einspritzung" SWORD kw_q1 1 100 -32768 32767 FORMAT "%8.2" ARRAY_SIZE 4 ECU_ADDRESS 0x5B96FC /end MEASUREMENT
/begin MEASUREMENT anzti "ti-Einspritzz‰hler" UBYTE dez 1 100 0 255 FORMAT "%5.1" ECU_ADDRESS 0x5B8C72 /end MEASUREMENT
/begin MEASUREMENT anzti_w "ti-Einspritzz‰hler" UWORD dez 1 100 0 65535 FORMAT "%8.2" ECU_ADDRESS 0x5B9704 /end MEASUREMENT
/begin MEASUREMENT AS_dimdk "" UBYTE B_TRUE 1 100 0 1 BIT_MASK 0x1 FORMAT "%13.11" ECU_ADDRESS 0x3FBE13 /end MEASUREMENT
/begin MEASUREMENT battort "Batterieeinbauort" UBYTE dez 1 100 0 255 FORMAT "%5.1" ECU_ADDRESS 0x5B8996 /end MEASUREMENT
/begin MEASUREMENT batto_a "Temp-Variable" FLOAT32_IEEE fak_r32_1 1 100 -1e+037 1e+037 FORMAT "%43.4" ECU_ADDRESS 0x3FB2B0 /end MEASUREMENT
/begin MEASUREMENT batto_a1 "Temp-Variable" FLOAT32_IEEE fak_r32_1 1 100 -1e+037 1e+037 FORMAT "%43.4" ECU_ADDRESS 0x3FB2B4 /end MEASUREMENT
/begin MEASUREMENT batto_b "Temp-Variable" FLOAT32_IEEE fak_r32_1 1 100 -1e+037 1e+037 FORMAT "%43.4" ECU_ADDRESS 0x3FB2B8 /end MEASUREMENT
/begin MEASUREMENT batto_c "Temp-Variable" FLOAT32_IEEE fak_r32_1 1 100 -1e+037 1e+037 FORMAT "%43.4" ECU_ADDRESS 0x3FB2BC /end MEASUREMENT
/begin MEASUREMENT batto_c1 "Temp-Variable" FLOAT32_IEEE fak_r32_1 1 100 -1e+037 1e+037 FORMAT "%43.4" ECU_ADDRESS 0x3FB2C0 /end MEASUREMENT
/begin MEASUREMENT batto_c2 "Temp-Variable" FLOAT32_IEEE fak_r32_1 1 100 -1e+037 1e+037 FORMAT "%43.4" ECU_ADDRESS 0x3FB2C4 /end MEASUREMENT
/begin MEASUREMENT batto_c3 "Temp-Variable" FLOAT32_IEEE fak_r32_1 1 100 -1e+037 1e+037 FORMAT "%43.4" ECU_ADDRESS 0x3FB2C8 /end MEASUREMENT
/begin MEASUREMENT batto_c4 "Temp-Variable" FLOAT32_IEEE fak_r32_1 1 100 -1e+037 1e+037 FORMAT "%43.4" ECU_ADDRESS 0x3FB2CC /end MEASUREMENT
/begin MEASUREMENT batto_c6 "Temp-Variable" FLOAT32_IEEE fak_r32_1 1 100 -1e+037 1e+037 FORMAT "%43.4" ECU_ADDRESS 0x3FB2D0 /end MEASUREMENT
/begin MEASUREMENT batto_c7 "Temp-Variable" FLOAT32_IEEE fak_r32_1 1 100 -1e+037 1e+037 FORMAT "%43.4" ECU_ADDRESS 0x3FB2D4 /end MEASUREMENT
/begin MEASUREMENT batt_a1 "Temp-Variable" FLOAT32_IEEE fak_r32_1 1 100 -1e+037 1e+037 FORMAT "%43.4" ECU_ADDRESS 0x3FB2D8 /end MEASUREMENT
/begin MEASUREMENT batt_a2 "Temp-Variable" FLOAT32_IEEE fak_r32_1 1 100 -1e+037 1e+037 FORMAT "%43.4" ECU_ADDRESS 0x3FB2DC /end MEASUREMENT
/begin MEASUREMENT batt_c10 "Temp-Variable" FLOAT32_IEEE fak_r32_1 1 100 -1e+037 1e+037 FORMAT "%43.4" ECU_ADDRESS 0x3FB2E0 /end MEASUREMENT
/begin MEASUREMENT batt_c11 "Temp-Variable" FLOAT32_IEEE fak_r32_1 1 100 -1e+037 1e+037 FORMAT "%43.4" ECU_ADDRESS 0x3FB2E4 /end MEASUREMENT
/begin MEASUREMENT batt_c12 "Temp-Variable" FLOAT32_IEEE fak_r32_1 1 100 -1e+037 1e+037 FORMAT "%43.4" ECU_ADDRESS 0x3FB2E8 /end MEASUREMENT
/begin MEASUREMENT batt_c13 "Temp-Variable" FLOAT32_IEEE fak_r32_1 1 100 -1e+037 1e+037 FORMAT "%43.4" ECU_ADDRESS 0x3FB2EC /end MEASUREMENT
/begin MEASUREMENT batt_c14 "Temp-Variable" FLOAT32_IEEE fak_r32_1 1 100 -1e+037 1e+037 FORMAT "%43.4" ECU_ADDRESS 0x3FB2F0 /end MEASUREMENT
/begin MEASUREMENT batt_c8 "Temp-Variable" FLOAT32_IEEE fak_r32_1 1 100 -1e+037 1e+037 FORMAT "%43.4" ECU_ADDRESS 0x3FB2F4 /end MEASUREMENT
/begin MEASUREMENT batt_c9 "Temp-Variable" FLOAT32_IEEE fak_r32_1 1 100 -1e+037 1e+037 FORMAT "%43.4" ECU_ADDRESS 0x3FB2F8 /end MEASUREMENT
/begin MEASUREMENT batt_d1 "Temp-Variable" FLOAT32_IEEE fak_r32_1 1 100 -1e+037 1e+037 FORMAT "%43.4" ECU_ADDRESS 0x3FB2FC /end MEASUREMENT
/begin MEASUREMENT batt_e1 "Temp-Variable" FLOAT32_IEEE fak_r32_1 1 100 -1e+037 1e+037 FORMAT "%43.4" ECU_ADDRESS 0x3FB300 /end MEASUREMENT
/begin MEASUREMENT batt_e2 "Temp-Variable" FLOAT32_IEEE fak_r32_1 1 100 -1e+037 1e+037 FORMAT "%43.4" ECU_ADDRESS 0x3FB304 /end MEASUREMENT
/begin MEASUREMENT batt_e3 "Temp-Variable" FLOAT32_IEEE fak_r32_1 1 100 -1e+037 1e+037 FORMAT "%43.4" ECU_ADDRESS 0x3FB308 /end MEASUREMENT
/begin MEASUREMENT batt_e4 "Temp-Variable" FLOAT32_IEEE fak_r32_1 1 100 -1e+037 1e+037 FORMAT "%43.4" ECU_ADDRESS 0x3FB30C /end MEASUREMENT
/begin MEASUREMENT batt_e5 "Temp-Variable" FLOAT32_IEEE fak_r32_1 1 100 -1e+037 1e+037 FORMAT "%43.4" ECU_ADDRESS 0x3FB310 /end MEASUREMENT
/begin MEASUREMENT batt_e6 "Temp-Variable" FLOAT32_IEEE fak_r32_1 1 100 -1e+037 1e+037 FORMAT "%43.4" ECU_ADDRESS 0x3FB314 /end MEASUREMENT
/begin MEASUREMENT batt_tfil "Zeitkonstante Batterie" FLOAT32_IEEE fak_r32_1 1 100 -1e+037 1e+037 FORMAT "%43.4" ECU_ADDRESS 0x3FB318 /end MEASUREMENT
/begin MEASUREMENT batt_w0 "Temp-Variable" FLOAT32_IEEE fak_r32_1 1 100 -1e+037 1e+037 FORMAT "%43.4" ECU_ADDRESS 0x3FB31C /end MEASUREMENT
/begin MEASUREMENT B_dcdisfr "Bedingung: Disable DV-E-Endstufe durch den Funktionsrechner" UBYTE B_TRUE 1 100 0 1 BIT_MASK 0x1 FORMAT "%13.11" ECU_ADDRESS 0x3FBE14 /end MEASUREMENT
/begin MEASUREMENT B_dfrf "Bedingung Anfettung in LR erkannt" UBYTE B_TRUE 1 100 0 1 BIT_MASK 0x1 FORMAT "%13.11" ECU_ADDRESS 0x3FBEA4 /end MEASUREMENT
/begin MEASUREMENT B_dfrf2 "Bedingung Anfettung in LR erkannt, Bank2" UBYTE B_TRUE 1 100 0 1 BIT_MASK 0x1 FORMAT "%13.11" ECU_ADDRESS 0x3FBEA5 /end MEASUREMENT
/begin MEASUREMENT B_dfrm "Bedingung Ausmagerung in LR erkannt" UBYTE B_TRUE 1 100 0 1 BIT_MASK 0x1 FORMAT "%13.11" ECU_ADDRESS 0x3FBEA6 /end MEASUREMENT
/begin MEASUREMENT B_dfrm2 "Bedingung Ausmagerung in LR erkannt, Bank2" UBYTE B_TRUE 1 100 0 1 BIT_MASK 0x1 FORMAT "%13.11" ECU_ADDRESS 0x3FBEA7 /end MEASUREMENT
/begin MEASUREMENT B_dkbew "Bedingung: DK hat sich bewegt" UBYTE B_TRUE 1 100 0 1 BIT_MASK 0x1 FORMAT "%13.11" ECU_ADDRESS 0x3FBE15 /end MEASUREMENT
/begin MEASUREMENT B_dlrbe "Bedingung: DLR-Stellbereich wurde ¸berschritten" UBYTE B_TRUE 1 100 0 1 BIT_MASK 0x1 FORMAT "%13.11" ECU_ADDRESS 0x3FBE16 /end MEASUREMENT
/begin MEASUREMENT B_dlrikla "Bedingung: DLR, I-Klein aktiv" UBYTE B_TRUE 1 100 0 1 BIT_MASK 0x1 FORMAT "%13.11" ECU_ADDRESS 0x3FBE17 /end MEASUREMENT
/begin MEASUREMENT B_dlriklst "Bedingung: Erster Durchlauf I-Klein nach Start" UBYTE B_TRUE 1 100 0 1 BIT_MASK 0x1 FORMAT "%13.11" ECU_ADDRESS 0x3FBE18 /end MEASUREMENT
/begin MEASUREMENT B_dlrparc "Bedingung: Sollgrˆﬂensprung steht an" UBYTE B_TRUE 1 100 0 1 BIT_MASK 0x1 FORMAT "%13.11" ECU_ADDRESS 0x3FBE19 /end MEASUREMENT
/begin MEASUREMENT B_dlrpide "Bedingung: Fehler, DLR-Stellbereich am Anschlag" UBYTE B_TRUE 1 100 0 1 BIT_MASK 0x1 FORMAT "%13.11" ECU_ADDRESS 0x3FBE1A /end MEASUREMENT
/begin MEASUREMENT B_dlrspid "Bedingung: DLR, Vorzeichen der Summe der PID-Anteile, =1: positiv, =0: negativ" UBYTE B_TRUE 1 100 0 1 BIT_MASK 0x1 FORMAT "%13.11" ECU_ADDRESS 0x3FBE1B /end MEASUREMENT
/begin MEASUREMENT B_dlrumzu "Bedingung: NLP-Umladen zugelassen" UBYTE B_TRUE 1 100 0 1 BIT_MASK 0x1 FORMAT "%13.11" ECU_ADDRESS 0x3FBE1C /end MEASUREMENT
/begin MEASUREMENT B_dslafa "Anfoderung Kurztest oder Adaption in DSLSXXX" UBYTE B_TRUE 1 100 0 1 BIT_MASK 0x1 FORMAT "%13.11" ECU_ADDRESS 0x5B8F08 /end MEASUREMENT
/begin MEASUREMENT B_dveese "Bedingung: DV-E-Endstufen-Fehler" UBYTE B_TRUE 1 100 0 1 BIT_MASK 0x1 FORMAT "%13.11" ECU_ADDRESS 0x3FBE1D /end MEASUREMENT
/begin MEASUREMENT B_dveesh "Bedingung: DV-E-Enstufen-Heilung" UBYTE B_TRUE 1 100 0 1 BIT_MASK 0x1 FORMAT "%13.11" ECU_ADDRESS 0x3FBE1E /end MEASUREMENT
/begin MEASUREMENT B_dvete "Bedingung: Erweiterte Stellertauscherkennung" UBYTE B_TRUE 1 100 0 1 BIT_MASK 0x1 FORMAT "%13.11" ECU_ADDRESS 0x3FBE1F /end MEASUREMENT
/begin MEASUREMENT B_dzbuf "" UBYTE B_TRUE 1 100 0 1 BIT_MASK 0x1 FORMAT "%13.11" ECU_ADDRESS 0x5B8B60 /end MEASUREMENT
/begin MEASUREMENT B_dzen "" UBYTE B_TRUE 1 100 0 1 BIT_MASK 0x1 FORMAT "%13.11" ECU_ADDRESS 0x5B8B61 /end MEASUREMENT
/begin MEASUREMENT B_dzrts "Bedingung ready to send" UBYTE B_TRUE 1 100 0 1 BIT_MASK 0x1 FORMAT "%13.11" ECU_ADDRESS 0x5B8B62 /end MEASUREMENT
/begin MEASUREMENT B_eemrdy "EEPROM-Spiegel bereit f¸r Speicherung" UBYTE B_TRUE 1 100 0 1 BIT_MASK 0x1 FORMAT "%13.11" ECU_ADDRESS 0x3FBE2C /end MEASUREMENT
/begin MEASUREMENT B_eemsav "EEPROM-Spiegel wird gespeichert" UBYTE B_TRUE 1 100 0 1 BIT_MASK 0x1 FORMAT "%13.11" ECU_ADDRESS 0x3FBE2D /end MEASUREMENT
/begin MEASUREMENT B_fallsa "Bedingung: Funktionsanforderung Drehzahl‰nderung durch Tester aktiv" UBYTE B_TRUE 1 100 0 1 BIT_MASK 0x1 FORMAT "%13.11" ECU_ADDRESS 0x3FBEF6 /end MEASUREMENT
/begin MEASUREMENT B_fbstabgm "Bedingung: Faktor Bauteileschutz ¸ber Abgastemperaturmodell" UBYTE B_TRUE 1 100 0 1 BIT_MASK 0x1 FORMAT "%13.11" ECU_ADDRESS 0x3FBD8B /end MEASUREMENT
/begin MEASUREMENT B_frab "Bedingung Regelfaktor fr auﬂerhalb adaptierten Band" UBYTE B_TRUE 1 100 0 1 BIT_MASK 0x1 FORMAT "%13.11" ECU_ADDRESS 0x3FBEA8 /end MEASUREMENT
/begin MEASUREMENT B_frab2 "Bedingung Regelfaktor fr auﬂerhalb adaptierten Band, Bank 2" UBYTE B_TRUE 1 100 0 1 BIT_MASK 0x1 FORMAT "%13.11" ECU_ADDRESS 0x3FBEA9 /end MEASUREMENT
/begin MEASUREMENT B_frmax "Lambda-Regelung setzt Bit sobald FR am Anschlag FRMAX" UBYTE B_TRUE 1 100 0 1 BIT_MASK 0x1 FORMAT "%13.11" ECU_ADDRESS 0x3FBEAA /end MEASUREMENT
/begin MEASUREMENT B_frmax2 "Lambda-Regelung setzt Bit sobald FR am Anschlag FRMAX, Bank 2" UBYTE B_TRUE 1 100 0 1 BIT_MASK 0x1 FORMAT "%13.11" ECU_ADDRESS 0x3FBEAB /end MEASUREMENT
/begin MEASUREMENT B_frmin "Lambda-Regelung setzt Bit sobald FR am Anschlag FRMIN" UBYTE B_TRUE 1 100 0 1 BIT_MASK 0x1 FORMAT "%13.11" ECU_ADDRESS 0x3FBEAC /end MEASUREMENT
/begin MEASUREMENT B_frmin2 "Lambda-Regelung setzt Bit sobald FR am Anschlag FRMIN, Bank 2" UBYTE B_TRUE 1 100 0 1 BIT_MASK 0x1 FORMAT "%13.11" ECU_ADDRESS 0x3FBEAD /end MEASUREMENT
/begin MEASUREMENT B_frmini "Bildung fr-Mittelwert: Bed. Initialisieren von frm_w" UBYTE B_TRUE 1 100 0 1 BIT_MASK 0x1 FORMAT "%13.11" ECU_ADDRESS 0x3FBEAE /end MEASUREMENT
/begin MEASUREMENT B_frsp "Bedingung Reglersprung" UBYTE B_TRUE 1 100 0 1 BIT_MASK 0x1 FORMAT "%13.11" ECU_ADDRESS 0x3FBEAF /end MEASUREMENT
/begin MEASUREMENT B_genactiv "" UBYTE B_TRUE 1 100 0 1 BIT_MASK 0x1 FORMAT "%13.11" ECU_ADDRESS 0x5B881E /end MEASUREMENT
/begin MEASUREMENT B_genfbsd "Bedingung Kommunikationsverlust BSD-Generator" UBYTE B_TRUE 1 100 0 1 BIT_MASK 0x1 FORMAT "%13.11" ECU_ADDRESS 0x5B881F /end MEASUREMENT
/begin MEASUREMENT B_genfel "Bedingung: Generatorfehler elektrisch" UBYTE B_TRUE 1 100 0 1 BIT_MASK 0x1 FORMAT "%13.11" ECU_ADDRESS 0x5B8820 /end MEASUREMENT
/begin MEASUREMENT B_genfht "Bedingung: Generatorzustand 'hohe Temperatur'" UBYTE B_TRUE 1 100 0 1 BIT_MASK 0x1 FORMAT "%13.11" ECU_ADDRESS 0x5B8821 /end MEASUREMENT
/begin MEASUREMENT B_genfme "Bedingung: Generatorfehler mechanisch" UBYTE B_TRUE 1 100 0 1 BIT_MASK 0x1 FORMAT "%13.11" ECU_ADDRESS 0x5B8822 /end MEASUREMENT
/begin MEASUREMENT B_genoffst "Bedingung Generatorabschaltung im Start" UBYTE B_TRUE 1 100 0 1 FORMAT "%13.11" ECU_ADDRESS 0x5B8CBF /end MEASUREMENT
/begin MEASUREMENT B_genoffvl "Bedingung Generatorabschaltung bei Vollast" UBYTE B_TRUE 1 100 0 1 FORMAT "%13.11" ECU_ADDRESS 0x5B8CC0 /end MEASUREMENT
/begin MEASUREMENT B_idlgspec "" UBYTE B_TRUE 1 100 0 1 FORMAT "%13.11" ECU_ADDRESS 0x5B8B69 /end MEASUREMENT
/begin MEASUREMENT B_iklrest "Bedingung: Retriggerung I-Klein" UBYTE B_TRUE 1 100 0 1 BIT_MASK 0x1 FORMAT "%13.11" ECU_ADDRESS 0x3FBE20 /end MEASUREMENT
/begin MEASUREMENT B_iklstar "Bedingung: I-Klein soll starten" UBYTE B_TRUE 1 100 0 1 BIT_MASK 0x1 FORMAT "%13.11" ECU_ADDRESS 0x3FBE21 /end MEASUREMENT
/begin MEASUREMENT B_inibumg "Hilfsbedingung Batterietemperaturumgebungsberechung" UBYTE B_TRUE 1 100 0 1 FORMAT "%13.11" ECU_ADDRESS 0x5B8994 /end MEASUREMENT
/begin MEASUREMENT B_inifrm "Bildung fr-Mittelwert: Bed. Auswahl Initialisierungswert von frm_w" UBYTE B_TRUE 1 100 0 1 BIT_MASK 0x1 FORMAT "%13.11" ECU_ADDRESS 0x3FBEB0 /end MEASUREMENT
/begin MEASUREMENT B_int "LR: Bedingung Integration erlaubt" UBYTE B_TRUE 1 100 0 1 BIT_MASK 0x1 FORMAT "%13.11" ECU_ADDRESS 0x3FBEB1 /end MEASUREMENT
/begin MEASUREMENT B_kr "Bedingung Klopregelung aktiv" UBYTE B_TRUE 1 100 0 1 BIT_MASK 0x1 FORMAT "%13.11" ECU_ADDRESS 0x3FBE4D /end MEASUREMENT
/begin MEASUREMENT B_kra "Bedingung KR-Adaption aktiv" UBYTE B_TRUE 1 100 0 1 BIT_MASK 0x1 FORMAT "%13.11" ECU_ADDRESS 0x3FBE4E /end MEASUREMENT
/begin MEASUREMENT B_kras "KR-Adaption schreiben zul‰ssig" UBYTE B_TRUE 1 100 0 1 BIT_MASK 0x1 FORMAT "%13.11" ECU_ADDRESS 0x3FBE4F /end MEASUREMENT
/begin MEASUREMENT B_ksa "Bedingung Ersatzsensor A wird benutzt" UBYTE B_TRUE 1 100 0 1 BIT_MASK 0x1 FORMAT "%13.11" ECU_ADDRESS 0x3FBE50 /end MEASUREMENT
/begin MEASUREMENT B_ksb "Bedingung Ersatzsensor B wird benutzt" UBYTE B_TRUE 1 100 0 1 BIT_MASK 0x1 FORMAT "%13.11" ECU_ADDRESS 0x3FBE51 /end MEASUREMENT
/begin MEASUREMENT B_ktm_ini "Bedingung KTM-Initialisierung" UBYTE B_TRUE 1 100 0 1 FORMAT "%13.11" ECU_ADDRESS 0x5B8B48 /end MEASUREMENT
/begin MEASUREMENT B_lalgf "Bedingung Laufgrenze ""Lambda fett"" aktiv" UBYTE B_TRUE 1 100 0 1 BIT_MASK 0x1 FORMAT "%13.11" ECU_ADDRESS 0x3FBD8F /end MEASUREMENT
/begin MEASUREMENT B_lambts "Lambda f¸r Bauteileschutz ist aktiv" UBYTE B_TRUE 1 100 0 1 BIT_MASK 0x1 FORMAT "%13.11" ECU_ADDRESS 0x3FBD90 /end MEASUREMENT
/begin MEASUREMENT B_lamka "Lambda f¸r Kat-Ausr‰umen aktiv" UBYTE B_TRUE 1 100 0 1 BIT_MASK 0x1 FORMAT "%13.11" ECU_ADDRESS 0x3FBD91 /end MEASUREMENT
/begin MEASUREMENT B_lamkh "Bedingung Lambdasoll f¸r Katheizen aktiv" UBYTE B_TRUE 1 100 0 1 BIT_MASK 0x1 FORMAT "%13.11" ECU_ADDRESS 0x3FBD92 /end MEASUREMENT
/begin MEASUREMENT B_lamkhe "keine Lambdaanforderung seitens LAKH" UBYTE B_TRUE 1 100 0 1 BIT_MASK 0x1 FORMAT "%13.11" ECU_ADDRESS 0x3FBE39 /end MEASUREMENT
/begin MEASUREMENT B_lamnswl "Lambda-Motor-Soll f¸r Nachstart und Warmlauf aktiv" UBYTE B_TRUE 1 100 0 1 BIT_MASK 0x1 FORMAT "%13.11" ECU_ADDRESS 0x3FBD93 /end MEASUREMENT
/begin MEASUREMENT B_lamsdef "Bedingung : definierte Soll-Lambda" UBYTE B_TRUE 1 100 0 1 BIT_MASK 0x1 FORMAT "%13.11" ECU_ADDRESS 0x3FBD94 /end MEASUREMENT
/begin MEASUREMENT B_ldef "Bedingung : definierte Soll-Lambda Bank1" UBYTE B_TRUE 1 100 0 1 BIT_MASK 0x1 FORMAT "%13.11" ECU_ADDRESS 0x3FBD95 /end MEASUREMENT
/begin MEASUREMENT B_lkrall "Bedingung  Leerlaufadaption aktiv" UBYTE B_TRUE 1 100 0 1 BIT_MASK 0x1 FORMAT "%13.11" ECU_ADDRESS 0x3FBE52 /end MEASUREMENT
/begin MEASUREMENT B_llr "Bedingung Leerlaufregelung" UBYTE B_TRUE 1 100 0 1 BIT_MASK 0x1 FORMAT "%13.11" ECU_ADDRESS 0x3FBEF1 /end MEASUREMENT
/begin MEASUREMENT B_llrein "Bedingung LLR ist aktiv" UBYTE B_TRUE 1 100 0 1 BIT_MASK 0x1 FORMAT "%13.11" ECU_ADDRESS 0x3FBEF2 /end MEASUREMENT
/begin MEASUREMENT B_llri "Bedingung I-Anteil der LLR aktiv" UBYTE B_TRUE 1 100 0 1 BIT_MASK 0x1 FORMAT "%13.11" ECU_ADDRESS 0x3FBEF3 /end MEASUREMENT
/begin MEASUREMENT B_llrimx "Bedingung dmllri hat Sicherheitsgrenze erreicht" UBYTE B_TRUE 1 100 0 1 BIT_MASK 0x1 FORMAT "%13.11" ECU_ADDRESS 0x3FBEF9 /end MEASUREMENT
/begin MEASUREMENT B_llrpd "Bedingung PD-Anteil der LLR aktiv" UBYTE B_TRUE 1 100 0 1 BIT_MASK 0x1 FORMAT "%13.11" ECU_ADDRESS 0x3FBEF4 /end MEASUREMENT
/begin MEASUREMENT B_lltdff "" UBYTE B_TRUE 1 100 0 1 BIT_MASK 0x1 FORMAT "%13.11" ECU_ADDRESS 0x3FBEF7 /end MEASUREMENT
/begin MEASUREMENT B_lrsp "Bedingung Sondensprung" UBYTE B_TRUE 1 100 0 1 BIT_MASK 0x1 FORMAT "%13.11" ECU_ADDRESS 0x3FBEB2 /end MEASUREMENT
/begin MEASUREMENT B_lrsp2 "Bedingung Sondensprung Zylinderbank 2" UBYTE B_TRUE 1 100 0 1 BIT_MASK 0x1 FORMAT "%13.11" ECU_ADDRESS 0x3FBEB3 /end MEASUREMENT
/begin MEASUREMENT B_lrstat "Bedingung Lambdaregler arbeitet station‰r" UBYTE B_TRUE 1 100 0 1 BIT_MASK 0x1 FORMAT "%13.11" ECU_ADDRESS 0x3FBEB4 /end MEASUREMENT
/begin MEASUREMENT B_lrstat2 "Bedingung Lambdaregler arbeitet station‰r, Bank2" UBYTE B_TRUE 1 100 0 1 BIT_MASK 0x1 FORMAT "%13.11" ECU_ADDRESS 0x3FBEB5 /end MEASUREMENT
/begin MEASUREMENT B_lrstta "Bedingung Lambdaregler arbeitet station‰r, Zeit und Amplitudenbedingung" UBYTE B_TRUE 1 100 0 1 BIT_MASK 0x1 FORMAT "%13.11" ECU_ADDRESS 0x3FBEB6 /end MEASUREMENT
/begin MEASUREMENT B_lrstta2 "Bedingung Lambdaregler arbeitet station‰r, Zeit und Amplitudenbedingung Bank 2" UBYTE B_TRUE 1 100 0 1 BIT_MASK 0x1 FORMAT "%13.11" ECU_ADDRESS 0x3FBEB7 /end MEASUREMENT
/begin MEASUREMENT B_lrtpp "Periodendauer g¸ltig, Bed. LR arbeitet station‰r (Amplitude/Periode) erf¸llt" UBYTE B_TRUE 1 100 0 1 BIT_MASK 0x1 FORMAT "%13.11" ECU_ADDRESS 0x3FBEB8 /end MEASUREMENT
/begin MEASUREMENT B_lrtpp2 "Bedingung Lambdaregler arbeitet station‰r (Amplitude/Periode) Bank2" UBYTE B_TRUE 1 100 0 1 BIT_MASK 0x1 FORMAT "%13.11" ECU_ADDRESS 0x3FBEB9 /end MEASUREMENT
/begin MEASUREMENT B_nivns "Bedingung niedrige Solldrehzahl" UBYTE B_TRUE 1 100 0 1 BIT_MASK 0x1 FORMAT "%13.11" ECU_ADDRESS 0x3FBEF8 /end MEASUREMENT
/begin MEASUREMENT B_nldve "Anforderung Steuerger‰tenachlauf von DVE" UBYTE B_TRUE 1 100 0 1 BIT_MASK 0x1 FORMAT "%13.11" ECU_ADDRESS 0x3FBE22 /end MEASUREMENT
/begin MEASUREMENT B_nlpne "Bedingung: Bei gefordertem DK-Notluftfahren wurde NLP nicht erreicht" UBYTE B_TRUE 1 100 0 1 BIT_MASK 0x1 FORMAT "%13.11" ECU_ADDRESS 0x3FBE23 /end MEASUREMENT
/begin MEASUREMENT B_nsabg "Bedingung Abgleich Solldrehzahl" UBYTE B_TRUE 1 100 0 1 BIT_MASK 0x1 FORMAT "%13.11" ECU_ADDRESS 0x3FBEF0 /end MEASUREMENT
/begin MEASUREMENT B_nsub "Bedingung f¸r Solldrehzahlanhebung bei niedriger Batteriespannung" UBYTE B_TRUE 1 100 0 1 FORMAT "%13.11" ECU_ADDRESS 0x5B8B6A /end MEASUREMENT
/begin MEASUREMENT B_pwrsv "Bedingung: DV-E-powersave ist aktiv" UBYTE B_TRUE 1 100 0 1 BIT_MASK 0x1 FORMAT "%13.11" ECU_ADDRESS 0x3FBE24 /end MEASUREMENT
/begin MEASUREMENT B_sgnalt "Vorzeichen f¸r Gemisch vor Kat (Bool), 1 Rechenraster verzˆgert" UBYTE B_TRUE 1 100 0 1 BIT_MASK 0x1 FORMAT "%13.11" ECU_ADDRESS 0x3FBEBA /end MEASUREMENT
/begin MEASUREMENT B_sgnlr "Vorzeichen f¸r Gemisch vor Kat (Bool)" UBYTE B_TRUE 1 100 0 1 BIT_MASK 0x1 FORMAT "%13.11" ECU_ADDRESS 0x3FBEBB /end MEASUREMENT
/begin MEASUREMENT B_sgnlr2 "Vorzeichen f¸r Gemisch vor Kat (Bool), Bank 2" UBYTE B_TRUE 1 100 0 1 BIT_MASK 0x1 FORMAT "%13.11" ECU_ADDRESS 0x3FBEBC /end MEASUREMENT
/begin MEASUREMENT B_sgnra "Vorzeichen f¸r Gemisch vor Kat gem. Sperrzeitsteuerung (Bool)" UBYTE B_TRUE 1 100 0 1 BIT_MASK 0x1 FORMAT "%13.11" ECU_ADDRESS 0x3FBEBD /end MEASUREMENT
/begin MEASUREMENT B_tabgbts "Bedingung Abgastemperatur f¸r Bauteileschutz ¸berschritten" UBYTE B_TRUE 1 100 0 1 BIT_MASK 0x1 FORMAT "%13.11" ECU_ADDRESS 0x3FBD8C /end MEASUREMENT
/begin MEASUREMENT B_tevtini "TEV timer wurde neu initialisiert" UBYTE B_TRUE 1 100 0 1 BIT_MASK 0x1 FORMAT "%13.11" ECU_ADDRESS 0x3FBE2A /end MEASUREMENT
/begin MEASUREMENT B_tkatbts "Bedingung Katalysatortemperatur f¸r Bauteileschutz ¸berschritten" UBYTE B_TRUE 1 100 0 1 BIT_MASK 0x1 FORMAT "%13.11" ECU_ADDRESS 0x3FBD8D /end MEASUREMENT
/begin MEASUREMENT B_tkerr "Fehler TK-Signal g¸ltig" UBYTE B_TRUE 1 100 0 1 BIT_MASK 0x4 FORMAT "%13.11" ECU_ADDRESS 0x5B8C77 /end MEASUREMENT
/begin MEASUREMENT B_tmkr "Bedingung Temperatur (tmot) fuer KR aktiv erreicht" UBYTE B_TRUE 1 100 0 1 BIT_MASK 0x1 FORMAT "%13.11" ECU_ADDRESS 0x3FBE53 /end MEASUREMENT
/begin MEASUREMENT B_toel "Bedingung Oeltemperaturmesswert vorhanden" UBYTE B_TRUE 1 100 0 1 FORMAT "%13.11" ECU_ADDRESS 0x5B882D /end MEASUREMENT
/begin MEASUREMENT B_tog "Bedingung Oelniveaumesswert vorhanden" UBYTE B_TRUE 1 100 0 1 FORMAT "%13.11" ECU_ADDRESS 0x5B882E /end MEASUREMENT
/begin MEASUREMENT B_togerr "Fehlerz‰hler > TOG_CNTMAX" UBYTE B_TRUE 1 100 0 1 BIT_MASK 0x40 FORMAT "%13.11" ECU_ADDRESS 0x5B8C77 /end MEASUREMENT
/begin MEASUREMENT B_togok "Statemaschine erfolgreich gerechnet" UBYTE B_TRUE 1 100 0 1 BIT_MASK 0x20 FORMAT "%13.11" ECU_ADDRESS 0x5B8C77 /end MEASUREMENT
/begin MEASUREMENT B_togupl "TOG-Signal unplausibel. Tog_uplcnt > TOGMAXUPL" UBYTE B_TRUE 1 100 0 1 BIT_MASK 0x80 FORMAT "%13.11" ECU_ADDRESS 0x5B8C77 /end MEASUREMENT
/begin MEASUREMENT B_trerr "Fehler TR Signal g¸ltig" UBYTE B_TRUE 1 100 0 1 BIT_MASK 0x10 FORMAT "%13.11" ECU_ADDRESS 0x5B8C77 /end MEASUREMENT
/begin MEASUREMENT B_tsper "LR: Bedingung Starten der Sperrzeit" UBYTE B_TRUE 1 100 0 1 BIT_MASK 0x1 FORMAT "%13.11" ECU_ADDRESS 0x3FBEBE /end MEASUREMENT
/begin MEASUREMENT B_tspon "Bedingung Entstˆrsperrzeit in der Lambdaregelung starten" UBYTE B_TRUE 1 100 0 1 BIT_MASK 0x1 FORMAT "%13.11" ECU_ADDRESS 0x3FBEBF /end MEASUREMENT
/begin MEASUREMENT B_tverr "Fehler TV Signal g¸ltig" UBYTE B_TRUE 1 100 0 1 BIT_MASK 0x8 FORMAT "%13.11" ECU_ADDRESS 0x5B8C77 /end MEASUREMENT
/begin MEASUREMENT B_ubdve "Bedingung: Batteriespannung f¸r DV-E-Ansteuerung i.O." UBYTE B_TRUE 1 100 0 1 BIT_MASK 0x1 FORMAT "%13.11" ECU_ADDRESS 0x3FBE25 /end MEASUREMENT
/begin MEASUREMENT B_ubpvg "Bedingung Batteriespannung ausreichend f¸r 5V-Potiversorgung" UBYTE B_TRUE 1 100 0 1 BIT_MASK 0x1 FORMAT "%13.11" ECU_ADDRESS 0x3FBE26 /end MEASUREMENT
/begin MEASUREMENT B_ub_ok "Batteriespannung o.k." UBYTE B_TRUE 1 100 0 1 BIT_MASK 0x1 FORMAT "%13.11" ECU_ADDRESS 0x3FBE27 /end MEASUREMENT
/begin MEASUREMENT B_vla "Bedingung Vollastanreicherung > 1.0" UBYTE B_TRUE 1 100 0 1 BIT_MASK 0x1 FORMAT "%13.11" ECU_ADDRESS 0x3FBD8E /end MEASUREMENT
/begin MEASUREMENT B_vllr "Bedingung Fahrzeug rollt mit eingelegtem Gang" UBYTE B_TRUE 1 100 0 1 BIT_MASK 0x1 FORMAT "%13.11" ECU_ADDRESS 0x3FBEF5 /end MEASUREMENT
/begin MEASUREMENT B_wdksauf "Bedingung: DLR, Sollsprung in Richtung AUF" UBYTE B_TRUE 1 100 0 1 BIT_MASK 0x1 FORMAT "%13.11" ECU_ADDRESS 0x3FBE28 /end MEASUREMENT
/begin MEASUREMENT B_wdksive "Bedingung: Fehler im Vergleich DK-Winkel-Sollwert/-Istwert" UBYTE B_TRUE 1 100 0 1 BIT_MASK 0x1 FORMAT "%13.11" ECU_ADDRESS 0x3FBE29 /end MEASUREMENT
/begin MEASUREMENT B_wkral "Bedingung wkr aus KR-Adaptionskennfeld einlesen" UBYTE B_TRUE 1 100 0 1 BIT_MASK 0x1 FORMAT "%13.11" ECU_ADDRESS 0x3FBE54 /end MEASUREMENT
/begin MEASUREMENT B_zwkraa "Bedingung Z¸ndwinkel der KR wird ausgegeben" UBYTE B_TRUE 1 100 0 1 BIT_MASK 0x1 FORMAT "%13.11" ECU_ADDRESS 0x3FBE55 /end MEASUREMENT
/begin MEASUREMENT B_zwkrum "Flag: schnelle Fr¸hverstellung" UBYTE B_TRUE 1 100 0 1 BIT_MASK 0x1 FORMAT "%13.11" ECU_ADDRESS 0x3FBE56 /end MEASUREMENT
/begin MEASUREMENT chkbfgen "Speicherzelle f¸r Check-Byte von Generatorschnittstelle" UBYTE dez 1 100 0 255 FORMAT "%5.1" ECU_ADDRESS 0x5B8823 /end MEASUREMENT
/begin MEASUREMENT cobattort "Codierzelle Batterieeinbauort" UBYTE dez 1 100 0 255 FORMAT "%5.1" ECU_ADDRESS 0x5B8997 /end MEASUREMENT
/begin MEASUREMENT ctrgenutar "Generatorsollspannung" UBYTE spg_gencan 1 100 10.6 16.975 FORMAT "%5.2" ECU_ADDRESS 0x5B8CBC /end MEASUREMENT
/begin MEASUREMENT dbetalf_t "Temp-Variable" FLOAT32_IEEE fak_r32_1 1 100 -1e+037 1e+037 FORMAT "%43.4" ECU_ADDRESS 0x3FB320 /end MEASUREMENT
/begin MEASUREMENT dbet_alf "Batterieaplphawert" FLOAT32_IEEE fak_r32_1 1 100 -1e+037 1e+037 FORMAT "%43.4" ECU_ADDRESS 0x3FB324 /end MEASUREMENT
/begin MEASUREMENT detazwbs "Delta ZW-Wirkungsgrad f¸r Bauteileschutz" UBYTE rel_ub_b127p5 1 100 0 127.5 FORMAT "%5.1" ECU_ADDRESS 0x5B8756 /end MEASUREMENT
/begin MEASUREMENT dffgen "vom Generator empfangenes Lastsignal" UBYTE rel_ub_b100 1 100 0 100 FORMAT "%5.1" ECU_ADDRESS 0x5B8824 /end MEASUREMENT
/begin MEASUREMENT dffgenflo "DF-Signal temp" FLOAT32_IEEE fak_r32_1 1 100 0 1e+037 FORMAT "%43.4" ECU_ADDRESS 0x5B89AC /end MEASUREMENT
/begin MEASUREMENT dfmonitor "DF-Monitor f¸r Batterie-Ladezustand in %" UBYTE PCENT 1 100 0 99.6094 FORMAT "%5.2" ECU_ADDRESS 0x3FDCA4 /end MEASUREMENT
/begin MEASUREMENT dfrsp2_w "delta Spitzenwert Lambdaregelfaktor frsp Bank 2" SWORD fak_sw_b1 1 100 -1 0.999969 FORMAT "%8.6" ECU_ADDRESS 0x5B92AE /end MEASUREMENT
/begin MEASUREMENT dfrsp_w "delta Spitzenwert Lambdaregelfaktor frsp" SWORD fak_sw_b1 1 100 -1 0.999969 FORMAT "%8.6" ECU_ADDRESS 0x5B92B0 /end MEASUREMENT
/begin MEASUREMENT dfrst2_w "fr-Regelhub im Station‰rzustand (Zylinderbank 2)" SWORD fak_sw_b1 1 100 -1 0.999969 FORMAT "%8.6" ECU_ADDRESS 0x5B92B2 /end MEASUREMENT
/begin MEASUREMENT dfrstga_w "Regelhub im Station‰rbetrieb (Grundadaptions-Phase)" SWORD fak_sw_b1 1 100 -1 0.999969 FORMAT "%8.6" ECU_ADDRESS 0x3FDC6E /end MEASUREMENT
/begin MEASUREMENT dfrstte_w "Regelhub im Station‰rbetrieb (Tankentl¸ftung-Sp¸lphase)" SWORD fak_sw_b1 1 100 -1 0.999969 FORMAT "%8.6" ECU_ADDRESS 0x3FDC70 /end MEASUREMENT
/begin MEASUREMENT dfrst_w "fr-Regelhub im Station‰rzustand" SWORD fak_sw_b1 1 100 -1 0.999969 FORMAT "%8.6" ECU_ADDRESS 0x5B92B4 /end MEASUREMENT
/begin MEASUREMENT dfsumme "DFMonitor Summe FASTA" FLOAT32_IEEE fak_r32_1 1 100 0 1e+037 FORMAT "%43.4" ECU_ADDRESS 0x3FDCA8 /end MEASUREMENT
/begin MEASUREMENT dfwanzahl "DF-Wertez‰hler" FLOAT32_IEEE fak_r32_1 1 100 1 1e+037 FORMAT "%43.4" ECU_ADDRESS 0x3FDCAC /end MEASUREMENT
/begin MEASUREMENT Disa_spg "DISA Spannung" UWORD spg_uw_b5 1 100 0 319.995 FORMAT "%8.4" ECU_ADDRESS 0x5B9276 /end MEASUREMENT
/begin MEASUREMENT dklagerc "Fehlerz‰hler DK-Lage¸berwachung" UBYTE t20msxs_ub_b5p1 1 100 0 5.1 FORMAT "%5.3" ECU_ADDRESS 0x5B8EF8 /end MEASUREMENT
/begin MEASUREMENT dlambts_w "Delta Lambda f¸r Bauteileschutz" SWORD fak_sw_b8 1 100 -8 7.99976 FORMAT "%8.6" ECU_ADDRESS 0x5B875C /end MEASUREMENT
/begin MEASUREMENT dlrd "DLR, D-Parameter" UBYTE relDK_q4 1 100 0 1020 FORMAT "%5.0" ECU_ADDRESS 0x3FC03D /end MEASUREMENT
/begin MEASUREMENT dlrhaftak "Zeitz‰hler Haftreibungsroutine" SWORD relDK_q0p1957 1 100 -6412.52 6412.33 FORMAT "%8.3" ECU_ADDRESS 0x5B881C /end MEASUREMENT
/begin MEASUREMENT dlri "DLR, I-Parameter" UBYTE relDK_q0p0625 1 100 0 15.9375 FORMAT "%5.2" ECU_ADDRESS 0x3FC03E /end MEASUREMENT
/begin MEASUREMENT dlriamax "DLR, maximal mˆglicher I-Anteil" UWORD relDK_q0p1957 1 100 0 12824.9 FORMAT "%8.2" ECU_ADDRESS 0x3FC074 /end MEASUREMENT
/begin MEASUREMENT dlriant_w "DLR, I-Anteil, highword von dlriant_l" SWORD rel_sw_q0p1953 1 100 -6400 6399.8 FORMAT "%8.3" ECU_ADDRESS 0x5B9284 /end MEASUREMENT
/begin MEASUREMENT dlrihaftc "DLR, Z‰hler f¸r DV-E in Haftreibung" UBYTE t50msxs_q0p05 1 100 0 12.75 FORMAT "%5.2" ECU_ADDRESS 0x5B8818 /end MEASUREMENT
/begin MEASUREMENT dlriklst_w "Vorladewert I-Kleinanteil" SWORD relDK_q0p1957 1 100 -6412.52 6412.33 FORMAT "%8.3" ECU_ADDRESS 0x5B9286 /end MEASUREMENT
/begin MEASUREMENT dlrikl_w "DLR, I-Kleinanteil" SWORD relDK_q0p1957 1 100 -6412.52 6412.33 FORMAT "%8.3" ECU_ADDRESS 0x3FC076 /end MEASUREMENT
/begin MEASUREMENT dlrini_w "I-Anteil bei Initialisierung der NLP-Function" UWORD relDK_q0p1957 1 100 0 12824.9 FORMAT "%8.2" ECU_ADDRESS 0x3FC078 /end MEASUREMENT
/begin MEASUREMENT dlrkomp "DLR, Faktor Kreisverst‰rkung" UBYTE fak_ub_b2 1 100 0 1.99219 FORMAT "%5.3" ECU_ADDRESS 0x3FC03F /end MEASUREMENT
/begin MEASUREMENT dlrndif_w "Istwert aktuell - Istwert letzter f¸r D-Anteil des DLR" SWORD relDK_q0p02441 1 100 -800 799.976 FORMAT "%8.4" ECU_ADDRESS 0x3FC07A /end MEASUREMENT
/begin MEASUREMENT dlrp "DLR, P-Parameter" UBYTE relDK_q1 1 100 0 255 FORMAT "%5.1" ECU_ADDRESS 0x3FC040 /end MEASUREMENT
/begin MEASUREMENT dlrpidc "Fehlerz‰hler DLR-Stellbereichs¸berwachung" UWORD t10msxs_uw_b655p35 1 100 0 655.35 FORMAT "%8.4" ECU_ADDRESS 0x5B9288 /end MEASUREMENT
/begin MEASUREMENT dlrspid_w "DLR f¸r DV-E: Summe der PID-Anteile" UWORD rel_uw_b100 1 100 0 99.9985 FORMAT "%8.5" ECU_ADDRESS 0x3FC07C /end MEASUREMENT
/begin MEASUREMENT dlrubrsq "Batterie-Normalspanung in Quantisierung von ubrsq" UBYTE spg_q0p1 1 100 0 25.5 FORMAT "%5.2" ECU_ADDRESS 0x5B8819 /end MEASUREMENT
/begin MEASUREMENT dmdresdtev "Delta-Momentenreserve f¸r TEV Drehzahlcheck" SBYTE rel_sb_q0p0976 1 100 -12.4988 12.4012 FORMAT "%5.2" ECU_ADDRESS 0x5B8F8E /end MEASUREMENT
/begin MEASUREMENT dmdresfs "dyn. Delta-Moment nach eingelegter Fahrstufe" UBYTE rel_ub_b24p9 1 100 0 24.9 FORMAT "%5.2" ECU_ADDRESS 0x5B8F8F /end MEASUREMENT
/begin MEASUREMENT dmlllmn_w "Reservemomentschwelle f¸r Lufteingriffe" SWORD rel_sw_b100 1 100 -100 99.9969 FORMAT "%8.4" ECU_ADDRESS 0x5B9326 /end MEASUREMENT
/begin MEASUREMENT dmllrdz_w "geforderte Drehmoment‰nderung von der LLR (D-Z¸ndungsanteil)" SWORD rel_sw_b100 1 100 -100 99.9969 FORMAT "%8.4" ECU_ADDRESS 0x5B9312 /end MEASUREMENT
/begin MEASUREMENT dmllrd_w "geforderte Drehmoment‰nderung von der LLR (D-Anteil)" SWORD rel_sw_b100 1 100 -100 99.9969 FORMAT "%8.4" ECU_ADDRESS 0x5B9314 /end MEASUREMENT
/begin MEASUREMENT dmllri_w "geforderte Drehmoment‰nderung von der LLR (I-Anteil)" SWORD rel_sw_b100 1 100 -100 99.9969 FORMAT "%8.4" ECU_ADDRESS 0x5B9316 /end MEASUREMENT
/begin MEASUREMENT dmllrpz_w "geforderte Drehmoment‰nderung von der LLR (P-Z¸ndungsanteil)" SWORD rel_sw_b100 1 100 -100 99.9969 FORMAT "%8.4" ECU_ADDRESS 0x5B9318 /end MEASUREMENT
/begin MEASUREMENT dmllrp_w "geforderte Drehmoment‰nderung von der LLR (P-Anteil)" SWORD rel_sw_b100 1 100 -100 99.9969 FORMAT "%8.4" ECU_ADDRESS 0x5B931A /end MEASUREMENT
/begin MEASUREMENT dmllrz_w "geforderte MD-ƒnderung von der LLR (PD-Z¸ndungsanteil)" SWORD rel_sw_b100 1 100 -100 99.9969 FORMAT "%8.4" ECU_ADDRESS 0x5B931C /end MEASUREMENT
/begin MEASUREMENT dmllr_w "geforderte Drehmoment‰nderung von der LLR (PD-Anteil)" SWORD rel_sw_b100 1 100 -100 99.9969 FORMAT "%8.4" ECU_ADDRESS 0x5B931E /end MEASUREMENT
/begin MEASUREMENT dmrllr_w "Momenten-Reserve f¸r Leerlaufregelung" UWORD rel_q0p09726 1 100 0 6399.3 FORMAT "%8.3" ECU_ADDRESS 0x5B9328 /end MEASUREMENT
/begin MEASUREMENT dn "Drehzahlabweichung bei Leerlaufregelung" SBYTE nmotd_sb_q10 1 100 -1280 1270 FORMAT "%5.0" ECU_ADDRESS 0x5B8F8C /end MEASUREMENT
/begin MEASUREMENT dnfsacmv "LLRNS: Delta-Solldrehzahl von DS2-Kommunikator, AC mit FS" SBYTE nmotd_sb_q10 1 100 -1280 1270 FORMAT "%5.0" ECU_ADDRESS 0x5B88D0 /end MEASUREMENT
/begin MEASUREMENT dnfsmv "LLRNS: Delta-Solldrehzahl von DS2-Kommunikator, mit FS" SBYTE nmotd_sb_q10 1 100 -1280 1270 FORMAT "%5.0" ECU_ADDRESS 0x5B88D1 /end MEASUREMENT
/begin MEASUREMENT dnllmv "LLRNS: Delta-Solldrehzahl von DS2-Kommunikator" SBYTE nmotd_sb_q10 1 100 -1280 1270 FORMAT "%5.0" ECU_ADDRESS 0x5B88D2 /end MEASUREMENT
/begin MEASUREMENT dns "LLR: Drehzahlabweichung zur station‰ren Solldrehzahl" SBYTE nmotd_sb_q10 1 100 -1280 1270 FORMAT "%5.0" ECU_ADDRESS 0x5B8F85 /end MEASUREMENT
/begin MEASUREMENT dnsacmv "LLRNS: Delta-Solldrehzahl von DS2-Kommunikator, AC ohne FS" SBYTE nmotd_sb_q10 1 100 -1280 1270 FORMAT "%5.0" ECU_ADDRESS 0x5B88D3 /end MEASUREMENT
/begin MEASUREMENT dnslbv "LLRNS: Delta-Solldrehzahl von DS2-Kommunikator, aus LLRUB" SBYTE nmotd_sb_q10 1 100 -1280 1270 FORMAT "%5.0" ECU_ADDRESS 0x5B88D4 /end MEASUREMENT
/begin MEASUREMENT dn_w "Drehzahlabweichung bei Leerlaufregelung" SWORD nmotd_sw_q0p25 1 100 -8192 8191.75 FORMAT "%8.3" ECU_ADDRESS 0x5B9320 /end MEASUREMENT
/begin MEASUREMENT dpwrsvc "Zeitz‰hler DV-E-Powersave" UWORD t10msxs_uw_b655p35 1 100 0 655.35 FORMAT "%8.4" ECU_ADDRESS 0x5B928A /end MEASUREMENT
/begin MEASUREMENT dt_tumg "delta T-Umgebung" FLOAT32_IEEE fak_r32_1 1 100 -1e+037 1e+037 FORMAT "%43.4" ECU_ADDRESS 0x3FB328 /end MEASUREMENT
/begin MEASUREMENT dveesc "Entprellz‰hler f¸r DV-E-Endstufe" UBYTE t10msxs_ub_b2p55 1 100 0 2.55 FORMAT "%5.3" ECU_ADDRESS 0x5B8EF9 /end MEASUREMENT
/begin MEASUREMENT dwdkdlr_w "Differenz-DK-Winkel Sollwert - Istwert (wdkdlr_w - wdkba_w)" SWORD relDK_q0p02441 1 100 -800 799.976 FORMAT "%8.4" ECU_ADDRESS 0x3FC07E /end MEASUREMENT
/begin MEASUREMENT dweksw "aktueller KL-Wert delta Winkel Ersatz-Klopfsensor" UBYTE zw_ub_qn0p75 1 100 -191.25 0 FORMAT "%5.1" ECU_ADDRESS 0x5B8C92 /end MEASUREMENT
/begin MEASUREMENT dwkr "zylinderindividuelle Z¸ndwinkelsp‰tverstellung KR" SBYTE zw_sb_q0p75 1 100 -96 95.25 FORMAT "%5.2" ECU_ADDRESS 0x5B8F10 /end MEASUREMENT
/begin MEASUREMENT dwkrmsw "aktueller Wert f¸r Mittelwertbegrenzung der Sp‰tverstellung" UBYTE zw_ub_qn0p75 1 100 -191.25 0 FORMAT "%5.1" ECU_ADDRESS 0x5B8F11 /end MEASUREMENT
/begin MEASUREMENT dwkrz "zyl.ind. ZW-Sp‰tverstellung inkl. Dyn.vorhalt" SBYTE zw_sb_q0p75 1 100 -96 95.25 FORMAT "%5.2" ARRAY_SIZE 8 ECU_ADDRESS 0x5B8F14 /end MEASUREMENT
/begin MEASUREMENT dzkflag "Flagbyte Diagnoseflags" UBYTE dez 1 100 0 255 FORMAT "%5.1" ARRAY_SIZE 8 ECU_ADDRESS 0x5B8C68 /end MEASUREMENT
/begin MEASUREMENT dzwg "Delta Z¸ndwinkel Grund-ZW zu Optimal-ZW" SBYTE zw_sb_q0p75 1 100 -96 95.25 FORMAT "%5.2" ECU_ADDRESS 0x5B8757 /end MEASUREMENT
/begin MEASUREMENT dzwibts "Delta Z¸ndwinkel Ist-ZW zu Optimal-ZW" SBYTE zw_sb_q0p75 1 100 -96 95.25 FORMAT "%5.2" ECU_ADDRESS 0x5B8758 /end MEASUREMENT
/begin MEASUREMENT eavzrph2_l "" ULONG dez 1 100 0 4.29497e+009 FORMAT "%13.2" ECU_ADDRESS 0x5B9A5C /end MEASUREMENT
/begin MEASUREMENT eavzrph3_l "" ULONG dez 1 100 0 4.29497e+009 FORMAT "%13.2" ECU_ADDRESS 0x5B9A60 /end MEASUREMENT
/begin MEASUREMENT eavzrph4_l "" ULONG dez 1 100 0 4.29497e+009 FORMAT "%13.2" ECU_ADDRESS 0x5B9A64 /end MEASUREMENT
/begin MEASUREMENT eavzrph_l "" ULONG dez 1 100 0 4.29497e+009 FORMAT "%13.2" ECU_ADDRESS 0x5B9A68 /end MEASUREMENT
/begin MEASUREMENT end_init "Temp-Variable Initialisierungsende" UBYTE B_TRUE 1 100 0 1 FORMAT "%13.11" ECU_ADDRESS 0x5B8995 /end MEASUREMENT
/begin MEASUREMENT esst_sdn08llsw "" ULONG dez 1 100 0 4.29497e+009 FORMAT "%13.2" ECU_ADDRESS 0x5B9A74 /end MEASUREMENT
/begin MEASUREMENT esst_sdn08lltsw "" ULONG dez 1 100 0 4.29497e+009 FORMAT "%13.2" ECU_ADDRESS 0x5B9A78 /end MEASUREMENT
/begin MEASUREMENT esst_sns06llsb "" ULONG dez 1 100 0 4.29497e+009 FORMAT "%13.2" ECU_ADDRESS 0x5B9A6C /end MEASUREMENT
/begin MEASUREMENT esst_sns06lltsb "" ULONG dez 1 100 0 4.29497e+009 FORMAT "%13.2" ECU_ADDRESS 0x5B9A70 /end MEASUREMENT
/begin MEASUREMENT etazwg "Wirkungsgrad beim Grundz¸ndwinkel" UBYTE rel_ub_b127p5 1 100 0 127.5 FORMAT "%5.1" ECU_ADDRESS 0x5B8759 /end MEASUREMENT
/begin MEASUREMENT etazwibts "Ist-Z¸ndwinkelwirkungsgrad Bauteileschutz" UBYTE rel_ub_b127p5 1 100 0 127.5 FORMAT "%5.1" ECU_ADDRESS 0x5B875A /end MEASUREMENT
/begin MEASUREMENT etazwim "Gemittelter Wirkungsgrad beim Ist-Z¸ndwinkel" UBYTE rel_ub_b127p5 1 100 0 127.5 FORMAT "%5.1" ECU_ADDRESS 0x5B875B /end MEASUREMENT
/begin MEASUREMENT ffri "LR mit Integratorstop : Gewichtungsfaktor I-Steigung bei langsamer Sonde" UBYTE fak_ub_b4 1 100 0 3.98438 FORMAT "%5.3" ECU_ADDRESS 0x5B88AA /end MEASUREMENT
/begin MEASUREMENT ffrip_w "Gewichtungsfaktor I-Steigung und P-Sprung zur Ver‰nderung der Reglerdynamik" UWORD fak_uw_b8 1 100 0 7.99988 FORMAT "%8.6" ECU_ADDRESS 0x5B88AC /end MEASUREMENT
/begin MEASUREMENT fkvaum_ee "EEPROM Ablage von FKVAUM" UWORD tefuel_uw_b312p5 1 100 0 312.5 FORMAT "%8.4" ECU_ADDRESS 0x3FE978 /end MEASUREMENT
/begin MEASUREMENT flags_w "" UWORD dez 1 100 0 65535 FORMAT "%8.2" ECU_ADDRESS 0x5B96C2 /end MEASUREMENT
/begin MEASUREMENT flaskh "Faktor ‹bergang zu Lambda-Abgas bei Sekund‰rluft" UBYTE fak_ub_b1 1 100 0 0.996094 ECU_ADDRESS 0x5B8846 /end MEASUREMENT
/begin MEASUREMENT flmsslkh "Faktor Lambda-Motor-Soll-Sekund‰rluftanteil, resultierend" UBYTE fak_ub_b1 1 100 0 0.996094 ECU_ADDRESS 0x5B8847 /end MEASUREMENT
/begin MEASUREMENT fr2_w "Lambda-Regler-Ausgang; Bank2 (Word)" UWORD fak_uw_b2 1 100 0 1.99997 FORMAT "%8.6" ECU_ADDRESS 0x5B92B6 /end MEASUREMENT
/begin MEASUREMENT frband_w "Lambdaregelung (Zwei-Punkt) frm-Bildung,  lokale Variable im Zustandsautomat" SWORD fak_sw_b1 1 100 -1 0.999969 FORMAT "%8.6" ECU_ADDRESS 0x5B92B8 /end MEASUREMENT
/begin MEASUREMENT fri "LR mit Integratorstop : I-Steigung aus KFRI(n,tL) oder gem‰ﬂ DSLS" UBYTE fak_ub_b77p81 1 100 0 77.8198 FORMAT "%5.2" ECU_ADDRESS 0x5B8F65 /end MEASUREMENT
/begin MEASUREMENT friband_w "Lambdaregelung (Zwei-Punkt) frm-Bildung,  lokale Variable im Zustandsautomat" SWORD fak_sw_b1 1 100 -1 0.999969 FORMAT "%8.6" ECU_ADDRESS 0x5B92BA /end MEASUREMENT
/begin MEASUREMENT friint "I-Steigung aus KFRI(nmot,rL) oder gem‰ﬂ DSLS, lokale Hilfsgrˆﬂe" UBYTE fak_ub_b77p81 1 100 0 77.8198 FORMAT "%5.2" ECU_ADDRESS 0x5B8F66 /end MEASUREMENT
/begin MEASUREMENT frint_w "Regelfaktor Lambdaregelung, Integratorausgang" UWORD fak_uw_b2 1 100 0 1.99997 FORMAT "%8.6" ECU_ADDRESS 0x5B92BC /end MEASUREMENT
/begin MEASUREMENT frm2_w "schneller Mittelwert des Lambdaregelfaktors Bank 2(Word)" UWORD fak_uw_b2 1 100 0 1.99997 FORMAT "%8.6" ECU_ADDRESS 0x5B92BE /end MEASUREMENT
/begin MEASUREMENT frmn2_w "Lambda-Regler-Ausgang Minimalwert, Bank 2" UWORD fak_uw_b2 1 100 0 1.99997 FORMAT "%8.6" ECU_ADDRESS 0x5B92C0 /end MEASUREMENT
/begin MEASUREMENT frmn_w "Lambda-Regler-Ausgang Minimalwert" UWORD fak_uw_b2 1 100 0 1.99997 FORMAT "%8.6" ECU_ADDRESS 0x5B92C2 /end MEASUREMENT
/begin MEASUREMENT frmx2_w "LR Bank 2: Max. Begrenzung Integrator fr,; FRMAX / angehoben d.DSLS" UWORD fak_uw_b2 1 100 0 1.99997 FORMAT "%8.6" ECU_ADDRESS 0x5B92C4 /end MEASUREMENT
/begin MEASUREMENT frmx_w "LR mit Integratorstop : Max. Begrenzung Integrator fr,; FRMAX / angehoben d.DSLS" UWORD fak_uw_b2 1 100 0 1.99997 FORMAT "%8.6" ECU_ADDRESS 0x5B92C6 /end MEASUREMENT
/begin MEASUREMENT frm_w "schneller Mittelwert des Lambdaregelfaktors (Word)" UWORD fak_uw_b2 1 100 0 1.99997 FORMAT "%8.6" ECU_ADDRESS 0x5B92C8 /end MEASUREMENT
/begin MEASUREMENT frp "LR mit Integratorstop : P-Sprung aus KFRP(n,tL) oder 0 bei DSLS aktiv" UBYTE fak_ub_b12p45 1 100 0 12.4512 FORMAT "%5.2" ECU_ADDRESS 0x5B8F67 /end MEASUREMENT
/begin MEASUREMENT frpint "P-Sprung aus KFRP(nmot,rL) oder gem‰ﬂ DSLS, lokale Hilfsgrˆﬂe" UBYTE fak_ub_b12p45 1 100 0 12.4512 FORMAT "%5.2" ECU_ADDRESS 0x5B8F68 /end MEASUREMENT
/begin MEASUREMENT frsp_w "Zweipunktregelung: Regelfaktor fr vor Sprung (Max-/Min-Wert)" UWORD fak_uw_b2 1 100 0 1.99997 FORMAT "%8.6" ECU_ADDRESS 0x5B92CA /end MEASUREMENT
/begin MEASUREMENT frtv "tv-Zeit aus KFRTV(nmot,rL) oder gem‰ﬂ DSLS" SBYTE t10msxs_sb_q0p01 1 100 -1.28 1.27 FORMAT "%5.3" ECU_ADDRESS 0x5B8F69 /end MEASUREMENT
/begin MEASUREMENT fr_w "Lambda-Regler-Ausgang (Word)" UWORD fak_uw_b2 1 100 0 1.99997 FORMAT "%8.6" ECU_ADDRESS 0x5B92CC /end MEASUREMENT
/begin MEASUREMENT fslsdyn "Faktor Dynamikbeschreibung Sekund‰rluftsystem" UBYTE fak_ub_b1 1 100 0 0.996094 ECU_ADDRESS 0x5B8848 /end MEASUREMENT
/begin MEASUREMENT fwlmkhkst "" UBYTE fak_ub_b1 1 100 0 0.996094 ECU_ADDRESS 0x5B8849 /end MEASUREMENT
/begin MEASUREMENT genmanufak "Kennung Generator Hersteller" UBYTE dez 1 100 0 255 FORMAT "%5.1" ECU_ADDRESS 0x5B8825 /end MEASUREMENT
/begin MEASUREMENT gentypkenn "Kennung Generatortyp" UBYTE dez 1 100 0 255 FORMAT "%5.1" ECU_ADDRESS 0x5B8826 /end MEASUREMENT
/begin MEASUREMENT gwdkdlr_w "ƒnderung des Drosselklappen-Sollwinkels, Betrag f¸r Kennlinieneingang" SWORD relDK_q0p00152 1 100 -50 49.9985 FORMAT "%8.5" ECU_ADDRESS 0x3FC080 /end MEASUREMENT
/begin MEASUREMENT gwdk_kge "ƒnderung des Drosselklappen-Sollwinkels, Betrag f¸r Kennlinieneingang" UWORD relDK_q0p00152 1 100 0 99.9985 FORMAT "%8.5" ECU_ADDRESS 0x5B928C /end MEASUREMENT
/begin MEASUREMENT ignbuf "" UBYTE default 1 100 0 255 FORMAT "%5.1" ECU_ADDRESS 0x5B8C70 /end MEASUREMENT
/begin MEASUREMENT ignchan "" UBYTE dez 1 100 0 255 FORMAT "%5.1" ECU_ADDRESS 0x5B8C71 /end MEASUREMENT
/begin MEASUREMENT ignFadeStatBits "" UBYTE dez 1 100 0 255 FORMAT "%5.1" ECU_ADDRESS 0x5B8C7C /end MEASUREMENT
/begin MEASUREMENT ignfdostat "" UBYTE dez 1 100 0 255 FORMAT "%5.1" ECU_ADDRESS 0x5B8C7D /end MEASUREMENT
/begin MEASUREMENT ignFdReqStat "" UBYTE dez 1 100 0 255 FORMAT "%5.1" ECU_ADDRESS 0x5B8C7E /end MEASUREMENT
/begin MEASUREMENT ignStpStat "" UBYTE dez 1 100 0 255 FORMAT "%5.1" ECU_ADDRESS 0x5B8C7F /end MEASUREMENT
/begin MEASUREMENT injec_error_abb "" UWORD dez 1 100 0 65535 FORMAT "%8.2" ARRAY_SIZE 8 ECU_ADDRESS 0x5B9706 /end MEASUREMENT
/begin MEASUREMENT kral1w "aktueller Wert Last-Adaptionsbereich 1" UBYTE rel_ub_q0p75 1 100 0 191.25 FORMAT "%5.1" ECU_ADDRESS 0x5B887C /end MEASUREMENT
/begin MEASUREMENT kral2w "aktueller Wert Last-Adaptionsbereich 2" UBYTE rel_ub_q0p75 1 100 0 191.25 FORMAT "%5.1" ECU_ADDRESS 0x5B887D /end MEASUREMENT
/begin MEASUREMENT krdwsw "aktueller KL-Wert der Sicherheitssp‰tverstellung" UBYTE zw_ub_qn0p75 1 100 -191.25 0 FORMAT "%5.1" ECU_ADDRESS 0x5B8F1C /end MEASUREMENT
/begin MEASUREMENT krfkw "Aktueller Wert aus KRFKN" UBYTE zw_ub_qn0p75 1 100 -191.25 0 FORMAT "%5.1" ECU_ADDRESS 0x5B8F1D /end MEASUREMENT
/begin MEASUREMENT krmxw "aktueller Wert f¸r Sp‰tbegrenzung der Sp‰tverstellung" UBYTE zw_ub_qn0p75 1 100 -191.25 0 FORMAT "%5.1" ECU_ADDRESS 0x5B8F1E /end MEASUREMENT
/begin MEASUREMENT krvfakt "" UBYTE dez 1 100 0 255 FORMAT "%5.1" ECU_ADDRESS 0x5B8F1F /end MEASUREMENT
/begin MEASUREMENT krvfsw "Initwert f¸r schnelle Fr¸hverstellung" UBYTE dez 1 100 0 255 FORMAT "%5.1" ECU_ADDRESS 0x5B8F20 /end MEASUREMENT
/begin MEASUREMENT krvfw "Initwert f¸r normale Fr¸hverstellung" UBYTE dez 1 100 0 255 FORMAT "%5.1" ECU_ADDRESS 0x5B8F21 /end MEASUREMENT
/begin MEASUREMENT ksa "Nummer des Klopfsensors" UBYTE dezsub1 1 100 1 256 FORMAT "%5.1" ECU_ADDRESS 0x5B8C93 /end MEASUREMENT
/begin MEASUREMENT ksb "Ersatzklopfsensor B" UBYTE dezsub1 1 100 1 256 FORMAT "%5.1" ECU_ADDRESS 0x5B8C94 /end MEASUREMENT
/begin MEASUREMENT ksdefa "Nummer des defekten Klopfsensors von Ersatzsensor A" UBYTE dezsub1 1 100 1 256 FORMAT "%5.1" ECU_ADDRESS 0x5B8C95 /end MEASUREMENT
/begin MEASUREMENT ksdefb "Nummer des defekten Klopfsensors von Ersatzsensor B" UBYTE dezsub1 1 100 1 256 FORMAT "%5.1" ECU_ADDRESS 0x5B8C96 /end MEASUREMENT
/begin MEASUREMENT kt_zuen_fdOutPattern_u8 "" UBYTE dez 1 100 0 255 FORMAT "%5.1" ECU_ADDRESS 0x5B8C80 /end MEASUREMENT
/begin MEASUREMENT kt_zuen_fdPatArray_u8 "" UBYTE dez 1 100 0 255 FORMAT "%5.1" ARRAY_SIZE 8 ECU_ADDRESS 0x5B8C84 /end MEASUREMENT
/begin MEASUREMENT kt_zuen_fdReq_u16 "" UWORD dez 1 100 0 65535 FORMAT "%8.2" ECU_ADDRESS 0x5B971E /end MEASUREMENT
/begin MEASUREMENT kt_zuen_lastzkvek "" UBYTE dez 1 100 0 255 FORMAT "%5.1" ECU_ADDRESS 0x5B8EFC /end MEASUREMENT
/begin MEASUREMENT kt_zuen_lastzzyl "" UBYTE dez 1 100 0 255 FORMAT "%5.1" ECU_ADDRESS 0x5B8EFD /end MEASUREMENT
/begin MEASUREMENT kt_zuen_zkvek "" UBYTE dez 1 100 0 255 FORMAT "%5.1" ECU_ADDRESS 0x5B8EFE /end MEASUREMENT
/begin MEASUREMENT kvarest "KVA-Rest" UWORD fuel_uw_b1 1 100 0 0.999985 FORMAT "%9.7" ECU_ADDRESS 0x5B980C /end MEASUREMENT
/begin MEASUREMENT kvaverbr "Verbrauchte Kraftstoffmenge ¸ber CAN; normiert in u-Liter" UWORD fuel_uw_b65535 1 100 0 65535 FORMAT "%8.2" ECU_ADDRESS 0x5B980E /end MEASUREMENT
/begin MEASUREMENT kva_korr "Korrekturfaktor f¸r die Kraftstoffmenge" SBYTE rel_uw_q0p001 1 100 -0.128 0.127 FORMAT "%6.4" ECU_ADDRESS 0x3FE97A /end MEASUREMENT
/begin MEASUREMENT LAKHlokBits_10ms "" UBYTE dez 1 100 0 255 FORMAT "%5.1" ECU_ADDRESS 0x5B8F08 /end MEASUREMENT
/begin MEASUREMENT lambas "Basis-Lambda" UBYTE fak_ub_b2 1 100 0 1.99219 FORMAT "%5.3" ECU_ADDRESS 0x5B8EBC /end MEASUREMENT
/begin MEASUREMENT lambts_w "Lambda f¸r Bauteileschutz" UWORD fak_uw_b16 1 100 0 15.9998 FORMAT "%8.5" ECU_ADDRESS 0x5B875E /end MEASUREMENT
/begin MEASUREMENT lamfa_w "Lambdasoll Fahrerwunsch (word)" UWORD fak_uw_b16 1 100 0 15.9998 FORMAT "%8.5" ECU_ADDRESS 0x5B8762 /end MEASUREMENT
/begin MEASUREMENT lamkh2_w "Lambda-Motor-Soll bei Katheizen, Bank 2 (word)" UWORD fak_q0p000244 1 100 0 15.9998 FORMAT "%8.5" ECU_ADDRESS 0x5B929C /end MEASUREMENT
/begin MEASUREMENT lamkhe_w "Lambda-Motor-Soll bei Katheizen, effektiv" UWORD fak_uw_b16 1 100 0 15.9998 FORMAT "%8.5" ECU_ADDRESS 0x5B91DA /end MEASUREMENT
/begin MEASUREMENT lamkhg_w "Lambda-Motor-Soll bei Katheizen (word) gewichtet mit flakh" UWORD fak_q0p000244 1 100 0 15.9998 FORMAT "%8.5" ECU_ADDRESS 0x5B929E /end MEASUREMENT
/begin MEASUREMENT lamkhr_w "Lambda-Motor-Soll resultierend bei Katheizen (word)" UWORD fak_q0p000244 1 100 0 15.9998 FORMAT "%8.5" ECU_ADDRESS 0x5B884A /end MEASUREMENT
/begin MEASUREMENT lamkh_w "Lambda-Motor-Soll bei Katheizen (word)" UWORD fak_q0p000244 1 100 0 15.9998 FORMAT "%8.5" ECU_ADDRESS 0x5B92A0 /end MEASUREMENT
/begin MEASUREMENT lamlgfmn "Lambda Motorlaufgrenze fett" UBYTE fak_ub_b2 1 100 0 1.99219 FORMAT "%5.3" ECU_ADDRESS 0x5B8764 /end MEASUREMENT
/begin MEASUREMENT lamlgm "Laufgrenze ""Lambda mager""" UBYTE fak_ub_b2 1 100 0 1.99219 FORMAT "%5.3" ECU_ADDRESS 0x5B8765 /end MEASUREMENT
/begin MEASUREMENT lamsbg_w "Lambdasoll Begrenzung (word)" UWORD fak_uw_b16 1 100 0 15.9998 FORMAT "%8.5" ECU_ADDRESS 0x5B91DC /end MEASUREMENT
/begin MEASUREMENT lamsons_w "Lambda-Sollwert bezogen auf Einbauort Lambda-Sensor" UWORD fak_uw_b16 1 100 0 15.9998 FORMAT "%8.5" ECU_ADDRESS 0x5B91DE /end MEASUREMENT
/begin MEASUREMENT lamsos_w "Lambda-Sollwert bezogen auf Einbauort Lambda-Sensor" UWORD fak_uw_b16 1 100 0 15.9998 FORMAT "%8.5" ECU_ADDRESS 0x5B91E0 /end MEASUREMENT
/begin MEASUREMENT lamsubg_w "Lambdasoll unbegrenzt (word)" UWORD fak_uw_b16 1 100 0 15.9998 FORMAT "%8.5" ECU_ADDRESS 0x5B91E2 /end MEASUREMENT
/begin MEASUREMENT lams_w "Lambdasoll (word)" UWORD fak_uw_b16 1 100 0 15.9998 FORMAT "%8.5" ECU_ADDRESS 0x5B91E4 /end MEASUREMENT
/begin MEASUREMENT lamvoa_w "Lambdavorsteuerung ohne additive Anteile" UWORD fak_uw_b16 1 100 0 15.9998 FORMAT "%8.5" ECU_ADDRESS 0x5B91E6 /end MEASUREMENT
/begin MEASUREMENT lanskh_w "Lambda-Motor-Soll im Nachstart bei Katheizen" UWORD fak_q0p000244 1 100 0 15.9998 FORMAT "%8.5" ECU_ADDRESS 0x5B884C /end MEASUREMENT
/begin MEASUREMENT lasdslg_w "Lambda-Abgas-Soll f¸r Sekund‰rluftdiagnose gewichtet mit flamsl" UWORD fak_q0p000244 1 100 0 15.9998 FORMAT "%8.5" ECU_ADDRESS 0x5B884E /end MEASUREMENT
/begin MEASUREMENT lasdsl_w "Lambda-Abgas-Soll f¸r Sekund‰rluftdiagnose" UWORD fak_q0p000244 1 100 0 15.9998 FORMAT "%8.5" ECU_ADDRESS 0x5B8850 /end MEASUREMENT
/begin MEASUREMENT laskh_w "Lambda-Abgas-Soll bei Katheizen (word)" UWORD fak_q0p000244 1 100 0 15.9998 FORMAT "%8.5" ECU_ADDRESS 0x5B8852 /end MEASUREMENT
/begin MEASUREMENT lbts_w "Lambda f¸r Bauteileschutz aus Station‰rkennfeld" UWORD fak_uw_b16 1 100 0 15.9998 FORMAT "%8.5" ECU_ADDRESS 0x5B8760 /end MEASUREMENT
/begin MEASUREMENT limax_w "LLR-Integrator-Maximalwert" SWORD rel_sw_b100 1 100 -100 99.9969 FORMAT "%8.4" ECU_ADDRESS 0x5B9322 /end MEASUREMENT
/begin MEASUREMENT limin_w "LLR-Integrator-Minimalwert" SWORD rel_sw_b100 1 100 -100 99.9969 FORMAT "%8.4" ECU_ADDRESS 0x5B9324 /end MEASUREMENT
/begin MEASUREMENT limnst "LLR-Integrator-Minimalwert w‰hrend Nachstart" UBYTE rel_ub_b24p9 1 100 0 24.9 FORMAT "%5.2" ECU_ADDRESS 0x5B8F8D /end MEASUREMENT
/begin MEASUREMENT lkrw "aktueller Wert der Lastschwelle Klopfregelung" UBYTE rel_ub_q0p75 1 100 0 191.25 FORMAT "%5.1" ECU_ADDRESS 0x5B887E /end MEASUREMENT
/begin MEASUREMENT llsstat "Funktionsstatus LLRNS bei Anforderung Systemcheck" UBYTE dez 1 100 0 255 FORMAT "%5.1" ECU_ADDRESS 0x5B88D5 /end MEASUREMENT
/begin MEASUREMENT lmskh_w "Lambda-Motor-Soll bei katheizen (word)" UWORD fak_q0p000244 1 100 0 15.9998 FORMAT "%8.5" ECU_ADDRESS 0x5B8854 /end MEASUREMENT
/begin MEASUREMENT lmssl_w "Lambda-Motor-Soll wegen Sekund‰rluft bei Katheizen (word)" UWORD fak_q0p000244 1 100 0 15.9998 FORMAT "%8.5" ECU_ADDRESS 0x5B8856 /end MEASUREMENT
/begin MEASUREMENT loadresp "gerechnete Loadresponse" UBYTE t100msxs_ub_b25p5 1 100 0 25.5 FORMAT "%5.2" ECU_ADDRESS 0x5B8CC1 /end MEASUREMENT
/begin MEASUREMENT lrfgen "Zwischenspeicher f¸r Load-Response-Zeit,wenn DATA1=0" UBYTE tlr_q3 1 100 0 765 FORMAT "%5.1" ECU_ADDRESS 0x5B8827 /end MEASUREMENT
/begin MEASUREMENT lrfrmz "Zustandsbyte des Automaten Bildung des fr-Mittelwert frm_w" UBYTE dez 1 100 0 255 FORMAT "%5.1" ECU_ADDRESS 0x5B8F6A /end MEASUREMENT
/begin MEASUREMENT lrfrz "Zustandsbyte des LR-Automaten" UBYTE dez 1 100 0 255 FORMAT "%5.1" ECU_ADDRESS 0x5B8F6B /end MEASUREMENT
/begin MEASUREMENT nnstart "Motordrehzahl nach Motorstart" UWORD nmot_uw_q0p25 1 100 0 16383.8 FORMAT "%8.2" ECU_ADDRESS 0x5B9756 /end MEASUREMENT
/begin MEASUREMENT nsfsm "LLR: Motortemperaturabh‰ngige Solldrehzahl im LL bei S_fs=1" UBYTE nmot_ub_q10 1 100 0 2550 FORMAT "%5.0" ECU_ADDRESS 0x5B88D6 /end MEASUREMENT
/begin MEASUREMENT nsfsmn "LLR: Minimale Solldrehzahl bei eingelegter Fahrstufe" UBYTE nmot_ub_q10 1 100 0 2550 FORMAT "%5.0" ECU_ADDRESS 0x5B8F86 /end MEASUREMENT
/begin MEASUREMENT nslb "Nsoll Korrektur von Ladebilanz Batterie" UBYTE nmot_ub_q10 1 100 0 2550 FORMAT "%5.0" ECU_ADDRESS 0x5B8CBE /end MEASUREMENT
/begin MEASUREMENT nslbz "Solldrehtahl abh‰ngig von lbz" UBYTE nmot_ub_q10 1 100 0 2550 FORMAT "%5.0" ECU_ADDRESS 0x5B88D7 /end MEASUREMENT
/begin MEASUREMENT nsllm "LLR: Motortemperaturabh‰ngige Solldrehzahl im LL" UBYTE nmot_ub_q10 1 100 0 2550 FORMAT "%5.0" ECU_ADDRESS 0x5B88D8 /end MEASUREMENT
/begin MEASUREMENT nsllmn "LLR: Minimale Solldrehzahl im LL" UBYTE nmot_ub_q10 1 100 0 2550 FORMAT "%5.0" ECU_ADDRESS 0x5B8F87 /end MEASUREMENT
/begin MEASUREMENT nsnf "LLR: Nachgef¸hrte Solldrehzahl" UBYTE nmot_ub_q10 1 100 0 2550 FORMAT "%5.0" ECU_ADDRESS 0x5B8F88 /end MEASUREMENT
/begin MEASUREMENT nsol "Leerlaufsolldrehzahl" UBYTE nmot_ub_q10 1 100 0 2550 FORMAT "%5.0" ECU_ADDRESS 0x5B8F89 /end MEASUREMENT
/begin MEASUREMENT nsol_w "Leerlaufsolldrehzahl" UWORD nmot_uw_q0p25 1 100 0 16383.8 FORMAT "%8.2" ECU_ADDRESS 0x5B9310 /end MEASUREMENT
/begin MEASUREMENT nsst "Initialisierungswert der Solldrehzahl im Start" UBYTE nmot_ub_q10 1 100 0 2550 FORMAT "%5.0" ECU_ADDRESS 0x5B8F8A /end MEASUREMENT
/begin MEASUREMENT nstat "Solldrehzahl station‰r" UBYTE nmot_ub_q10 1 100 0 2550 FORMAT "%5.0" ECU_ADDRESS 0x5B8F8B /end MEASUREMENT
/begin MEASUREMENT nwpos_nkor "Ausg. Vanos NW_POS Drehzahlkorrektur" SBYTE sprzi_q0p1 1 100 -12.8 12.7 FORMAT "%4.1" ECU_ADDRESS 0x5B8C73 /end MEASUREMENT
/begin MEASUREMENT nwpos_tkor "Ausg. Vanos NW_POS Motortemperaturkorrektur" SBYTE sprzi_q0p1 1 100 -12.8 12.7 FORMAT "%4.1" ECU_ADDRESS 0x5B8C74 /end MEASUREMENT
/begin MEASUREMENT stkrlx "Lastst¸tzstelle f¸r die KR-Adaption" UBYTE dez 1 100 0 255 FORMAT "%5.1" ECU_ADDRESS 0x5B8F22 /end MEASUREMENT
/begin MEASUREMENT stkrnx "Drehzahlst¸tzstelle f¸r die KR-Adaption" UBYTE dez 1 100 0 255 FORMAT "%5.1" ECU_ADDRESS 0x5B8F23 /end MEASUREMENT
/begin MEASUREMENT st_ldstgen "Lastzustand Generator elektrisch/thermisch" UBYTE dez 1 100 0 255 FORMAT "%5.1" ECU_ADDRESS 0x5B8CBD /end MEASUREMENT
/begin MEASUREMENT tabst_fl "Abstellzeit in float" FLOAT32_IEEE fak_r32_1 1 100 -1e+037 1e+037 FORMAT "%43.4" ECU_ADDRESS 0x3FB32C /end MEASUREMENT
/begin MEASUREMENT tansf "Ansaugluft in float" FLOAT32_IEEE fak_r32_1 1 100 -1e+037 1e+037 FORMAT "%43.4" ECU_ADDRESS 0x3FB330 /end MEASUREMENT
/begin MEASUREMENT ta_w "Einschaltzeit bis zum Erreichen der 2A-Prim‰rstromschwelle" UWORD txms_uw_q0p001 1 100 0 65.535 FORMAT "%8.5" ARRAY_SIZE 8 ECU_ADDRESS 0x5B96C4 /end MEASUREMENT
/begin MEASUREMENT tbatinmanf "Initwert Batterietmperatur Hand temp." FLOAT32_IEEE fak_r32_1 1 100 -1e+037 1e+037 FORMAT "%43.4" ECU_ADDRESS 0x3FB334 /end MEASUREMENT
/begin MEASUREMENT tbatstiniv "Starttemperatur Batterie vorne" FLOAT32_IEEE fak_r32_1 1 100 -1e+037 1e+037 FORMAT "%43.4" ECU_ADDRESS 0x3FB338 /end MEASUREMENT
/begin MEASUREMENT tbatt "Batterietemperatur" UBYTE temp_ub_q0p75_o48 1 100 -48 143.25 FORMAT "%5.1" ECU_ADDRESS 0x5B8998 /end MEASUREMENT
/begin MEASUREMENT tc_w "Zeit f¸r l‰ngsten Spannungsimpulse" UWORD txms_uw_q0p001 1 100 0 65.535 FORMAT "%8.5" ARRAY_SIZE 8 ECU_ADDRESS 0x5B96D4 /end MEASUREMENT
/begin MEASUREMENT teemrdy "Zeitz‰hler f¸r EEPROM-Spiegel-Bereitschaft" UBYTE t100msxs_ub_b25p5 1 100 0 25.5 FORMAT "%5.2" ECU_ADDRESS 0x5B882F /end MEASUREMENT
/begin MEASUREMENT tesum_l "Summe effektive Einspritzzeit long word" ULONG dez 1 100 0 4.29497e+009 FORMAT "%13.2" ECU_ADDRESS 0x5B9A58 /end MEASUREMENT
/begin MEASUREMENT te_ges "" UWORD t3p2usxms_uw_b209p7 1 100 0 209.748 FORMAT "%8.4" ECU_ADDRESS 0x5B9810 /end MEASUREMENT
/begin MEASUREMENT tfrnint_w "Z‰hler zum Ausmessen Zeitdauer Lambdaregler I-Anteil negative Steigung" UWORD t10msxs_uw_b655p35 1 100 0 655.35 FORMAT "%8.4" ECU_ADDRESS 0x5B92CE /end MEASUREMENT
/begin MEASUREMENT tfrn_w "Zeitdauer Lambdaregler I-Anteil negative Steigung" UWORD t10msxs_uw_b655p35 1 100 0 655.35 FORMAT "%8.4" ECU_ADDRESS 0x5B92D0 /end MEASUREMENT
/begin MEASUREMENT tfrpint_w "Z‰hler zur Messung der Zeitdauer Lambdaregler I-Anteil positive Steigung" UWORD t10msxs_uw_b655p35 1 100 0 655.35 FORMAT "%8.4" ECU_ADDRESS 0x5B92D2 /end MEASUREMENT
/begin MEASUREMENT tfrp_w "Zeitdauer Lambdaregler I-Anteil positive Steigung" UWORD t10msxs_uw_b655p35 1 100 0 655.35 FORMAT "%8.4" ECU_ADDRESS 0x5B92D4 /end MEASUREMENT
/begin MEASUREMENT timelr "Load-Response-Zeit (sec)" UBYTE tlr_q3 1 100 0 765 FORMAT "%5.1" ECU_ADDRESS 0x5B8828 /end MEASUREMENT
/begin MEASUREMENT tkakor_in "Temperaturdifferenz tmot-tans" SWORD temp_sb_q0p75 1 100 -192 191.25 FORMAT "%8.4" ECU_ADDRESS 0x5B966A /end MEASUREMENT
/begin MEASUREMENT tkrst "Kraftstofftemperatur" UBYTE temp_ub_q0p75_o48 1 100 -48 143.25 FORMAT "%5.1" ECU_ADDRESS 0x5B8C4B /end MEASUREMENT
/begin MEASUREMENT tkrstab "Kraftstofftemperatur beim Abstellen aus Modell" UBYTE temp_ub_q0p75_o48 1 100 -48 143.25 FORMAT "%5.1" ECU_ADDRESS 0x3FDC2C /end MEASUREMENT
/begin MEASUREMENT tkrstluft "Offset durch Lufteinfluss auf tkrst" SBYTE temp_sb_q1p5 1 100 -192 190.5 FORMAT "%5.1" ECU_ADDRESS 0x5B8C4C /end MEASUREMENT
/begin MEASUREMENT tkrststart "Startwert f¸r tkrst nach Reset" SWORD temp_sw_q0p75 1 100 -192 191.25 FORMAT "%8.4" ECU_ADDRESS 0x5B966C /end MEASUREMENT
/begin MEASUREMENT tkrstvt "Rohwert tkrst" SWORD temp_sw_q0p75 1 100 -192 191.25 FORMAT "%8.4" ECU_ADDRESS 0x5B966E /end MEASUREMENT
/begin MEASUREMENT tkrstwand "Einfluss Wandtemperatur Rail tkrst" SBYTE temp_sb_q1p5 1 100 -192 190.5 FORMAT "%5.1" ECU_ADDRESS 0x5B8C4D /end MEASUREMENT
/begin MEASUREMENT tkrstzu "Einfluﬂ Zulaufmassenstrom Kraftstoff mit tumg auf tkrst" SBYTE temp_sb_q1p5 1 100 -192 190.5 FORMAT "%5.1" ECU_ADDRESS 0x5B8C4E /end MEASUREMENT
/begin MEASUREMENT tlrfgen "vom Generator empfangene Load response Zeit (Kopie gesendeter Wert)" UBYTE t100msxs_ub_b25p5 1 100 0 25.5 FORMAT "%5.2" ECU_ADDRESS 0x5B8829 /end MEASUREMENT
/begin MEASUREMENT tlrgen "physikal. Eingangswert (sec.) f¸r Load response Zeit" UBYTE t100msxs_ub_b25p5 1 100 0 25.5 FORMAT "%5.2" ECU_ADDRESS 0x5B8CC2 /end MEASUREMENT
/begin MEASUREMENT tlrgen2 "" UBYTE t100msxs_ub_b25p5 1 100 0 25.5 FORMAT "%5.2" ECU_ADDRESS 0x5B89B0 /end MEASUREMENT
/begin MEASUREMENT Tog_cnt "Anzahl gemessener neg. Tog-Flanken max 255" UBYTE dez 1 100 0 255 FORMAT "%5.1" ECU_ADDRESS 0x5B8C75 /end MEASUREMENT
/begin MEASUREMENT Tog_icnt "Aufrufz‰hler ohne Flanke vom Toens" UWORD t10msxs_ub_b2p55 1 100 0 655.35 FORMAT "%8.4" ECU_ADDRESS 0x5B9716 /end MEASUREMENT
/begin MEASUREMENT Tog_pwmst "Status vom HW-Treiber IPWM" UBYTE dez 1 100 0 255 FORMAT "%5.1" ECU_ADDRESS 0x5B8C76 /end MEASUREMENT
/begin MEASUREMENT Tog_st "Statusbyte Toens" UBYTE dez 1 100 0 255 FORMAT "%5.1" ECU_ADDRESS 0x5B8C77 /end MEASUREMENT
/begin MEASUREMENT Tog_state "State in dem sich die Auswertungs-Statemschine befindet" UBYTE dez 1 100 0 255 FORMAT "%5.1" ECU_ADDRESS 0x5B8C78 /end MEASUREMENT
/begin MEASUREMENT Tog_tk "Tog Abkuehlzeit" UWORD t_q0p1ms 1 100 0 6553.5 FORMAT "%8.3" ECU_ADDRESS 0x5B9718 /end MEASUREMENT
/begin MEASUREMENT Tog_tr "Tog, Korrekturwert" UWORD t_q0p1ms 1 100 0 6553.5 FORMAT "%8.3" ECU_ADDRESS 0x5B971A /end MEASUREMENT
/begin MEASUREMENT Tog_tv "Tog, Temperatursignalzeit" UWORD t_q0p1ms 1 100 0 6553.5 FORMAT "%8.3" ECU_ADDRESS 0x5B971C /end MEASUREMENT
/begin MEASUREMENT Tog_uplcnt "Z‰hler unplausible Werte vom Toens" UBYTE dez 1 100 0 255 FORMAT "%5.1" ECU_ADDRESS 0x5B8C79 /end MEASUREMENT
/begin MEASUREMENT tplrvk2_w "Periodendauerwert Rohwert der Sonde vor Kat, ermittelt in %LR, Bank 2" UWORD t10msxs_uw_b655p35 1 100 0 655.35 FORMAT "%8.4" ECU_ADDRESS 0x5B92D6 /end MEASUREMENT
/begin MEASUREMENT tplrvk_w "Periodendauerwert Rohwert der Sonde vor Kat, ermittelt in %LR" UWORD t10msxs_uw_b655p35 1 100 0 655.35 FORMAT "%8.4" ECU_ADDRESS 0x5B92D8 /end MEASUREMENT
/begin MEASUREMENT tptmot_out "Einfluss ¸ber K¸hlwassertemperatur auf tkrst" UBYTE temp_ub_q0p75_o48 1 100 -48 143.25 FORMAT "%5.1" ECU_ADDRESS 0x5B8C4F /end MEASUREMENT
/begin MEASUREMENT tsperr "Sperrzeit f¸r Lambdaregelung" UBYTE t10msxs_ub_b2p55 1 100 0 2.55 FORMAT "%5.3" ECU_ADDRESS 0x5B8F6C /end MEASUREMENT
/begin MEASUREMENT ts_w "Tats‰chliche Schlieﬂzeit" UWORD txms_uw_q0p001 1 100 0 65.535 FORMAT "%8.5" ARRAY_SIZE 8 ECU_ADDRESS 0x5B96E4 /end MEASUREMENT
/begin MEASUREMENT tumgbatold "vorherige Batterieumgebungstemperatur" FLOAT32_IEEE fak_r32_1 1 100 -1e+037 1e+037 FORMAT "%43.4" ECU_ADDRESS 0x3FB33C /end MEASUREMENT
/begin MEASUREMENT tumgbattab "Abstell-Umgebungstemperatur Batterie" FLOAT32_IEEE fak_r32_1 1 100 -1e+037 1e+037 FORMAT "%43.4" ECU_ADDRESS 0x3FDC9C /end MEASUREMENT
/begin MEASUREMENT tumgcanf "aktuelle Aussentemperatur float" FLOAT32_IEEE fak_r32_1 1 100 -1e+037 1e+037 FORMAT "%43.4" ECU_ADDRESS 0x3FB340 /end MEASUREMENT
/begin MEASUREMENT tumgtemp "Umgebungstemperatur Ersatz" SBYTE temp_q1 1 100 -128 127 FORMAT "%5.1" ECU_ADDRESS 0x5B8999 /end MEASUREMENT
/begin MEASUREMENT tumg_ers "Aussentemperatur oder Ersatzwert" SBYTE temp_q1 1 100 -128 127 FORMAT "%5.1" ECU_ADDRESS 0x5B899A /end MEASUREMENT
/begin MEASUREMENT tv "LR: Integratorstopzeit-Z‰hler / ES: Bereitstellung Spannungskorrektur" SBYTE t10msxs_sb_q0p01 1 100 -1.28 1.27 FORMAT "%5.3" ECU_ADDRESS 0x5B8F6D /end MEASUREMENT
/begin MEASUREMENT tvdfrfgen "Zwischenspeicher f¸r DF-Signal (Gen.-Last), wenn DATA1=2" UBYTE rel_ub_b31 1 100 0 822.581 FORMAT "%5.1" ECU_ADDRESS 0x5B882A /end MEASUREMENT
/begin MEASUREMENT tvlr "LR: Summenwert f¸r verzˆgerte Reglerumschaltung tv" SBYTE t10msxs_sb_q0p01 1 100 -1.28 1.27 FORMAT "%5.3" ECU_ADDRESS 0x5B8F6E /end MEASUREMENT
/begin MEASUREMENT twdknlc "Z‰hler Motorstillstand nach KL.15 aus" UBYTE t100msxs_ub_b25p5 1 100 0 25.5 FORMAT "%5.2" ECU_ADDRESS 0x5B881A /end MEASUREMENT
/begin MEASUREMENT t_battabst "Batterieabstelltemperatur" FLOAT32_IEEE fak_r32_1 1 100 -1e+037 1e+037 FORMAT "%43.4" ECU_ADDRESS 0x3FDCA0 /end MEASUREMENT
/begin MEASUREMENT t_batt_ini "Startwert Batterietemperatur" FLOAT32_IEEE fak_r32_1 1 100 -1e+037 1e+037 FORMAT "%43.4" ECU_ADDRESS 0x3FB344 /end MEASUREMENT
/begin MEASUREMENT t_umgabst "Abstell-Aussentemperatur" SBYTE temp_q1 1 100 -128 127 FORMAT "%5.1" ECU_ADDRESS 0x3FDC98 /end MEASUREMENT
/begin MEASUREMENT t_umgabstf "letzte Aussentemperatur" FLOAT32_IEEE fak_r32_1 1 100 -1e+037 1e+037 FORMAT "%43.4" ECU_ADDRESS 0x3FB348 /end MEASUREMENT
/begin MEASUREMENT ubdedis "Untere Hstereseschwelle zur DV-E Unterspannungserkennung 8Bit-Quant." UBYTE spg_q0p1 1 100 0 25.5 FORMAT "%5.2" ECU_ADDRESS 0x5B8EFA /end MEASUREMENT
/begin MEASUREMENT ubdeen "Obere Hystereseschwelle zur DV-E Unterspannungserkennung 8 Bit" UBYTE spg_q0p1 1 100 0 25.5 FORMAT "%5.2" ECU_ADDRESS 0x5B8EFB /end MEASUREMENT
/begin MEASUREMENT uddss_w "Spannung Differenzdrucksensor Saugrohr" UWORD spg_uw_q0p00488 1 100 0 319.995 FORMAT "%8.4" ECU_ADDRESS 0x5B96BE /end MEASUREMENT
/begin MEASUREMENT udkp1v_w "Verst‰rkte Spannung DK-Poti 1" UWORD spg_uw_q0p00488 1 100 0 319.995 FORMAT "%8.4" ECU_ADDRESS 0x5B9278 /end MEASUREMENT
/begin MEASUREMENT udkp1_w "Spannung DK-Poti 1" UWORD spg_uw_q0p001222 1 100 0 80.0838 FORMAT "%8.5" ECU_ADDRESS 0x5B927A /end MEASUREMENT
/begin MEASUREMENT udkp2_w "Spannung DK-Poti 2" UWORD spg_uw_q0p001222 1 100 0 80.0838 FORMAT "%8.5" ECU_ADDRESS 0x5B927C /end MEASUREMENT
/begin MEASUREMENT udsu_w "Spannung Umgebungsdrucksensor (word 10-Bit von ADC)" UWORD spg_uw_b5 1 100 0 319.995 FORMAT "%8.4" ECU_ADDRESS 0x5B8814 /end MEASUREMENT
/begin MEASUREMENT ufgen "vom Generator empfangene Generatorsollspannung (Kopie gesendeter Wert)" UBYTE spg_ugen 1 100 10.6 36.1 FORMAT "%5.2" ECU_ADDRESS 0x5B882B /end MEASUREMENT
/begin MEASUREMENT ugenbegr "begrenzte Generatorsollspannung" UBYTE spg_ugen 1 100 10.6 36.1 FORMAT "%5.2" ECU_ADDRESS 0x5B882C /end MEASUREMENT
/begin MEASUREMENT uhfm_w "HFM-Spannung" UWORD spg_q0p00977 1 100 0 639.99 FORMAT "%8.4" ECU_ADDRESS 0x5B8816 /end MEASUREMENT
/begin MEASUREMENT uhsh "Spannung an der Heizerendstufe hinter Kat" UBYTE spg_ub_b5 1 100 0 4.98047 FORMAT "%5.3" ECU_ADDRESS 0x5B8EED /end MEASUREMENT
/begin MEASUREMENT uhsh2 "Spannung an der Heizerendstufe 2 hinter Kat" UBYTE spg_ub_b5 1 100 0 4.98047 FORMAT "%5.3" ECU_ADDRESS 0x5B8EEE /end MEASUREMENT
/begin MEASUREMENT uhsv "Spannung an der Heizerendstufe vor Kat" UBYTE spg_ub_b5 1 100 0 4.98047 FORMAT "%5.3" ECU_ADDRESS 0x5B8EEF /end MEASUREMENT
/begin MEASUREMENT uhsv2 "Spannung an der Heizerendstufe 2 vor Kat" UBYTE spg_ub_b5 1 100 0 4.98047 FORMAT "%5.3" ECU_ADDRESS 0x5B8EF0 /end MEASUREMENT
/begin MEASUREMENT upr1ms_w "Spannung Raildrucksensor im 1 ms Raster" UWORD spg_uw_q0p00488 1 100 0 319.995 FORMAT "%8.4" ECU_ADDRESS 0x5B96C0 /end MEASUREMENT
/begin MEASUREMENT upwg1_w "Spannung PWG-Poti 1 (Word)" UWORD spg_uw_q0p00488 1 100 0 319.995 FORMAT "%8.4" ECU_ADDRESS 0x5B927E /end MEASUREMENT
/begin MEASUREMENT upwg2_w "Spannung PWG-Poti 2 (Word)" UWORD spg_uw_q0p00488 1 100 0 319.995 FORMAT "%8.4" ECU_ADDRESS 0x5B9280 /end MEASUREMENT
/begin MEASUREMENT uthk "Spannung Abgastemperatursensor hinter Kat" UBYTE spg_ub_b5 1 100 0 4.98047 FORMAT "%5.3" ECU_ADDRESS 0x5B8EF1 /end MEASUREMENT
/begin MEASUREMENT uthk2 "Spannung Abgastemperatursensor hinter Kat Bank 2" UBYTE spg_ub_b5 1 100 0 4.98047 FORMAT "%5.3" ECU_ADDRESS 0x5B8EF2 /end MEASUREMENT
/begin MEASUREMENT uulsuv2_w "Sondenspannung vor Kat einer Breitbandlambdasonde Bank2 (ADC-Wert)" UWORD spg_uw_q0p00488 1 100 0 319.995 FORMAT "%8.4" ECU_ADDRESS 0x5B9292 /end MEASUREMENT
/begin MEASUREMENT uulsuv_w "Sondenspannung vor Kat einer Breitbandlambdasonde (ADC-Wert)" UWORD spg_uw_q0p00488 1 100 0 319.995 FORMAT "%8.4" ECU_ADDRESS 0x5B9294 /end MEASUREMENT
/begin MEASUREMENT uuptes_w "ADC-Spannung Pumpenstrom Tankdiagnose" UWORD spg_uw_b5 1 100 0 319.995 FORMAT "%8.4" ECU_ADDRESS 0x5B9282 /end MEASUREMENT
/begin MEASUREMENT uushk_w "ADC-Spannung Lambdasonde hinter Katalysator (Word)" UWORD spg_uw_q0p00488 1 100 0 319.995 FORMAT "%8.4" ECU_ADDRESS 0x5B96F4 /end MEASUREMENT
/begin MEASUREMENT uushk_w_1ms "" UWORD spg_uw_q0p00488 1 100 0 319.995 FORMAT "%8.4" ECU_ADDRESS 0x5B96F6 /end MEASUREMENT
/begin MEASUREMENT uusvk_w "ADC-Spannung Lambdasonde vor Katalysator (Word)" UWORD spg_uw_q0p00488 1 100 0 319.995 FORMAT "%8.4" ECU_ADDRESS 0x5B96F8 /end MEASUREMENT
/begin MEASUREMENT uusvk_w_1ms "" UWORD spg_uw_q0p00488 1 100 0 319.995 FORMAT "%8.4" ECU_ADDRESS 0x5B96FA /end MEASUREMENT
/begin MEASUREMENT vfzgf "" FLOAT32_IEEE fak_r32_1 1 100 0 65535 FORMAT "%43.37" ECU_ADDRESS 0x5B899C /end MEASUREMENT
/begin MEASUREMENT vroh_w "Fahrzeuggeschwindigkeit ungefiltert" UWORD vfzg_uw_b512 1 100 0 511.992 FORMAT "%8.4" ECU_ADDRESS 0x5B9720 /end MEASUREMENT
/begin MEASUREMENT vszwm "Mittelwert der ZW-Verstellung ¸ber VS2x" SBYTE zw_sb_q0p75 1 100 -96 95.25 FORMAT "%5.2" ECU_ADDRESS 0x5B8F24 /end MEASUREMENT
/begin MEASUREMENT wdkdlra_w "Alter Sollwert DK-Winkel in 12 Bit-Auflˆsung" UWORD relDK_q0p02441 1 100 0 1599.98 FORMAT "%8.3" ECU_ADDRESS 0x5B928E /end MEASUREMENT
/begin MEASUREMENT wdkdlr_w "Sollwert DK-Winkel in 12 Bit-Auflˆsung" UWORD relDK_q0p02441 1 100 0 1599.98 FORMAT "%8.3" ECU_ADDRESS 0x3FC082 /end MEASUREMENT
/begin MEASUREMENT wdksfi_w "aus wdks_w pr‰dizierter DK-Winkel" SWORD relDK_q0p02441 1 100 -800 799.976 FORMAT "%8.4" ECU_ADDRESS 0x5B9290 /end MEASUREMENT
/begin MEASUREMENT wkr "zylinderindividuelle Z¸ndwinkelsp‰tverstellung KR" UBYTE zw_ub_qn0p75 1 100 -191.25 0 FORMAT "%5.1" ARRAY_SIZE 8 ECU_ADDRESS 0x3FC048 /end MEASUREMENT
/begin MEASUREMENT wkra "last und drehzahlabh. Adaptionskennfeld f. wkr" UBYTE zw_ub_qn0p75 1 100 -191.25 0 FORMAT "%5.1" ARRAY_SIZE 168 ECU_ADDRESS 0x3FD704 /end MEASUREMENT
/begin MEASUREMENT wkratst "wkra mit Synchro-Raster rollierend" UBYTE zw_ub_qn0p75 1 100 -191.25 0 FORMAT "%5.1" ECU_ADDRESS 0x5B8F25 /end MEASUREMENT
/begin MEASUREMENT wkrksa "mittlere KR-Sp‰tverstellung aller Zylinder an Ersatzsensor A" UBYTE zw_ub_qn0p75 1 100 -191.25 0 FORMAT "%5.1" ECU_ADDRESS 0x5B8C97 /end MEASUREMENT
/begin MEASUREMENT wkrksb "mittlere KR-Sp‰tverstellung aller Zylinder an Ersatzsensor B" UBYTE zw_ub_qn0p75 1 100 -191.25 0 FORMAT "%5.1" ECU_ADDRESS 0x5B8C98 /end MEASUREMENT
/begin MEASUREMENT wkrm "Mittelwert der zylinderindividuellen ZW-Sp‰tverstellungen durch KR" UBYTE zw_ub_qn0p75 1 100 -191.25 0 FORMAT "%5.1" ECU_ADDRESS 0x3FC050 /end MEASUREMENT
/begin MEASUREMENT wkrma "Mittelwert der ZW-Sp‰tverstellungen KR, allgemein (im Notlauf mit Sicherheit)" UBYTE zw_ub_qn0p75 1 100 -191.25 0 FORMAT "%5.1" ECU_ADDRESS 0x3FC051 /end MEASUREMENT
/begin MEASUREMENT wkr_tst "zyl.ind. ZW-Sp‰tverstellung, rollierend" UBYTE zw_ub_qn0p75 1 100 -191.25 0 FORMAT "%5.1" ECU_ADDRESS 0x5B8F26 /end MEASUREMENT
/begin MEASUREMENT wtans "A/D-Wert f¸r Ansauglufttemperatur tans" UBYTE spg_ub_b5 1 100 0 4.98047 FORMAT "%5.3" ECU_ADDRESS 0x5B8EF3 /end MEASUREMENT
/begin MEASUREMENT wtka "A/D-Wert f¸r TKA (Temperatur K¸hlerausgang)" UBYTE spg_ub_b5 1 100 0 4.98047 FORMAT "%5.3" ECU_ADDRESS 0x5B8EF4 /end MEASUREMENT
/begin MEASUREMENT wtmot "A/D-Wert f¸r tmot" UBYTE spg_ub_b5 1 100 0 4.98047 FORMAT "%5.3" ECU_ADDRESS 0x5B8EF5 /end MEASUREMENT
/begin MEASUREMENT wtol "A/D-Wert f¸r (Motor-) Oeltemperatur" UBYTE spg_ub_b5 1 100 0 4.98047 FORMAT "%5.3" ECU_ADDRESS 0x5B8EF6 /end MEASUREMENT
/begin MEASUREMENT wtsg "Wert Temperatur Steuerger‰t" UBYTE spg_ub_b5 1 100 0 4.98047 FORMAT "%5.3" ECU_ADDRESS 0x5B8EF7 /end MEASUREMENT
/begin MEASUREMENT wub "Batteriespannung; vom AD-Wandler erfaﬂter Wert" UBYTE spg_ubatt 1 100 0 24.021 FORMAT "%5.2" ECU_ADDRESS 0x5B8812 /end MEASUREMENT
/begin MEASUREMENT zkrvf "Z‰hler, bestimmt die Frequenz der zyl.-individuellen Z¸ndwinkelfr¸hverstellung" UBYTE dez 1 100 0 255 FORMAT "%5.1" ARRAY_SIZE 8 ECU_ADDRESS 0x5B8F28 /end MEASUREMENT
/begin MEASUREMENT zzylzue "SW-Zylinderz‰hler f¸r Z¸ndungsberechnung" UBYTE dez 1 100 0 255 FORMAT "%5.1" ECU_ADDRESS 0x5B8EFF /end MEASUREMENT
/begin FUNCTION KRRA "Klopfregelung mit Adaption der zylinderindividuellen Sp‰tverstellung"
 /begin DEF_CHARACTERISTIC CW_KRRA DWEKSN DWKRMSN KRAL1N KRAL2N KRALH KRAN1 KRAN2 KRAN3 KRAN4 KRANH KRDWA KRDWKLA KRDWSA KRDWSN KRFKN KRLMDY KRMXN KRNMDY KRVFLN KRVFSLN LKRALL LKRN NFKRAS NKRF SENE1 SENE2 SENE3 SENE4 STKRLDY STKRNDY TMKR TMKRA VS100ZWKR /end DEF_CHARACTERISTIC
 /begin REF_CHARACTERISTIC KSZA SENZZYL S_ZNDRLP /end REF_CHARACTERISTIC
 /begin IN_MEASUREMENT B_clradkr B_kl B_krdws B_krldy B_krldya B_krndy B_ll B_pwf B_stend B_vl nmot rl rlp tmot tpnt_aktiv vszwkr zwkrafld zzylkr /end IN_MEASUREMENT
 /begin OUT_MEASUREMENT B_kr B_tmkr B_zwkraa dwkr dwkrz krfkw krvfakt lkrw stkrnx vszwm wkr wkra wkratst wkrm wkrma wkr_tst /end OUT_MEASUREMENT
 /begin LOC_MEASUREMENT B_kra B_kras B_ksa B_ksb B_lkrall B_wkral B_zwkrum dweksw dwkrmsw kral1w kral2w krdwsw krmxw krvfsw krvfw ksa ksb ksdefa ksdefb stkrlx wkrksa wkrksb zkrvf /end LOC_MEASUREMENT
/end FUNCTION
/begin FUNCTION KTM "KTM.      Kraftstofftemperaturmodell"
 /begin DEF_CHARACTERISTIC CWKTM KFKTM KFKTM2 KFTMOKOR KFZKTMTKR MKRSTFAK TABKOR TKAKOR TKRSTINT ZKTMTKA ZKTMTMOT ZKTMVFZLU /end DEF_CHARACTERISTIC
 /begin IN_MEASUREMENT B_nmot B_pwf B_st B_stend nmot tabgmab tabst_w taml tans tka tmot tnst_w tumg vfzg vsskrst /end IN_MEASUREMENT
 /begin OUT_MEASUREMENT B_ktm_ini tkrst tkrstab /end OUT_MEASUREMENT
 /begin LOC_MEASUREMENT tkakor_in tkrstluft tkrststart tkrstvt tkrstwand tkrstzu tptmot_out /end LOC_MEASUREMENT
/end FUNCTION
/begin FUNCTION KT_ADC "" /begin IN_MEASUREMENT B_adcc_um /end IN_MEASUREMENT
 /begin OUT_MEASUREMENT Disa_spg uddss_w udkp1v_w udkp1_w udkp2_w udsu_w uhfm_w uhsh uhsh2 uhsv uhsv2 upr1ms_w upwg1_w upwg2_w uthk uthk2 uuptes_w wtans wtka wtmot wtol wtsg wub /end OUT_MEASUREMENT
/end FUNCTION
/begin FUNCTION KT_DVE ""
 /begin DEF_CHARACTERISTIC CWDLRIKL DANTGESWNV DANTGESWV DANTSCHWNV DANTSCHWV DKLAGERT DLRDWDKSS1 DLRDWDKSS2 DLRHAFTMN DLRHAFTST DLRIAMAXA DLRIKLPAR DLRININI DLRKDONLP0 DLRKDUNLP0 DLRKDUNLP1 DLRKDUNLP2 DLRKDUNLP3 DLRKIONLP0 DLRKIUNLP0 DLRKIUNLP1 DLRKIUNLP2 DLRKIUNLP3 DLRKPONLP0 DLRKPUNLP0 DLRKPUNLP1 DLRKPUNLP2 DLRKPUNLP3 DLRKREIS DLRKREISST DLRNLPD DLRPID0T DLRPID1T DLRPID2T DLRPIDMAX DLRPIDMIN DLRUBSOLL DLRUMABAND DLRUMAIINI DVEEST DWDKSBAMX DWDKSIKLS KDLRIDDVE TDKLAGDE TDLRHAFTMX TDLRPIDC TPWRSV TWDKNL UDKNLPTOL WDKBEWS WDKNLPTOL WDKREIB WDKSAPNOL WDKSTFEIN WDKSTGROB ZKUBDLR ZKWDKSPT1 /end DEF_CHARACTERISTIC
 /begin IN_MEASUREMENT B_appnolu B_dcdisr B_dkaden B_dknolu B_dknot B_dkp1e B_dkp2e B_dkpiu B_dlrien B_ESrdy B_i_ska_um B_kl15 B_nmin B_nmot B_st B_wdk1v B_wdk2sel dwdks_w ES_sfmdk nmot ub ubrsq udknlp1 udknlp2 udkp1_w udkp2_w wdkada_w wdkba_w wdknlp_w wdks_w wped /end IN_MEASUREMENT
 /begin OUT_MEASUREMENT AS_dimdk B_dcdisfr B_dlrbe B_dlrparc B_dlrpide B_dlrspid B_dlrumzu B_dveese B_dvete B_nldve B_nlpne B_pwrsv B_ubdve B_ubpvg B_ub_ok B_wdksive dklagerc dlrhaftak dlrini_w dlrpidc dlrspid_w dpwrsvc dveesc /end OUT_MEASUREMENT
 /begin LOC_MEASUREMENT B_dkbew B_dlrikla B_dlriklst B_dveesh B_iklrest B_iklstar B_wdksauf dlrd dlri dlriamax dlriant_w dlrihaftc dlriklst_w dlrikl_w dlrkomp dlrndif_w dlrp dlrubrsq dwdkdlr_w gwdkdlr_w gwdk_kge twdknlc ubdedis ubdeen wdkdlra_w wdkdlr_w wdksfi_w /end LOC_MEASUREMENT
/end FUNCTION
/begin FUNCTION kt_dzku "Hardware-Interface f¸r DZKU-Funktion" /begin IN_MEASUREMENT B_dzack B_dzenable /end IN_MEASUREMENT /begin OUT_MEASUREMENT B_dzrts dzkflag ta_w tc_w ts_w /end OUT_MEASUREMENT /begin LOC_MEASUREMENT B_dzbuf B_dzen flags_w ignbuf ignchan /end LOC_MEASUREMENT /end FUNCTION
/begin FUNCTION KT_EAVNS "Komponententreiber EAVanos"
 /begin DEF_CHARACTERISTIC KLNWPOSN KLNWPOST NW0FLANKE NW1FLANKE NW2FLANKE NW3FLANKE NWSEGOFFS /end DEF_CHARACTERISTIC
 /begin IN_MEASUREMENT nmot synstate tmot tnwia_l tnwie_l wnwkwa_w wnwkwe_w zrph2_l zrph3_l zrph4_l zrph_l /end IN_MEASUREMENT
 /begin OUT_MEASUREMENT eavzrph2_l eavzrph3_l eavzrph4_l eavzrph_l nwpos_nkor nwpos_tkor /end OUT_MEASUREMENT
/end FUNCTION
/begin FUNCTION KT_EEP "" /begin DEF_CHARACTERISTIC TEEMRDYMAX /end DEF_CHARACTERISTIC /begin IN_MEASUREMENT B_nlEEPR /end IN_MEASUREMENT /begin OUT_MEASUREMENT B_eemrdy B_eemsav teemrdy /end OUT_MEASUREMENT /end FUNCTION
/begin FUNCTION KT_FADC "" /begin REF_CHARACTERISTIC MLHFM /end REF_CHARACTERISTIC /begin IN_MEASUREMENT mlhfma_w /end IN_MEASUREMENT /end FUNCTION
/begin FUNCTION KT_GEN "Komponententreiber f¸r den/die Generator/en an der BSD"
 /begin DEF_CHARACTERISTIC OUINIGEN QKORRDF QKORRLR S_RDGENTYP TGENIDLE UGENTYP UGMN UGMX /end DEF_CHARACTERISTIC
 /begin IN_MEASUREMENT address B_lroff tlrgen ugen /end IN_MEASUREMENT
 /begin OUT_MEASUREMENT B_genactiv B_genfbsd B_genfel B_genfht B_genfme dffgen genmanufak gentypkenn tlrfgen tvdfrfgen ufgen /end OUT_MEASUREMENT
 /begin LOC_MEASUREMENT chkbfgen lrfgen timelr ugenbegr /end LOC_MEASUREMENT
/end FUNCTION
/begin FUNCTION KT_GGLS "" /begin IN_MEASUREMENT B_priph B_pripv /end IN_MEASUREMENT /begin OUT_MEASUREMENT uulsuv2_w uulsuv_w uushk_w uushk_w_1ms uusvk_w uusvk_w_1ms /end OUT_MEASUREMENT /end FUNCTION
/begin FUNCTION KT_INJEC "Komponententreiber Einspritzung ME 9" /begin DEF_CHARACTERISTIC NINJO /end DEF_CHARACTERISTIC /begin REF_CHARACTERISTIC DTEMN /end REF_CHARACTERISTIC
 /begin IN_MEASUREMENT B_eculock B_esbnb B_esbst B_nmin B_stend nmot tez_l tvu_w wea wes wvesp zzyl /end IN_MEASUREMENT
 /begin OUT_MEASUREMENT anzti anzti_w injec_error_abb tesum_l /end OUT_MEASUREMENT
 /begin LOC_MEASUREMENT abbwevz /end LOC_MEASUREMENT
/end FUNCTION
/begin FUNCTION KT_KFT "" /begin DEF_CHARACTERISTIC TKWPERIOD /end DEF_CHARACTERISTIC /begin IN_MEASUREMENT tkwpwm /end IN_MEASUREMENT /end FUNCTION
/begin FUNCTION KT_MLS "" /begin IN_MEASUREMENT fqml taml /end IN_MEASUREMENT /end FUNCTION
/begin FUNCTION KT_PORTSOFF "" /end FUNCTION
/begin FUNCTION KT_TEV "" /begin IN_MEASUREMENT B_bttev B_tevet B_tevtstp tateout tevper /end IN_MEASUREMENT /begin OUT_MEASUREMENT B_tevtini /end OUT_MEASUREMENT /end FUNCTION
/begin FUNCTION KT_TOENS "Komponententreiber ÷lniveausensor"
 /begin DEF_CHARACTERISTIC TOGVERZOEG TOG_TK_MAX TOG_TK_MIN TOG_TR_MAX TOG_TR_MIN TOG_TV_MAX TOG_TV_MIN TOG_VERS /end DEF_CHARACTERISTIC
 /begin OUT_MEASUREMENT B_tkerr B_toel B_tog B_togerr B_togok B_togupl B_trerr B_tverr Tog_cnt Tog_icnt Tog_pwmst Tog_st Tog_state Tog_tk Tog_tr Tog_tv Tog_uplcnt /end OUT_MEASUREMENT
/end FUNCTION
/begin FUNCTION KT_VFZG "" /begin DEF_CHARACTERISTIC AIMV /end DEF_CHARACTERISTIC /begin OUT_MEASUREMENT vroh_w /end OUT_MEASUREMENT /end FUNCTION
/begin FUNCTION KT_ZUEN "Komponententreiber Z¸ndung Masterfunktion f¸r ME9"
 /begin IN_MEASUREMENT B_ff B_llrein B_nmin ffzanz ffztld_w ffztof_w flgstign_w szout_w zwoutar zzyl /end IN_MEASUREMENT
 /begin OUT_MEASUREMENT ignFadeStatBits ignfdostat ignFdReqStat ignStpStat kt_zuen_fdOutPattern_u8 kt_zuen_fdPatArray_u8 kt_zuen_fdReq_u16 kt_zuen_lastzkvek kt_zuen_lastzzyl kt_zuen_zkvek zzylzue /end OUT_MEASUREMENT
/end FUNCTION
/begin FUNCTION KVA "Ausgangssignal: Kraftstoff-Verbrauchs-Anzeige" /begin DEF_CHARACTERISTIC FKVAUM /end DEF_CHARACTERISTIC /begin REF_CHARACTERISTIC FRLFSDP KLKRKTE /end REF_CHARACTERISTIC /begin IN_MEASUREMENT B_eemrdy B_eepwf dps_w rkte_w rk_w tesum_l /end IN_MEASUREMENT /begin OUT_MEASUREMENT fkvaum_ee kvarest kvaverbr kva_korr te_ges /end OUT_MEASUREMENT /end FUNCTION
/begin FUNCTION LAKH "Lambda-Koordination bei Katheizen"
 /begin DEF_CHARACTERISTIC CWLAKH IMLLASKH KFLANSKH KFLASKH KFLMSKHKST KFLMSKHMAG KFLMSKHSLP KLLAKHFH LASDSLA LASTMOT LMSTMOT TFWLMKHKST TMSTLMS ZFLASKH /end DEF_CHARACTERISTIC
 /begin IN_MEASUREMENT anztib_w B_dsla B_fasla B_fs B_kh B_nstabk B_sls fho_w flakh flamsl_w flmssl fmsldyn fslpdyn imlpr ml_w nmot_w rl_w tmot tmst /end IN_MEASUREMENT
 /begin OUT_MEASUREMENT B_lamkhe lamkh2_w lamkh_w /end OUT_MEASUREMENT
 /begin LOC_MEASUREMENT B_dslafa flaskh flmsslkh fslsdyn fwlmkhkst LAKHlokBits_10ms lamkhg_w lamkhr_w lanskh_w lasdslg_w lasdsl_w laskh_w lmskh_w lmssl_w /end LOC_MEASUREMENT
/end FUNCTION
/begin FUNCTION LAMBTS "Lambda Bauteileschutz"
 /begin DEF_CHARACTERISTIC CWLAMBTS DLBTS DTBTS ETADZW FBSTABGM KFFDLBTS KFLBTS KFZWOBTS KLBTSVL KLZWBSVL TABGBTS TKATBTS ZDLBTS /end DEF_CHARACTERISTIC
 /begin REF_CHARACTERISTIC SNM16GKUB SNM16OPUW SRL12GKUB SRL16OPUW /end REF_CHARACTERISTIC
 /begin IN_MEASUREMENT B_dash B_gsaf B_vl esst_snm16gkub esst_snm16opuw esst_srl12gkub esst_srl16opuw etazwist nmot nmot_w rl rl_w_kge tabgm_w tkatm_w zwgru zwist zwopt /end IN_MEASUREMENT
 /begin OUT_MEASUREMENT lambts_w /end OUT_MEASUREMENT
 /begin LOC_MEASUREMENT B_fbstabgm B_tabgbts B_tkatbts detazwbs dlambts_w dzwg dzwibts etazwg etazwibts etazwim lbts_w /end LOC_MEASUREMENT
/end FUNCTION
/begin FUNCTION LAMFAW "Lambda Fahrerwunsch" /begin DEF_CHARACTERISTIC KFLAMFA LAMFAVL TLAFA TMVL /end DEF_CHARACTERISTIC /begin IN_MEASUREMENT B_vl nmot rl tmot /end IN_MEASUREMENT /begin OUT_MEASUREMENT B_vla lamfa_w /end OUT_MEASUREMENT /end FUNCTION
/begin FUNCTION LAMKO "Lambdakoordination"
 /begin DEF_CHARACTERISTIC CWLAMKH LAMFLGSL LAMLGFTM LAMLGMTM LAMSOSOF LAMSOSUF LASOAB /end DEF_CHARACTERISTIC
 /begin REF_CHARACTERISTIC STM12ESUB /end REF_CHARACTERISTIC
 /begin IN_MEASUREMENT B_bevab B_dsla B_falsh B_fasla B_kh B_lamdkt B_lamkhe B_lamlash B_lamnse B_sls B_slsfz esst_stm12esub flamkh flamsl_w imlatm lambts_w lamdkt_w lamelsh_w lamfa_w lamka_w lamkh_w lamlash_w lamnswl_w tmot /end IN_MEASUREMENT
 /begin OUT_MEASUREMENT B_lalgf B_lamka B_lamsdef lambas lamsbg_w lamsons_w lamvoa_w /end OUT_MEASUREMENT
 /begin LOC_MEASUREMENT B_lambts B_lamkh B_lamnswl B_ldef lamkhe_w lamlgfmn lamlgm lamsos_w lamsubg_w lams_w /end LOC_MEASUREMENT
/end FUNCTION
/begin FUNCTION LBATTCAL "LBATTCAL. Berechnung Batterieladespannung"
 /begin DEF_CHARACTERISTIC APPTBATINI BATTHTAUVG BATTHTAUVK BATTORT0 BATTORT2 BATTVTAUVG BATTVTAUVK BATT_ALFAH BATT_ALFAV BATT_BETAV BATVFZGTAU CWBATTCOD DTANSKOR ILMINUMG KLBATTLSTR KLEXPALH KLEXPALV KLEXPBETAV LADEKENNL LBATTMAX LBATTMIN MCOBATTORT NMINUMG OFTUMGCAN OFULADE PLBATTUMG TBATINIMAN TBATTFTAUV TBATTTAUFH TUMGINI TUMGTAU UBATTNORM ULADE_TAU VMINUMG /end DEF_CHARACTERISTIC
 /begin IN_MEASUREMENT B_etum B_pwf B_taerr B_tns B_tumers imlatm nmot tabst_w tans tumgcan vfzg /end IN_MEASUREMENT
 /begin OUT_MEASUREMENT battort batt_tfil cobattort ctrgenutar tbatstiniv tbatt tumgbattab tumg_ers t_battabst t_batt_ini t_umgabst /end OUT_MEASUREMENT
 /begin LOC_MEASUREMENT batto_a batto_a1 batto_b batto_c batto_c1 batto_c2 batto_c3 batto_c4 batto_c6 batto_c7 batt_a1 batt_a2 batt_c10 batt_c11 batt_c12 batt_c13 batt_c14 batt_c8 batt_c9 batt_d1 batt_e1 batt_e2 batt_e3 batt_e4 batt_e5 batt_e6 batt_w0 B_inibumg dbetalf_t dbet_alf dt_tumg end_init tabst_fl tansf tbatinmanf tumgbatold tumgcanf tumgtemp t_umgabstf vfzgf /end LOC_MEASUREMENT
/end FUNCTION
/begin FUNCTION LDSTGEN "LDSTGEN.  Berechnung Lastzustand Generator"
 /begin DEF_CHARACTERISTIC DFMODE DFS_MAX DFS_MIN DFS_MITT GENLDDFMAX KLGENLDST TNNSTART /end DEF_CHARACTERISTIC
 /begin IN_MEASUREMENT B_genfprl B_genoff B_noctrgen B_pwf B_sta B_stend dffgen gentemp nmot_w /end IN_MEASUREMENT
 /begin OUT_MEASUREMENT dfmonitor dfsumme dfwanzahl nnstart st_ldstgen /end OUT_MEASUREMENT
 /begin LOC_MEASUREMENT dffgenflo /end LOC_MEASUREMENT
/end FUNCTION
/begin FUNCTION LLRABG "Leerlaufregelung-Solldrehzahl Korrektur mit Tester"
 /begin DEF_CHARACTERISTIC NFSACVMN NFSACVMX NFSMVMN NFSMVMX NLLMVMN NLLMVMX NSACMVMN NSACMVMX NSLBVMN NSLBVMX TMLLRNS TMNV TMNVFS /end DEF_CHARACTERISTIC
 /begin IN_MEASUREMENT B_eepdif B_ll tmot /end IN_MEASUREMENT
 /begin OUT_MEASUREMENT B_nsabg dnfsacmv dnfsmv dnllmv dnsacmv dnslbv /end OUT_MEASUREMENT
/end FUNCTION
/begin FUNCTION LLRANH "LLRANH.   Leerlauf-Anhebung" /begin DEF_CHARACTERISTIC B_APP_LLAH GENLLAHAPP NSUBO NSUBU /end DEF_CHARACTERISTIC /begin IN_MEASUREMENT B_fs B_ll nsllm n_idlgspec vfzg /end IN_MEASUREMENT /begin OUT_MEASUREMENT B_idlgspec B_nsub nslb /end OUT_MEASUREMENT /end FUNCTION
/begin FUNCTION LLRBB "Leerlaufregelung Betriebsbedingungen"
 /begin DEF_CHARACTERISTIC CNFKUPPL DNLLR TVDK TVKUPPL TVLLRI TVLLRIT TVLLRPD TVLLRPDT VLLR /end DEF_CHARACTERISTIC
 /begin IN_MEASUREMENT B_dash B_fil B_fs B_gd B_kuppl B_ll B_mdein B_nmot B_sa B_sab B_stend dmllri_w dn gangi mill_w mistt nmot nmotll nstat tmot vfzg /end IN_MEASUREMENT
 /begin OUT_MEASUREMENT B_llr B_llrein B_llri B_llrpd B_vllr /end OUT_MEASUREMENT
/end FUNCTION
/begin FUNCTION LLRMR "Momentenreserve Leerlaufregelung"
 /begin DEF_CHARACTERISTIC CWLLRMR DMRESFS DMRESLL DMRESLW DNLLRES KFMRES KFMRESFS KFMRESFST KFMREST MRESFSM MRESLLM MRESTEV TDMRESLL TVLLRMRTEV TVRESFS TVRESLL /end DEF_CHARACTERISTIC
 /begin REF_CHARACTERISTIC SNS06LLSB STA04SAUB STM04SAUB /end REF_CHARACTERISTIC
 /begin IN_MEASUREMENT B_dtebn B_fs B_ll B_nswo1 B_stend dmrac dmrkrll dns dpsfak esst_sns06llsb esst_sta04saub esst_stm04saub lws_w tans tmot /end IN_MEASUREMENT
 /begin OUT_MEASUREMENT dmdresdtev dmdresfs dmlllmn_w dmrllr_w /end OUT_MEASUREMENT
/end FUNCTION
/begin FUNCTION LLRNS "Leerlaufregelung-Solldrehzahl"
 /begin DEF_CHARACTERISTIC DNSNFX FNSNF FNSNFT FNSSTM FNSSTMT FWVFZG KNSNF KNSNFT MINHUBTDNS NFHZ NFHZFS NFSM NFSMHZ NGNSNF NLLM NLLMHZ NSAC NSACFS NSFSHLS NSFSR NSHLS NSKAT NSLPP NSLPPFS NSMNEGS NSMNGD NSMNGDFS NSMNTD NSMNTDFS NSNOT NSNOT1 NSNOT1FS NSNOTFS NSOELH NSOELHFS NTEB NTEBFS SNS06LLSB SNS06LLTSB ZKNS ZNSM ZNSMT ZNSUB /end DEF_CHARACTERISTIC
 /begin REF_CHARACTERISTIC STM06LLTUB STM06LLUB /end REF_CHARACTERISTIC
 /begin IN_MEASUREMENT B_autget B_dknolu B_dkpu B_egscok B_fakat B_falls B_fhz B_fs B_gd B_gdvhub B_hkwnll B_HLSKW B_hz B_kuppl B_ll B_llrein B_lltd B_nac B_nftev B_nnot B_nsub B_nswo1 B_oelh B_pn B_stend dnfsacmv dnfsmv dnllmv dnsacmv dnslbv dpsfak esst_stm06lltub esst_stm06llub gangauti minhub_w nfskh ngfil nllkh nmotll nslb nsolfa psl stvfzg tmot vfzgv1_w vsns /end IN_MEASUREMENT
 /begin OUT_MEASUREMENT B_fallsa B_lltdff B_nivns dns esst_sns06llsb esst_sns06lltsb llsstat nsfsm nsllm nsol nsol_w nsst nstat /end OUT_MEASUREMENT
 /begin LOC_MEASUREMENT nsfsmn nslbz nsllmn nsnf /end LOC_MEASUREMENT
/end FUNCTION
/begin FUNCTION LLRRM "Leerlaufregelung Reglereingriff Drehmoment"
 /begin DEF_CHARACTERISTIC DMLLRIMXN DMLLRMN DMLLRMXN DMLLRZMN DMLLRZMXN DNMNI DVNG DVNGV DVZNG DVZNGT DVZNGV DVZNGVT FDDN FDDZN FDDZNT IVDN IVDNT IVDNTV IVDNV LIMN LIMNDLLR LIMNDTES LIMNV LIMX LIMXV LISTM LISTMT LLRICNF NDSU PVDN PVDNT PVDNTV PVDNV PVDNVZ PVDNVZT PVDNZ PVDNZT SDN08LLSW SDN08LLTSW TVLISTUM TVLISTUMT ZKLLRD ZKLLRDZ ZLIBG /end DEF_CHARACTERISTIC
 /begin REF_CHARACTERISTIC SNG06LLSB SNG06LLTSB SNM06LLUB SNS06LLSB SNS06LLTSB STM06LLTUB STM06LLUB /end REF_CHARACTERISTIC
 /begin IN_MEASUREMENT B_dllr B_dtes B_gd B_llr B_llrein B_llri B_llrpd B_mdmin B_nswo1 B_st B_stend B_vllr dns dpsfak esst_sng06llsb esst_sng06lltsb esst_snm06llub esst_sns06llsb esst_sns06lltsb esst_stm06lltub esst_stm06llub ngfil nmot nmot_w nsol tmot /end IN_MEASUREMENT
 /begin OUT_MEASUREMENT dmllri_w dmllrz_w dmllr_w dn dn_w esst_sdn08llsw esst_sdn08lltsw limax_w limin_w /end OUT_MEASUREMENT
 /begin LOC_MEASUREMENT B_llrimx dmllrdz_w dmllrd_w dmllrpz_w dmllrp_w limnst /end LOC_MEASUREMENT
/end FUNCTION
/begin FUNCTION LOADRESP "LOADRESP. BMW Funktion"
 /begin DEF_CHARACTERISTIC ENAPPLGOFF ENAPPLRESP FHOGNMN KFLORESP KFZLRESOF KFZLRRESOFV KLLORESPM LRESPAPP NMXGENOF RLMXGENOF S_LORESLL TABSTGNMN TABSTGNMX TATMGENOF TGENOFVL TLORESPST TMOTABGNMN TUMGGNMN TUMGGNMX TVLOFHYST VGENOFMN VGENOGMX VZLORESOFV /end DEF_CHARACTERISTIC
 /begin IN_MEASUREMENT B_genoffmd B_ll B_llrein B_stend B_vl fho kmstand nmot rl tabst_w tkatm tmot tmotab tmst tumg vfzg /end IN_MEASUREMENT
 /begin OUT_MEASUREMENT B_genoffst B_genoffvl tlrgen tlrgen2 /end OUT_MEASUREMENT
 /begin LOC_MEASUREMENT loadresp /end LOC_MEASUREMENT
/end FUNCTION
/begin FUNCTION LR "Lambdaregelung"
 /begin DEF_CHARACTERISTIC CFRA DFRMN DFRSPS FFRITMS FLRFKATE FLRM FRIPDSL1 FRIPDSL4 FRIPDTES FRIPTES FRMAX FRMINSLS FRMINSLSK FRTEMX KFFRMIN KFRI KFRI2 KFRP KFRP2 KFRTV KFRTV2 QUFRMN QUFRMX TSPERN TSPERN2 USR ZDFR ZLRFRI /end DEF_CHARACTERISTIC
 /begin REF_CHARACTERISTIC SNM07LRUB SRL06LRUB /end REF_CHARACTERISTIC
 /begin IN_MEASUREMENT B_atmtpa B_dktlp B_dsl1 B_dsl4 B_dslme B_dtefrr B_dtes B_dtest B_fasls B_frini B_ll B_lrnd B_pwf B_te B_tehbx dtvka esst_snm07lrub esst_srl06lrub falrdkt fkatei frini_w nmot rl tmot tmst tnst_w tvlrh tvlrhi usvk /end IN_MEASUREMENT
 /begin OUT_MEASUREMENT B_dfrf B_dfrf2 B_dfrm B_dfrm2 B_frab B_frab2 B_frmax B_frmax2 B_frmin B_frmin2 B_lrsp B_lrsp2 B_lrstat B_lrstat2 B_lrstta B_lrstta2 B_lrtpp B_lrtpp2 B_sgnlr B_sgnlr2 dfrsp2_w dfrsp_w dfrst2_w dfrst_w fr2_w frm2_w frmn2_w frmn_w frmx2_w frmx_w frm_w fr_w tfrn_w tplrvk2_w tplrvk_w /end OUT_MEASUREMENT
 /begin LOC_MEASUREMENT B_frmini B_frsp B_inifrm B_int B_sgnalt B_sgnra B_tsper B_tspon dfrstga_w dfrstte_w ffri ffrip_w frband_w fri friband_w friint frint_w frp frpint frsp_w frtv lrfrmz lrfrz tfrnint_w tfrpint_w tfrp_w tsperr tv tvlr /end LOC_MEASUREMENT
/end FUNCTION
/begin COMPU_METHOD aimv_ul_b4p608e11 "" RAT_FUNC "%13.0" "-" COEFFS 0 0 460800000000 0 1 0 /end COMPU_METHOD
/begin COMPU_METHOD B_TRUE "boolsche Zust‰nde, positive Logik" TAB_VERB "%6.3" "" COMPU_TAB_REF B_TRUE /end COMPU_METHOD
/begin COMPU_VTAB B_TRUE "boolsche Zust‰nde, positive Logik" TAB_VERB 2 0 "----" 1 "TRUE" /end COMPU_VTAB
/begin COMPU_METHOD DEZ "1 : 1 Umrechnug (dez/hex)" RAT_FUNC "%6.2" "" COEFFS 0 1 0 0 0 1 /end COMPU_METHOD
/begin COMPU_METHOD dez "1 : 1 Umrechnug (dez/hex)" RAT_FUNC "%6.2" "" COEFFS 0 1 0 0 0 1 /end COMPU_METHOD
/begin COMPU_METHOD dezsub1 "" RAT_FUNC "%6.2" "-" COEFFS 0 1 -1 0 0 1 /end COMPU_METHOD
/begin COMPU_METHOD fak_q0p000244 "" RAT_FUNC "%6.5" "-" COEFFS 0 65536 0 0 0 16 /end COMPU_METHOD
/begin COMPU_METHOD fak_q0p00273 "" RAT_FUNC "%6.4" "-" COEFFS 0 256 0 0 0 0.7 /end COMPU_METHOD
/begin COMPU_METHOD fak_r32_1 "" RAT_FUNC "%43.21" "-" COEFFS 0 1 0 0 0 1 /end COMPU_METHOD
/begin COMPU_METHOD fak_sb_b1 "" RAT_FUNC "%6.4" "-" COEFFS 0 256 0 0 0 2 /end COMPU_METHOD
/begin COMPU_METHOD fak_sw_b1 "" RAT_FUNC "%7.6" "-" COEFFS 0 65536 0 0 0 2 /end COMPU_METHOD
/begin COMPU_METHOD fak_sw_b8 "" RAT_FUNC "%6.5" "-" COEFFS 0 65536 0 0 0 16 /end COMPU_METHOD
/begin COMPU_METHOD fak_ub_b0p5 "" RAT_FUNC "%6.4" "-" COEFFS 0 256 0 0 0 0.5 /end COMPU_METHOD
/begin COMPU_METHOD fak_ub_b1 "" RAT_FUNC "%6.4" "-" COEFFS 0 256 0 0 0 1 /end COMPU_METHOD
/begin COMPU_METHOD fak_ub_b12p45 "" RAT_FUNC "%6.4" "%" COEFFS 0 2048 0 0 0 100 /end COMPU_METHOD
/begin COMPU_METHOD fak_ub_b2 "" RAT_FUNC "%6.4" "-" COEFFS 0 256 0 0 0 2 /end COMPU_METHOD
/begin COMPU_METHOD fak_ub_b4 "" RAT_FUNC "%6.4" "-" COEFFS 0 256 0 0 0 4 /end COMPU_METHOD
/begin COMPU_METHOD fak_ub_b77p81 "" RAT_FUNC "%6.3" "%/s" COEFFS 0 327.68 0 0 0 100 /end COMPU_METHOD
/begin COMPU_METHOD fak_uw_b1 "" RAT_FUNC "%7.6" "-" COEFFS 0 65536 0 0 0 1 /end COMPU_METHOD
/begin COMPU_METHOD fak_uw_b16 "" RAT_FUNC "%6.5" "-" COEFFS 0 65536 0 0 0 16 /end COMPU_METHOD
/begin COMPU_METHOD fak_uw_b2 "" RAT_FUNC "%7.6" "-" COEFFS 0 65536 0 0 0 2 /end COMPU_METHOD
/begin COMPU_METHOD fak_uw_b4 "" RAT_FUNC "%7.6" "-" COEFFS 0 65536 0 0 0 4 /end COMPU_METHOD
/begin COMPU_METHOD fak_uw_b8 "" RAT_FUNC "%6.5" "-" COEFFS 0 65536 0 0 0 8 /end COMPU_METHOD
/begin COMPU_METHOD fuel_ub_q1 "" RAT_FUNC "%6.2" "l" COEFFS 0 1 0 0 0 1 /end COMPU_METHOD
/begin COMPU_METHOD fuel_uw_b1 "" RAT_FUNC "%7.6" "ul" COEFFS 0 65536 0 0 0 1 /end COMPU_METHOD
/begin COMPU_METHOD fuel_uw_b65535 "" RAT_FUNC "%6.2" "ul" COEFFS 0 1 0 0 0 1 /end COMPU_METHOD
/begin COMPU_METHOD hub_uw_q0p001 "" RAT_FUNC "%6.5" "mm" COEFFS 0 1000 0 0 0 1 /end COMPU_METHOD
/begin COMPU_METHOD km_uw_q10 "" RAT_FUNC "%6.1" "km" COEFFS 0 1 0 0 0 10 /end COMPU_METHOD
/begin COMPU_METHOD kw_q1 "" RAT_FUNC "%6.2" "Grad KW" COEFFS 0 1 0 0 0 1 /end COMPU_METHOD
/begin COMPU_METHOD lws_q0p04375 "" RAT_FUNC "%6.4" "Grad" COEFFS 0 1 0 0 0 0.04375 /end COMPU_METHOD
/begin COMPU_METHOD m_ub_b23p3 "" RAT_FUNC "%6.3" "kg" COEFFS 0 2812.5 0 0 0 256 /end COMPU_METHOD
/begin COMPU_METHOD m_uw_b6553p5 "" RAT_FUNC "%6.3" "kg/h" COEFFS 0 1 0 0 0 0.1 /end COMPU_METHOD
/begin COMPU_METHOD nmotd_sb_q10 "" RAT_FUNC "%6.1" "1/min" COEFFS 0 1 0 0 0 10 /end COMPU_METHOD
/begin COMPU_METHOD nmotd_sw_q0p25 "" RAT_FUNC "%6.3" "1/min" COEFFS 0 1 0 0 0 0.25 /end COMPU_METHOD
/begin COMPU_METHOD nmotg_sb_q100 "" RAT_FUNC "%6.0" "1/min/s" COEFFS 0 1 0 0 0 100 /end COMPU_METHOD
/begin COMPU_METHOD nmotg_ub_q100 "" RAT_FUNC "%6.0" "1/min/s" COEFFS 0 1 0 0 0 100 /end COMPU_METHOD
/begin COMPU_METHOD nmot_ub_q10 "" RAT_FUNC "%6.1" "1/min" COEFFS 0 1 0 0 0 10 /end COMPU_METHOD
/begin COMPU_METHOD nmot_ub_q40 "" RAT_FUNC "%6.1" "1/min" COEFFS 0 1 0 0 0 40 /end COMPU_METHOD
/begin COMPU_METHOD nmot_uw_q0p25 "" RAT_FUNC "%6.3" "1/min" COEFFS 0 1 0 0 0 0.25 /end COMPU_METHOD
/begin COMPU_METHOD PCENT "Prozent" RAT_FUNC "%6.3" "%" COEFFS 0 256 0 0 0 100 /end COMPU_METHOD
/begin COMPU_METHOD relDK_q0p00152 "" RAT_FUNC "%6.4" "%DK" COEFFS 0 65536 0 0 0 100 /end COMPU_METHOD
/begin COMPU_METHOD relDK_q0p02441 "" RAT_FUNC "%6.4" "%DK" COEFFS 0 65536 0 0 0 1600 /end COMPU_METHOD
/begin COMPU_METHOD relDK_q0p0625 "" RAT_FUNC "%6.4" "%PWM/%DK" COEFFS 0 16 0 0 0 1 /end COMPU_METHOD
/begin COMPU_METHOD relDK_q0p1957 "" RAT_FUNC "%6.3" "%DK" COEFFS 0 511 0 0 0 100 /end COMPU_METHOD
/begin COMPU_METHOD relDK_q1 "" RAT_FUNC "%6.2" "%PWM/%DK" COEFFS 0 1 0 0 0 1 /end COMPU_METHOD
/begin COMPU_METHOD relDK_q4 "" RAT_FUNC "%6.2" "%" COEFFS 0 1 0 0 0 4 /end COMPU_METHOD
/begin COMPU_METHOD relDK_uw_b100 "" RAT_FUNC "%6.4" "%DK" COEFFS 0 65535 0 0 0 100 /end COMPU_METHOD
/begin COMPU_METHOD relgrad_20ms_qn0p019 "" RAT_FUNC "%6.5" "%/s" COEFFS 0 -1 0 0 0 0.019 /end COMPU_METHOD
/begin COMPU_METHOD rel_q0p09726 "" RAT_FUNC "%6.3" "%" COEFFS 0 255 0 0 0 24.9 /end COMPU_METHOD
/begin COMPU_METHOD rel_q0p1957 "" RAT_FUNC "%6.3" "%" COEFFS 0 511 0 0 0 100 /end COMPU_METHOD
/begin COMPU_METHOD rel_sb_q0p0976 "" RAT_FUNC "%6.3" "%" COEFFS 0 1 0 0 0 0.097647 /end COMPU_METHOD
/begin COMPU_METHOD rel_sw_b100 "" RAT_FUNC "%6.4" "%" COEFFS 0 32768 0 0 0 100 /end COMPU_METHOD
/begin COMPU_METHOD rel_sw_q0p1953 "" RAT_FUNC "%6.3" "%" COEFFS 0 65536 0 0 0 12800 /end COMPU_METHOD
/begin COMPU_METHOD rel_ub_b0p78 "" RAT_FUNC "%6.4" "%" COEFFS 0 256 0 0 0 0.78125 /end COMPU_METHOD
/begin COMPU_METHOD rel_ub_b100 "" RAT_FUNC "%6.3" "%" COEFFS 0 255 0 0 0 100 /end COMPU_METHOD
/begin COMPU_METHOD rel_ub_b127p5 "" RAT_FUNC "%6.3" "%" COEFFS 0 2 0 0 0 1 /end COMPU_METHOD
/begin COMPU_METHOD rel_ub_b1p0 "" RAT_FUNC "%6.4" "%" COEFFS 0 256 0 0 0 1 /end COMPU_METHOD
/begin COMPU_METHOD rel_ub_b24p9 "" RAT_FUNC "%6.3" "%" COEFFS 0 255 0 0 0 24.9 /end COMPU_METHOD
/begin COMPU_METHOD rel_ub_b31 "" RAT_FUNC "%6.2" "%" COEFFS 0 31 0 0 0 100 /end COMPU_METHOD
/begin COMPU_METHOD rel_ub_b99p6 "" RAT_FUNC "%6.3" "%" COEFFS 0 256 0 0 0 100 /end COMPU_METHOD
/begin COMPU_METHOD rel_ub_bn0p125 "" RAT_FUNC "%8.7" "%" COEFFS 0 -256 0 0 0 0.125 /end COMPU_METHOD
/begin COMPU_METHOD rel_ub_bn24p9 "" RAT_FUNC "%6.5" "%" COEFFS 0 -255 0 0 0 24.9 /end COMPU_METHOD
/begin COMPU_METHOD rel_ub_q0p75 "" RAT_FUNC "%6.3" "%" COEFFS 0 1 0 0 0 0.75 /end COMPU_METHOD
/begin COMPU_METHOD rel_uw_b100 "" RAT_FUNC "%6.4" "%" COEFFS 0 65536 0 0 0 100 /end COMPU_METHOD
/begin COMPU_METHOD rel_uw_q0p001 "" RAT_FUNC "%6.5" "%" COEFFS 0 1000 0 0 0 1 /end COMPU_METHOD
/begin COMPU_METHOD rel_uw_q0p0234 "" RAT_FUNC "%6.4" "%" COEFFS 0 32 0 0 0 0.75 /end COMPU_METHOD
/begin COMPU_METHOD spg_gencan "" RAT_FUNC "%6.2" "V" COEFFS 0 40 -424 0 0 1 /end COMPU_METHOD
/begin COMPU_METHOD spg_q0p00977 "" RAT_FUNC "%6.4" "V" COEFFS 0 256 0 0 0 2.5 /end COMPU_METHOD
/begin COMPU_METHOD spg_q0p1 "" RAT_FUNC "%6.3" "V" COEFFS 0 1 0 0 0 0.1 /end COMPU_METHOD
/begin COMPU_METHOD spg_ubatt "" RAT_FUNC "%6.3" "V" COEFFS 0 1 0 0 0 0.0942 /end COMPU_METHOD
/begin COMPU_METHOD spg_ub_b5 "" RAT_FUNC "%6.4" "V" COEFFS 0 256 0 0 0 5 /end COMPU_METHOD
/begin COMPU_METHOD spg_ub_q0p0052_o0p2 "" RAT_FUNC "%6.3" "V" COEFFS 0 255 51 0 0 1.33 /end COMPU_METHOD
/begin COMPU_METHOD spg_ugen "" RAT_FUNC "%6.2" "V" COEFFS 0 10 -106 0 0 1 /end COMPU_METHOD
/begin COMPU_METHOD spg_uw_b5 "" RAT_FUNC "%6.4" "V" COEFFS 0 1024 0 0 0 5 /end COMPU_METHOD
/begin COMPU_METHOD spg_uw_q0p001222 "" RAT_FUNC "%6.4" "V" COEFFS 0 1 0 0 0 0.001222 /end COMPU_METHOD
/begin COMPU_METHOD spg_uw_q0p00488 "" RAT_FUNC "%6.4" "V" COEFFS 0 1024 0 0 0 5 /end COMPU_METHOD
/begin COMPU_METHOD sprzi_q0p1 "" RAT_FUNC "%4.2" "Grad KW" COEFFS 0 10 0 0 0 1 /end COMPU_METHOD
/begin COMPU_METHOD sprzi_q0p1o12p8 "" RAT_FUNC "%6.5" "Grad KW" COEFFS 0 10 128 0 0 1 /end COMPU_METHOD
/begin COMPU_METHOD t100msxs_ub_b25p5 "" RAT_FUNC "%6.3" "s" COEFFS 0 1 0 0 0 0.1 /end COMPU_METHOD
/begin COMPU_METHOD t100msxs_uw_b6553p5 "" RAT_FUNC "%6.3" "s" COEFFS 0 1 0 0 0 0.1 /end COMPU_METHOD
/begin COMPU_METHOD t10msxs_sb_q0p01 "" RAT_FUNC "%6.4" "s" COEFFS 0 1 0 0 0 0.01 /end COMPU_METHOD
/begin COMPU_METHOD t10msxs_ub_b2p55 "" RAT_FUNC "%6.4" "s" COEFFS 0 1 0 0 0 0.01 /end COMPU_METHOD
/begin COMPU_METHOD t10msxs_uw_b655p35 "" RAT_FUNC "%6.4" "s" COEFFS 0 1 0 0 0 0.01 /end COMPU_METHOD
/begin COMPU_METHOD t1sxs_ub_q1 "" RAT_FUNC "%6.2" "s" COEFFS 0 1 0 0 0 1 /end COMPU_METHOD
/begin COMPU_METHOD t1sxs_uw_q1 "" RAT_FUNC "%6.2" "s" COEFFS 0 1 0 0 0 1 /end COMPU_METHOD
/begin COMPU_METHOD t200msxs_ub_b51 "" RAT_FUNC "%6.3" "s" COEFFS 0 1 0 0 0 0.2 /end COMPU_METHOD
/begin COMPU_METHOD t20msxs_ub_b5p1 "" RAT_FUNC "%6.4" "s" COEFFS 0 1 0 0 0 0.02 /end COMPU_METHOD
/begin COMPU_METHOD t3p2usxms_uw_b209p7 "" RAT_FUNC "%6.4" "ms" COEFFS 0 65536 0 0 0 209.751 /end COMPU_METHOD
/begin COMPU_METHOD t50msxs_q0p05 "" RAT_FUNC "%6.4" "s" COEFFS 0 1 0 0 0 0.05 /end COMPU_METHOD
/begin COMPU_METHOD tefuel_uw_b312p5 "" RAT_FUNC "%6.4" "ul/ms" COEFFS 0 65535 0 0 0 312.5 /end COMPU_METHOD
/begin COMPU_METHOD temp_q1 "" RAT_FUNC "%6.2" "Grad C" COEFFS 0 1 0 0 0 1 /end COMPU_METHOD
/begin COMPU_METHOD temp_sb_q0p75 "" RAT_FUNC "%6.3" "Grad C" COEFFS 0 1 0 0 0 0.75 /end COMPU_METHOD
/begin COMPU_METHOD temp_sb_q1p5 "" RAT_FUNC "%6.2" "Grad C" COEFFS 0 1 0 0 0 1.5 /end COMPU_METHOD
/begin COMPU_METHOD temp_sw_q0p75 "" RAT_FUNC "%6.3" "Grad C" COEFFS 0 4 0 0 0 3 /end COMPU_METHOD
/begin COMPU_METHOD temp_ub_q0p75_o48 "" RAT_FUNC "%6.2" "Grad C" COEFFS 0 1 48 0 0 0.75 /end COMPU_METHOD
/begin COMPU_METHOD temp_ub_q5_o50 "" RAT_FUNC "%6.2" "Grad C" COEFFS 0 1 50 0 0 5 /end COMPU_METHOD
/begin COMPU_METHOD temp_uw_q0p0195 "" RAT_FUNC "%6.4" "Grad C" COEFFS 0 256 0 0 0 5 /end COMPU_METHOD
/begin COMPU_METHOD temp_uw_q0p0195_o50 "" RAT_FUNC "%6.2" "Grad C" COEFFS 0 256 12800 0 0 5 /end COMPU_METHOD
/begin COMPU_METHOD temp_uw_q0p75_o48 "" RAT_FUNC "%6.2" "Grad C" COEFFS 0 1 48 0 0 0.75 /end COMPU_METHOD
/begin COMPU_METHOD tlr_q3 "" RAT_FUNC "%6.2" "s" COEFFS 0 1 0 0 0 3 /end COMPU_METHOD
/begin COMPU_METHOD txms_uw_q0p001 "" RAT_FUNC "%6.5" "ms" COEFFS 0 1000 0 0 0 1 /end COMPU_METHOD
/begin COMPU_METHOD t_q0p1ms "" RAT_FUNC "%6.3" "ms" COEFFS 0 10 0 0 0 1 /end COMPU_METHOD
/begin COMPU_METHOD vfzg_ub_q1p25 "" RAT_FUNC "%6.2" "km/h" COEFFS 0 1 0 0 0 1.25 /end COMPU_METHOD
/begin COMPU_METHOD vfzg_uw_b512 "" RAT_FUNC "%6.4" "km/h" COEFFS 0 65536 0 0 0 512 /end COMPU_METHOD
/begin COMPU_METHOD zk100msxs_ub_b25p5 "" RAT_FUNC "%6.3" "s" COEFFS 0 0 256 0 10 0 /end COMPU_METHOD
/begin COMPU_METHOD zk100msxs_uw_b655 "" RAT_FUNC "%6.1" "s" COEFFS 0 0 65536 0 10 0 /end COMPU_METHOD
/begin COMPU_METHOD zk100msxs_uw_b6553 "" RAT_FUNC "%10.3" "s" COEFFS 0 0 65536 0 10 0 /end COMPU_METHOD
/begin COMPU_METHOD zk200msxs_ub_b51p2 "" RAT_FUNC "%6.3" "s" COEFFS 0 0 51.2 0 1 0 /end COMPU_METHOD
/begin COMPU_METHOD zk20msxs_ub_b5p1 "" RAT_FUNC "%6.4" "s" COEFFS 0 0 5.1 0 1 0 /end COMPU_METHOD
/begin COMPU_METHOD zk20msxs_uw_b1310 "" RAT_FUNC "%6.1" "s" COEFFS 0 0 1310 0 1 0 /end COMPU_METHOD
/begin COMPU_METHOD zw_sb_q0p75 "" RAT_FUNC "%6.3" "Grad KW" COEFFS 0 255 0 0 0 191.25 /end COMPU_METHOD
/begin COMPU_METHOD zw_sb_qn0p75 "" RAT_FUNC "%6.4" "Grad KW" COEFFS 0 1 0 0 0 -0.75 /end COMPU_METHOD
/begin COMPU_METHOD zw_ub_q0p75 "" RAT_FUNC "%6.3" "Grad KW" COEFFS 0 255 0 0 0 191.25 /end COMPU_METHOD
/begin COMPU_METHOD zw_ub_qn0p75 "" RAT_FUNC "%6.4" "Grad KW" COEFFS 0 1 0 0 0 -0.75 /end COMPU_METHOD
/begin COMPU_METHOD default "" RAT_FUNC "%6.2" "" COEFFS 0 1 0 0 0 1 /end COMPU_METHOD
/begin RECORD_LAYOUT FklWUb FNC_VALUES 1 UBYTE COLUMN_DIR DIRECT /end RECORD_LAYOUT
/begin RECORD_LAYOUT GkfWSb FNC_VALUES 1 SBYTE COLUMN_DIR DIRECT /end RECORD_LAYOUT
/begin RECORD_LAYOUT GkfWUb FNC_VALUES 1 UBYTE COLUMN_DIR DIRECT /end RECORD_LAYOUT
/begin RECORD_LAYOUT GklWSb FNC_VALUES 1 SBYTE COLUMN_DIR DIRECT /end RECORD_LAYOUT
/begin RECORD_LAYOUT GklWUb FNC_VALUES 1 UBYTE COLUMN_DIR DIRECT /end RECORD_LAYOUT
/begin RECORD_LAYOUT KfAxU8AyU8SstxU16SstyU16WU16 NO_AXIS_PTS_X 1 UWORD NO_AXIS_PTS_Y 2 UWORD AXIS_PTS_X 3 UWORD INDEX_INCR DIRECT AXIS_PTS_Y 4 UWORD INDEX_INCR DIRECT FNC_VALUES 5 UWORD COLUMN_DIR DIRECT /end RECORD_LAYOUT
/begin RECORD_LAYOUT KfAxU8AyU8SstxU8SstyU16WU8 NO_AXIS_PTS_X 1 UBYTE NO_AXIS_PTS_Y 2 UBYTE AXIS_PTS_X 3 UBYTE INDEX_INCR DIRECT AXIS_PTS_Y 4 UWORD INDEX_INCR DIRECT FNC_VALUES 5 UBYTE COLUMN_DIR DIRECT /end RECORD_LAYOUT
/begin RECORD_LAYOUT KfAxU8AyU8SstxU8SstyU8WU8 NO_AXIS_PTS_X 1 UBYTE NO_AXIS_PTS_Y 2 UBYTE AXIS_PTS_X 3 UBYTE INDEX_INCR DIRECT AXIS_PTS_Y 4 UBYTE INDEX_INCR DIRECT FNC_VALUES 5 UBYTE COLUMN_DIR DIRECT /end RECORD_LAYOUT
/begin RECORD_LAYOUT KfAxUbAyUbSstxUbSstyUbWUb NO_AXIS_PTS_X 1 UBYTE NO_AXIS_PTS_Y 2 UBYTE AXIS_PTS_X 3 UBYTE INDEX_INCR DIRECT AXIS_PTS_Y 4 UBYTE INDEX_INCR DIRECT FNC_VALUES 5 UBYTE COLUMN_DIR DIRECT /end RECORD_LAYOUT
/begin RECORD_LAYOUT KfAxUbAyUbSstxUbSstyUwWUw NO_AXIS_PTS_X 1 UBYTE NO_AXIS_PTS_Y 2 UBYTE AXIS_PTS_X 3 UBYTE INDEX_INCR DIRECT AXIS_PTS_Y 4 UWORD INDEX_INCR DIRECT FNC_VALUES 5 UWORD COLUMN_DIR DIRECT /end RECORD_LAYOUT
/begin RECORD_LAYOUT KfAxUwAyUwSstxUwSstyUwWUw NO_AXIS_PTS_X 1 UWORD NO_AXIS_PTS_Y 2 UWORD AXIS_PTS_X 3 UWORD INDEX_INCR DIRECT AXIS_PTS_Y 4 UWORD INDEX_INCR DIRECT FNC_VALUES 5 UWORD COLUMN_DIR DIRECT /end RECORD_LAYOUT
/begin RECORD_LAYOUT KlAUbSstSbWUb NO_AXIS_PTS_X 1 UBYTE AXIS_PTS_X 2 SBYTE INDEX_INCR DIRECT FNC_VALUES 3 UBYTE COLUMN_DIR DIRECT /end RECORD_LAYOUT
/begin RECORD_LAYOUT KlAUbSstUbWSb NO_AXIS_PTS_X 1 UBYTE AXIS_PTS_X 2 UBYTE INDEX_INCR DIRECT FNC_VALUES 3 SBYTE COLUMN_DIR DIRECT /end RECORD_LAYOUT
/begin RECORD_LAYOUT KlAUbSstUbWUb NO_AXIS_PTS_X 1 UBYTE AXIS_PTS_X 2 UBYTE INDEX_INCR DIRECT FNC_VALUES 3 UBYTE COLUMN_DIR DIRECT /end RECORD_LAYOUT
/begin RECORD_LAYOUT KlAUwSstSwWUw NO_AXIS_PTS_X 1 UWORD AXIS_PTS_X 2 SWORD INDEX_INCR DIRECT FNC_VALUES 3 UWORD COLUMN_DIR DIRECT /end RECORD_LAYOUT
/begin RECORD_LAYOUT KlAUwSstUwWUw NO_AXIS_PTS_X 1 UWORD AXIS_PTS_X 2 UWORD INDEX_INCR DIRECT FNC_VALUES 3 UWORD COLUMN_DIR DIRECT /end RECORD_LAYOUT
/begin RECORD_LAYOUT KlAxU8SstxR32WR32 NO_AXIS_PTS_X 1 ULONG AXIS_PTS_X 2 FLOAT32_IEEE INDEX_INCR DIRECT FNC_VALUES 3 FLOAT32_IEEE COLUMN_DIR DIRECT /end RECORD_LAYOUT
/begin RECORD_LAYOUT KlAxU8SstxS16WS16 NO_AXIS_PTS_X 1 SWORD AXIS_PTS_X 2 SWORD INDEX_INCR DIRECT FNC_VALUES 3 SWORD COLUMN_DIR DIRECT /end RECORD_LAYOUT
/begin RECORD_LAYOUT KlAxU8SstxU16WU16 NO_AXIS_PTS_X 1 UWORD AXIS_PTS_X 2 UWORD INDEX_INCR DIRECT FNC_VALUES 3 UWORD COLUMN_DIR DIRECT /end RECORD_LAYOUT
/begin RECORD_LAYOUT KlAxU8SstxU8WU8 NO_AXIS_PTS_X 1 UBYTE AXIS_PTS_X 2 UBYTE INDEX_INCR DIRECT FNC_VALUES 3 UBYTE COLUMN_DIR DIRECT /end RECORD_LAYOUT
/begin RECORD_LAYOUT KwbUb FNC_VALUES 1 UBYTE COLUMN_DIR DIRECT /end RECORD_LAYOUT
/begin RECORD_LAYOUT KwbUw FNC_VALUES 1 UWORD COLUMN_DIR DIRECT /end RECORD_LAYOUT
/begin RECORD_LAYOUT KwbWS8 FNC_VALUES 1 SBYTE COLUMN_DIR DIRECT /end RECORD_LAYOUT
/begin RECORD_LAYOUT KwSb FNC_VALUES 1 SBYTE COLUMN_DIR DIRECT /end RECORD_LAYOUT
/begin RECORD_LAYOUT KwSw FNC_VALUES 1 SWORD COLUMN_DIR DIRECT /end RECORD_LAYOUT
/begin RECORD_LAYOUT KwUb FNC_VALUES 1 UBYTE COLUMN_DIR DIRECT /end RECORD_LAYOUT
/begin RECORD_LAYOUT KwUw FNC_VALUES 1 UWORD COLUMN_DIR DIRECT /end RECORD_LAYOUT
/begin RECORD_LAYOUT KwWR32 FNC_VALUES 1 FLOAT32_IEEE COLUMN_DIR DIRECT /end RECORD_LAYOUT
/begin RECORD_LAYOUT KwWS16 FNC_VALUES 1 SWORD COLUMN_DIR DIRECT /end RECORD_LAYOUT
/begin RECORD_LAYOUT KwWS8 FNC_VALUES 1 SBYTE COLUMN_DIR DIRECT /end RECORD_LAYOUT
/begin RECORD_LAYOUT KwWU16 FNC_VALUES 1 UWORD COLUMN_DIR DIRECT /end RECORD_LAYOUT
/begin RECORD_LAYOUT KwWU32 FNC_VALUES 1 ULONG COLUMN_DIR DIRECT /end RECORD_LAYOUT
/begin RECORD_LAYOUT KwWU8 FNC_VALUES 1 UBYTE COLUMN_DIR DIRECT /end RECORD_LAYOUT
/begin RECORD_LAYOUT SstASwSstSw NO_AXIS_PTS_X 1 SWORD AXIS_PTS_X 2 SWORD INDEX_INCR DIRECT /end RECORD_LAYOUT
/begin RECORD_LAYOUT SstAUbSstSb NO_AXIS_PTS_X 1 UBYTE AXIS_PTS_X 2 SBYTE INDEX_INCR DIRECT /end RECORD_LAYOUT
/begin RECORD_LAYOUT SstAUbSstUb NO_AXIS_PTS_X 1 UBYTE AXIS_PTS_X 2 UBYTE INDEX_INCR DIRECT /end RECORD_LAYOUT
/begin RECORD_LAYOUT SstAUwSstUw NO_AXIS_PTS_X 1 UWORD AXIS_PTS_X 2 UWORD INDEX_INCR DIRECT /end RECORD_LAYOUT
/end MODULE
/end PROJECT
