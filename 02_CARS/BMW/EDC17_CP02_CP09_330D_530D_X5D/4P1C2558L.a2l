ASAP2_VERSION 1 4
/begin PROJECT P_558 "EDC17_CP02"
/begin HEADER "" VERSION "V1C1" PROJECT_NO P_558 /end HEADER
/begin MODULE DIM ""
/begin MOD_COMMON "" BYTE_ORDER MSB_LAST ALIGNMENT_BYTE 1 ALIGNMENT_WORD 2 ALIGNMENT_LONG 4 ALIGNMENT_FLOAT32_IEEE 4 /end MOD_COMMON
/begin CHARACTERISTIC Com_dTestMsg_C "" VALUE 0x8004D75C Val_Wu16 65535.00 OneToOne 0.00 65535.00 FORMAT "%8.2" /end CHARACTERISTIC
/begin CHARACTERISTIC Com_dTestSig_C "" VALUE 0x8004D75E Val_Wu16 65535.00 OneToOne 0.00 65535.00 FORMAT "%8.2" /end CHARACTERISTIC
/begin CHARACTERISTIC Com_stTxEvent_C "" VALUE 0x8004D760 Val_Wu16 65535.00 OneToOne 0.00 65535.00 FORMAT "%8.2" /end CHARACTERISTIC
/begin CHARACTERISTIC Com_swtEngineRpm_C "" VALUE 0x8004D762 Val_Wu8 1.000 OneToOne 0.00 1.000 FORMAT "%5.3" EXTENDED_LIMITS 0.00 255.0 /end CHARACTERISTIC
/begin CHARACTERISTIC Com_swtEngine_C "" VALUE 0x8004D763 Val_Wu8 1.000 OneToOne 0.00 1.000 FORMAT "%5.3" EXTENDED_LIMITS 0.00 255.0 /end CHARACTERISTIC
/begin CHARACTERISTIC Com_swtHeatFlowEngine_C "" VALUE 0x8004D764 Val_Wu8 1.000 OneToOne 0.00 1.000 FORMAT "%5.3" EXTENDED_LIMITS 0.00 255.0 /end CHARACTERISTIC
/begin CHARACTERISTIC Com_swtMileageRange_C "" VALUE 0x8004BA16 Val_Wu8 1.000 OneToOne 0.00 1.000 FORMAT "%5.3" EXTENDED_LIMITS 0.00 255.0 /end CHARACTERISTIC
/begin CHARACTERISTIC Com_swtStatusMSA_C "" VALUE 0x8004D765 Val_Wu8 1.000 OneToOne 0.00 1.000 FORMAT "%5.3" EXTENDED_LIMITS 0.00 255.0 /end CHARACTERISTIC
/begin CHARACTERISTIC Com_swtStKombi_C "" VALUE 0x8004BA17 Val_Wu8 1.000 OneToOne 0.00 1.000 FORMAT "%5.3" EXTENDED_LIMITS 0.00 255.0 /end CHARACTERISTIC
/begin CHARACTERISTIC Com_swtTempRelTime_C "" VALUE 0x8004BA18 Val_Wu8 1.000 OneToOne 0.00 1.000 FORMAT "%5.3" EXTENDED_LIMITS 0.00 255.0 /end CHARACTERISTIC
/begin CHARACTERISTIC Com_swtTest_C "" VALUE 0x8004D766 Val_Wu8 1.000 OneToOne 0.00 1.000 FORMAT "%5.3" EXTENDED_LIMITS 0.00 255.0 /end CHARACTERISTIC
/begin CHARACTERISTIC Com_swtTimeDate_C "" VALUE 0x8004BA19 Val_Wu8 1.000 OneToOne 0.00 1.000 FORMAT "%5.3" EXTENDED_LIMITS 0.00 255.0 /end CHARACTERISTIC
/begin CHARACTERISTIC Com_swtTorque1_C "" VALUE 0x8004D767 Val_Wu8 1.000 OneToOne 0.00 1.000 FORMAT "%5.3" EXTENDED_LIMITS 0.00 255.0 /end CHARACTERISTIC
/begin CHARACTERISTIC Com_swtTorque2_C "" VALUE 0x8004D768 Val_Wu8 1.000 OneToOne 0.00 1.000 FORMAT "%5.3" EXTENDED_LIMITS 0.00 255.0 /end CHARACTERISTIC
/begin CHARACTERISTIC Com_swtTorque3_C "" VALUE 0x8004D769 Val_Wu8 1.000 OneToOne 0.00 1.000 FORMAT "%5.3" EXTENDED_LIMITS 0.00 255.0 /end CHARACTERISTIC
/begin CHARACTERISTIC DSCHED_AsgnCheck.FId_InhibitAlways_C "/" VALUE 0x800791A6 Val_Wu16 576. DFC_Verb 0.00 576. FORMAT "%2.0" /end CHARACTERISTIC
/begin CHARACTERISTIC DSCHED_AsgnCheck.FId_CoordALS_C "/" VALUE 0x800791A8 Val_Wu16 576. DFC_Verb 0.00 576. FORMAT "%2.0" /end CHARACTERISTIC
/begin CHARACTERISTIC DSCHED_AsgnCheck.FId_CoordFBC_C "/" VALUE 0x800791AA Val_Wu16 576. DFC_Verb 0.00 576. FORMAT "%2.0" /end CHARACTERISTIC
/begin CHARACTERISTIC DSCHED_AsgnCheck.FId_CoordTAA_C "/" VALUE 0x800791AC Val_Wu16 576. DFC_Verb 0.00 576. FORMAT "%2.0" /end CHARACTERISTIC
/begin CHARACTERISTIC DSCHED_AsgnCheck.FId_CoordZFC_C "/" VALUE 0x800791AE Val_Wu16 576. DFC_Verb 0.00 576. FORMAT "%2.0" /end CHARACTERISTIC
/begin CHARACTERISTIC DSCHED_BsPrio.FId_InhibitAlways_C "/" VALUE 0x800791B0 Val_Wu16 65535.00 DFC_OneToOne 0.00 65535.00 FORMAT "%8.2" /end CHARACTERISTIC
/begin CHARACTERISTIC DSCHED_BsPrio.FId_CoordALS_C "/" VALUE 0x800791B2 Val_Wu16 65535.00 DFC_OneToOne 0.00 65535.00 FORMAT "%8.2" /end CHARACTERISTIC
/begin CHARACTERISTIC DSCHED_BsPrio.FId_CoordFBC_C "/" VALUE 0x800791B4 Val_Wu16 65535.00 DFC_OneToOne 0.00 65535.00 FORMAT "%8.2" /end CHARACTERISTIC
/begin CHARACTERISTIC DSCHED_BsPrio.FId_CoordTAA_C "/" VALUE 0x800791B6 Val_Wu16 65535.00 DFC_OneToOne 0.00 65535.00 FORMAT "%8.2" /end CHARACTERISTIC
/begin CHARACTERISTIC DSCHED_BsPrio.FId_CoordZFC_C "/" VALUE 0x800791B8 Val_Wu16 65535.00 DFC_OneToOne 0.00 65535.00 FORMAT "%8.2" /end CHARACTERISTIC
/begin CHARACTERISTIC DSCHED_DrvModeMsk.FId_InhibitAlways_C "/" VALUE 0x800791BA Val_Wu16 65535.00 DFC_OneToOne 0.00 65535.00 FORMAT "%8.2" /end CHARACTERISTIC
/begin CHARACTERISTIC DSCHED_DrvModeMsk.FId_CoordALS_C "/" VALUE 0x800791BC Val_Wu16 65535.00 DFC_OneToOne 0.00 65535.00 FORMAT "%8.2" /end CHARACTERISTIC
/begin CHARACTERISTIC DSCHED_DrvModeMsk.FId_CoordFBC_C "/" VALUE 0x800791BE Val_Wu16 65535.00 DFC_OneToOne 0.00 65535.00 FORMAT "%8.2" /end CHARACTERISTIC
/begin CHARACTERISTIC DSCHED_DrvModeMsk.FId_CoordTAA_C "/" VALUE 0x800791C0 Val_Wu16 65535.00 DFC_OneToOne 0.00 65535.00 FORMAT "%8.2" /end CHARACTERISTIC
/begin CHARACTERISTIC DSCHED_DrvModeMsk.FId_CoordZFC_C "/" VALUE 0x800791C2 Val_Wu16 65535.00 DFC_OneToOne 0.00 65535.00 FORMAT "%8.2" /end CHARACTERISTIC
/begin CHARACTERISTIC DSCHED_Excl.FId_InhibitAlways_CA "/" VAL_BLK 0x800791C4 ValA_Wu16 5. DSCHED_FIdExcVerb 0.00 5. FORMAT "%2.0" NUMBER 6 /end CHARACTERISTIC
/begin CHARACTERISTIC DSCHED_Excl.FId_CoordALS_CA "/" VAL_BLK 0x800791D0 ValA_Wu16 5. DSCHED_FIdExcVerb 0.00 5. FORMAT "%2.0" NUMBER 6 /end CHARACTERISTIC
/begin CHARACTERISTIC DSCHED_Excl.FId_CoordFBC_CA "/" VAL_BLK 0x800791DC ValA_Wu16 5. DSCHED_FIdExcVerb 0.00 5. FORMAT "%2.0" NUMBER 6 /end CHARACTERISTIC
/begin CHARACTERISTIC DSCHED_Excl.FId_CoordTAA_CA "/" VAL_BLK 0x800791E8 ValA_Wu16 5. DSCHED_FIdExcVerb 0.00 5. FORMAT "%2.0" NUMBER 6 /end CHARACTERISTIC
/begin CHARACTERISTIC DSCHED_Excl.FId_CoordZFC_CA "/" VAL_BLK 0x800791F4 ValA_Wu16 5. DSCHED_FIdExcVerb 0.00 5. FORMAT "%2.0" NUMBER 6 /end CHARACTERISTIC
/begin CHARACTERISTIC DSCHED_FacPhys.FId_InhibitAlways_C "/" VALUE 0x80079200 Val_Wu8 255.0000 DFC_OneToOne 0.00 255.0000 FORMAT "%8.4" /end CHARACTERISTIC
/begin CHARACTERISTIC DSCHED_FacPhys.FId_CoordALS_C "/" VALUE 0x80079201 Val_Wu8 255.0000 DFC_OneToOne 0.00 255.0000 FORMAT "%8.4" /end CHARACTERISTIC
/begin CHARACTERISTIC DSCHED_FacPhys.FId_CoordFBC_C "/" VALUE 0x80079202 Val_Wu8 255.0000 DFC_OneToOne 0.00 255.0000 FORMAT "%8.4" /end CHARACTERISTIC
/begin CHARACTERISTIC DSCHED_FacPhys.FId_CoordTAA_C "/" VALUE 0x80079203 Val_Wu8 255.0000 DFC_OneToOne 0.00 255.0000 FORMAT "%8.4" /end CHARACTERISTIC
/begin CHARACTERISTIC DSCHED_FacPhys.FId_CoordZFC_C "/" VALUE 0x80079204 Val_Wu8 255.0000 DFC_OneToOne 0.00 255.0000 FORMAT "%8.4" /end CHARACTERISTIC
/begin CHARACTERISTIC DSCHED_JmpActvPrio.FId_InhibitAlways_C "/" VALUE 0x80079206 Val_Wu16 65535.00 DFC_OneToOne 0.00 65535.00 FORMAT "%8.2" /end CHARACTERISTIC
/begin CHARACTERISTIC DSCHED_JmpActvPrio.FId_CoordALS_C "/" VALUE 0x80079208 Val_Wu16 65535.00 DFC_OneToOne 0.00 65535.00 FORMAT "%8.2" /end CHARACTERISTIC
/begin CHARACTERISTIC DSCHED_JmpActvPrio.FId_CoordFBC_C "/" VALUE 0x8007920A Val_Wu16 65535.00 DFC_OneToOne 0.00 65535.00 FORMAT "%8.2" /end CHARACTERISTIC
/begin CHARACTERISTIC DSCHED_JmpActvPrio.FId_CoordTAA_C "/" VALUE 0x8007920C Val_Wu16 65535.00 DFC_OneToOne 0.00 65535.00 FORMAT "%8.2" /end CHARACTERISTIC
/begin CHARACTERISTIC DSCHED_JmpActvPrio.FId_CoordZFC_C "/" VALUE 0x8007920E Val_Wu16 65535.00 DFC_OneToOne 0.00 65535.00 FORMAT "%8.2" /end CHARACTERISTIC
/begin CHARACTERISTIC DSCHED_OpModeMsk.FId_InhibitAlways_C "/" VALUE 0x80079210 Val_Wu16 65535.00 DFC_OneToOne 0.00 65535.00 FORMAT "%8.2" /end CHARACTERISTIC
/begin CHARACTERISTIC DSCHED_OpModeMsk.FId_CoordALS_C "/" VALUE 0x80079212 Val_Wu16 65535.00 DFC_OneToOne 0.00 65535.00 FORMAT "%8.2" /end CHARACTERISTIC
/begin CHARACTERISTIC DSCHED_OpModeMsk.FId_CoordFBC_C "/" VALUE 0x80079214 Val_Wu16 65535.00 DFC_OneToOne 0.00 65535.00 FORMAT "%8.2" /end CHARACTERISTIC
/begin CHARACTERISTIC DSCHED_OpModeMsk.FId_CoordTAA_C "/" VALUE 0x80079216 Val_Wu16 65535.00 DFC_OneToOne 0.00 65535.00 FORMAT "%8.2" /end CHARACTERISTIC
/begin CHARACTERISTIC DSCHED_OpModeMsk.FId_CoordZFC_C "/" VALUE 0x80079218 Val_Wu16 65535.00 DFC_OneToOne 0.00 65535.00 FORMAT "%8.2" /end CHARACTERISTIC
/begin CHARACTERISTIC DSCHED_RmpIniPrio.FId_InhibitAlways_C "/" VALUE 0x8007921A Val_Wu16 65535.00 DFC_OneToOne 0.00 65535.00 FORMAT "%8.2" /end CHARACTERISTIC
/begin CHARACTERISTIC DSCHED_RmpIniPrio.FId_CoordALS_C "/" VALUE 0x8007921C Val_Wu16 65535.00 DFC_OneToOne 0.00 65535.00 FORMAT "%8.2" /end CHARACTERISTIC
/begin CHARACTERISTIC DSCHED_RmpIniPrio.FId_CoordFBC_C "/" VALUE 0x8007921E Val_Wu16 65535.00 DFC_OneToOne 0.00 65535.00 FORMAT "%8.2" /end CHARACTERISTIC
/begin CHARACTERISTIC DSCHED_RmpIniPrio.FId_CoordTAA_C "/" VALUE 0x80079220 Val_Wu16 65535.00 DFC_OneToOne 0.00 65535.00 FORMAT "%8.2" /end CHARACTERISTIC
/begin CHARACTERISTIC DSCHED_RmpIniPrio.FId_CoordZFC_C "/" VALUE 0x80079222 Val_Wu16 65535.00 DFC_OneToOne 0.00 65535.00 FORMAT "%8.2" /end CHARACTERISTIC
/begin CHARACTERISTIC DSCHED_RmpSlpActv.FId_InhibitAlways_C "/" VALUE 0x80079224 Val_Wu16 327675.0 DSCHED_RmpSlp 0.00 327675.0 FORMAT "%8.1" /end CHARACTERISTIC
/begin CHARACTERISTIC DSCHED_RmpSlpActv.FId_CoordALS_C "/" VALUE 0x80079226 Val_Wu16 327675.0 DSCHED_RmpSlp 0.00 327675.0 FORMAT "%8.1" /end CHARACTERISTIC
/begin CHARACTERISTIC DSCHED_RmpSlpActv.FId_CoordFBC_C "/" VALUE 0x80079228 Val_Wu16 327675.0 DSCHED_RmpSlp 0.00 327675.0 FORMAT "%8.1" /end CHARACTERISTIC
/begin CHARACTERISTIC DSCHED_RmpSlpActv.FId_CoordTAA_C "/" VALUE 0x8007922A Val_Wu16 327675.0 DSCHED_RmpSlp 0.00 327675.0 FORMAT "%8.1" /end CHARACTERISTIC
/begin CHARACTERISTIC DSCHED_RmpSlpActv.FId_CoordZFC_C "/" VALUE 0x8007922C Val_Wu16 327675.0 DSCHED_RmpSlp 0.00 327675.0 FORMAT "%8.1" /end CHARACTERISTIC
/begin CHARACTERISTIC DSCHED_RmpSlpPas.FId_InhibitAlways_C "/" VALUE 0x8007922E Val_Wu16 327675.0 DSCHED_RmpSlp 0.00 327675.0 FORMAT "%8.1" /end CHARACTERISTIC
/begin CHARACTERISTIC DSCHED_RmpSlpPas.FId_CoordALS_C "/" VALUE 0x80079230 Val_Wu16 327675.0 DSCHED_RmpSlp 0.00 327675.0 FORMAT "%8.1" /end CHARACTERISTIC
/begin CHARACTERISTIC DSCHED_RmpSlpPas.FId_CoordFBC_C "/" VALUE 0x80079232 Val_Wu16 327675.0 DSCHED_RmpSlp 0.00 327675.0 FORMAT "%8.1" /end CHARACTERISTIC
/begin CHARACTERISTIC DSCHED_RmpSlpPas.FId_CoordTAA_C "/" VALUE 0x80079234 Val_Wu16 327675.0 DSCHED_RmpSlp 0.00 327675.0 FORMAT "%8.1" /end CHARACTERISTIC
/begin CHARACTERISTIC DSCHED_RmpSlpPas.FId_CoordZFC_C "/" VALUE 0x80079236 Val_Wu16 327675.0 DSCHED_RmpSlp 0.00 327675.0 FORMAT "%8.1" /end CHARACTERISTIC
/begin CHARACTERISTIC DSCHED_RmpUpLim.FId_InhibitAlways_C "/" VALUE 0x80079238 Val_Wu16 65535.00 DFC_OneToOne 0.00 65535.00 FORMAT "%8.2" /end CHARACTERISTIC
/begin CHARACTERISTIC DSCHED_RmpUpLim.FId_CoordALS_C "/" VALUE 0x8007923A Val_Wu16 65535.00 DFC_OneToOne 0.00 65535.00 FORMAT "%8.2" /end CHARACTERISTIC
/begin CHARACTERISTIC DSCHED_RmpUpLim.FId_CoordFBC_C "/" VALUE 0x8007923C Val_Wu16 65535.00 DFC_OneToOne 0.00 65535.00 FORMAT "%8.2" /end CHARACTERISTIC
/begin CHARACTERISTIC DSCHED_RmpUpLim.FId_CoordTAA_C "/" VALUE 0x8007923E Val_Wu16 65535.00 DFC_OneToOne 0.00 65535.00 FORMAT "%8.2" /end CHARACTERISTIC
/begin CHARACTERISTIC DSCHED_RmpUpLim.FId_CoordZFC_C "/" VALUE 0x80079240 Val_Wu16 65535.00 DFC_OneToOne 0.00 65535.00 FORMAT "%8.2" /end CHARACTERISTIC
/begin CHARACTERISTIC DSCHED_SetPointRateActv.FId_InhibitAlways_C "/" VALUE 0x80079242 Val_Wu16 13107.00 DSCHED_Time200ms 0.00 13107.00 FORMAT "%8.2" /end CHARACTERISTIC
/begin CHARACTERISTIC DSCHED_SetPointRateActv.FId_CoordALS_C "/" VALUE 0x80079244 Val_Wu16 13107.00 DSCHED_Time200ms 0.00 13107.00 FORMAT "%8.2" /end CHARACTERISTIC
/begin CHARACTERISTIC DSCHED_SetPointRateActv.FId_CoordFBC_C "/" VALUE 0x80079246 Val_Wu16 13107.00 DSCHED_Time200ms 0.00 13107.00 FORMAT "%8.2" /end CHARACTERISTIC
/begin CHARACTERISTIC DSCHED_SetPointRateActv.FId_CoordTAA_C "/" VALUE 0x80079248 Val_Wu16 13107.00 DSCHED_Time200ms 0.00 13107.00 FORMAT "%8.2" /end CHARACTERISTIC
/begin CHARACTERISTIC DSCHED_SetPointRateActv.FId_CoordZFC_C "/" VALUE 0x8007924A Val_Wu16 13107.00 DSCHED_Time200ms 0.00 13107.00 FORMAT "%8.2" /end CHARACTERISTIC
/begin CHARACTERISTIC DSCHED_SetPointRatePas.FId_InhibitAlways_C "/" VALUE 0x8007924C Val_Wu16 13107.00 DSCHED_Time200ms 0.00 13107.00 FORMAT "%8.2" /end CHARACTERISTIC
/begin CHARACTERISTIC DSCHED_SetPointRatePas.FId_CoordALS_C "/" VALUE 0x8007924E Val_Wu16 13107.00 DSCHED_Time200ms 0.00 13107.00 FORMAT "%8.2" /end CHARACTERISTIC
/begin CHARACTERISTIC DSCHED_SetPointRatePas.FId_CoordFBC_C "/" VALUE 0x80079250 Val_Wu16 13107.00 DSCHED_Time200ms 0.00 13107.00 FORMAT "%8.2" /end CHARACTERISTIC
/begin CHARACTERISTIC DSCHED_SetPointRatePas.FId_CoordTAA_C "/" VALUE 0x80079252 Val_Wu16 13107.00 DSCHED_Time200ms 0.00 13107.00 FORMAT "%8.2" /end CHARACTERISTIC
/begin CHARACTERISTIC DSCHED_SetPointRatePas.FId_CoordZFC_C "/" VALUE 0x80079254 Val_Wu16 13107.00 DSCHED_Time200ms 0.00 13107.00 FORMAT "%8.2" /end CHARACTERISTIC
/begin CHARACTERISTIC DSCHED_tiWTT_CA "" VAL_BLK 0x80079256 ValA_Wu16 6553.500 DSCHED_Time100ms 0.00 6553.500 FORMAT "%8.3" NUMBER 50 /end CHARACTERISTIC
/begin CHARACTERISTIC DSCHED_UpLimRateLow.FId_InhibitAlways_C "/" VALUE 0x800792BA Val_Wu16 8191.000 DFC_OneToOne 0.00 8191.000 EXTENDED_LIMITS 0.00 65535.00 /end CHARACTERISTIC
/begin CHARACTERISTIC DSCHED_UpLimRateLow.FId_CoordALS_C "/" VALUE 0x800792BC Val_Wu16 8191.000 DFC_OneToOne 0.00 8191.000 EXTENDED_LIMITS 0.00 65535.00 /end CHARACTERISTIC
/begin CHARACTERISTIC DSCHED_UpLimRateLow.FId_CoordFBC_C "/" VALUE 0x800792BE Val_Wu16 8191.000 DFC_OneToOne 0.00 8191.000 EXTENDED_LIMITS 0.00 65535.00 /end CHARACTERISTIC
/begin CHARACTERISTIC DSCHED_UpLimRateLow.FId_CoordTAA_C "/" VALUE 0x800792C0 Val_Wu16 8191.000 DFC_OneToOne 0.00 8191.000 EXTENDED_LIMITS 0.00 65535.00 /end CHARACTERISTIC
/begin CHARACTERISTIC DSCHED_UpLimRateLow.FId_CoordZFC_C "/" VALUE 0x800792C2 Val_Wu16 8191.000 DFC_OneToOne 0.00 8191.000 EXTENDED_LIMITS 0.00 65535.00 /end CHARACTERISTIC
/begin CHARACTERISTIC DSCHED_UpLimRateOk.FId_InhibitAlways_C "/" VALUE 0x800792C4 Val_Wu16 8191.000 DFC_OneToOne 0.00 8191.000 EXTENDED_LIMITS 0.00 65535.00 /end CHARACTERISTIC
/begin CHARACTERISTIC DSCHED_UpLimRateOk.FId_CoordALS_C "/" VALUE 0x800792C6 Val_Wu16 8191.000 DFC_OneToOne 0.00 8191.000 EXTENDED_LIMITS 0.00 65535.00 /end CHARACTERISTIC
/begin CHARACTERISTIC DSCHED_UpLimRateOk.FId_CoordFBC_C "/" VALUE 0x800792C8 Val_Wu16 8191.000 DFC_OneToOne 0.00 8191.000 EXTENDED_LIMITS 0.00 65535.00 /end CHARACTERISTIC
/begin CHARACTERISTIC DSCHED_UpLimRateOk.FId_CoordTAA_C "/" VALUE 0x800792CA Val_Wu16 8191.000 DFC_OneToOne 0.00 8191.000 EXTENDED_LIMITS 0.00 65535.00 /end CHARACTERISTIC
/begin CHARACTERISTIC DSCHED_UpLimRateOk.FId_CoordZFC_C "/" VALUE 0x800792CC Val_Wu16 8191.000 DFC_OneToOne 0.00 8191.000 EXTENDED_LIMITS 0.00 65535.00 /end CHARACTERISTIC
/begin CHARACTERISTIC DSCHED_xWTTFId_CA "" VAL_BLK 0x800792CE ValA_Wu16 32773. DSCHED_FIdWTTVerb 0.00 32773. FORMAT "%2.0" NUMBER 50 /end CHARACTERISTIC
/begin CHARACTERISTIC DSMAUX_dtWUCMin_C "Mindesttemperaturanstieg für einen warm up cycle" VALUE 0x8004B894 Val_Ws16 6553.500 Temp_Kelv -3276.800 3276.700 FORMAT "%8.3" /end CHARACTERISTIC
/begin CHARACTERISTIC DSMAUX_tWUCMin_C "Mindesttemperatur für einen warm up cycle" VALUE 0x8004B896 Val_Ws16 6553.500 Temp_Cels -3549.940 3003.560 FORMAT "%8.3" /end CHARACTERISTIC
/begin CHARACTERISTIC DSMAUX_xClearMode_C "Loeschmodus fuer den Trigger (DFC_Unused = alle Eintraege)" VALUE 0x8004B898 Val_Wu16 576. DFC_Verb 0.00 576. FORMAT "%2.0" /end CHARACTERISTIC
/begin CHARACTERISTIC DSMAUX_xClearTrg_C "Trigger zum Loeschen der DSM Informationen" VALUE 0x8004B89A Val_Wu8 255.0000 DFC_OneToOne 0.00 255.0000 FORMAT "%8.4" /end CHARACTERISTIC
/begin CHARACTERISTIC DSMDur_valEvntQntDist_C "" VALUE 0x8004B89C Val_Wu16 65535.00 DFES_OneToOne 0.00 65535.00 FORMAT "%8.2" /end CHARACTERISTIC
/begin CHARACTERISTIC DSMDur_valEvntQntTi_C "" VALUE 0x8004B89E Val_Wu16 65535.00 DFES_OneToOne 0.00 65535.00 FORMAT "%8.2" /end CHARACTERISTIC
/begin CHARACTERISTIC DSMDur_xEnaDFES_CA "" VAL_BLK 0x80079332 ValA_Wu16 65535.00 DFES_OneToOne 0.00 65535.00 FORMAT "%8.2" NUMBER 3 /end CHARACTERISTIC
/begin CHARACTERISTIC DSMDur_xEnaGlb_CA "" VAL_BLK 0x80079338 ValA_Wu16 65535.00 DFES_OneToOne 0.00 65535.00 FORMAT "%8.2" NUMBER 1 /end CHARACTERISTIC
/begin CHARACTERISTIC DSMDur_xRstDFES_CA "" VAL_BLK 0x8007933A ValA_Wu8 255.0 DFES_OneToOne 0.00 255.0 FORMAT "%5.1" NUMBER 3 /end CHARACTERISTIC
/begin CHARACTERISTIC DSMDur_xRstGlb_CA "" VAL_BLK 0x8007933D ValA_Wu8 255.0 DFES_OneToOne 0.00 255.0 FORMAT "%5.1" NUMBER 1 /end CHARACTERISTIC
/begin CHARACTERISTIC DSMDur_xSelEvntDFES_CA "" VAL_BLK 0x8007933E ValA_Wu8 4. DSMDur_EvntSel_Verb 0.00 4. FORMAT "%2.0" NUMBER 3 /end CHARACTERISTIC
/begin CHARACTERISTIC DSMDur_xSelEvntGlb_CA "" VAL_BLK 0x80079341 ValA_Wu8 4. DSMDur_EvntSel_Verb 0.00 4. FORMAT "%2.0" NUMBER 1 /end CHARACTERISTIC
/begin CHARACTERISTIC DSMRdy_Grp.Misf_CA "/" VAL_BLK 0x8004B8A0 ValA_Wu16 576. DFC_Verb 0.00 576. FORMAT "%2.0" NUMBER 10 /end CHARACTERISTIC
/begin CHARACTERISTIC DSMRdy_Grp.FlSys_CA "/" VAL_BLK 0x8004B8B4 ValA_Wu16 576. DFC_Verb 0.00 576. FORMAT "%2.0" NUMBER 20 /end CHARACTERISTIC
/begin CHARACTERISTIC DSMRdy_Grp.ComprCmpnt_CA "/" VAL_BLK 0x8004B8DC ValA_Wu16 576. DFC_Verb 0.00 576. FORMAT "%2.0" NUMBER 40 /end CHARACTERISTIC
/begin CHARACTERISTIC DSMRdy_Grp.Cat_CA "/" VAL_BLK 0x8004B92C ValA_Wu16 576. DFC_Verb 0.00 576. FORMAT "%2.0" NUMBER 10 /end CHARACTERISTIC
/begin CHARACTERISTIC DSMRdy_Grp.HtCat_CA "/" VAL_BLK 0x8004B940 ValA_Wu16 576. DFC_Verb 0.00 576. FORMAT "%2.0" NUMBER 10 /end CHARACTERISTIC
/begin CHARACTERISTIC DSMRdy_Grp.EvpSys_CA "/" VAL_BLK 0x8004B954 ValA_Wu16 576. DFC_Verb 0.00 576. FORMAT "%2.0" NUMBER 10 /end CHARACTERISTIC
/begin CHARACTERISTIC DSMRdy_Grp.SecAirSys_CA "/" VAL_BLK 0x8004B968 ValA_Wu16 576. DFC_Verb 0.00 576. FORMAT "%2.0" NUMBER 10 /end CHARACTERISTIC
/begin CHARACTERISTIC DSMRdy_Grp.AC_CA "/" VAL_BLK 0x8004B97C ValA_Wu16 576. DFC_Verb 0.00 576. FORMAT "%2.0" NUMBER 10 /end CHARACTERISTIC
/begin CHARACTERISTIC DSMRdy_Grp.O2Sens_CA "/" VAL_BLK 0x8004B990 ValA_Wu16 576. DFC_Verb 0.00 576. FORMAT "%2.0" NUMBER 10 /end CHARACTERISTIC
/begin CHARACTERISTIC DSMRdy_Grp.O2SensHt_CA "/" VAL_BLK 0x8004B9A4 ValA_Wu16 576. DFC_Verb 0.00 576. FORMAT "%2.0" NUMBER 10 /end CHARACTERISTIC
/begin CHARACTERISTIC DSMRdy_Grp.EGR_CA "/" VAL_BLK 0x8004B9B8 ValA_Wu16 576. DFC_Verb 0.00 576. FORMAT "%2.0" NUMBER 25 /end CHARACTERISTIC
/begin CHARACTERISTIC DSMRdy_X.PID1ForceLowMsk_C "/" VALUE 0x8004B9EC Val_Wu32 4294967295. DSMRdy_OneToOne 0.00 4294967295. FORMAT "%8.0" /end CHARACTERISTIC
/begin CHARACTERISTIC DSMRdy_X.PID1ForceHighMsk_C "/" VALUE 0x8004B9F0 Val_Wu32 4294967295. DSMRdy_OneToOne 0.00 4294967295. FORMAT "%8.0" /end CHARACTERISTIC
/begin CHARACTERISTIC DSMRdy_X.PID41ForceLowMsk_C "/" VALUE 0x8004B9F4 Val_Wu32 4294967295. DSMRdy_OneToOne 0.00 4294967295. FORMAT "%8.0" /end CHARACTERISTIC
/begin CHARACTERISTIC DSMRdy_X.PID41ForceHighMsk_C "/" VALUE 0x8004B9F8 Val_Wu32 4294967295. DSMRdy_OneToOne 0.00 4294967295. FORMAT "%8.0" /end CHARACTERISTIC
/begin CHARACTERISTIC DSMRdy_X.DFESSetMode_C "/" VALUE 0x8004B9FC Val_Wu8 1. DSMRdy_Mode3ModeVerb 0.00 1. FORMAT "%2.0" /end CHARACTERISTIC
/begin CHARACTERISTIC DTR_numCANOBDId_CA "" VAL_BLK 0x80079342 ValA_Wu8 255.0000 DFC_OneToOne 0.00 255.0000 FORMAT "%8.4" NUMBER 5 /end CHARACTERISTIC
/begin CHARACTERISTIC DTR_numCANTstId_CA "" VAL_BLK 0x80079347 ValA_Wu8 255.0000 DFC_OneToOne 0.00 255.0000 FORMAT "%8.4" NUMBER 5 /end CHARACTERISTIC
/begin CHARACTERISTIC DTR_xAsgnCANRslt_CA "" VAL_BLK 0x8007934C ValA_Wu8 255. DTR_Verb 0.00 255. FORMAT "%2.0" NUMBER 5 /end CHARACTERISTIC
/begin CHARACTERISTIC DTR_xAsgnKLineRslt_CA "" VAL_BLK 0x80079351 ValA_Wu8 255. DTR_Verb 0.00 255. FORMAT "%2.0" NUMBER 5 /end CHARACTERISTIC
/begin CHARACTERISTIC DTR_xKLineCmpnId_CA "" VAL_BLK 0x80079356 ValA_Wu8 255.0000 DFC_OneToOne 0.00 255.0000 FORMAT "%8.4" NUMBER 5 /end CHARACTERISTIC
/begin CHARACTERISTIC DTR_xKLineFactor_CA "" VAL_BLK 0x8007935C ValA_Ws16 8. DTR_Fact -4. 4. FORMAT "%2.0" NUMBER 5 /end CHARACTERISTIC
/begin CHARACTERISTIC DTR_xKLineOffset_CA "" VAL_BLK 0x80079366 ValA_Ws16 65535.00 DFC_OneToOne -32768.00 32767.00 FORMAT "%8.2" NUMBER 5 /end CHARACTERISTIC
/begin CHARACTERISTIC DTR_xKLineTstId_CA "" VAL_BLK 0x80079370 ValA_Wu8 255.0000 DFC_OneToOne 0.00 255.0000 FORMAT "%8.4" NUMBER 5 /end CHARACTERISTIC
/begin CHARACTERISTIC ECBVlv_Pwm.tiPer_C "/" VALUE 0x8004BA6C Val_Ws16 9.900000 Period 0.1000000 10.00000 FORMAT "%8.5" EXTENDED_LIMITS -3276.800 3276.700 /end CHARACTERISTIC
/begin CHARACTERISTIC ECBVlv_Pwm.stLvl_C "/" VALUE 0x8004BA6E Val_Wu8 1.000 OneToOne 0.00 1.000 FORMAT "%5.3" EXTENDED_LIMITS 0.00 255.0 /end CHARACTERISTIC
/begin CHARACTERISTIC ECBVlv_Pwm.rMaxDty_C "/" VALUE 0x8004BA70 Val_Ws16 100.0000 DtyCyc 0.00 100.0000 FORMAT "%8.4" EXTENDED_LIMITS -327.6800 327.6700 /end CHARACTERISTIC
/begin CHARACTERISTIC ECBVlv_Pwm.rPerUn_C "/" VALUE 0x8004BA72 Val_Ws16 3276.700 Period 0.00 3276.700 FORMAT "%8.3" EXTENDED_LIMITS -3276.800 3276.700 /end CHARACTERISTIC
/begin CHARACTERISTIC ECBVlv_Pwm.tiPh_C "/" VALUE 0x8004BA74 Val_Ws16 65535.00 OneToOne -32768.00 32767.00 FORMAT "%8.2" /end CHARACTERISTIC
/begin CHARACTERISTIC ECBVlv_PwmOut.rMin_C "/" VALUE 0x8004BA76 Kw_Ws16 100.0000 DtyCyc 0.00 100.0000 FORMAT "%8.4" EXTENDED_LIMITS -327.6800 327.6700 /end CHARACTERISTIC
/begin CHARACTERISTIC ECBVlv_PwmOut.rMax_C "/" VALUE 0x8004BA78 Kw_Ws16 100.0000 DtyCyc 0.00 100.0000 FORMAT "%8.4" EXTENDED_LIMITS -327.6800 327.6700 /end CHARACTERISTIC
/begin CHARACTERISTIC ECBVlv_PwmOut.tiBtwTstSCB_C "/" VALUE 0x8004BA7A Kw_Ws16 1000.000 Time_ms 0.00 1000.000 FORMAT "%8.3" EXTENDED_LIMITS -327680.0 327670.0 /end CHARACTERISTIC
/begin CHARACTERISTIC ECBVlv_PwmOut.tiBtwTstOT_C "/" VALUE 0x8004BA7C Kw_Ws16 327.6700 Time_s 0.00 327.6700 FORMAT "%8.4" EXTENDED_LIMITS -327.6800 327.6700 /end CHARACTERISTIC
/begin CHARACTERISTIC ECBVlv_PwmOut.numTstMax_C "/" VALUE 0x8004BA7E Kw_Wu16 65535.00 OneToOne 0.00 65535.00 FORMAT "%8.2" /end CHARACTERISTIC
/begin CHARACTERISTIC ECBVlv_PwmOut.swtBattCor_C "/" VALUE 0x8004BA80 Kw_Wu8 1.000 OneToOne 0.00 1.000 FORMAT "%5.3" EXTENDED_LIMITS 0.00 255.0 /end CHARACTERISTIC
/begin CHARACTERISTIC ECBVlv_PwmOut.swtPsInv_C "/" VALUE 0x8004BA81 Kw_Wu8 255.0 OneToOne 0.00 255.0 FORMAT "%5.1" /end CHARACTERISTIC
/begin CHARACTERISTIC ECBVlv_rCnv_CUR "" CURVE 0x8004BA82 Cur_Xs16Ws16 100.0000 DtyCyc 0.00 100.0000 FORMAT "%8.4" EXTENDED_LIMITS -327.6800 327.6700
 /begin AXIS_DESCR STD_AXIS ECBVlv_r Prc 16 -400.0000 399.9878 FORMAT "%8.4" DEPOSIT ABSOLUTE /end AXIS_DESCR
/end CHARACTERISTIC
/begin CHARACTERISTIC ECBVlv_RmpSlp.Pos_C "/" VALUE 0x8004BA60 Kw_Ws32 399999.999814 RmpPrc 0.00 399999.999814 FORMAT "%13.6" EXTENDED_LIMITS -400000.000000 399999.999814 /end CHARACTERISTIC
/begin CHARACTERISTIC ECBVlv_RmpSlp.Neg_C "/" VALUE 0x8004BA64 Kw_Ws32 399999.999814 RmpPrc 0.00 399999.999814 FORMAT "%13.6" EXTENDED_LIMITS -400000.000000 399999.999814 /end CHARACTERISTIC
/begin CHARACTERISTIC ECBVlv_rTransf_CUR "" CURVE 0x8004BA1A Cur_Xs16Ws16 799.9878 Prc -400.0000 399.9878 FORMAT "%8.4"
 /begin AXIS_DESCR STD_AXIS ECBVlv_uRaw Volt 16 -6553.600 6553.400 FORMAT "%8.3" DEPOSIT ABSOLUTE /end AXIS_DESCR
/end CHARACTERISTIC
/begin CHARACTERISTIC ECBVlv_SRC.uMin_C "/" VALUE 0x8004BA5C Kw_Ws16 13107.00 Volt -6553.600 6553.400 FORMAT "%8.3" /end CHARACTERISTIC
/begin CHARACTERISTIC ECBVlv_SRC.uMax_C "/" VALUE 0x8004BA5E Kw_Ws16 13107.00 Volt -6553.600 6553.400 FORMAT "%8.3" /end CHARACTERISTIC
/begin CHARACTERISTIC ECBVlv_stPsDiaDisbl_C "" VALUE 0x8004BAC4 Val_Wu8 255.0 OneToOne 0.00 255.0 FORMAT "%5.1" /end CHARACTERISTIC
/begin CHARACTERISTIC ECBVlv_stPsDisbl_C "" VALUE 0x8004BAC5 Val_Wu8 255.0 OneToOne 0.00 255.0 FORMAT "%5.1" /end CHARACTERISTIC
/begin CHARACTERISTIC ECBVlv_TransStg.Dfl_C "/" VALUE 0x8004BA68 Kw_Ws16 799.9878 Prc -400.0000 399.9878 FORMAT "%8.4" /end CHARACTERISTIC
/begin CHARACTERISTIC ECBVlv_TransStg.stSensId_C "/" VALUE 0x8004BA6A Kw_Wu8 255.0 OneToOne 0.00 255.0 FORMAT "%5.1" /end CHARACTERISTIC
/begin CHARACTERISTIC edc2layer_bkwdrehtHi_C "" VALUE 0x80079376 Val_Ws16 32767.50 EngN -16384.00 16383.50 FORMAT "%8.2" /end CHARACTERISTIC
/begin CHARACTERISTIC edc2layer_bkwdrehtLo_C "" VALUE 0x80079378 Val_Ws16 32767.50 EngN -16384.00 16383.50 FORMAT "%8.2" /end CHARACTERISTIC
/begin CHARACTERISTIC edc2layer_B_ulcp_C "" VALUE 0x8007937A Val_Wu8 255.0 OneToOne 0.00 255.0 FORMAT "%5.1" /end CHARACTERISTIC
/begin CHARACTERISTIC edc2layer_nbmsastopt_C "" VALUE 0x8007937C Val_Ws16 32767.50 EngN -16384.00 16383.50 FORMAT "%8.2" /end CHARACTERISTIC
/begin CHARACTERISTIC edc2layer_nSetPointHigh_C "" VALUE 0x8007937E Val_Ws16 32767.50 EngN -16384.00 16383.50 FORMAT "%8.2" /end CHARACTERISTIC
/begin CHARACTERISTIC edc2layer_nSetPointLow_C "" VALUE 0x80079380 Val_Ws16 32767.50 EngN -16384.00 16383.50 FORMAT "%8.2" /end CHARACTERISTIC
/begin CHARACTERISTIC edc2layer_rLoadMax_C "" VALUE 0x80079382 Val_Ws16 799.9878 Prc -400.0000 399.9878 FORMAT "%8.4" /end CHARACTERISTIC
/begin CHARACTERISTIC edc2layer_rLoadMin_C "" VALUE 0x80079384 Val_Ws16 799.9878 Prc -400.0000 399.9878 FORMAT "%8.4" /end CHARACTERISTIC
/begin CHARACTERISTIC Eep_EnFirstInit_CW "" VALUE 0x8004D478 Val_Wu8 255.0 default 0.00 255.0 FORMAT "%5.1" /end CHARACTERISTIC
/begin CHARACTERISTIC Eep_EnvRamClr_CW "" VALUE 0x8004D479 Val_Wu8 255.0 default 0.00 255.0 FORMAT "%5.1" /end CHARACTERISTIC
/begin CHARACTERISTIC EGRClg_ClgOff_CUR "Kennlinie unterer drehzahlabhängiger Schwellwert der ARF-Kühlung" CURVE 0x800793A4 Kl_Xs16_Ws16 327.6700 InjMass 0.00 327.6700 FORMAT "%8.4" EXTENDED_LIMITS -327.6800 327.6700
 /begin AXIS_DESCR STD_AXIS Epm_nEng EngN 25 0.00 6000.000 FORMAT "%8.3" EXTENDED_LIMITS -16384.00 16383.50 DEPOSIT ABSOLUTE /end AXIS_DESCR
/end CHARACTERISTIC
/begin CHARACTERISTIC EGRClg_ClgOn_CUR "Kennlinie oberer drehzahlabhängiger Schwellwert der ARF-Kühlung" CURVE 0x8007940A Kl_Xs16_Ws16 327.6700 InjMass 0.00 327.6700 FORMAT "%8.4" EXTENDED_LIMITS -327.6800 327.6700
 /begin AXIS_DESCR STD_AXIS Epm_nEng EngN 25 0.00 6000.000 FORMAT "%8.3" EXTENDED_LIMITS -16384.00 16383.50 DEPOSIT ABSOLUTE /end AXIS_DESCR
/end CHARACTERISTIC
/begin CHARACTERISTIC EGRClg_numAirTempCtlVal_C "" VALUE 0x8004BAC6 Val_Wu8 2.00000000000 AirTempFldSel 0.00 2.00000000000 FORMAT "%13.11" /end CHARACTERISTIC
/begin CHARACTERISTIC EGRClg_numEngTempCtlVal_C "Index zur Auswahl der Motortemperatur für die Ansteuerung des ARF-Kühler-Bypass-Ventils" VALUE 0x80079388 Kw_Wu8 2.00000000000 EngTempFldSel 0.00 2.00000000000 FORMAT "%13.11" /end CHARACTERISTIC
/begin CHARACTERISTIC EGRClg_rAirCtlClgOff_C "" VALUE 0x8004BAC8 Val_Ws16 100.0000 Prc 0.00 100.0000 FORMAT "%8.4" EXTENDED_LIMITS -400.0000 399.9878 /end CHARACTERISTIC
/begin CHARACTERISTIC EGRClg_rClgOff_C "ARF-Kühler-Bypass-Ventils geöffne" VALUE 0x8007938A Kw_Ws16 100.0000 Prc 0.00 100.0000 FORMAT "%8.4" EXTENDED_LIMITS -400.0000 399.9878 /end CHARACTERISTIC
/begin CHARACTERISTIC EGRClg_rClgOn_C "ARF-Kühler-Bypass-Ventils geschlossen" VALUE 0x8007938C Kw_Ws16 100.0000 Prc 0.00 100.0000 FORMAT "%8.4" EXTENDED_LIMITS -400.0000 399.9878 /end CHARACTERISTIC
/begin CHARACTERISTIC EGRClg_rDflVal_CA "" VAL_BLK 0x8007938E ValA_Ws16 799.9878 Prc -400.0000 399.9878 FORMAT "%8.4" NUMBER 3 /end CHARACTERISTIC
/begin CHARACTERISTIC EGRClg_stBitMskCtlVal_C "Maske zur Aktivierung der Ansteuerung des ARF-Kühler-Bypass-Ventils" VALUE 0x80079394 Kw_Wu32 4294967295.00 OneToOne 0.00 4294967295.00 FORMAT "%13.2" /end CHARACTERISTIC
/begin CHARACTERISTIC EGRClg_stBitMskEOM_CA "Bitmaske zur Auswahl der relevanten Abschaltfälle im Regenerationsbetrieb" VAL_BLK 0x80079478 ValA_Wu32 4294967295.00 OneToOne 0.00 4294967295.00 FORMAT "%13.2" NUMBER 5 /end CHARACTERISTIC
/begin CHARACTERISTIC EGRClg_stMonEOMMsk_CA "Maske zur Umschaltung zwischen der Maskierung für den normalen Betrieb und der Maskierung des Regenerationsbetriebs" VAL_BLK 0x8007948C ValA_Wu32 4294967295.00 OneToOne 0.00 4294967295.00 FORMAT "%13.2" NUMBER 5 /end CHARACTERISTIC
/begin CHARACTERISTIC EGRClg_stPrioMon_CA "Liste für die Priorisierung der Abschaltfälle" VAL_BLK 0x80079398 ValA_Ws16 65535.00 OneToOne -32768.00 32767.00 FORMAT "%8.2" NUMBER 3 /end CHARACTERISTIC
/begin CHARACTERISTIC EGRClg_stShOffEOMMsk_C "Bitmaske zum Selektieren der relevanten Regenerationsanforderungen für Ansteuerung des ARF-Kühler-Bypass-Ventils" VALUE 0x80079474 Kw_Wu32 4294967295.00 OneToOne 0.00 4294967295.00 FORMAT "%13.2" /end CHARACTERISTIC
/begin CHARACTERISTIC EGRClg_tAirClgOff_C "" VALUE 0x8004BACA Val_Ws16 180.0000 Temp_Cels -30.04000 149.9600 FORMAT "%8.4" EXTENDED_LIMITS -3549.940 3003.560 /end CHARACTERISTIC
/begin CHARACTERISTIC EGRClg_tAirClgOn_C "" VALUE 0x8004BACC Val_Ws16 180.0000 Temp_Cels -30.04000 149.9600 FORMAT "%8.4" EXTENDED_LIMITS -3549.940 3003.560 /end CHARACTERISTIC
/begin CHARACTERISTIC EGRClg_tCldStrtThres_C "Temperatur-Schwellewert für die Kaltstarterkennung" VALUE 0x80079470 Kw_Ws16 250.0000 Temp_Cels -50.14000 199.8600 FORMAT "%8.4" EXTENDED_LIMITS -3549.940 3003.560 /end CHARACTERISTIC
/begin CHARACTERISTIC EGRClg_tEngClgOff_C "unterer Schwellwert der Temperatur aus Motortemperaturfeld" VALUE 0x8007939E Kw_Ws16 250.0000 Temp_Cels -50.14000 199.8600 FORMAT "%8.4" EXTENDED_LIMITS -3549.940 3003.560 /end CHARACTERISTIC
/begin CHARACTERISTIC EGRClg_tEngClgOn_C "oberer Schwellwert der Temperatur aus Motortemperaturfeld" VALUE 0x800793A0 Kw_Ws16 250.0000 Temp_Cels -50.14000 199.8600 FORMAT "%8.4" EXTENDED_LIMITS -3549.940 3003.560 /end CHARACTERISTIC
/begin CHARACTERISTIC EGRClg_tEngLowClgOff_C "" VALUE 0x8004BACE Val_Ws16 180.0000 Temp_Cels -30.04000 149.9600 FORMAT "%8.4" EXTENDED_LIMITS -3549.940 3003.560 /end CHARACTERISTIC
/begin CHARACTERISTIC EGRClg_tEngLowClgOn_C "" VALUE 0x8004BAD0 Val_Ws16 180.0000 Temp_Cels -30.04000 149.9600 FORMAT "%8.4" EXTENDED_LIMITS -3549.940 3003.560 /end CHARACTERISTIC
/begin CHARACTERISTIC EGRClg_tiCldStrt_C "Zeit für die Aktivierung des ARF-Kühler-Bypasses bei Kaltstart" VALUE 0x80079472 Kw_Ws16 300.0000 Time_s 0.00 300.0000 FORMAT "%8.4" EXTENDED_LIMITS -327.6800 327.6700 /end CHARACTERISTIC
/begin CHARACTERISTIC EGRClg_tiMonEOM_CA "Zeitverzögerung zur Umschaltung zwischen der Maskierung für den normalen Betrieb und der Maskierung des Regenerationsbetriebs" VAL_BLK 0x800794A0 ValA_Ws16 655350.0 TimeDeb -327680.0 327670.0 FORMAT "%8.1" NUMBER 5 /end CHARACTERISTIC
/begin CHARACTERISTIC EGRVlv_DKdNgv_C "" VALUE 0x80079560 Val_Ws32 10.0000000000 Kd 0.00 10.0000000000 FORMAT "%13.10" EXTENDED_LIMITS -32768.0000000 32767.9999847 /end CHARACTERISTIC
/begin CHARACTERISTIC EGRVlv_DKdPsv_C "" VALUE 0x80079564 Val_Ws32 10.0000000000 Kd 0.00 10.0000000000 FORMAT "%13.10" EXTENDED_LIMITS -32768.0000000 32767.9999847 /end CHARACTERISTIC
/begin CHARACTERISTIC EGRVlv_drActNgv_C "" VALUE 0x80079568 Val_Ws16 1000.000 VlvVel 0.00 1000.000 FORMAT "%8.3" EXTENDED_LIMITS -4000.000 3999.878 /end CHARACTERISTIC
/begin CHARACTERISTIC EGRVlv_facAdapClsStrt_C "Maximale Schwelle der tatsächlich erfassten Ventilposition" VALUE 0x800795FC Val_Ws16 4.000000 Fact 0.00 4.000000 FORMAT "%8.6" EXTENDED_LIMITS -4.000000 3.999878 /end CHARACTERISTIC
/begin CHARACTERISTIC EGRVlv_facAdapPosCls_C "Maximale Schwelle der tatsächlich erfassten Ventilposition" VALUE 0x800795FE Val_Ws16 4.000000 Fact 0.00 4.000000 FORMAT "%8.6" EXTENDED_LIMITS -4.000000 3.999878 /end CHARACTERISTIC
/begin CHARACTERISTIC EGRVlv_facCorStrt_C "Zusätzlicher Batteriespannungskorrekturfaktor, wenn der Motor im Startzustand ist" VALUE 0x800794AC Val_Ws16 7.999878 Fact -4.000000 3.999878 FORMAT "%8.6" /end CHARACTERISTIC
/begin CHARACTERISTIC EGRVlv_iEff_CUR "Kennlinie zum Erhalten des modellierten Stroms zur Begrenzung des AGR-Ventil-PID-Reglers" CURVE 0x8007956A Cur_Xs16Ws16 10.00000 Curr_A 0.00 10.00000 FORMAT "%8.5" EXTENDED_LIMITS -327.6800 327.6700
 /begin AXIS_DESCR STD_AXIS EGRVlv_rPs DtyCyc 8 0.00 100.0000 FORMAT "%8.4" EXTENDED_LIMITS -327.6800 327.6700 DEPOSIT ABSOLUTE /end AXIS_DESCR
/end CHARACTERISTIC
/begin CHARACTERISTIC EGRVlv_IKiNgv_C "" VALUE 0x8007958C Val_Ws32 99.9998301268 Ki 0.00 99.9998301268 FORMAT "%13.9" EXTENDED_LIMITS -1000000.00000 999999.999534 /end CHARACTERISTIC
/begin CHARACTERISTIC EGRVlv_IKiOfsLrnDwn_C "Maximale Schwelle der tatsächlich erfassten Ventilposition" VALUE 0x80079600 Val_Ws32 9999.99977648 Ki 0.00 9999.99977648 FORMAT "%13.7" EXTENDED_LIMITS -1000000.00000 999999.999534 /end CHARACTERISTIC
/begin CHARACTERISTIC EGRVlv_IKiOfsLrnUp_C "Maximale Schwelle der tatsächlich erfassten Ventilposition" VALUE 0x80079604 Val_Ws32 9999.99977648 Ki 0.00 9999.99977648 FORMAT "%13.7" EXTENDED_LIMITS -1000000.00000 999999.999534 /end CHARACTERISTIC
/begin CHARACTERISTIC EGRVlv_IKiPsv_C "" VALUE 0x80079590 Val_Ws32 99.9998301268 Ki 0.00 99.9998301268 FORMAT "%13.9" EXTENDED_LIMITS -1000000.00000 999999.999534 /end CHARACTERISTIC
/begin CHARACTERISTIC EGRVlv_numAdapClsMax_C "Maximale Schwelle der tatsächlich erfassten Ventilposition" VALUE 0x80079608 Val_Wu8 255.0 OneToOne 0.00 255.0 FORMAT "%5.1" /end CHARACTERISTIC
/begin CHARACTERISTIC EGRVlv_numEngTempMon_C "" VALUE 0x8007952C Val_Wu8 2.00000000000 EngTempFldSel 0.00 2.00000000000 FORMAT "%13.11" /end CHARACTERISTIC
/begin CHARACTERISTIC EGRVlv_numTempSel_C "" VALUE 0x80079609 Val_Wu8 2.00000000000 EngTempFldSel 0.00 2.00000000000 FORMAT "%13.11" /end CHARACTERISTIC
/begin CHARACTERISTIC EGRVlv_PKpNgv_C "" VALUE 0x80079594 Val_Ws32 10.0000000000 Kp 0.00 10.0000000000 FORMAT "%13.10" EXTENDED_LIMITS -65536.0000000 65535.9999695 /end CHARACTERISTIC
/begin CHARACTERISTIC EGRVlv_PKpPsv_C "" VALUE 0x80079598 Val_Ws32 10.0000000000 Kp 0.00 10.0000000000 FORMAT "%13.10" EXTENDED_LIMITS -65536.0000000 65535.9999695 /end CHARACTERISTIC
/begin CHARACTERISTIC EGRVlv_PullDwnIKi_C "Integrationszeitkonstante des Pull-Down-Integrators" VALUE 0x80079530 Val_Ws32 100.000016391 Ki_EGRVlv 0.00 100.000016391 FORMAT "%13.9" EXTENDED_LIMITS -400000.000000 399999.999814 /end CHARACTERISTIC
/begin CHARACTERISTIC EGRVlv_Pwm.tiPer_C "/" VALUE 0x800794AE Kw_Ws16 6553.500 Period -3276.800 3276.700 FORMAT "%8.3" /end CHARACTERISTIC
/begin CHARACTERISTIC EGRVlv_Pwm.stLvl_C "/" VALUE 0x800794B0 Kw_Wu8 255.0 OneToOne 0.00 255.0 FORMAT "%5.1" /end CHARACTERISTIC
/begin CHARACTERISTIC EGRVlv_Pwm.rMaxDty_C "/" VALUE 0x800794B2 Kw_Ws16 655.3500 DtyCyc -327.6800 327.6700 FORMAT "%8.4" /end CHARACTERISTIC
/begin CHARACTERISTIC EGRVlv_Pwm.rPerUn_C "/" VALUE 0x800794B4 Kw_Ws16 65535.00 OneToOne -32768.00 32767.00 FORMAT "%8.2" /end CHARACTERISTIC
/begin CHARACTERISTIC EGRVlv_Pwm.tiPh_C "/" VALUE 0x800794B6 Kw_Ws16 6553.500 Period -3276.800 3276.700 FORMAT "%8.3" /end CHARACTERISTIC
/begin CHARACTERISTIC EGRVlv_PwmOut.rMin_C "/" VALUE 0x800794B8 Kw_Ws16 655.3500 DtyCyc -327.6800 327.6700 FORMAT "%8.4" /end CHARACTERISTIC
/begin CHARACTERISTIC EGRVlv_PwmOut.rMax_C "/" VALUE 0x800794BA Kw_Ws16 655.3500 DtyCyc -327.6800 327.6700 FORMAT "%8.4" /end CHARACTERISTIC
/begin CHARACTERISTIC EGRVlv_PwmOut.tiBtwTstSCB_C "/" VALUE 0x800794BC Kw_Ws16 655350.0 Time_ms -327680.0 327670.0 FORMAT "%8.1" /end CHARACTERISTIC
/begin CHARACTERISTIC EGRVlv_PwmOut.tiBtwTstOT_C "/" VALUE 0x800794BE Kw_Ws16 655.3500 Time_s -327.6800 327.6700 FORMAT "%8.4" /end CHARACTERISTIC
/begin CHARACTERISTIC EGRVlv_PwmOut.numTstMax_C "/" VALUE 0x800794C0 Kw_Wu16 65535.00 OneToOne 0.00 65535.00 FORMAT "%8.2" /end CHARACTERISTIC
/begin CHARACTERISTIC EGRVlv_PwmOut.swtBattCor_C "/" VALUE 0x800794C2 Kw_Wu8 255.0 OneToOne 0.00 255.0 FORMAT "%5.1" /end CHARACTERISTIC
/begin CHARACTERISTIC EGRVlv_PwmOut.swtPsInv_C "/" VALUE 0x800794C3 Kw_Wu8 255.0 OneToOne 0.00 255.0 FORMAT "%5.1" /end CHARACTERISTIC
/begin CHARACTERISTIC EGRVlv_rActMax_C "Maximale Schwelle der tatsächlich erfassten Ventilposition" VALUE 0x8007960A Val_Ws16 100.0000 Prc 0.00 100.0000 FORMAT "%8.4" EXTENDED_LIMITS -400.0000 399.9878 /end CHARACTERISTIC
/begin CHARACTERISTIC EGRVlv_rActMin_C "Minimale Schwelle der tatsächlich erfassten Ventilposition" VALUE 0x8007960C Val_Ws16 100.0000 Prc 0.00 100.0000 FORMAT "%8.4" EXTENDED_LIMITS -400.0000 399.9878 /end CHARACTERISTIC
/begin CHARACTERISTIC EGRVlv_rActNgv_C "" VALUE 0x8007959C Val_Ws16 100.0000 Prc 0.00 100.0000 FORMAT "%8.4" EXTENDED_LIMITS -400.0000 399.9878 /end CHARACTERISTIC
/begin CHARACTERISTIC EGRVlv_rActOfs_C "" VALUE 0x8007960E Val_Ws16 100.0000 Prc 0.00 100.0000 FORMAT "%8.4" EXTENDED_LIMITS -400.0000 399.9878 /end CHARACTERISTIC
/begin CHARACTERISTIC EGRVlv_rAdapAgOpnMax_C "Maximale Schwelle der tatsächlich erfassten Ventilposition" VALUE 0x80079610 Val_Ws16 100.0000 Prc 0.00 100.0000 FORMAT "%8.4" EXTENDED_LIMITS -400.0000 399.9878 /end CHARACTERISTIC
/begin CHARACTERISTIC EGRVlv_rAdapAgOpnMin_C "Maximale Schwelle der tatsächlich erfassten Ventilposition" VALUE 0x80079612 Val_Ws16 100.0000 Prc 0.00 100.0000 FORMAT "%8.4" EXTENDED_LIMITS -400.0000 399.9878 /end CHARACTERISTIC
/begin CHARACTERISTIC EGRVlv_rAdapDiffPlausLgT_C "" VALUE 0x80079614 Val_Ws16 100.0000 Prc 0.00 100.0000 FORMAT "%8.4" EXTENDED_LIMITS -400.0000 399.9878 /end CHARACTERISTIC
/begin CHARACTERISTIC EGRVlv_rAdapDiffPlausShT_C "" VALUE 0x80079616 Val_Ws16 100.0000 Prc 0.00 100.0000 FORMAT "%8.4" EXTENDED_LIMITS -400.0000 399.9878 /end CHARACTERISTIC
/begin CHARACTERISTIC EGRVlv_rAdapDiffPlaus_C "" VALUE 0x80079618 Val_Ws16 100.0000 Prc 0.00 100.0000 FORMAT "%8.4" EXTENDED_LIMITS -400.0000 399.9878 /end CHARACTERISTIC
/begin CHARACTERISTIC EGRVlv_rAdapIniOpn0_C "" VALUE 0x8007961A Val_Ws16 100.0000 Prc 0.00 100.0000 FORMAT "%8.4" EXTENDED_LIMITS -400.0000 399.9878 /end CHARACTERISTIC
/begin CHARACTERISTIC EGRVlv_rAdapIniOpn_C "" VALUE 0x8007961C Val_Ws16 100.0000 Prc 0.00 100.0000 FORMAT "%8.4" EXTENDED_LIMITS -400.0000 399.9878 /end CHARACTERISTIC
/begin CHARACTERISTIC EGRVlv_rAdapOpnBnd_C "Maximale Schwelle der tatsächlich erfassten Ventilposition" VALUE 0x8007961E Val_Ws16 100.0000 Prc 0.00 100.0000 FORMAT "%8.4" EXTENDED_LIMITS -400.0000 399.9878 /end CHARACTERISTIC
/begin CHARACTERISTIC EGRVlv_rCmpNewCtlUn_C "Maximale Schwelle der tatsächlich erfassten Ventilposition" VALUE 0x80079620 Val_Ws16 100.0000 Prc 0.00 100.0000 FORMAT "%8.4" EXTENDED_LIMITS -400.0000 399.9878 /end CHARACTERISTIC
/begin CHARACTERISTIC EGRVlv_rCnv_MAP "Kennfeld zur Konvertierung der Endstufe ins Tastverhältnis." MAP 0x800794C4 Map_Xs16Ys16Ws16 655.3500 DtyCyc -327.6800 327.6700 FORMAT "%8.4"
 /begin AXIS_DESCR STD_AXIS EGRVlv_rEGR Prc 2 -400.0000 399.9878 FORMAT "%8.4" DEPOSIT ABSOLUTE /end AXIS_DESCR
 /begin AXIS_DESCR STD_AXIS Epm_nEng EngN 2 -16384.00 16383.50 FORMAT "%8.2" DEPOSIT ABSOLUTE /end AXIS_DESCR
/end CHARACTERISTIC
/begin CHARACTERISTIC EGRVlv_rDvtMax_C "Obere Schwelle der AGR-Ventilregelabweichung zur Erkennung der positiven bleibenden Regelabweichung" VALUE 0x80079534 Val_Ws16 100.0000 Prc 0.00 100.0000 FORMAT "%8.4" EXTENDED_LIMITS -400.0000 399.9878 /end CHARACTERISTIC
/begin CHARACTERISTIC EGRVlv_rDvtMin_C "Untere Schwelle der AGR-Ventilregelabweichung zur Erkennung der negativen bleibenden Regelabweichung" VALUE 0x80079536 Val_Ws16 100.0000 Prc -100.0000 0.00 FORMAT "%8.4" EXTENDED_LIMITS -400.0000 399.9878 /end CHARACTERISTIC
/begin CHARACTERISTIC EGRVlv_rGovDvtThres_C "" VALUE 0x8007959E Val_Ws16 100.0000 Prc 0.00 100.0000 FORMAT "%8.4" EXTENDED_LIMITS -400.0000 399.9878 /end CHARACTERISTIC
/begin CHARACTERISTIC EGRVlv_rGovMax_CUR "" CURVE 0x800795A0 Cur_Xs16Ws16 100.0000 Prc 0.00 100.0000 FORMAT "%8.4" EXTENDED_LIMITS -400.0000 399.9878
 /begin AXIS_DESCR STD_AXIS EGRVlv_iEffFlt_mp Curr_A 3 0.00 10.00000 FORMAT "%8.5" EXTENDED_LIMITS -327.6800 327.6700 DEPOSIT ABSOLUTE /end AXIS_DESCR
/end CHARACTERISTIC
/begin CHARACTERISTIC EGRVlv_rGovMin_CUR "" CURVE 0x800795AE Cur_Xs16Ws16 100.0000 Prc -100.0000 0.00 FORMAT "%8.4" EXTENDED_LIMITS -400.0000 399.9878
 /begin AXIS_DESCR STD_AXIS EGRVlv_iEffFlt_mp Curr_A 3 0.00 10.00000 FORMAT "%8.5" EXTENDED_LIMITS -327.6800 327.6700 DEPOSIT ABSOLUTE /end AXIS_DESCR
/end CHARACTERISTIC
/begin CHARACTERISTIC EGRVlv_rIniStp_C "" VALUE 0x800795BC Val_Ws16 100.0000 Prc 0.00 100.0000 FORMAT "%8.4" EXTENDED_LIMITS -400.0000 399.9878 /end CHARACTERISTIC
/begin CHARACTERISTIC EGRVlv_rJamVlvOpnDemMax_C "" VALUE 0x80079538 Val_Ws16 100.0000 Prc 0.00 100.0000 FORMAT "%8.4" EXTENDED_LIMITS -400.0000 399.9878 /end CHARACTERISTIC
/begin CHARACTERISTIC EGRVlv_rJamVlvOpnHi_C "" VALUE 0x8007953A Val_Ws16 100.0000 Prc 0.00 100.0000 FORMAT "%8.4" EXTENDED_LIMITS -400.0000 399.9878 /end CHARACTERISTIC
/begin CHARACTERISTIC EGRVlv_rJamVlvOpnLo_C "" VALUE 0x8007953C Val_Ws16 100.0000 Prc 0.00 100.0000 FORMAT "%8.4" EXTENDED_LIMITS -400.0000 399.9878 /end CHARACTERISTIC
/begin CHARACTERISTIC EGRVlv_rLMSActThresDwn_C "" VALUE 0x8007953E Val_Ws16 100.0000 Prc 0.00 100.0000 FORMAT "%8.4" EXTENDED_LIMITS -400.0000 399.9878 /end CHARACTERISTIC
/begin CHARACTERISTIC EGRVlv_rLMSThresDwn_C "" VALUE 0x80079540 Val_Ws16 100.0000 Prc 0.00 100.0000 FORMAT "%8.4" EXTENDED_LIMITS -400.0000 399.9878 /end CHARACTERISTIC
/begin CHARACTERISTIC EGRVlv_rLMSThresUp_C "" VALUE 0x80079542 Val_Ws16 100.0000 Prc 0.00 100.0000 FORMAT "%8.4" EXTENDED_LIMITS -400.0000 399.9878 /end CHARACTERISTIC
/begin CHARACTERISTIC EGRVlv_RlsIKi_C "Integrationszeitkonstante des Freigabeintegrators" VALUE 0x80079544 Val_Ws32 100000.000000 Ki_EGRVlv 0.00 100000.000000 FORMAT "%13.6" EXTENDED_LIMITS -400000.000000 399999.999814 /end CHARACTERISTIC
/begin CHARACTERISTIC EGRVlv_RmpSlp.Pos_C "/" VALUE 0x80079624 Kw_Ws32 399999.999814 RmpPrc 0.00 399999.999814 FORMAT "%13.6" EXTENDED_LIMITS -400000.000000 399999.999814 /end CHARACTERISTIC
/begin CHARACTERISTIC EGRVlv_RmpSlp.Neg_C "/" VALUE 0x80079628 Kw_Ws32 399999.999814 RmpPrc 0.00 399999.999814 FORMAT "%13.6" EXTENDED_LIMITS -400000.000000 399999.999814 /end CHARACTERISTIC
/begin CHARACTERISTIC EGRVlv_rOfsLrnVlvMax_C "Maximale Schwelle der tatsächlich erfassten Ventilposition" VALUE 0x8007962C Val_Ws16 100.0000 Prc 0.00 100.0000 FORMAT "%8.4" EXTENDED_LIMITS -400.0000 399.9878 /end CHARACTERISTIC
/begin CHARACTERISTIC EGRVlv_rOfsLrnVlvMin_C "Maximale Schwelle der tatsächlich erfassten Ventilposition" VALUE 0x8007962E Val_Ws16 200.0000 Prc -100.0000 100.0000 FORMAT "%8.4" EXTENDED_LIMITS -400.0000 399.9878 /end CHARACTERISTIC
/begin CHARACTERISTIC EGRVlv_rOutDfl_C "Vorgegebenes Tastverhältnis für AGR-Ventil" VALUE 0x800794D8 Val_Ws16 655.3500 DtyCyc -327.6800 327.6700 FORMAT "%8.4" /end CHARACTERISTIC
/begin CHARACTERISTIC EGRVlv_rOutDMax_C "Obere Grenze für Absolutwert des D-Anteils der AGR-Positionsregelung" VALUE 0x800795BE Val_Ws16 100.0000 Prc 0.00 100.0000 FORMAT "%8.4" EXTENDED_LIMITS -400.0000 399.9878 /end CHARACTERISTIC
/begin CHARACTERISTIC EGRVlv_rOutIMax_C "" VALUE 0x800795C0 Val_Ws16 100.0000 Prc 0.00 100.0000 FORMAT "%8.4" EXTENDED_LIMITS -400.0000 399.9878 /end CHARACTERISTIC
/begin CHARACTERISTIC EGRVlv_rPIDWinNgv_C "" VALUE 0x800795C2 Val_Ws16 100.0000 Prc -100.0000 0.00 FORMAT "%8.4" EXTENDED_LIMITS -400.0000 399.9878 /end CHARACTERISTIC
/begin CHARACTERISTIC EGRVlv_rPIDWinPsv_C "" VALUE 0x800795C4 Val_Ws16 100.0000 Prc 0.00 100.0000 FORMAT "%8.4" EXTENDED_LIMITS -400.0000 399.9878 /end CHARACTERISTIC
/begin CHARACTERISTIC EGRVlv_rPullDwnMax_C "Parameter zur Begrenzung des Pull-Down-Integratorausgangs" VALUE 0x80079548 Val_Ws16 100.0000 Prc 0.00 100.0000 FORMAT "%8.4" EXTENDED_LIMITS -400.0000 399.9878 /end CHARACTERISTIC
/begin CHARACTERISTIC EGRVlv_rRlsMax_C "Parameter zur Begrenzung des Freigabeintegratorausgangs" VALUE 0x8007954A Val_Ws16 100.0000 Prc 0.00 100.0000 FORMAT "%8.4" EXTENDED_LIMITS -400.0000 399.9878 /end CHARACTERISTIC
/begin CHARACTERISTIC EGRVlv_rSensVlvThres_C "Maximale Schwelle der tatsächlich erfassten Ventilposition" VALUE 0x80079630 Val_Ws16 100.0000 Prc 0.00 100.0000 FORMAT "%8.4" EXTENDED_LIMITS -400.0000 399.9878 /end CHARACTERISTIC
/begin CHARACTERISTIC EGRVlv_rStpThres_C "" VALUE 0x8007954C Val_Ws16 100.0000 Prc 0.00 100.0000 FORMAT "%8.4" EXTENDED_LIMITS -400.0000 399.9878 /end CHARACTERISTIC
/begin CHARACTERISTIC EGRVlv_rTransf_CUR "Kennlinie zum Übergang der Rohspannung in das Tastverhältnis" CURVE 0x800794E4 Cur_Xs16Ws16 100.0000 Prc 0.00 100.0000 FORMAT "%8.4" EXTENDED_LIMITS -400.0000 399.9878
 /begin AXIS_DESCR STD_AXIS EGRVlv_uRaw Volt 16 0.00 5200.000 FORMAT "%8.3" EXTENDED_LIMITS -6553.600 6553.400 DEPOSIT ABSOLUTE /end AXIS_DESCR
/end CHARACTERISTIC
/begin CHARACTERISTIC EGRVlv_SlwClsDKd_C "Parameter zum Einstellen der Differenzverstärkung bei Erkennung eines langsamen Schließens" VALUE 0x800795C8 Val_Ws32 10.0000000000 Kd 0.00 10.0000000000 FORMAT "%13.10" EXTENDED_LIMITS -32768.0000000 32767.9999847 /end CHARACTERISTIC
/begin CHARACTERISTIC EGRVlv_SlwClsIKi_C "Parameter zum Einstellen der Integriererverstärkung innerhalb des Fensters bei Erkennung eines langsamen Schließens" VALUE 0x800795CC Val_Ws32 99.9998301268 Ki 0.00 99.9998301268 FORMAT "%13.9" EXTENDED_LIMITS -1000000.00000 999999.999534 /end CHARACTERISTIC
/begin CHARACTERISTIC EGRVlv_SlwClsPKp_C "Parameter zum Einstellen der proportionalen Verstärkung innerhalb des Fensters bei Erkennung eines langsamen Schließens" VALUE 0x800795D0 Val_Ws32 10.0000000000 Kp 0.00 10.0000000000 FORMAT "%13.10" EXTENDED_LIMITS -65536.0000000 65535.9999695 /end CHARACTERISTIC
/begin CHARACTERISTIC EGRVlv_SmlSigNgvDKd_C "" VALUE 0x800795D4 Val_Ws32 10.0000000000 Kd 0.00 10.0000000000 FORMAT "%13.10" EXTENDED_LIMITS -32768.0000000 32767.9999847 /end CHARACTERISTIC
/begin CHARACTERISTIC EGRVlv_SmlSigNgvIKi_C "" VALUE 0x800795D8 Val_Ws32 99.9998301268 Ki 0.00 99.9998301268 FORMAT "%13.9" EXTENDED_LIMITS -1000000.00000 999999.999534 /end CHARACTERISTIC
/begin CHARACTERISTIC EGRVlv_SmlSigNgvPKp_C "" VALUE 0x800795DC Val_Ws32 131071.999969 Kp -65536.0000000 65535.9999695 FORMAT "%13.7" /end CHARACTERISTIC
/begin CHARACTERISTIC EGRVlv_SmlSigPsvDKd_C "" VALUE 0x800795E0 Val_Ws32 10.0000000000 Kd 0.00 10.0000000000 FORMAT "%13.10" EXTENDED_LIMITS -32768.0000000 32767.9999847 /end CHARACTERISTIC
/begin CHARACTERISTIC EGRVlv_SmlSigPsvIKi_C "" VALUE 0x800795E4 Val_Ws32 99.9998301268 Ki 0.00 99.9998301268 FORMAT "%13.9" EXTENDED_LIMITS -1000000.00000 999999.999534 /end CHARACTERISTIC
/begin CHARACTERISTIC EGRVlv_SmlSigPsvPKp_C "" VALUE 0x800795E8 Val_Ws32 10.0000000000 Kp 0.00 10.0000000000 FORMAT "%13.10" EXTENDED_LIMITS -65536.0000000 65535.9999695 /end CHARACTERISTIC
/begin CHARACTERISTIC EGRVlv_SRC.uMin_C "/" VALUE 0x80079526 Val_Ws16 5200.000 Volt 0.00 5200.000 FORMAT "%8.3" EXTENDED_LIMITS -6553.600 6553.400 /end CHARACTERISTIC
/begin CHARACTERISTIC EGRVlv_SRC.uMax_C "/" VALUE 0x80079528 Val_Ws16 5200.000 Volt 0.00 5200.000 FORMAT "%8.3" EXTENDED_LIMITS -6553.600 6553.400 /end CHARACTERISTIC
/begin CHARACTERISTIC EGRVlv_stNewVlvTrg_C "Maximale Schwelle der tatsächlich erfassten Ventilposition" VALUE 0x80079632 Val_Wu8 1.000 OneToOne 0.00 1.000 FORMAT "%5.3" EXTENDED_LIMITS 0.00 255.0 /end CHARACTERISTIC
/begin CHARACTERISTIC EGRVlv_stOfsLrnTrg_C "Maximale Schwelle der tatsächlich erfassten Ventilposition" VALUE 0x80079633 Val_Wu8 1.000 OneToOne 0.00 1.000 FORMAT "%5.3" EXTENDED_LIMITS 0.00 255.0 /end CHARACTERISTIC
/begin CHARACTERISTIC EGRVlv_stPwrStgDiaDis_C "Statuswort zur Sperrung der Endstufendiagnose unter bestimmten Fahrzeug- und Motorzuständen." VALUE 0x800794DA Val_Wu8 255.0 OneToOne 0.00 255.0 FORMAT "%5.1" /end CHARACTERISTIC
/begin CHARACTERISTIC EGRVlv_stPwrStgDis_C "Statuswort zur Sperrung der Endstufe unter bestimmten Fahrzeug- und Motorzuständen" VALUE 0x800794DB Val_Wu8 255.0 OneToOne 0.00 255.0 FORMAT "%5.1" /end CHARACTERISTIC
/begin CHARACTERISTIC EGRVlv_swtActOfs_C "" VALUE 0x80079634 Val_Wu8 1.000 OneToOne 0.00 1.000 FORMAT "%5.3" EXTENDED_LIMITS 0.00 255.0 /end CHARACTERISTIC
/begin CHARACTERISTIC EGRVlv_swtGovByp_C "" VALUE 0x8007954E Val_Wu8 1.000 OneToOne 0.00 1.000 FORMAT "%5.3" EXTENDED_LIMITS 0.00 255.0 /end CHARACTERISTIC
/begin CHARACTERISTIC EGRVlv_swtHwSel_C "" VALUE 0x800794DC Val_Wu8 255.0 OneToOne 0.00 255.0 FORMAT "%5.1" /end CHARACTERISTIC
/begin CHARACTERISTIC EGRVlv_swtLMSPwrStgOn_C "" VALUE 0x800794DD Val_Wu8 255.0 OneToOne 0.00 255.0 FORMAT "%5.1" /end CHARACTERISTIC
/begin CHARACTERISTIC EGRVlv_swtOfsLrnActv_C "" VALUE 0x80079635 Val_Wu8 255.0 OneToOne 0.00 255.0 FORMAT "%5.1" /end CHARACTERISTIC
/begin CHARACTERISTIC EGRVlv_swtSelDT1In_C "" VALUE 0x800795EC Val_Wu8 255.0 OneToOne 0.00 255.0 FORMAT "%5.1" /end CHARACTERISTIC
/begin CHARACTERISTIC EGRVlv_swtSensPrs_C "" VALUE 0x8007952A Val_Wu8 1.000 OneToOne 0.00 1.000 FORMAT "%5.3" EXTENDED_LIMITS 0.00 255.0 /end CHARACTERISTIC
/begin CHARACTERISTIC EGRVlv_tEngHi_C "" VALUE 0x80079550 Val_Ws16 250.0000 Temp_Cels -50.14000 199.8600 FORMAT "%8.4" EXTENDED_LIMITS -3549.940 3003.560 /end CHARACTERISTIC
/begin CHARACTERISTIC EGRVlv_tEngLo_C "" VALUE 0x80079552 Val_Ws16 250.0000 Temp_Cels -50.14000 199.8600 FORMAT "%8.4" EXTENDED_LIMITS -3549.940 3003.560 /end CHARACTERISTIC
/begin CHARACTERISTIC EGRVlv_tEngMax_C "Maximale Schwelle der tatsächlich erfassten Ventilposition" VALUE 0x80079636 Val_Ws16 250.0000 Temp_Cels -50.14000 199.8600 FORMAT "%8.4" EXTENDED_LIMITS -3549.940 3003.560 /end CHARACTERISTIC
/begin CHARACTERISTIC EGRVlv_tEngMin_C "Maximale Schwelle der tatsächlich erfassten Ventilposition" VALUE 0x80079638 Val_Ws16 250.0000 Temp_Cels -50.14000 199.8600 FORMAT "%8.4" EXTENDED_LIMITS -3549.940 3003.560 /end CHARACTERISTIC
/begin CHARACTERISTIC EGRVlv_tiAdapJamVlv_C "Maximale Schwelle der tatsächlich erfassten Ventilposition" VALUE 0x8007963A Val_Ws16 20000.00 Time_ms 0.00 20000.00 FORMAT "%8.2" EXTENDED_LIMITS -327680.0 327670.0 /end CHARACTERISTIC
/begin CHARACTERISTIC EGRVlv_tiAdapPullDwn_C "Maximale Schwelle der tatsächlich erfassten Ventilposition" VALUE 0x8007963C Val_Ws16 20000.00 Time_ms 0.00 20000.00 FORMAT "%8.2" EXTENDED_LIMITS -327680.0 327670.0 /end CHARACTERISTIC
/begin CHARACTERISTIC EGRVlv_tiBattCorFacFlt_C "Zeitkonstante zur Filterung des Batteriespannungskorrekturfaktors" VALUE 0x800794E0 Val_Ws32 4294.9672940 TimeDelay_s 0.000002000000001 4294.9672960 FORMAT "%12.7" /end CHARACTERISTIC
/begin CHARACTERISTIC EGRVlv_tiClsJamVlv_C "" VALUE 0x8007963E Val_Ws16 20000.00 Time_ms 0.00 20000.00 FORMAT "%8.2" EXTENDED_LIMITS -327680.0 327670.0 /end CHARACTERISTIC
/begin CHARACTERISTIC EGRVlv_tiCrntEffFlt_C "" VALUE 0x800795F0 Val_Ws32 4294.9672940 TimeDelay_s 0.000002000000001 4294.9672960 FORMAT "%12.7" /end CHARACTERISTIC
/begin CHARACTERISTIC EGRVlv_tiGovDT1_C "" VALUE 0x800795F4 Val_Ws32 4294.9662960 TimeDelay_s 0.0010000000689 4294.9672960 FORMAT "%12.7" EXTENDED_LIMITS 0.000002000000001 4294.9672960 /end CHARACTERISTIC
/begin CHARACTERISTIC EGRVlv_tiParDT1_C "Zeitkonstante von DT1-Element, das das Geschwindigkeitssignal der AGR-Ventilbewegung glättet" VALUE 0x800795F8 Val_Ws32 4294.9662960 TimeDelay_s 0.0010000000689 4294.9672960 FORMAT "%12.7" EXTENDED_LIMITS 0.000002000000001 4294.9672960 /end CHARACTERISTIC
/begin CHARACTERISTIC EGRVlv_tiPullDwn_C "Zeitgrenze zur Erkennung des unteren mechanischen Anschlags LS" VALUE 0x80079554 Val_Ws16 5.000000 Time_s 0.00 5.000000 FORMAT "%8.6" EXTENDED_LIMITS -327.6800 327.6700 /end CHARACTERISTIC
/begin CHARACTERISTIC EGRVlv_tiRepRls_C "Zeitschwelle zur Neuaktivierung der endgültigen Regelabweichlungs-Überwachung" VALUE 0x80079558 Val_Ws32 3600.00000000 Time_s 0.00 3600.00000000 FORMAT "%13.8" EXTENDED_LIMITS -21474836.4800 21474836.4700 /end CHARACTERISTIC
/begin CHARACTERISTIC EGRVlv_tiRls_C "Nachwirkungszeit der endgültigen Regelabweichung zur Erkennung des geklemmten AGR-Ventils" VALUE 0x8007955C Val_Ws16 5.000000 Time_s 0.00 5.000000 FORMAT "%8.6" EXTENDED_LIMITS -327.6800 327.6700 /end CHARACTERISTIC
/begin CHARACTERISTIC EGRVlv_TransStg.Dfl_C "/" VALUE 0x80079640 Kw_Ws16 100.0000 Prc 0.00 100.0000 FORMAT "%8.4" EXTENDED_LIMITS -400.0000 399.9878 /end CHARACTERISTIC
/begin CHARACTERISTIC EGRVlv_TransStg.stSensId_C "/" VALUE 0x80079642 Kw_Wu8 255.0 OneToOne 0.00 255.0 FORMAT "%5.1" /end CHARACTERISTIC
/begin CHARACTERISTIC EGRVlv_uBattMax_C "Maximale Schwelle der tatsächlich erfassten Ventilposition" VALUE 0x80079644 Val_Ws16 28600.00 Volt_Batt 0.00 28600.00 FORMAT "%8.2" EXTENDED_LIMITS -655360.0 655340.0 /end CHARACTERISTIC
/begin CHARACTERISTIC EGRVlv_uBattMin_C "Maximale Schwelle der tatsächlich erfassten Ventilposition" VALUE 0x80079646 Val_Ws16 28600.00 Volt_Batt 0.00 28600.00 FORMAT "%8.2" EXTENDED_LIMITS -655360.0 655340.0 /end CHARACTERISTIC
/begin CHARACTERISTIC EGT_stRgnLckMsk_C "" VALUE 0x8007964C Kw_Wu32 2147483647.00 OneToOne 0.00 2147483647.00 FORMAT "%13.2" EXTENDED_LIMITS 0.00 4294967295.00 /end CHARACTERISTIC
/begin CHARACTERISTIC EGT_swtEGTActv_C "" VALUE 0x80079648 Kw_Wu8 1.00000000000 EGT_swtVAL 0.00 1.00000000000 FORMAT "%13.11" EXTENDED_LIMITS 0.00 3.00000000000 /end CHARACTERISTIC
/begin CHARACTERISTIC EGT_swtRgnLckRst_C "" VALUE 0x80079650 Kw_Wu8 1.000 OneToOne 0.00 1.000 FORMAT "%5.3" EXTENDED_LIMITS 0.00 255.0 /end CHARACTERISTIC
/begin CHARACTERISTIC EGT_swtServiceVal_C "" VALUE 0x80079651 Kw_Wu8 1.000 OneToOne 0.00 1.000 FORMAT "%5.3" EXTENDED_LIMITS 0.00 255.0 /end CHARACTERISTIC
/begin CHARACTERISTIC EGT_swtSetEndRmpBit_C "" VALUE 0x80079649 Kw_Wu8 1.000 OneToOne 0.00 1.000 FORMAT "%5.3" EXTENDED_LIMITS 0.00 255.0 /end CHARACTERISTIC
/begin CHARACTERISTIC EGT_tiRgnOilDilMax_C "" VALUE 0x80079654 Kw_Ws32 500.000000000 Time_s 0.00 500.000000000 FORMAT "%13.9" EXTENDED_LIMITS -21474836.4800 21474836.4700 /end CHARACTERISTIC
/begin CHARACTERISTIC EGT_tiRgnOilDilSubs_C "" VALUE 0x80079658 Kw_Ws32 500.000000000 Time_s 0.00 500.000000000 FORMAT "%13.9" EXTENDED_LIMITS -21474836.4800 21474836.4700 /end CHARACTERISTIC
/begin CHARACTERISTIC EGT_tiRmpSlpMax_C "" VALUE 0x8007965C Kw_Wu32 20.852363636363634 TimeEGTRmp 0.992969696969697 21.845333333333333 FORMAT "%19.16" EXTENDED_LIMITS 0.000000015258789 65.536000000000001 /end CHARACTERISTIC
/begin CHARACTERISTIC EMCtl_nEngHysDelta_C "" VALUE 0x8004BAD2 Val_Ws16 32767.50 EngN -16384.00 16383.50 FORMAT "%8.2" /end CHARACTERISTIC
/begin CHARACTERISTIC EMCtl_nEngHysHi_CUR "" CURVE 0x8004BAD4 Cur_Xs16Ws16 65535.00 EngN -32768.00 32767.00 FORMAT "%8.2" EXTENDED_LIMITS -16384.00 16383.50
 /begin AXIS_DESCR STD_AXIS EngDa_tEng Temp_Cels 4 -50.14000 199.8600 FORMAT "%8.4" EXTENDED_LIMITS -3549.940 3003.560 DEPOSIT ABSOLUTE /end AXIS_DESCR
/end CHARACTERISTIC
/begin CHARACTERISTIC EMCtl_nEngLim_C "" VALUE 0x8004BAE6 Val_Ws16 6000.000 EngN 0.00 6000.000 FORMAT "%8.3" EXTENDED_LIMITS -16384.00 16383.50 /end CHARACTERISTIC
/begin CHARACTERISTIC EMCtl_rOutHard_C "" VALUE 0x8004BAE8 Val_Ws16 255.0049 Prc 0.00 255.0049 FORMAT "%8.4" EXTENDED_LIMITS -400.0000 399.9878 /end CHARACTERISTIC
/begin CHARACTERISTIC EMCtl_rOutSoft_C "" VALUE 0x8004BAEA Val_Ws16 255.0049 Prc 0.00 255.0049 FORMAT "%8.4" EXTENDED_LIMITS -400.0000 399.9878 /end CHARACTERISTIC
/begin CHARACTERISTIC EMCtl_tiHardAftrGear_C "" VALUE 0x8004BAEC Val_Wu16 655.0000 Time_s 0.00 655.0000 FORMAT "%8.4" EXTENDED_LIMITS 0.00 655.3500 /end CHARACTERISTIC
/begin CHARACTERISTIC EMCtl_tiSoftAftrStrt_C "" VALUE 0x8004BAEE Val_Wu16 655.0000 Time_s 0.00 655.0000 FORMAT "%8.4" EXTENDED_LIMITS 0.00 655.3500 /end CHARACTERISTIC
/begin CHARACTERISTIC EMCtl_vXHysHi_C "" VALUE 0x8004BAF0 Val_Ws16 300.0000 Vel 0.00 300.0000 FORMAT "%8.4" EXTENDED_LIMITS -327.6800 327.6700 /end CHARACTERISTIC
/begin CHARACTERISTIC EMCtl_vXHysLo_C "" VALUE 0x8004BAF2 Val_Ws16 300.0000 Vel 0.00 300.0000 FORMAT "%8.4" EXTENDED_LIMITS -327.6800 327.6700 /end CHARACTERISTIC
/begin CHARACTERISTIC EMDmp_DigOut.tiBtwTstSCB_C "/" VALUE 0x8004BAF4 Kw_Ws16 1000.000 Time_ms 0.00 1000.000 FORMAT "%8.3" EXTENDED_LIMITS -327680.0 327670.0 /end CHARACTERISTIC
/begin CHARACTERISTIC EMDmp_DigOut.tiBtwTstOT_C "/" VALUE 0x8004BAF6 Kw_Ws16 1000.000 Time_s 0.00 1000.000 FORMAT "%8.3" EXTENDED_LIMITS -327.6800 327.6700 /end CHARACTERISTIC
/begin CHARACTERISTIC EMDmp_DigOut.numTstMax_C "/" VALUE 0x8004BAF8 Kw_Wu16 65535.00 OneToOne 0.00 65535.00 FORMAT "%8.2" /end CHARACTERISTIC
/begin CHARACTERISTIC EMDmp_Pwm.tiPer_C "/" VALUE 0x8004BAFA Val_Ws16 9.900000 Period 0.1000000 10.00000 FORMAT "%8.5" EXTENDED_LIMITS -3276.800 3276.700 /end CHARACTERISTIC
/begin CHARACTERISTIC EMDmp_Pwm.stLvl_C "/" VALUE 0x8004BAFC Val_Wu8 1.000 OneToOne 0.00 1.000 FORMAT "%5.3" EXTENDED_LIMITS 0.00 255.0 /end CHARACTERISTIC
/begin CHARACTERISTIC EMDmp_Pwm.rMaxDty_C "/" VALUE 0x8004BAFE Val_Ws16 100.0000 DtyCyc 0.00 100.0000 FORMAT "%8.4" EXTENDED_LIMITS -327.6800 327.6700 /end CHARACTERISTIC
/begin CHARACTERISTIC EMDmp_Pwm.rPerUn_C "/" VALUE 0x8004BB00 Val_Ws16 3276.700 Period 0.00 3276.700 FORMAT "%8.3" EXTENDED_LIMITS -3276.800 3276.700 /end CHARACTERISTIC
/begin CHARACTERISTIC EMDmp_Pwm.tiPh_C "/" VALUE 0x8004BB02 Val_Ws16 65535.00 OneToOne -32768.00 32767.00 FORMAT "%8.2" /end CHARACTERISTIC
/begin CHARACTERISTIC EMDmp_PwmOut.rMin_C "/" VALUE 0x8004BB04 Kw_Ws16 100.0000 DtyCyc 0.00 100.0000 FORMAT "%8.4" EXTENDED_LIMITS -327.6800 327.6700 /end CHARACTERISTIC
/begin CHARACTERISTIC EMDmp_PwmOut.rMax_C "/" VALUE 0x8004BB06 Kw_Ws16 100.0000 DtyCyc 0.00 100.0000 FORMAT "%8.4" EXTENDED_LIMITS -327.6800 327.6700 /end CHARACTERISTIC
/begin CHARACTERISTIC EMDmp_PwmOut.tiBtwTstSCB_C "/" VALUE 0x8004BB08 Kw_Ws16 1000.000 Time_ms 0.00 1000.000 FORMAT "%8.3" EXTENDED_LIMITS -327680.0 327670.0 /end CHARACTERISTIC
/begin CHARACTERISTIC EMDmp_PwmOut.tiBtwTstOT_C "/" VALUE 0x8004BB0A Kw_Ws16 327.6700 Time_s 0.00 327.6700 FORMAT "%8.4" EXTENDED_LIMITS -327.6800 327.6700 /end CHARACTERISTIC
/begin CHARACTERISTIC EMDmp_PwmOut.numTstMax_C "/" VALUE 0x8004BB0C Kw_Wu16 65535.00 OneToOne 0.00 65535.00 FORMAT "%8.2" /end CHARACTERISTIC
/begin CHARACTERISTIC EMDmp_PwmOut.swtBattCor_C "/" VALUE 0x8004BB0E Kw_Wu8 1.000 OneToOne 0.00 1.000 FORMAT "%5.3" EXTENDED_LIMITS 0.00 255.0 /end CHARACTERISTIC
/begin CHARACTERISTIC EMDmp_PwmOut.swtPsInv_C "/" VALUE 0x8004BB0F Kw_Wu8 255.0 OneToOne 0.00 255.0 FORMAT "%5.1" /end CHARACTERISTIC
/begin CHARACTERISTIC EMDmp_rCnv0_CUR "" CURVE 0x8004BB10 Cur_Xs16Ws16 100.0000 DtyCyc 0.00 100.0000 FORMAT "%8.4" EXTENDED_LIMITS -327.6800 327.6700
 /begin AXIS_DESCR STD_AXIS EMDmp_r0 Prc 16 -400.0000 399.9878 FORMAT "%8.4" DEPOSIT ABSOLUTE /end AXIS_DESCR
/end CHARACTERISTIC
/begin CHARACTERISTIC EMDmp_rCnv1_CUR "" CURVE 0x8004BB52 Cur_Xs16Ws16 100.0000 DtyCyc 0.00 100.0000 FORMAT "%8.4" EXTENDED_LIMITS -327.6800 327.6700
 /begin AXIS_DESCR STD_AXIS EMDmp_r1 Prc 16 -400.0000 399.9878 FORMAT "%8.4" DEPOSIT ABSOLUTE /end AXIS_DESCR
/end CHARACTERISTIC
/begin CHARACTERISTIC EMDmp_rThresHi_CA "" VAL_BLK 0x8004BB94 ValA_Ws16 799.9878 Prc -400.0000 399.9878 FORMAT "%8.4" NUMBER 1 /end CHARACTERISTIC
/begin CHARACTERISTIC EMDmp_rThresLo_CA "" VAL_BLK 0x8004BB96 ValA_Ws16 799.9878 Prc -400.0000 399.9878 FORMAT "%8.4" NUMBER 1 /end CHARACTERISTIC
/begin CHARACTERISTIC EMDmp_stPsDiaDisbl_CA "" VAL_BLK 0x8004BB98 ValA_Wu8 255.0 OneToOne 0.00 255.0 FORMAT "%5.1" NUMBER 1 /end CHARACTERISTIC
/begin CHARACTERISTIC EMDmp_stPwrStgDis_CA "" VAL_BLK 0x8004BB99 ValA_Wu8 255.0 OneToOne 0.00 255.0 FORMAT "%5.1" NUMBER 1 /end CHARACTERISTIC
/begin CHARACTERISTIC EMDmp_swtHWsel_C "" VALUE 0x8004BB9A Val_Wu8 255.0 OneToOne 0.00 255.0 FORMAT "%5.1" /end CHARACTERISTIC
/begin CHARACTERISTIC EngDa_lEepUpd_C "Streckenintervall zwischen zwei EEPROM Block Updates für EngDa_tiEngOn" VALUE 0x8004D47C Val_Ws32 2147473647.00 Length 10000.0000000 2147483647.00 FORMAT "%13.2" EXTENDED_LIMITS -2147483648.00 2147483647.00 /end CHARACTERISTIC
/begin CHARACTERISTIC EngDa_tEng_C "" VALUE 0x8004D47A Val_Wu8 1.00000000000 EngTempFldSel 0.00 1.00000000000 FORMAT "%13.11" EXTENDED_LIMITS 0.00 2.00000000000 /end CHARACTERISTIC
/begin CHARACTERISTIC EngDem_dnOvrFulMax_C "obere Hysteresegrenze für Overfueling Drehzahlgradient" VALUE 0x8004D480 Val_Ws16 327675.0 dn_dZ20 -163840.0 163835.0 FORMAT "%8.1" /end CHARACTERISTIC
/begin CHARACTERISTIC EngDem_dnOvrFulMin_C "untere Hysteresegrenze für Overfueling Drehzahlgradient" VALUE 0x8004D482 Val_Ws16 327675.0 dn_dZ20 -163840.0 163835.0 FORMAT "%8.1" /end CHARACTERISTIC
/begin CHARACTERISTIC EngDem_dtrqEngPrtRgnMon.Pos_C "Steigung zur Aufwärtsrampung im Fehlerfall/" VALUE 0x8004D484 Kw_Ws32 3276799.99847 RmpTrq 0.00 3276799.99847 FORMAT "%13.5" EXTENDED_LIMITS -3276800.00000 3276799.99847 /end CHARACTERISTIC
/begin CHARACTERISTIC EngDem_dtrqEngPrtRgnMon.Neg_C "Steigung zur Aufwärtsrampung im Fehlerfall/" VALUE 0x8004D488 Kw_Ws32 3276799.99847 RmpTrq 0.00 3276799.99847 FORMAT "%13.5" EXTENDED_LIMITS -3276800.00000 3276799.99847 /end CHARACTERISTIC
/begin CHARACTERISTIC EngDem_dtrqOvrFulDown_C "Steigung für Overfueling Rampe (down)" VALUE 0x8004D48C Val_Ws32 6553599.99847 RmpTrq -3276800.00000 3276799.99847 FORMAT "%13.5" /end CHARACTERISTIC
/begin CHARACTERISTIC EngDem_dtrqOvrFulUp_C "Steigung für Overfueling Rampe (up)" VALUE 0x8004D490 Val_Ws32 6553599.99847 RmpTrq -3276800.00000 3276799.99847 FORMAT "%13.5" /end CHARACTERISTIC
/begin CHARACTERISTIC EngDem_EpmNEngDT1.T1_C "Zeit für Overfueling DT1/" VALUE 0x8004D494 Kw_Ws32 4294.9672940 TimeDelay_s 0.000002000000001 4294.9672960 FORMAT "%12.7" /end CHARACTERISTIC
/begin CHARACTERISTIC EngDem_EpmNEngDT1.Kd_C "Zeit für Overfueling DT1/" VALUE 0x8004D498 Kw_Ws32 65535.9999847 Kd_rpm2dndt -32768.0000000 32767.9999847 FORMAT "%13.7" /end CHARACTERISTIC
/begin CHARACTERISTIC EngDem_facAdjMax_C "Max. Abgleichwert." VALUE 0x8004D49C Val_Ws16 7.999878 Fact -4.000000 3.999878 FORMAT "%8.6" /end CHARACTERISTIC
/begin CHARACTERISTIC EngDem_facAdjMin_C "Min. Abgleichwert" VALUE 0x8004D49E Val_Ws16 7.999878 Fact -4.000000 3.999878 FORMAT "%8.6" /end CHARACTERISTIC
/begin CHARACTERISTIC EngDem_nOvrFulMax_C "obere Hysteresegrenze für Overfueling Motordrehzahl" VALUE 0x8004D4A0 Val_Ws16 5960.000 EngN 40.00000 6000.000 FORMAT "%8.3" EXTENDED_LIMITS -16384.00 16383.50 /end CHARACTERISTIC
/begin CHARACTERISTIC EngDem_nOvrFulMin_C "untere Hysteresegrenze für Overfueling Motordrehzahl" VALUE 0x8004D4A2 Val_Ws16 5960.000 EngN 40.00000 6000.000 FORMAT "%8.3" EXTENDED_LIMITS -16384.00 16383.50 /end CHARACTERISTIC
/begin CHARACTERISTIC EngDem_RmpLimErr.Pos_C "positive Rampensteigung für Rampenschalter/" VALUE 0x8004D4A4 Kw_Ws32 3276799.99847 RmpTrq 0.00 3276799.99847 FORMAT "%13.5" EXTENDED_LIMITS -3276800.00000 3276799.99847 /end CHARACTERISTIC
/begin CHARACTERISTIC EngDem_RmpLimErr.Neg_C "positive Rampensteigung für Rampenschalter/" VALUE 0x8004D4A8 Kw_Ws32 3276799.99847 RmpTrq 0.00 3276799.99847 FORMAT "%13.5" EXTENDED_LIMITS -3276800.00000 3276799.99847 /end CHARACTERISTIC
/begin CHARACTERISTIC EngDem_RmpLimErr1.Pos_C "positive Rampensteigung für Rampenschalter/" VALUE 0x8004D4AC Kw_Ws32 3276799.99847 RmpTrq 0.00 3276799.99847 FORMAT "%13.5" EXTENDED_LIMITS -3276800.00000 3276799.99847 /end CHARACTERISTIC
/begin CHARACTERISTIC EngDem_RmpLimErr1.Neg_C "positive Rampensteigung für Rampenschalter/" VALUE 0x8004D4B0 Kw_Ws32 3276799.99847 RmpTrq 0.00 3276799.99847 FORMAT "%13.5" EXTENDED_LIMITS -3276800.00000 3276799.99847 /end CHARACTERISTIC
/begin CHARACTERISTIC EngDem_RmpLimErr2.Pos_C "positive Rampensteigung für Rampenschalter/" VALUE 0x8004D4B4 Kw_Ws32 3276799.99847 RmpTrq 0.00 3276799.99847 FORMAT "%13.5" EXTENDED_LIMITS -3276800.00000 3276799.99847 /end CHARACTERISTIC
/begin CHARACTERISTIC EngDem_RmpLimErr2.Neg_C "positive Rampensteigung für Rampenschalter/" VALUE 0x8004D4B8 Kw_Ws32 3276799.99847 RmpTrq 0.00 3276799.99847 FORMAT "%13.5" EXTENDED_LIMITS -3276800.00000 3276799.99847 /end CHARACTERISTIC
/begin CHARACTERISTIC EngDem_RmpLimErr3.Pos_C "positive Rampensteigung für Rampenschalter/" VALUE 0x8004D4BC Kw_Ws32 3276799.99847 RmpTrq 0.00 3276799.99847 FORMAT "%13.5" EXTENDED_LIMITS -3276800.00000 3276799.99847 /end CHARACTERISTIC
/begin CHARACTERISTIC EngDem_RmpLimErr3.Neg_C "positive Rampensteigung für Rampenschalter/" VALUE 0x8004D4C0 Kw_Ws32 3276799.99847 RmpTrq 0.00 3276799.99847 FORMAT "%13.5" EXTENDED_LIMITS -3276800.00000 3276799.99847 /end CHARACTERISTIC
/begin CHARACTERISTIC EngDem_RmpLimErr4.Pos_C "positive Rampensteigung für Rampenschalter/" VALUE 0x8004D4C4 Kw_Ws32 3276799.99847 RmpTrq 0.00 3276799.99847 FORMAT "%13.5" EXTENDED_LIMITS -3276800.00000 3276799.99847 /end CHARACTERISTIC
/begin CHARACTERISTIC EngDem_RmpLimErr4.Neg_C "positive Rampensteigung für Rampenschalter/" VALUE 0x8004D4C8 Kw_Ws32 3276799.99847 RmpTrq 0.00 3276799.99847 FORMAT "%13.5" EXTENDED_LIMITS -3276800.00000 3276799.99847 /end CHARACTERISTIC
/begin CHARACTERISTIC EngDem_RmpOvrFul.Pos_C "Steigung des Drehmoments (Nm/s) für Overfueling ramp switch/" VALUE 0x8004D4CC Kw_Ws32 3276799.99847 RmpTrq 0.00 3276799.99847 FORMAT "%13.5" EXTENDED_LIMITS -3276800.00000 3276799.99847 /end CHARACTERISTIC
/begin CHARACTERISTIC EngDem_RmpOvrFul.Neg_C "Steigung des Drehmoments (Nm/s) für Overfueling ramp switch/" VALUE 0x8004D4D0 Kw_Ws32 3276799.99847 RmpTrq 0.00 3276799.99847 FORMAT "%13.5" EXTENDED_LIMITS -3276800.00000 3276799.99847 /end CHARACTERISTIC
/begin CHARACTERISTIC EngDem_rOvrFulMax_C "obere Hysteresegrenze für Overfueling Gaspedalposition" VALUE 0x8004D4D4 Val_Ws16 100.0000 Prc 0.00 100.0000 FORMAT "%8.4" EXTENDED_LIMITS -400.0000 399.9878 /end CHARACTERISTIC
/begin CHARACTERISTIC EngDem_rOvrFulMin_C "untere Hysteresegrenze für Overfueling Gaspedalposition" VALUE 0x8004D4D6 Val_Ws16 100.0000 Prc 0.00 100.0000 FORMAT "%8.4" EXTENDED_LIMITS -400.0000 399.9878 /end CHARACTERISTIC
/begin CHARACTERISTIC EngDem_swtPPreCat_C "Schalter für Auswahl Differenzdruck" VALUE 0x8004D4D8 Val_Wu8 1.000 OneToOne 0.00 1.000 FORMAT "%5.3" EXTENDED_LIMITS 0.00 255.0 /end CHARACTERISTIC
/begin CHARACTERISTIC EngDem_tiPFltdVolPT1_C "Filterzeitkonstante für Abgasvolumenstrom" VALUE 0x8004D4DC Val_Ws32 4294.9672940 TimeDelay_s 0.000002000000001 4294.9672960 FORMAT "%12.7" /end CHARACTERISTIC
/begin CHARACTERISTIC EngDem_tiPFltResFlowPT1_C "Filterzeitkonstante für Strömungswiderstand" VALUE 0x8004D4E0 Val_Ws32 4294.9672940 TimeDelay_s 0.000002000000001 4294.9672960 FORMAT "%12.7" /end CHARACTERISTIC
/begin CHARACTERISTIC EngDem_tiRepOvrFul_C "Sperrzeit nach einem Overfueling Eingriff" VALUE 0x8004D4E4 Val_Ws32 21474836.4700 Time_s 0.00 21474836.4700 FORMAT "%13.4" EXTENDED_LIMITS -21474836.4800 21474836.4700 /end CHARACTERISTIC
/begin CHARACTERISTIC EngDem_trqLimErr1_CUR "Kennlinie zur Ermittelung des Begrenzungsmomentes 1 aus der Drehzahl" CURVE 0x8004D4E8 Cur_Xs16Ws16 1000.000 Trq 0.00 1000.000 FORMAT "%8.3" EXTENDED_LIMITS -3276.800 3276.700
 /begin AXIS_DESCR STD_AXIS Epm_nEng EngN 10 0.00 6000.000 FORMAT "%8.3" EXTENDED_LIMITS -16384.00 16383.50 DEPOSIT ABSOLUTE /end AXIS_DESCR
/end CHARACTERISTIC
/begin CHARACTERISTIC EngDem_trqLimErr2_CUR "Kennlinie zur Ermittelung des Begrenzungsmomentes 2 aus der Drehzahl" CURVE 0x8004D512 Cur_Xs16Ws16 1000.000 Trq 0.00 1000.000 FORMAT "%8.3" EXTENDED_LIMITS -3276.800 3276.700
 /begin AXIS_DESCR STD_AXIS Epm_nEng EngN 10 0.00 6000.000 FORMAT "%8.3" EXTENDED_LIMITS -16384.00 16383.50 DEPOSIT ABSOLUTE /end AXIS_DESCR
/end CHARACTERISTIC
/begin CHARACTERISTIC EngDem_trqLimErr3_CUR "Kennlinie zur Ermittelung des Begrenzungsmomentes 3 aus der Drehzahl" CURVE 0x8004D53C Cur_Xs16Ws16 1000.000 Trq 0.00 1000.000 FORMAT "%8.3" EXTENDED_LIMITS -3276.800 3276.700
 /begin AXIS_DESCR STD_AXIS Epm_nEng EngN 10 0.00 6000.000 FORMAT "%8.3" EXTENDED_LIMITS -16384.00 16383.50 DEPOSIT ABSOLUTE /end AXIS_DESCR
/end CHARACTERISTIC
/begin CHARACTERISTIC EngDem_trqLimErr4_CUR "Kennlinie zur Ermittelung des Begrenzungsmomentes 4 aus der Drehzahl" CURVE 0x8004D566 Cur_Xs16Ws16 1000.000 Trq 0.00 1000.000 FORMAT "%8.3" EXTENDED_LIMITS -3276.800 3276.700
 /begin AXIS_DESCR STD_AXIS Epm_nEng EngN 10 0.00 6000.000 FORMAT "%8.3" EXTENDED_LIMITS -16384.00 16383.50 DEPOSIT ABSOLUTE /end AXIS_DESCR
/end CHARACTERISTIC
/begin CHARACTERISTIC EngDem_trqLimErrLeadMax_C "Begrenzungsmoment Leadpfad bei keinem Momentbegrenzungsfehler" VALUE 0x8004D590 Val_Ws16 1000.000 Trq 0.00 1000.000 FORMAT "%8.3" EXTENDED_LIMITS -3276.800 3276.700 /end CHARACTERISTIC
/begin CHARACTERISTIC EngDem_trqLimErr_CUR "Kennlinie für das Begrenzungsmoment bei Systemfehlern" CURVE 0x8004D592 Cur_Xs16Ws16 1000.000 Trq 0.00 1000.000 FORMAT "%8.3" EXTENDED_LIMITS -3276.800 3276.700
 /begin AXIS_DESCR STD_AXIS Epm_nEng EngN 10 0.00 6000.000 FORMAT "%8.3" EXTENDED_LIMITS -16384.00 16383.50 DEPOSIT ABSOLUTE /end AXIS_DESCR
/end CHARACTERISTIC
/begin CHARACTERISTIC EngDem_trqLimPDiff1_CUR "Begrenzungsmoment PFlt Notfahrbetrieb" CURVE 0x8004D5BC Cur_Xs16Ws16 1500.000 Trq -500.0000 1000.000 FORMAT "%8.3" EXTENDED_LIMITS -3276.800 3276.700
 /begin AXIS_DESCR STD_AXIS Exh_pAdapPFltDiff Pres_hPa 8 0.00 3500.000 FORMAT "%8.3" EXTENDED_LIMITS -32768.00 32767.00 DEPOSIT ABSOLUTE /end AXIS_DESCR
/end CHARACTERISTIC
/begin CHARACTERISTIC EngDem_trqLimPDiffNOffs_CUR "Begrenzungswert im Fall des pflt-Systemfehlers, Startmoment ansteigen" CURVE 0x8004D5DE Cur_Xs16Ws16 1000.000 Trq 0.00 1000.000 FORMAT "%8.3" EXTENDED_LIMITS -3276.800 3276.700
 /begin AXIS_DESCR STD_AXIS Epm_nEng EngN 16 0.00 6000.000 FORMAT "%8.3" EXTENDED_LIMITS -16384.00 16383.50 DEPOSIT ABSOLUTE /end AXIS_DESCR
/end CHARACTERISTIC
/begin CHARACTERISTIC EngDem_trqLimPDiff_MAP "Begrenzungsmoment aufgrund Abgasgegendruck" MAP 0x8004D620 Map_Xs16Ys16Ws16 1500.000 Trq -500.0000 1000.000 FORMAT "%8.3" EXTENDED_LIMITS -3276.800 3276.700
 /begin AXIS_DESCR STD_AXIS EngDem_pDiffPFltPrdc2_mp Pres_hPa 16 0.00 3500.000 FORMAT "%8.3" EXTENDED_LIMITS -32768.00 32767.00 DEPOSIT ABSOLUTE /end AXIS_DESCR
 /begin AXIS_DESCR STD_AXIS Epm_nEng EngN 8 0.00 6000.000 FORMAT "%8.3" EXTENDED_LIMITS -16384.00 16383.50 DEPOSIT ABSOLUTE /end AXIS_DESCR
/end CHARACTERISTIC
/begin CHARACTERISTIC EngDem_trqOvrFulMax_C "oberer Wert für Overfueling Rampe" VALUE 0x8004D754 Val_Ws16 1000.000 Trq 0.00 1000.000 FORMAT "%8.3" EXTENDED_LIMITS -3276.800 3276.700 /end CHARACTERISTIC
/begin CHARACTERISTIC EngDem_trqOvrFulMin_C "unterer Wert für Overfueling Rampe" VALUE 0x8004D756 Val_Ws16 1000.000 Trq 0.00 1000.000 FORMAT "%8.3" EXTENDED_LIMITS -3276.800 3276.700 /end CHARACTERISTIC
/begin CHARACTERISTIC EngDem_vOvrFulMax_C "obere Hysteresegrenze für Overfueling Fahrgeschwindigkeit" VALUE 0x8004D758 Val_Ws16 300.0000 Vel 0.00 300.0000 FORMAT "%8.4" EXTENDED_LIMITS -327.6800 327.6700 /end CHARACTERISTIC
/begin CHARACTERISTIC EngDem_vOvrFulMin_C "untere Hysteresegrenze für Overfueling Fahrgeschwindigkeit" VALUE 0x8004D75A Val_Ws16 300.0000 Vel 0.00 300.0000 FORMAT "%8.4" EXTENDED_LIMITS -327.6800 327.6700 /end CHARACTERISTIC
/begin MEASUREMENT ASMod_dVolPFltEG "" SWORD CubMtrPerHr 1 100 -3276.800 3276.700 FORMAT "%8.3" ECU_ADDRESS 0xD00069AA /end MEASUREMENT
/begin MEASUREMENT Com_dDay "" UBYTE OneToOne 1 100 0.00 255.0 FORMAT "%5.1" ECU_ADDRESS 0xD0008F73 /end MEASUREMENT
/begin MEASUREMENT Com_dMonth "" UBYTE OneToOne 1 100 0.00 255.0 FORMAT "%5.1" ECU_ADDRESS 0xD0008F74 /end MEASUREMENT
/begin MEASUREMENT Com_dStKombiCTR "" UWORD OneToOne 1 100 0.00 65535.00 FORMAT "%8.2" ECU_ADDRESS 0xD000762A /end MEASUREMENT
/begin MEASUREMENT Com_dTestMsg "" UWORD OneToOne 1 100 0.00 65535.00 FORMAT "%8.2" ECU_ADDRESS 0xD0007630 /end MEASUREMENT
/begin MEASUREMENT Com_dTestSig "" UWORD OneToOne 1 100 0.00 65535.00 FORMAT "%8.2" ECU_ADDRESS 0xD0007632 /end MEASUREMENT
/begin MEASUREMENT Com_dYear "" UWORD OneToOne 1 100 0.00 65535.00 FORMAT "%8.2" ECU_ADDRESS 0xD0007642 /end MEASUREMENT
/begin MEASUREMENT Com_lSum "" ULONG OneToOne_km 1 100 0.00 4294967295.00 FORMAT "%13.2" ECU_ADDRESS 0xD0004500 /end MEASUREMENT
/begin MEASUREMENT Com_stSeason "" UBYTE OneToOne 1 100 0.00 255.0 FORMAT "%5.1" ECU_ADDRESS 0xD0008F9E /end MEASUREMENT
/begin MEASUREMENT Com_tEnvT "" SWORD Temp_Cels 1 100 -3549.940 3003.560 FORMAT "%8.3" ECU_ADDRESS 0xD0006D0E /end MEASUREMENT
/begin MEASUREMENT Com_volFlTnkQnt "" UBYTE OneToOne_l 1 100 0.00 255.0 FORMAT "%5.1" ECU_ADDRESS 0xD0008FB1 /end MEASUREMENT
/begin MEASUREMENT DSCHED_DynPrio.FId_Unused "" SWORD DFC_OneToOne 1 100 -32768.00 32767.00 FORMAT "%8.2" ECU_ADDRESS 0xD0006310 /end MEASUREMENT
/begin MEASUREMENT DSCHED_DynPrio.FId_InhibitAlways "" SWORD DFC_OneToOne 1 100 -32768.00 32767.00 FORMAT "%8.2" ECU_ADDRESS 0xD0006312 /end MEASUREMENT
/begin MEASUREMENT DSCHED_DynPrio.FId_CoordALS "" SWORD DFC_OneToOne 1 100 -32768.00 32767.00 FORMAT "%8.2" ECU_ADDRESS 0xD0006314 /end MEASUREMENT
/begin MEASUREMENT DSCHED_DynPrio.FId_CoordFBC "" SWORD DFC_OneToOne 1 100 -32768.00 32767.00 FORMAT "%8.2" ECU_ADDRESS 0xD0006316 /end MEASUREMENT
/begin MEASUREMENT DSCHED_DynPrio.FId_CoordTAA "" SWORD DFC_OneToOne 1 100 -32768.00 32767.00 FORMAT "%8.2" ECU_ADDRESS 0xD0006318 /end MEASUREMENT
/begin MEASUREMENT DSCHED_DynPrio.FId_CoordZFC "" SWORD DFC_OneToOne 1 100 -32768.00 32767.00 FORMAT "%8.2" ECU_ADDRESS 0xD000631A /end MEASUREMENT
/begin MEASUREMENT DSCHED_PhysPrio.FId_Unused "" UBYTE DFC_OneToOne 1 100 0.00 255.0000 FORMAT "%8.4" ECU_ADDRESS 0xD00088F8 /end MEASUREMENT
/begin MEASUREMENT DSCHED_PhysPrio.FId_InhibitAlways "" UBYTE DFC_OneToOne 1 100 0.00 255.0000 FORMAT "%8.4" ECU_ADDRESS 0xD00088F9 /end MEASUREMENT
/begin MEASUREMENT DSCHED_PhysPrio.FId_CoordALS "" UBYTE DFC_OneToOne 1 100 0.00 255.0000 FORMAT "%8.4" ECU_ADDRESS 0xD00088FA /end MEASUREMENT
/begin MEASUREMENT DSCHED_PhysPrio.FId_CoordFBC "" UBYTE DFC_OneToOne 1 100 0.00 255.0000 FORMAT "%8.4" ECU_ADDRESS 0xD00088FB /end MEASUREMENT
/begin MEASUREMENT DSCHED_PhysPrio.FId_CoordTAA "" UBYTE DFC_OneToOne 1 100 0.00 255.0000 FORMAT "%8.4" ECU_ADDRESS 0xD00088FC /end MEASUREMENT
/begin MEASUREMENT DSCHED_PhysPrio.FId_CoordZFC "" UBYTE DFC_OneToOne 1 100 0.00 255.0000 FORMAT "%8.4" ECU_ADDRESS 0xD00088FD /end MEASUREMENT
/begin MEASUREMENT DSCHED_RmpPrio.FId_Unused "" UWORD DFC_OneToOne 1 100 0.00 65535.00 FORMAT "%8.2" ECU_ADDRESS 0xD00062EC /end MEASUREMENT
/begin MEASUREMENT DSCHED_RmpPrio.FId_InhibitAlways "" UWORD DFC_OneToOne 1 100 0.00 65535.00 FORMAT "%8.2" ECU_ADDRESS 0xD00062EE /end MEASUREMENT
/begin MEASUREMENT DSCHED_RmpPrio.FId_CoordALS "" UWORD DFC_OneToOne 1 100 0.00 65535.00 FORMAT "%8.2" ECU_ADDRESS 0xD00062F0 /end MEASUREMENT
/begin MEASUREMENT DSCHED_RmpPrio.FId_CoordFBC "" UWORD DFC_OneToOne 1 100 0.00 65535.00 FORMAT "%8.2" ECU_ADDRESS 0xD00062F2 /end MEASUREMENT
/begin MEASUREMENT DSCHED_RmpPrio.FId_CoordTAA "" UWORD DFC_OneToOne 1 100 0.00 65535.00 FORMAT "%8.2" ECU_ADDRESS 0xD00062F4 /end MEASUREMENT
/begin MEASUREMENT DSCHED_RmpPrio.FId_CoordZFC "" UWORD DFC_OneToOne 1 100 0.00 65535.00 FORMAT "%8.2" ECU_ADDRESS 0xD00062F6 /end MEASUREMENT
/begin MEASUREMENT DSCHED_St.FId_Unused "" UBYTE DSCHED_StVerb 1 100 0.00 238. FORMAT "%2.0" ECU_ADDRESS 0xD00088F2 /end MEASUREMENT
/begin MEASUREMENT DSCHED_St.FId_InhibitAlways "" UBYTE DSCHED_StVerb 1 100 0.00 238. FORMAT "%2.0" ECU_ADDRESS 0xD00088F3 /end MEASUREMENT
/begin MEASUREMENT DSCHED_St.FId_CoordALS "" UBYTE DSCHED_StVerb 1 100 0.00 238. FORMAT "%2.0" ECU_ADDRESS 0xD00088F4 /end MEASUREMENT
/begin MEASUREMENT DSCHED_St.FId_CoordFBC "" UBYTE DSCHED_StVerb 1 100 0.00 238. FORMAT "%2.0" ECU_ADDRESS 0xD00088F5 /end MEASUREMENT
/begin MEASUREMENT DSCHED_St.FId_CoordTAA "" UBYTE DSCHED_StVerb 1 100 0.00 238. FORMAT "%2.0" ECU_ADDRESS 0xD00088F6 /end MEASUREMENT
/begin MEASUREMENT DSCHED_St.FId_CoordZFC "" UBYTE DSCHED_StVerb 1 100 0.00 238. FORMAT "%2.0" ECU_ADDRESS 0xD00088F7 /end MEASUREMENT
/begin MEASUREMENT DSCHED_TiActv.FId_Unused "" UWORD DFC_OneToOne 1 100 0.00 65535.00 FORMAT "%8.2" ECU_ADDRESS 0xD00062F8 /end MEASUREMENT
/begin MEASUREMENT DSCHED_TiActv.FId_InhibitAlways "" UWORD DSCHED_Time200ms 1 100 0.00 13107.00 FORMAT "%8.2" ECU_ADDRESS 0xD00062FA /end MEASUREMENT
/begin MEASUREMENT DSCHED_TiActv.FId_CoordALS "" UWORD DSCHED_Time200ms 1 100 0.00 13107.00 FORMAT "%8.2" ECU_ADDRESS 0xD00062FC /end MEASUREMENT
/begin MEASUREMENT DSCHED_TiActv.FId_CoordFBC "" UWORD DSCHED_Time200ms 1 100 0.00 13107.00 FORMAT "%8.2" ECU_ADDRESS 0xD00062FE /end MEASUREMENT
/begin MEASUREMENT DSCHED_TiActv.FId_CoordTAA "" UWORD DSCHED_Time200ms 1 100 0.00 13107.00 FORMAT "%8.2" ECU_ADDRESS 0xD0006300 /end MEASUREMENT
/begin MEASUREMENT DSCHED_TiActv.FId_CoordZFC "" UWORD DSCHED_Time200ms 1 100 0.00 13107.00 FORMAT "%8.2" ECU_ADDRESS 0xD0006302 /end MEASUREMENT
/begin MEASUREMENT DSCHED_TiPas.FId_Unused "" UWORD DFC_OneToOne 1 100 0.00 65535.00 FORMAT "%8.2" ECU_ADDRESS 0xD0006304 /end MEASUREMENT
/begin MEASUREMENT DSCHED_TiPas.FId_InhibitAlways "" UWORD DSCHED_Time200ms 1 100 0.00 13107.00 FORMAT "%8.2" ECU_ADDRESS 0xD0006306 /end MEASUREMENT
/begin MEASUREMENT DSCHED_TiPas.FId_CoordALS "" UWORD DSCHED_Time200ms 1 100 0.00 13107.00 FORMAT "%8.2" ECU_ADDRESS 0xD0006308 /end MEASUREMENT
/begin MEASUREMENT DSCHED_TiPas.FId_CoordFBC "" UWORD DSCHED_Time200ms 1 100 0.00 13107.00 FORMAT "%8.2" ECU_ADDRESS 0xD000630A /end MEASUREMENT
/begin MEASUREMENT DSCHED_TiPas.FId_CoordTAA "" UWORD DSCHED_Time200ms 1 100 0.00 13107.00 FORMAT "%8.2" ECU_ADDRESS 0xD000630C /end MEASUREMENT
/begin MEASUREMENT DSCHED_TiPas.FId_CoordZFC "" UWORD DSCHED_Time200ms 1 100 0.00 13107.00 FORMAT "%8.2" ECU_ADDRESS 0xD000630E /end MEASUREMENT
/begin MEASUREMENT DSCHED_WhyExcl.FId_Unused "" UWORD DSCHED_FIdExcCauseVerb 1 100 0.00 255. FORMAT "%2.0" ECU_ADDRESS 0xD000631C /end MEASUREMENT
/begin MEASUREMENT DSCHED_WhyExcl.FId_InhibitAlways "" UWORD DSCHED_FIdExcCauseVerb 1 100 0.00 255. FORMAT "%2.0" ECU_ADDRESS 0xD000631E /end MEASUREMENT
/begin MEASUREMENT DSCHED_WhyExcl.FId_CoordALS "" UWORD DSCHED_FIdExcCauseVerb 1 100 0.00 255. FORMAT "%2.0" ECU_ADDRESS 0xD0006320 /end MEASUREMENT
/begin MEASUREMENT DSCHED_WhyExcl.FId_CoordFBC "" UWORD DSCHED_FIdExcCauseVerb 1 100 0.00 255. FORMAT "%2.0" ECU_ADDRESS 0xD0006322 /end MEASUREMENT
/begin MEASUREMENT DSCHED_WhyExcl.FId_CoordTAA "" UWORD DSCHED_FIdExcCauseVerb 1 100 0.00 255. FORMAT "%2.0" ECU_ADDRESS 0xD0006324 /end MEASUREMENT
/begin MEASUREMENT DSCHED_WhyExcl.FId_CoordZFC "" UWORD DSCHED_FIdExcCauseVerb 1 100 0.00 255. FORMAT "%2.0" ECU_ADDRESS 0xD0006326 /end MEASUREMENT
/begin MEASUREMENT DSMAUX_DTRG.DTRG_Time200ms "" UBYTE DFC_OneToOne 1 100 0.00 255.0000 FORMAT "%8.4" ECU_ADDRESS 0xD00088FF /end MEASUREMENT
/begin MEASUREMENT DSMAUX_DTRG.DTRG_SimilarCondHLC "" UBYTE DFC_OneToOne 1 100 0.00 255.0000 FORMAT "%8.4" ECU_ADDRESS 0xD0008900 /end MEASUREMENT
/begin MEASUREMENT DSMAUX_DTRG.DTRG_AlwaysTrue "" UBYTE DFC_OneToOne 1 100 0.00 255.0000 FORMAT "%8.4" ECU_ADDRESS 0xD0008901 /end MEASUREMENT
/begin MEASUREMENT DSMAUX_DTRG.DTRG_DrivingCycleFLC "" UBYTE DFC_OneToOne 1 100 0.00 255.0000 FORMAT "%8.4" ECU_ADDRESS 0xD0008902 /end MEASUREMENT
/begin MEASUREMENT DSMAUX_DTRG.DTRG_DrivingCycleHLC "" UBYTE DFC_OneToOne 1 100 0.00 255.0000 FORMAT "%8.4" ECU_ADDRESS 0xD0008903 /end MEASUREMENT
/begin MEASUREMENT DSMAUX_DTRG.DTRG_NoTrigger "" UBYTE DFC_OneToOne 1 100 0.00 255.0000 FORMAT "%8.4" ECU_ADDRESS 0xD0008904 /end MEASUREMENT
/begin MEASUREMENT DSMAUX_DTRG.DTRG_WarmUpCycle "" UBYTE DFC_OneToOne 1 100 0.00 255.0000 FORMAT "%8.4" ECU_ADDRESS 0xD0008905 /end MEASUREMENT
/begin MEASUREMENT DSMDur_ctDFES0 "" UWORD DFES_OneToOne 1 100 0.00 65535.00 FORMAT "%8.2" ARRAY_SIZE 20 ECU_ADDRESS 0xD000CE96 /end MEASUREMENT
/begin MEASUREMENT DSMDur_ctDFES1 "" UWORD DFES_OneToOne 1 100 0.00 65535.00 FORMAT "%8.2" ARRAY_SIZE 20 ECU_ADDRESS 0xD000CEBE /end MEASUREMENT
/begin MEASUREMENT DSMDur_ctDFES2 "" UWORD DFES_OneToOne 1 100 0.00 65535.00 FORMAT "%8.2" ARRAY_SIZE 20 ECU_ADDRESS 0xD000CEE6 /end MEASUREMENT
/begin MEASUREMENT DSMDur_ctGlb "" ULONG DFES_OneToOne 1 100 0.00 4294967295.00 FORMAT "%13.2" ARRAY_SIZE 1 ECU_ADDRESS 0xD000CE90 /end MEASUREMENT
/begin MEASUREMENT DSMDur_stGlb "" UBYTE DSMDur_StDispl_Verb 1 100 0.00 2. FORMAT "%2.0" ARRAY_SIZE 1 ECU_ADDRESS 0xD000CE94 /end MEASUREMENT
/begin MEASUREMENT DSMRdy_Ct.RdyMisf_mp "" UBYTE DSMRdy_OneToOne 1 100 0.00 255.0000 FORMAT "%8.4" ECU_ADDRESS 0xD0008909 /end MEASUREMENT
/begin MEASUREMENT DSMRdy_Ct.RdyFlSys_mp "" UBYTE DSMRdy_OneToOne 1 100 0.00 255.0000 FORMAT "%8.4" ECU_ADDRESS 0xD000890A /end MEASUREMENT
/begin MEASUREMENT DSMRdy_Ct.RdyComprCmpnt_mp "" UBYTE DSMRdy_OneToOne 1 100 0.00 255.0000 FORMAT "%8.4" ECU_ADDRESS 0xD000890B /end MEASUREMENT
/begin MEASUREMENT DSMRdy_Ct.RdyCat_mp "" UBYTE DSMRdy_OneToOne 1 100 0.00 255.0000 FORMAT "%8.4" ECU_ADDRESS 0xD000890C /end MEASUREMENT
/begin MEASUREMENT DSMRdy_Ct.RdyHtCat_mp "" UBYTE DSMRdy_OneToOne 1 100 0.00 255.0000 FORMAT "%8.4" ECU_ADDRESS 0xD000890D /end MEASUREMENT
/begin MEASUREMENT DSMRdy_Ct.RdyEvpSys_mp "" UBYTE DSMRdy_OneToOne 1 100 0.00 255.0000 FORMAT "%8.4" ECU_ADDRESS 0xD000890E /end MEASUREMENT
/begin MEASUREMENT DSMRdy_Ct.RdySecAirSys_mp "" UBYTE DSMRdy_OneToOne 1 100 0.00 255.0000 FORMAT "%8.4" ECU_ADDRESS 0xD000890F /end MEASUREMENT
/begin MEASUREMENT DSMRdy_Ct.RdyAC_mp "" UBYTE DSMRdy_OneToOne 1 100 0.00 255.0000 FORMAT "%8.4" ECU_ADDRESS 0xD0008910 /end MEASUREMENT
/begin MEASUREMENT DSMRdy_Ct.RdyO2Sens_mp "" UBYTE DSMRdy_OneToOne 1 100 0.00 255.0000 FORMAT "%8.4" ECU_ADDRESS 0xD0008911 /end MEASUREMENT
/begin MEASUREMENT DSMRdy_Ct.RdyO2SensHt_mp "" UBYTE DSMRdy_OneToOne 1 100 0.00 255.0000 FORMAT "%8.4" ECU_ADDRESS 0xD0008912 /end MEASUREMENT
/begin MEASUREMENT DSMRdy_Ct.RdyEGR_mp "" UBYTE DSMRdy_OneToOne 1 100 0.00 255.0000 FORMAT "%8.4" ECU_ADDRESS 0xD0008913 /end MEASUREMENT
/begin MEASUREMENT DSMRdy_Ct.CyclCmplMisf_mp "" UBYTE DSMRdy_OneToOne 1 100 0.00 255.0000 FORMAT "%8.4" ECU_ADDRESS 0xD0008914 /end MEASUREMENT
/begin MEASUREMENT DSMRdy_Ct.CyclCmplFlSys_mp "" UBYTE DSMRdy_OneToOne 1 100 0.00 255.0000 FORMAT "%8.4" ECU_ADDRESS 0xD0008915 /end MEASUREMENT
/begin MEASUREMENT DSMRdy_Ct.CyclCmplComprCmpnt_mp "" UBYTE DSMRdy_OneToOne 1 100 0.00 255.0000 FORMAT "%8.4" ECU_ADDRESS 0xD0008916 /end MEASUREMENT
/begin MEASUREMENT DSMRdy_Ct.CyclCmplCat_mp "" UBYTE DSMRdy_OneToOne 1 100 0.00 255.0000 FORMAT "%8.4" ECU_ADDRESS 0xD0008917 /end MEASUREMENT
/begin MEASUREMENT DSMRdy_Ct.CyclCmplHtCat_mp "" UBYTE DSMRdy_OneToOne 1 100 0.00 255.0000 FORMAT "%8.4" ECU_ADDRESS 0xD0008918 /end MEASUREMENT
/begin MEASUREMENT DSMRdy_Ct.CyclCmplEvpSys_mp "" UBYTE DSMRdy_OneToOne 1 100 0.00 255.0000 FORMAT "%8.4" ECU_ADDRESS 0xD0008919 /end MEASUREMENT
/begin MEASUREMENT DSMRdy_Ct.CyclCmplSecAirSys_mp "" UBYTE DSMRdy_OneToOne 1 100 0.00 255.0000 FORMAT "%8.4" ECU_ADDRESS 0xD000891A /end MEASUREMENT
/begin MEASUREMENT DSMRdy_Ct.CyclCmplAC_mp "" UBYTE DSMRdy_OneToOne 1 100 0.00 255.0000 FORMAT "%8.4" ECU_ADDRESS 0xD000891B /end MEASUREMENT
/begin MEASUREMENT DSMRdy_Ct.CyclCmplO2Sens_mp "" UBYTE DSMRdy_OneToOne 1 100 0.00 255.0000 FORMAT "%8.4" ECU_ADDRESS 0xD000891C /end MEASUREMENT
/begin MEASUREMENT DSMRdy_Ct.CyclCmplO2SensHt_mp "" UBYTE DSMRdy_OneToOne 1 100 0.00 255.0000 FORMAT "%8.4" ECU_ADDRESS 0xD000891D /end MEASUREMENT
/begin MEASUREMENT DSMRdy_Ct.CyclCmplEGR_mp "" UBYTE DSMRdy_OneToOne 1 100 0.00 255.0000 FORMAT "%8.4" ECU_ADDRESS 0xD000891E /end MEASUREMENT
/begin MEASUREMENT DSMRdy_Ct.LockMisf_mp "" UBYTE DSMRdy_OneToOne 1 100 0.00 255.0000 FORMAT "%8.4" ECU_ADDRESS 0xD000891F /end MEASUREMENT
/begin MEASUREMENT DSMRdy_Ct.LockFlSys_mp "" UBYTE DSMRdy_OneToOne 1 100 0.00 255.0000 FORMAT "%8.4" ECU_ADDRESS 0xD0008920 /end MEASUREMENT
/begin MEASUREMENT DSMRdy_Ct.LockComprCmpnt_mp "" UBYTE DSMRdy_OneToOne 1 100 0.00 255.0000 FORMAT "%8.4" ECU_ADDRESS 0xD0008921 /end MEASUREMENT
/begin MEASUREMENT DSMRdy_Ct.LockCat_mp "" UBYTE DSMRdy_OneToOne 1 100 0.00 255.0000 FORMAT "%8.4" ECU_ADDRESS 0xD0008922 /end MEASUREMENT
/begin MEASUREMENT DSMRdy_Ct.LockHtCat_mp "" UBYTE DSMRdy_OneToOne 1 100 0.00 255.0000 FORMAT "%8.4" ECU_ADDRESS 0xD0008923 /end MEASUREMENT
/begin MEASUREMENT DSMRdy_Ct.LockEvpSys_mp "" UBYTE DSMRdy_OneToOne 1 100 0.00 255.0000 FORMAT "%8.4" ECU_ADDRESS 0xD0008924 /end MEASUREMENT
/begin MEASUREMENT DSMRdy_Ct.LockSecAirSys_mp "" UBYTE DSMRdy_OneToOne 1 100 0.00 255.0000 FORMAT "%8.4" ECU_ADDRESS 0xD0008925 /end MEASUREMENT
/begin MEASUREMENT DSMRdy_Ct.LockAC_mp "" UBYTE DSMRdy_OneToOne 1 100 0.00 255.0000 FORMAT "%8.4" ECU_ADDRESS 0xD0008926 /end MEASUREMENT
/begin MEASUREMENT DSMRdy_Ct.LockO2Sens_mp "" UBYTE DSMRdy_OneToOne 1 100 0.00 255.0000 FORMAT "%8.4" ECU_ADDRESS 0xD0008927 /end MEASUREMENT
/begin MEASUREMENT DSMRdy_Ct.LockO2SensHt_mp "" UBYTE DSMRdy_OneToOne 1 100 0.00 255.0000 FORMAT "%8.4" ECU_ADDRESS 0xD0008928 /end MEASUREMENT
/begin MEASUREMENT DSMRdy_Ct.LockEGR_mp "" UBYTE DSMRdy_OneToOne 1 100 0.00 255.0000 FORMAT "%8.4" ECU_ADDRESS 0xD0008929 /end MEASUREMENT
/begin MEASUREMENT DSMRdy_Ct.SupMisf_mp "" UBYTE DSMRdy_OneToOne 1 100 0.00 255.0000 FORMAT "%8.4" ECU_ADDRESS 0xD000892A /end MEASUREMENT
/begin MEASUREMENT DSMRdy_Ct.SupFlSys_mp "" UBYTE DSMRdy_OneToOne 1 100 0.00 255.0000 FORMAT "%8.4" ECU_ADDRESS 0xD000892B /end MEASUREMENT
/begin MEASUREMENT DSMRdy_Ct.SupComprCmpnt_mp "" UBYTE DSMRdy_OneToOne 1 100 0.00 255.0000 FORMAT "%8.4" ECU_ADDRESS 0xD000892C /end MEASUREMENT
/begin MEASUREMENT DSMRdy_Ct.SupCat_mp "" UBYTE DSMRdy_OneToOne 1 100 0.00 255.0000 FORMAT "%8.4" ECU_ADDRESS 0xD000892D /end MEASUREMENT
/begin MEASUREMENT DSMRdy_Ct.SupHtCat_mp "" UBYTE DSMRdy_OneToOne 1 100 0.00 255.0000 FORMAT "%8.4" ECU_ADDRESS 0xD000892E /end MEASUREMENT
/begin MEASUREMENT DSMRdy_Ct.SupEvpSys_mp "" UBYTE DSMRdy_OneToOne 1 100 0.00 255.0000 FORMAT "%8.4" ECU_ADDRESS 0xD000892F /end MEASUREMENT
/begin MEASUREMENT DSMRdy_Ct.SupSecAirSys_mp "" UBYTE DSMRdy_OneToOne 1 100 0.00 255.0000 FORMAT "%8.4" ECU_ADDRESS 0xD0008930 /end MEASUREMENT
/begin MEASUREMENT DSMRdy_Ct.SupAC_mp "" UBYTE DSMRdy_OneToOne 1 100 0.00 255.0000 FORMAT "%8.4" ECU_ADDRESS 0xD0008931 /end MEASUREMENT
/begin MEASUREMENT DSMRdy_Ct.SupO2Sens_mp "" UBYTE DSMRdy_OneToOne 1 100 0.00 255.0000 FORMAT "%8.4" ECU_ADDRESS 0xD0008932 /end MEASUREMENT
/begin MEASUREMENT DSMRdy_Ct.SupO2SensHt_mp "" UBYTE DSMRdy_OneToOne 1 100 0.00 255.0000 FORMAT "%8.4" ECU_ADDRESS 0xD0008933 /end MEASUREMENT
/begin MEASUREMENT DSMRdy_Ct.SupEGR_mp "" UBYTE DSMRdy_OneToOne 1 100 0.00 255.0000 FORMAT "%8.4" ECU_ADDRESS 0xD0008934 /end MEASUREMENT
/begin MEASUREMENT DSMRdy_stGrpAct "" UWORD DSMRdy_OneToOne 1 100 0.00 65535.00 FORMAT "%8.2" ECU_ADDRESS 0xD0008004 /end MEASUREMENT
/begin MEASUREMENT DSMRdy_stGrpLock "" UWORD DSMRdy_OneToOne 1 100 0.00 65535.00 FORMAT "%8.2" ECU_ADDRESS 0xD0008006 /end MEASUREMENT
/begin MEASUREMENT DSMRdy_stGrpRdy "" UWORD DSMRdy_OneToOne 1 100 0.00 65535.00 FORMAT "%8.2" ECU_ADDRESS 0xD000CF10 /end MEASUREMENT
/begin MEASUREMENT DSMRdy_stGrpRdyDFES "" UWORD DSMRdy_OneToOne 1 100 0.00 65535.00 FORMAT "%8.2" ECU_ADDRESS 0xD0008000 /end MEASUREMENT
/begin MEASUREMENT DSMRdy_stGrpRdyScan "" UWORD DSMRdy_OneToOne 1 100 0.00 65535.00 FORMAT "%8.2" ECU_ADDRESS 0xD0007FFE /end MEASUREMENT
/begin MEASUREMENT DSMRdy_stGrpSup "" UWORD DSMRdy_OneToOne 1 100 0.00 65535.00 FORMAT "%8.2" ECU_ADDRESS 0xD0008002 /end MEASUREMENT
/begin MEASUREMENT DSMRdy_Why.RdyMisf_mp "" UWORD DFCDSQ_Verb 1 100 0.00 656. FORMAT "%2.0" ECU_ADDRESS 0xD000632A /end MEASUREMENT
/begin MEASUREMENT DSMRdy_Why.RdyFlSys_mp "" UWORD DFCDSQ_Verb 1 100 0.00 656. FORMAT "%2.0" ECU_ADDRESS 0xD000632C /end MEASUREMENT
/begin MEASUREMENT DSMRdy_Why.RdyComprCmpnt_mp "" UWORD DFCDSQ_Verb 1 100 0.00 656. FORMAT "%2.0" ECU_ADDRESS 0xD000632E /end MEASUREMENT
/begin MEASUREMENT DSMRdy_Why.RdyCat_mp "" UWORD DFCDSQ_Verb 1 100 0.00 656. FORMAT "%2.0" ECU_ADDRESS 0xD0006330 /end MEASUREMENT
/begin MEASUREMENT DSMRdy_Why.RdyHtCat_mp "" UWORD DFCDSQ_Verb 1 100 0.00 656. FORMAT "%2.0" ECU_ADDRESS 0xD0006332 /end MEASUREMENT
/begin MEASUREMENT DSMRdy_Why.RdyEvpSys_mp "" UWORD DFCDSQ_Verb 1 100 0.00 656. FORMAT "%2.0" ECU_ADDRESS 0xD0006334 /end MEASUREMENT
/begin MEASUREMENT DSMRdy_Why.RdySecAirSys_mp "" UWORD DFCDSQ_Verb 1 100 0.00 656. FORMAT "%2.0" ECU_ADDRESS 0xD0006336 /end MEASUREMENT
/begin MEASUREMENT DSMRdy_Why.RdyAC_mp "" UWORD DFCDSQ_Verb 1 100 0.00 656. FORMAT "%2.0" ECU_ADDRESS 0xD0006338 /end MEASUREMENT
/begin MEASUREMENT DSMRdy_Why.RdyO2Sens_mp "" UWORD DFCDSQ_Verb 1 100 0.00 656. FORMAT "%2.0" ECU_ADDRESS 0xD000633A /end MEASUREMENT
/begin MEASUREMENT DSMRdy_Why.RdyO2SensHt_mp "" UWORD DFCDSQ_Verb 1 100 0.00 656. FORMAT "%2.0" ECU_ADDRESS 0xD000633C /end MEASUREMENT
/begin MEASUREMENT DSMRdy_Why.RdyEGR_mp "" UWORD DFCDSQ_Verb 1 100 0.00 656. FORMAT "%2.0" ECU_ADDRESS 0xD000633E /end MEASUREMENT
/begin MEASUREMENT DSMRdy_Why.CyclCmplMisf_mp "" UWORD DFCDSQ_Verb 1 100 0.00 656. FORMAT "%2.0" ECU_ADDRESS 0xD0006340 /end MEASUREMENT
/begin MEASUREMENT DSMRdy_Why.CyclCmplFlSys_mp "" UWORD DFCDSQ_Verb 1 100 0.00 656. FORMAT "%2.0" ECU_ADDRESS 0xD0006342 /end MEASUREMENT
/begin MEASUREMENT DSMRdy_Why.CyclCmplComprCmpnt_mp "" UWORD DFCDSQ_Verb 1 100 0.00 656. FORMAT "%2.0" ECU_ADDRESS 0xD0006344 /end MEASUREMENT
/begin MEASUREMENT DSMRdy_Why.CyclCmplCat_mp "" UWORD DFCDSQ_Verb 1 100 0.00 656. FORMAT "%2.0" ECU_ADDRESS 0xD0006346 /end MEASUREMENT
/begin MEASUREMENT DSMRdy_Why.CyclCmplHtCat_mp "" UWORD DFCDSQ_Verb 1 100 0.00 656. FORMAT "%2.0" ECU_ADDRESS 0xD0006348 /end MEASUREMENT
/begin MEASUREMENT DSMRdy_Why.CyclCmplEvpSys_mp "" UWORD DFCDSQ_Verb 1 100 0.00 656. FORMAT "%2.0" ECU_ADDRESS 0xD000634A /end MEASUREMENT
/begin MEASUREMENT DSMRdy_Why.CyclCmplSecAirSys_mp "" UWORD DFCDSQ_Verb 1 100 0.00 656. FORMAT "%2.0" ECU_ADDRESS 0xD000634C /end MEASUREMENT
/begin MEASUREMENT DSMRdy_Why.CyclCmplAC_mp "" UWORD DFCDSQ_Verb 1 100 0.00 656. FORMAT "%2.0" ECU_ADDRESS 0xD000634E /end MEASUREMENT
/begin MEASUREMENT DSMRdy_Why.CyclCmplO2Sens_mp "" UWORD DFCDSQ_Verb 1 100 0.00 656. FORMAT "%2.0" ECU_ADDRESS 0xD0006350 /end MEASUREMENT
/begin MEASUREMENT DSMRdy_Why.CyclCmplO2SensHt_mp "" UWORD DFCDSQ_Verb 1 100 0.00 656. FORMAT "%2.0" ECU_ADDRESS 0xD0006352 /end MEASUREMENT
/begin MEASUREMENT DSMRdy_Why.CyclCmplEGR_mp "" UWORD DFCDSQ_Verb 1 100 0.00 656. FORMAT "%2.0" ECU_ADDRESS 0xD0006354 /end MEASUREMENT
/begin MEASUREMENT DSMRdy_Why.LockMisf_mp "" UWORD DFCDSQ_Verb 1 100 0.00 656. FORMAT "%2.0" ECU_ADDRESS 0xD0006356 /end MEASUREMENT
/begin MEASUREMENT DSMRdy_Why.LockFlSys_mp "" UWORD DFCDSQ_Verb 1 100 0.00 656. FORMAT "%2.0" ECU_ADDRESS 0xD0006358 /end MEASUREMENT
/begin MEASUREMENT DSMRdy_Why.LockComprCmpnt_mp "" UWORD DFCDSQ_Verb 1 100 0.00 656. FORMAT "%2.0" ECU_ADDRESS 0xD000635A /end MEASUREMENT
/begin MEASUREMENT DSMRdy_Why.LockCat_mp "" UWORD DFCDSQ_Verb 1 100 0.00 656. FORMAT "%2.0" ECU_ADDRESS 0xD000635C /end MEASUREMENT
/begin MEASUREMENT DSMRdy_Why.LockHtCat_mp "" UWORD DFCDSQ_Verb 1 100 0.00 656. FORMAT "%2.0" ECU_ADDRESS 0xD000635E /end MEASUREMENT
/begin MEASUREMENT DSMRdy_Why.LockEvpSys_mp "" UWORD DFCDSQ_Verb 1 100 0.00 656. FORMAT "%2.0" ECU_ADDRESS 0xD0006360 /end MEASUREMENT
/begin MEASUREMENT DSMRdy_Why.LockSecAirSys_mp "" UWORD DFCDSQ_Verb 1 100 0.00 656. FORMAT "%2.0" ECU_ADDRESS 0xD0006362 /end MEASUREMENT
/begin MEASUREMENT DSMRdy_Why.LockAC_mp "" UWORD DFCDSQ_Verb 1 100 0.00 656. FORMAT "%2.0" ECU_ADDRESS 0xD0006364 /end MEASUREMENT
/begin MEASUREMENT DSMRdy_Why.LockO2Sens_mp "" UWORD DFCDSQ_Verb 1 100 0.00 656. FORMAT "%2.0" ECU_ADDRESS 0xD0006366 /end MEASUREMENT
/begin MEASUREMENT DSMRdy_Why.LockO2SensHt_mp "" UWORD DFCDSQ_Verb 1 100 0.00 656. FORMAT "%2.0" ECU_ADDRESS 0xD0006368 /end MEASUREMENT
/begin MEASUREMENT DSMRdy_Why.LockEGR_mp "" UWORD DFCDSQ_Verb 1 100 0.00 656. FORMAT "%2.0" ECU_ADDRESS 0xD000636A /end MEASUREMENT
/begin MEASUREMENT DSMRdy_xPId1 "" ULONG DSMRdy_OneToOne 1 100 0.00 4294967295. FORMAT "%8.0" ECU_ADDRESS 0xD00055B8 /end MEASUREMENT
/begin MEASUREMENT DSMRdy_xPId41 "" ULONG DSMRdy_OneToOne 1 100 0.00 4294967295. FORMAT "%8.0" ECU_ADDRESS 0xD00055BC /end MEASUREMENT
/begin MEASUREMENT DSM_DisblMode_mp "aktueller Disable Status" UWORD OneToOne 1 100 0.00 65535.00 FORMAT "%8.2" ECU_ADDRESS 0xC000069C /end MEASUREMENT
/begin MEASUREMENT DSM_ECUId_mp "ECU Id bei Master-Slave Systemen" UBYTE OneToOne 1 100 0.00 255.0 FORMAT "%5.1" ECU_ADDRESS 0xC000069E /end MEASUREMENT
/begin MEASUREMENT DSM_nEng_mp "Motordrehzahl zur DSM internen Verwendung" SWORD EngN 1 100 -16384.00 16383.50 FORMAT "%8.2" ECU_ADDRESS 0xC00006A0 /end MEASUREMENT
/begin MEASUREMENT DSM_pEnv_mp "Umgebungs-Luftdruck zur DSM internen Verwendung" SWORD Pres_hPa 1 100 -32768.00 3500.00 FORMAT "%8.2" ECU_ADDRESS 0xC00006A2 /end MEASUREMENT
/begin MEASUREMENT DSM_rAPP_mp "Fahrpedalwert zur DSM internen Verwendung" SWORD Prc 1 100 -400.0000 399.9878 FORMAT "%8.4" ECU_ADDRESS 0xC00006A4 /end MEASUREMENT
/begin MEASUREMENT DSM_stStrEnd_mp "" UBYTE OneToOne 1 100 0.00 255.0 FORMAT "%5.1" ECU_ADDRESS 0xC00006A6 /end MEASUREMENT
/begin MEASUREMENT DSM_stWiggle_mp "Aktivierungsstatus Wiggle-Test" UBYTE OneToOne 1 100 0.00 255.0 FORMAT "%5.1" ECU_ADDRESS 0xC00006A7 /end MEASUREMENT
/begin MEASUREMENT DSM_tEngDS_mp "Kühlwassertemperatur zur DM internen Verwendung" SWORD Temp_Cels 1 100 -3549.940 3003.560 FORMAT "%8.3" ECU_ADDRESS 0xC00006A8 /end MEASUREMENT
/begin MEASUREMENT DSM_tEnv_mp "Umgebungs-Lufttemperatur zur DSM internen Verwendung" SWORD Temp_Cels 1 100 -3549.940 3003.560 FORMAT "%8.3" ECU_ADDRESS 0xC00006AA /end MEASUREMENT
/begin MEASUREMENT DSM_vVeh_mp "Fahrzeuggeschwindigkeit zur DSM internen Verwendung" SWORD Vel 1 100 -327.6800 327.6700 FORMAT "%8.4" ECU_ADDRESS 0xC00006AC /end MEASUREMENT
/begin MEASUREMENT DTR_valLoLim "" UWORD DFES_OneToOne 1 100 0.00 65535.00 FORMAT "%8.2" ARRAY_SIZE 6 ECU_ADDRESS 0xD000CF2A /end MEASUREMENT
/begin MEASUREMENT DTR_valTst "" UWORD DFES_OneToOne 1 100 0.00 65535.00 FORMAT "%8.2" ARRAY_SIZE 6 ECU_ADDRESS 0xD000CF12 /end MEASUREMENT
/begin MEASUREMENT DTR_valUpLim "" UWORD DFES_OneToOne 1 100 0.00 65535.00 FORMAT "%8.2" ARRAY_SIZE 6 ECU_ADDRESS 0xD000CF1E /end MEASUREMENT
/begin MEASUREMENT ECBVlv_r "" SWORD Prc 1 100 -400.0000 399.9878 FORMAT "%8.4" ECU_ADDRESS 0xD0006D88 /end MEASUREMENT
/begin MEASUREMENT ECBVlv_rAct "" SWORD Prc 1 100 -400.0000 399.9878 FORMAT "%8.4" ECU_ADDRESS 0xD0006D8A /end MEASUREMENT
/begin MEASUREMENT ECBVlv_rPs "" SWORD DtyCyc 1 100 -327.6800 327.6700 FORMAT "%8.4" ECU_ADDRESS 0xD0006D90 /end MEASUREMENT
/begin MEASUREMENT ECBVlv_rSens "" SWORD Prc 1 100 -400.0000 399.9878 FORMAT "%8.4" ECU_ADDRESS 0xD0006D92 /end MEASUREMENT
/begin MEASUREMENT ECBVlv_uRaw "" SWORD Volt 1 100 -6553.600 6553.400 FORMAT "%8.3" ECU_ADDRESS 0xD0006D94 /end MEASUREMENT
/begin MEASUREMENT Eep_EnvRamHist "" UBYTE OneToOne 1 100 0.00 255.0 FORMAT "%5.1" ECU_ADDRESS 0xD00089BA /end MEASUREMENT
/begin MEASUREMENT Eep_EnvRamInvld "" UBYTE OneToOne 1 100 0.00 255.0 FORMAT "%5.1" ECU_ADDRESS 0xD00089B9 /end MEASUREMENT
/begin MEASUREMENT EGRClg_ClgOff_mp "untere Grenze für Einspritzmenge bzw. inneres Drehmoment" SWORD InjMass 1 100 -327.6800 327.6700 FORMAT "%8.4" ECU_ADDRESS 0xC00006C4 /end MEASUREMENT
/begin MEASUREMENT EGRClg_ClgOn_mp "obere Grenze für Einspritzmenge bzw. inneres Drehmoment" SWORD InjMass 1 100 -327.6800 327.6700 FORMAT "%8.4" ECU_ADDRESS 0xC00006C6 /end MEASUREMENT
/begin MEASUREMENT EGRClg_numEOMMode_mp "Index der geforderten Betriebsart" UWORD OneToOne 1 100 0.00 65535.00 FORMAT "%8.2" ECU_ADDRESS 0xC00006CC /end MEASUREMENT
/begin MEASUREMENT EGRClg_rCtlCor_mp "Korrigierter Steuerwert des ARF-Kühler-Bypass-Ventil" SWORD Prc 1 100 -400.0000 399.9878 FORMAT "%8.4" ECU_ADDRESS 0xC00006AE /end MEASUREMENT
/begin MEASUREMENT EGRClg_rCtlValNrm_mp "Steuerwert des ARF-Kühler-Bypass-Ventil im Normalbetrieb" SWORD Prc 1 100 -400.0000 399.9878 FORMAT "%8.4" ECU_ADDRESS 0xC00006B0 /end MEASUREMENT
/begin MEASUREMENT EGRClg_stBitMskEOM_mp "Bitmaske zur Auswahl der relevanten Abschaltfälle für die gewählte Betriebsart" ULONG OneToOne 1 100 0.00 4294967295.00 FORMAT "%13.2" ECU_ADDRESS 0xC00006D0 /end MEASUREMENT
/begin MEASUREMENT EGRClg_stCtlValBits_mp "Status der Bedingungen zur Ansteuerung des ARF-Kühler-Bypass-Ventils" ULONG OneToOne 1 100 0.00 4294967295.00 FORMAT "%13.2" ECU_ADDRESS 0xC00006BC /end MEASUREMENT
/begin MEASUREMENT EGRClg_stCtlVal_mp "selektierte Bedingungen zur Ansteuerung des ARF-Kühler-Bypass-Ventils" UBYTE OneToOne 1 100 0.00 255.0 FORMAT "%5.1" ECU_ADDRESS 0xC00006B2 /end MEASUREMENT
/begin MEASUREMENT EGRClg_stEGRClgBits_mp "relevante Abschaltfälle" ULONG OneToOne 1 100 0.00 4294967295.00 FORMAT "%13.2" ECU_ADDRESS 0xC00006C0 /end MEASUREMENT
/begin MEASUREMENT EGRClg_stMon "Priorisierte Abschaltfälle" UBYTE OneToOne 1 100 0.00 255.0 FORMAT "%5.1" ECU_ADDRESS 0xD0008FD1 /end MEASUREMENT
/begin MEASUREMENT EGRClg_stMonBits_mp "Selektierte Abschaltfälle" ULONG OneToOne 1 100 0.00 4294967295.00 FORMAT "%13.2" ECU_ADDRESS 0xC00006B4 /end MEASUREMENT
/begin MEASUREMENT EGRClg_stSelBitMskEOM_mp "selektierte Bitmaske für Abschaltfälle für die gewählte Betriebsart" ULONG OneToOne 1 100 0.00 4294967295.00 FORMAT "%13.2" ECU_ADDRESS 0xC00006D4 /end MEASUREMENT
/begin MEASUREMENT EGRClg_tAirCtlVal_mp "" SWORD Temp_Cels 1 100 -3549.940 3003.560 FORMAT "%8.3" ECU_ADDRESS 0xC00006C8 /end MEASUREMENT
/begin MEASUREMENT EGRClg_tEngCtlVal1_mp "" SWORD Temp_Cels 1 100 -3549.940 3003.560 FORMAT "%8.3" ECU_ADDRESS 0xC00006CA /end MEASUREMENT
/begin MEASUREMENT EGRClg_tEngCtlVal_mp "Ausgewählte Temperatur aus dem Motortemperaturfeld für die Ansteuerung des ARF-Kühler-Bypass-Ventils" SWORD Temp_Cels 1 100 -3549.940 3003.560 FORMAT "%8.3" ECU_ADDRESS 0xC00006B8 /end MEASUREMENT
/begin MEASUREMENT EGRClg_tiMonEOM_mp "Zeitverzögerung bei Auswahl der Abschaltfallmaske für die gewählte Betriebsart" SWORD TimeDeb 1 100 -327680.0 327670.0 FORMAT "%8.1" ECU_ADDRESS 0xC00006D8 /end MEASUREMENT
/begin MEASUREMENT EGRVlv_ctAdapCls_mp "Zähler des Offset-Lernens der AGR-Ventilposition" UBYTE OneToOne 1 100 0.00 255.0 FORMAT "%5.1" ECU_ADDRESS 0xC00006F1 /end MEASUREMENT
/begin MEASUREMENT EGRVlv_drAct_mp "" SWORD VlvVel 1 100 -4000.000 3999.878 FORMAT "%8.3" ECU_ADDRESS 0xC00006DE /end MEASUREMENT
/begin MEASUREMENT EGRVlv_facCorFlt_mp "Gefilterter Batteriespannungskorrekturfaktor" SWORD Fact 1 100 -4.000000 3.999878 FORMAT "%8.6" ECU_ADDRESS 0xC00006DA /end MEASUREMENT
/begin MEASUREMENT EGRVlv_iEffFlt_mp "Gefilterter Effektivstrom des AGR-Steuermoduls" SWORD Curr_A 1 100 -327.6800 327.6700 FORMAT "%8.4" ECU_ADDRESS 0xC00006E0 /end MEASUREMENT
/begin MEASUREMENT EGRVlv_iEff_mp "Effektivstrom des AGR-Steuermoduls" SWORD Curr_A 1 100 -327.6800 327.6700 FORMAT "%8.4" ECU_ADDRESS 0xC00006E2 /end MEASUREMENT
/begin MEASUREMENT EGRVlv_r "Eingangsstellersollwert ASW" SWORD Prc 1 100 -400.0000 399.9878 FORMAT "%8.4" ECU_ADDRESS 0xD0006D96 /end MEASUREMENT
/begin MEASUREMENT EGRVlv_rAbsEGR_mp "Absolutwert von rEGR" SWORD DtyCyc 1 100 -327.6800 327.6700 FORMAT "%8.4" ECU_ADDRESS 0xC00006E4 /end MEASUREMENT
/begin MEASUREMENT EGRVlv_rAct "Tatsächliche AGR-Ventilposition" SWORD Prc 1 100 -400.0000 399.9878 FORMAT "%8.4" ECU_ADDRESS 0xD0006D98 /end MEASUREMENT
/begin MEASUREMENT EGRVlv_rActNoErrHdl "" SWORD Prc 1 100 -400.0000 399.9878 FORMAT "%8.4" ECU_ADDRESS 0xD0006D9E /end MEASUREMENT
/begin MEASUREMENT EGRVlv_rActUnCorOld_mp "" SWORD Prc 1 100 -400.0000 399.9878 FORMAT "%8.4" ECU_ADDRESS 0xC00006F2 /end MEASUREMENT
/begin MEASUREMENT EGRVlv_rActUnCor_mp "Messpunkt zur Anzeige der unkorrigierten Sensorposition" SWORD Prc 1 100 -400.0000 399.9878 FORMAT "%8.4" ECU_ADDRESS 0xC00006F4 /end MEASUREMENT
/begin MEASUREMENT EGRVlv_rAdapLrn_mp "Gelernter Offsetwert der AGR-Ventilposition im aktuellen Fahrzyklus" SWORD Prc 1 100 -400.0000 399.9878 FORMAT "%8.4" ECU_ADDRESS 0xC00006F6 /end MEASUREMENT
/begin MEASUREMENT EGRVlv_rAdapPos_mp "" SWORD Prc 1 100 -400.0000 399.9878 FORMAT "%8.4" ECU_ADDRESS 0xC00006F8 /end MEASUREMENT
/begin MEASUREMENT EGRVlv_rCnv_mp "" SWORD DtyCyc 1 100 -327.6800 327.6700 FORMAT "%8.4" ECU_ADDRESS 0xC00006DC /end MEASUREMENT
/begin MEASUREMENT EGRVlv_rEGR "Steuerwert des AGR-Ventils" SWORD Prc 1 100 -400.0000 399.9878 FORMAT "%8.4" ECU_ADDRESS 0xD0006DA4 /end MEASUREMENT
/begin MEASUREMENT EGRVlv_rGovDvt "" SWORD Prc 1 100 -400.0000 399.9878 FORMAT "%8.4" ECU_ADDRESS 0xD0006DA6 /end MEASUREMENT
/begin MEASUREMENT EGRVlv_rGovDvtRel "" SWORD Prc 1 100 -400.0000 399.9878 FORMAT "%8.4" ECU_ADDRESS 0xD0006DA8 /end MEASUREMENT
/begin MEASUREMENT EGRVlv_rGovEGR "" SWORD Prc 1 100 -400.0000 399.9878 FORMAT "%8.4" ECU_ADDRESS 0xD0006DAA /end MEASUREMENT
/begin MEASUREMENT EGRVlv_rGovMax_mp "" SWORD Prc 1 100 -400.0000 399.9878 FORMAT "%8.4" ECU_ADDRESS 0xC00006E6 /end MEASUREMENT
/begin MEASUREMENT EGRVlv_rGovMin_mp "" SWORD Prc 1 100 -400.0000 399.9878 FORMAT "%8.4" ECU_ADDRESS 0xC00006E8 /end MEASUREMENT
/begin MEASUREMENT EGRVlv_rLinOfs_mp "Offset-korrigierter linearisierter Wert" SWORD Prc 1 100 -400.0000 399.9878 FORMAT "%8.4" ECU_ADDRESS 0xC00006FA /end MEASUREMENT
/begin MEASUREMENT EGRVlv_rOfsLrnFrst "Offsetwert, wenn entweder das Ventil oder das SG neu ist" SWORD Prc 1 100 -400.0000 399.9878 FORMAT "%8.4" ECU_ADDRESS 0xD0006DAC /end MEASUREMENT
/begin MEASUREMENT EGRVlv_rOfsLrnLst "In jedem Fahrzyklus gelernter Offsetwert der AGR-Position" SWORD Prc 1 100 -400.0000 399.9878 FORMAT "%8.4" ECU_ADDRESS 0xD0006DAE /end MEASUREMENT
/begin MEASUREMENT EGRVlv_rOfsLrnNew "Aktueller Offsetwert der AGR-Ventilposition" SWORD Prc 1 100 -400.0000 399.9878 FORMAT "%8.4" ECU_ADDRESS 0xD0006DB0 /end MEASUREMENT
/begin MEASUREMENT EGRVlv_rOfsLrnVlv "Steuerwert im Fall von Offset-Lernen" SWORD Prc 1 100 -400.0000 399.9878 FORMAT "%8.4" ECU_ADDRESS 0xD0006DB2 /end MEASUREMENT
/begin MEASUREMENT EGRVlv_rOfs_mp "AGR-Ventilpositionsoffset" SWORD Prc 1 100 -400.0000 399.9878 FORMAT "%8.4" ECU_ADDRESS 0xC00006FC /end MEASUREMENT
/begin MEASUREMENT EGRVlv_rOutD_mp "Regler DT1-Ausgang" SWORD Prc 1 100 -400.0000 399.9878 FORMAT "%8.4" ECU_ADDRESS 0xC00006EA /end MEASUREMENT
/begin MEASUREMENT EGRVlv_rOutI_mp "Stellgröße für I-Reglerausgang" SWORD Prc 1 100 -400.0000 399.9878 FORMAT "%8.4" ECU_ADDRESS 0xC00006EC /end MEASUREMENT
/begin MEASUREMENT EGRVlv_rOutP_mp "Stellgröße für P-Reglerausgang" SWORD Prc 1 100 -400.0000 399.9878 FORMAT "%8.4" ECU_ADDRESS 0xC00006EE /end MEASUREMENT
/begin MEASUREMENT EGRVlv_rPlausLgT_mp "" SWORD Prc 1 100 -400.0000 399.9878 FORMAT "%8.4" ECU_ADDRESS 0xC00006FE /end MEASUREMENT
/begin MEASUREMENT EGRVlv_rPlausShT_mp "" SWORD Prc 1 100 -400.0000 399.9878 FORMAT "%8.4" ECU_ADDRESS 0xC0000700 /end MEASUREMENT
/begin MEASUREMENT EGRVlv_rPlausVal_mp "Differenz zwischen max und min gelesenen Ventilpositionen" SWORD Prc 1 100 -400.0000 399.9878 FORMAT "%8.4" ECU_ADDRESS 0xC0000702 /end MEASUREMENT
/begin MEASUREMENT EGRVlv_rPosLrnMax_mp "Max. Wert der gelesenen Offsets" SWORD Prc 1 100 -400.0000 399.9878 FORMAT "%8.4" ECU_ADDRESS 0xC0000704 /end MEASUREMENT
/begin MEASUREMENT EGRVlv_rPosLrnMin_mp "Minimaler Wert der gelesenen Offsets" SWORD Prc 1 100 -400.0000 399.9878 FORMAT "%8.4" ECU_ADDRESS 0xC0000706 /end MEASUREMENT
/begin MEASUREMENT EGRVlv_rPosRef_mp "Referenzposition zum Öffnen des AGR-Ventils" SWORD Prc 1 100 -400.0000 399.9878 FORMAT "%8.4" ECU_ADDRESS 0xC0000708 /end MEASUREMENT
/begin MEASUREMENT EGRVlv_rPs "Tastverhältnisausgang der Endstufe" SWORD DtyCyc 1 100 -327.6800 327.6700 FORMAT "%8.4" ECU_ADDRESS 0xD0006DB4 /end MEASUREMENT
/begin MEASUREMENT EGRVlv_rPullDwnEGR "Steuerwert, zum langsamen Schließen des Ventils" SWORD Prc 1 100 -400.0000 399.9878 FORMAT "%8.4" ECU_ADDRESS 0xD0006DB6 /end MEASUREMENT
/begin MEASUREMENT EGRVlv_rRlsEGR "Zusätzlicher Steuerwert zur Freigabe eines klemmenden Ventils" SWORD Prc 1 100 -400.0000 399.9878 FORMAT "%8.4" ECU_ADDRESS 0xD0006DB8 /end MEASUREMENT
/begin MEASUREMENT EGRVlv_rSens "Umgewandelter AGR-Ventilpositionswert" SWORD Prc 1 100 -400.0000 399.9878 FORMAT "%8.4" ECU_ADDRESS 0xD0006DBA /end MEASUREMENT
/begin MEASUREMENT EGRVlv_rSum_mp "Summe der gelesenen Offsetpositionen" SWORD Prc 1 100 -400.0000 399.9878 FORMAT "%8.4" ECU_ADDRESS 0xC000070A /end MEASUREMENT
/begin MEASUREMENT EGRVlv_stAdap "Status des Zustandsautomaten für Offset-Lernen" UWORD OneToOne 1 100 0.00 65535.00 FORMAT "%8.2" ECU_ADDRESS 0xD0007658 /end MEASUREMENT
/begin MEASUREMENT EGRVlv_stAdapActv_mp "Anpassungsstatus" UBYTE OneToOne 1 100 0.00 255.0 FORMAT "%5.1" ECU_ADDRESS 0xC000070C /end MEASUREMENT
/begin MEASUREMENT EGRVlv_stAdapVlv_mp "Status, ob das AGR-Ventil während des Offset-Lernens geöffnet oder geschlossen ist" UBYTE OneToOne 1 100 0.00 255.0 FORMAT "%5.1" ECU_ADDRESS 0xC000070D /end MEASUREMENT
/begin MEASUREMENT EGRVlv_stEdgOpn_mp "" UBYTE OneToOne 1 100 0.00 255.0 FORMAT "%5.1" ECU_ADDRESS 0xC000070E /end MEASUREMENT
/begin MEASUREMENT EGRVlv_stFrstOpn_mp "Erkennung der ersten Öffnung des AGR-Ventils während des Offset-Lernens" UBYTE OneToOne 1 100 0.00 255.0 FORMAT "%5.1" ECU_ADDRESS 0xC000070F /end MEASUREMENT
/begin MEASUREMENT EGRVlv_stMon "Überwachungsstatus des AGR-Ventils" UWORD OneToOne 1 100 0.00 65535.00 FORMAT "%8.2" ECU_ADDRESS 0xD000765A /end MEASUREMENT
/begin MEASUREMENT EGRVlv_stMovFin_mp "Status des abgeschlossenen Offset-Lernenszyklen" UBYTE OneToOne 1 100 0.00 255.0 FORMAT "%5.1" ECU_ADDRESS 0xC0000710 /end MEASUREMENT
/begin MEASUREMENT EGRVlv_stNewVlvTrg_mp "Status, ob das AGR-Ventil neu ist." UBYTE OneToOne 1 100 0.00 255.0 FORMAT "%5.1" ECU_ADDRESS 0xC0000711 /end MEASUREMENT
/begin MEASUREMENT EGRVlv_stOfsLrn "Zustandsautomat des Offset-Lernens" UBYTE OneToOne 1 100 0.00 255.0 FORMAT "%5.1" ECU_ADDRESS 0xD0008FD4 /end MEASUREMENT
/begin MEASUREMENT EGRVlv_stOfsLrnRls_mp "Freigabestatus vom Offset-Lernen der AGR-Ventilposition" UBYTE OneToOne 1 100 0.00 255.0 FORMAT "%5.1" ECU_ADDRESS 0xC0000712 /end MEASUREMENT
/begin MEASUREMENT EGRVlv_stOfsLrnStMch_mp "Status des Zustandsautomaten für Offset-Lernen" UBYTE OneToOne 1 100 0.00 255.0 FORMAT "%5.1" ECU_ADDRESS 0xC0000713 /end MEASUREMENT
/begin MEASUREMENT EGRVlv_stOfsLrnStrt "Trigger zum Starten des Offset-Lernens von einem Diagnosetester-Werkzeug" UBYTE OneToOne 1 100 0.00 255.0 FORMAT "%5.1" ECU_ADDRESS 0xD0008FD5 /end MEASUREMENT
/begin MEASUREMENT EGRVlv_stSlwCls_mp "Status, ob Parameter berechnet werden" UBYTE OneToOne 1 100 0.00 255.0 FORMAT "%5.1" ECU_ADDRESS 0xC00006F0 /end MEASUREMENT
/begin MEASUREMENT EGRVlv_stStrStMch_mp "Status der Store- Zustandsautomat" UBYTE OneToOne 1 100 0.00 255.0 FORMAT "%5.1" ECU_ADDRESS 0xC0000714 /end MEASUREMENT
/begin MEASUREMENT EGRVlv_stStr_mp "Status, ob die gelesene Position gespeichert ist oder nicht" UBYTE OneToOne 1 100 0.00 255.0 FORMAT "%5.1" ECU_ADDRESS 0xC0000715 /end MEASUREMENT
/begin MEASUREMENT EGRVlv_stTPullDwn_mp "" UBYTE OneToOne 1 100 0.00 255.0 FORMAT "%5.1" ECU_ADDRESS 0xC0000716 /end MEASUREMENT
/begin MEASUREMENT EGRVlv_stTrg_mp "Trigger des Offset-Lernens der AGR-Ventilposition" UBYTE OneToOne 1 100 0.00 255.0 FORMAT "%5.1" ECU_ADDRESS 0xC0000717 /end MEASUREMENT
/begin MEASUREMENT EGRVlv_stVlvClsBuf_mp "Status des AGR-Ventilschlußes" UBYTE OneToOne 1 100 0.00 255.0 FORMAT "%5.1" ECU_ADDRESS 0xC0000718 /end MEASUREMENT
/begin MEASUREMENT EGRVlv_stVlvClsd_mp "Status, ob der geschlossenen Zyklus während des Offset-Lernens abgeschlossen ist." UBYTE OneToOne 1 100 0.00 255.0 FORMAT "%5.1" ECU_ADDRESS 0xC0000719 /end MEASUREMENT
/begin MEASUREMENT EGRVlv_stVlvDiff_mp "Status von dem Öffnen des Ventils" UBYTE OneToOne 1 100 0.00 255.0 FORMAT "%5.1" ECU_ADDRESS 0xC000071A /end MEASUREMENT
/begin MEASUREMENT EGRVlv_stVlvJamBuf_mp "Klemmender Status des AGR-Ventils während des Offset-Lernens" UBYTE OneToOne 1 100 0.00 255.0 FORMAT "%5.1" ECU_ADDRESS 0xC000071B /end MEASUREMENT
/begin MEASUREMENT EGRVlv_stVlvOpnBuf_mp "Offener Status des AGR-Ventils während des Offset-Lernens" UBYTE OneToOne 1 100 0.00 255.0 FORMAT "%5.1" ECU_ADDRESS 0xC000071C /end MEASUREMENT
/begin MEASUREMENT EGRVlv_stVlvStkCls_mp "" UBYTE OneToOne 1 100 0.00 255.0 FORMAT "%5.1" ECU_ADDRESS 0xC000071D /end MEASUREMENT
/begin MEASUREMENT EGRVlv_stVlvStk_mp "Status, ob das AGR-Ventil während des Offset-Lernens geklemmt ist" UBYTE OneToOne 1 100 0.00 255.0 FORMAT "%5.1" ECU_ADDRESS 0xC000071E /end MEASUREMENT
/begin MEASUREMENT EGRVlv_uRaw "Rohwert aus dem AGR-Ventilpositionssensor" SWORD Volt 1 100 -6553.600 6553.400 FORMAT "%8.3" ECU_ADDRESS 0xD0006DBC /end MEASUREMENT
/begin MEASUREMENT EGT_facRmpVal "" SWORD EGTSwt_S16 1 100 -2.000000 1.999939 FORMAT "%8.6" ECU_ADDRESS 0xD0006DBE /end MEASUREMENT
/begin MEASUREMENT EGT_st "Regenerationsanforderung für Abgasnachbehandlung (drehzahlsynchron)" ULONG OneToOne 1 100 0.00 4294967295.00 FORMAT "%13.2" ECU_ADDRESS 0xD0004508 /end MEASUREMENT
/begin MEASUREMENT EGT_stCoRgn "" UBYTE OneToOne 1 100 0.00 255.0 FORMAT "%5.1" ECU_ADDRESS 0xD0008FD6 /end MEASUREMENT
/begin MEASUREMENT EGT_stCoRgnOld_mp "" UBYTE OneToOne 1 100 0.00 255.0 FORMAT "%5.1" ECU_ADDRESS 0xC0000720 /end MEASUREMENT
/begin MEASUREMENT EGT_stCoRgnTSync "" UBYTE OneToOne 1 100 0.00 255.0 FORMAT "%5.1" ECU_ADDRESS 0xD0008FD7 /end MEASUREMENT
/begin MEASUREMENT EGT_stEndRmp_mp "" UBYTE OneToOne 1 100 0.00 255.0 FORMAT "%5.1" ECU_ADDRESS 0xC000071F /end MEASUREMENT
/begin MEASUREMENT EGT_stLck "" UBYTE OneToOne 1 100 0.00 255.0 FORMAT "%5.1" ECU_ADDRESS 0xD0008FD9 /end MEASUREMENT
/begin MEASUREMENT EGT_stRgnOilDil_mp "" UBYTE OneToOne 1 100 0.00 255.0 FORMAT "%5.1" ECU_ADDRESS 0xC0000721 /end MEASUREMENT
/begin MEASUREMENT EGT_stTSync "Regenerationsanforderung für Abgasnachbehandlung (zeitsynchron)" ULONG OneToOne 1 100 0.00 4294967295.00 FORMAT "%13.2" ECU_ADDRESS 0xD000450C /end MEASUREMENT
/begin MEASUREMENT EGT_stTSyncChngRls_mp "" UBYTE OneToOne 1 100 0.00 255.0 FORMAT "%5.1" ECU_ADDRESS 0xC0000722 /end MEASUREMENT
/begin MEASUREMENT EGT_stTSyncDes_mp "" ULONG OneToOne 1 100 0.00 4294967295.00 FORMAT "%13.2" ECU_ADDRESS 0xC0000724 /end MEASUREMENT
/begin MEASUREMENT EGT_stTSyncLck "" UBYTE OneToOne 1 100 0.00 255.0 FORMAT "%5.1" ECU_ADDRESS 0xD0008FDA /end MEASUREMENT
/begin MEASUREMENT EGT_stTSyncTmp_mp "" ULONG OneToOne 1 100 0.00 4294967295.00 FORMAT "%13.2" ECU_ADDRESS 0xC0000728 /end MEASUREMENT
/begin MEASUREMENT EGT_swtEGTActv "" UBYTE EGT_swtVAL 1 100 0.00 3.00000000000 FORMAT "%13.11" ECU_ADDRESS 0xD0008FDB /end MEASUREMENT
/begin MEASUREMENT EGT_swtRgnLck_mp "" UBYTE OneToOne 1 100 0.00 255.0 FORMAT "%5.1" ECU_ADDRESS 0xC000072C /end MEASUREMENT
/begin MEASUREMENT EGT_tiRgn "Zeit seit letzter Änderung von EGT_st (drehzahlsynchron)" SLONG Time_s 1 100 -21474836.4800 21474836.4700 FORMAT "%13.4" ECU_ADDRESS 0xD0004308 /end MEASUREMENT
/begin MEASUREMENT EGT_tiRgnOilDil "" SLONG Time_s 1 100 -21474836.4800 21474836.4700 FORMAT "%13.4" ECU_ADDRESS 0xD000430C /end MEASUREMENT
/begin MEASUREMENT EGT_tiRgnTSync "Zeit seit letzter Änderung von EGT_st (zeitsynchron)" SLONG Time_s 1 100 -21474836.4800 21474836.4700 FORMAT "%13.4" ECU_ADDRESS 0xD0004310 /end MEASUREMENT
/begin MEASUREMENT EGT_tiRmpSlpMax "" ULONG TimeEGTRmp 1 100 0.000000015258789 65.536000000000001 FORMAT "%19.16" ECU_ADDRESS 0xD0004510 /end MEASUREMENT
/begin MEASUREMENT EMCtl_nEngHysHi_mp "" SWORD EngN 1 100 -16384.00 16383.50 FORMAT "%8.2" ECU_ADDRESS 0xC000072E /end MEASUREMENT
/begin MEASUREMENT EMCtl_nEngHysLo_mp "" SWORD EngN 1 100 -16384.00 16383.50 FORMAT "%8.2" ECU_ADDRESS 0xC0000730 /end MEASUREMENT
/begin MEASUREMENT EMCtl_rEMDmp_mp "" SWORD Prc 1 100 -400.0000 399.9878 FORMAT "%8.4" ECU_ADDRESS 0xC0000732 /end MEASUREMENT
/begin MEASUREMENT EMCtl_stValCalc_mp "" UBYTE OneToOne 1 100 0.00 255.0 FORMAT "%5.1" ECU_ADDRESS 0xC0000734 /end MEASUREMENT
/begin MEASUREMENT EMDmp_r0 "" SWORD Prc 1 100 -400.0000 399.9878 FORMAT "%8.4" ECU_ADDRESS 0xD0006DC0 /end MEASUREMENT
/begin MEASUREMENT EMDmp_r1 "" SWORD Prc 1 100 -400.0000 399.9878 FORMAT "%8.4" ECU_ADDRESS 0xD0006DC2 /end MEASUREMENT
/begin MEASUREMENT EMDmp_rPs "" SWORD DtyCyc 1 100 -327.6800 327.6700 FORMAT "%8.4" ARRAY_SIZE 1 ECU_ADDRESS 0xD0006DC4 /end MEASUREMENT
/begin MEASUREMENT EMDmp_stPs "" UBYTE OneToOne 1 100 0.00 255.0 FORMAT "%5.1" ARRAY_SIZE 1 ECU_ADDRESS 0xD0008FDC /end MEASUREMENT
/begin MEASUREMENT EngDa_tEng "Motortemperatur" SWORD Temp_Cels 1 100 -3549.940 3003.560 FORMAT "%8.3" ECU_ADDRESS 0xD000694C /end MEASUREMENT
/begin MEASUREMENT EngDa_tFld "Motortemperatur-Feld" SWORD Temp_Cels 1 100 -3549.940 3003.560 FORMAT "%8.3" ARRAY_SIZE 3 ECU_ADDRESS 0xD000694E /end MEASUREMENT
/begin MEASUREMENT EngDa_tiEngOn "Aktuelle Betriebszeit" SLONG TimeEngOn 1 100 -2147483648.00 2147483647.00 FORMAT "%13.2" ECU_ADDRESS 0xD000427C /end MEASUREMENT
/begin MEASUREMENT EngDa_tStrt "Motorstarttemperatur" SWORD Temp_Cels 1 100 -3549.940 3003.560 FORMAT "%8.3" ECU_ADDRESS 0xD0006954 /end MEASUREMENT
/begin MEASUREMENT EngDem_dnEngnAvrg_mp "Drehzahlgradient nach DT1 Glied" SWORD dn_dZ20 1 100 -163840.0 163835.0 FORMAT "%8.1" ECU_ADDRESS 0xC0000736 /end MEASUREMENT
/begin MEASUREMENT EngDem_dVolFlt_mp "Gefilterter Abgasvolumenstrom" SWORD CubMtrPerHr 1 100 -3276.800 3276.700 FORMAT "%8.3" ECU_ADDRESS 0xC0000738 /end MEASUREMENT
/begin MEASUREMENT EngDem_facAdj "Abgleichwert aus EEPROM" SWORD Fact 1 100 -4.000000 3.999878 FORMAT "%8.6" ECU_ADDRESS 0xD0006E20 /end MEASUREMENT
/begin MEASUREMENT EngDem_pDiffPFltPrdc2_mp "Vorhergesagter Differenzdruck über Partikelfilter oder OxiCat" SWORD Pres_hPa 1 100 -32768.00 3500.00 FORMAT "%8.2" ECU_ADDRESS 0xC000073A /end MEASUREMENT
/begin MEASUREMENT EngDem_pDiffPFltPrdc_mp "Vorhergesagter Differenzdruck über Partikelfilter" SWORD Pres_hPa 1 100 -32768.00 3500.00 FORMAT "%8.2" ECU_ADDRESS 0xC000073C /end MEASUREMENT
/begin MEASUREMENT EngDem_resFlowFlt_mp "Gefilterter CSF Strömungswdst." SWORD Res_hPaHrPerCM 1 100 -3.276800 3.276700 FORMAT "%8.6" ECU_ADDRESS 0xC000073E /end MEASUREMENT
/begin MEASUREMENT EngDem_stOvrFul_mp "Statusbits Overfueling" UBYTE OneToOne 1 100 0.00 255.0 FORMAT "%5.1" ECU_ADDRESS 0xC0000740 /end MEASUREMENT
/begin MEASUREMENT EngDem_stTrqLimErr "Status Momentenbegrenzung" UBYTE OneToOne 1 100 0.00 255.0 FORMAT "%5.1" ECU_ADDRESS 0xD0008FE8 /end MEASUREMENT
/begin MEASUREMENT EngDem_stTrqLimErr1 "Statusmessage f. Ersatzmoment bei Systemfehler_1" UBYTE OneToOne 1 100 0.00 255.0 FORMAT "%5.1" ECU_ADDRESS 0xD0008FE4 /end MEASUREMENT
/begin MEASUREMENT EngDem_stTrqLimErr2 "Statusmessage f. Ersatzmoment bei Systemfehler_2" UBYTE OneToOne 1 100 0.00 255.0 FORMAT "%5.1" ECU_ADDRESS 0xD0008FE5 /end MEASUREMENT
/begin MEASUREMENT EngDem_stTrqLimErr3 "Statusmessage f. Ersatzmoment bei Systemfehler_3" UBYTE OneToOne 1 100 0.00 255.0 FORMAT "%5.1" ECU_ADDRESS 0xD0008FE6 /end MEASUREMENT
/begin MEASUREMENT EngDem_stTrqLimErr4 "Statusmessage f. Ersatzmoment bei Systemfehler_4" UBYTE OneToOne 1 100 0.00 255.0 FORMAT "%5.1" ECU_ADDRESS 0xD0008FE7 /end MEASUREMENT
/begin MEASUREMENT EngDem_stTrqLimErrActv "Statusmessage zur Überprüfung ob Momentenbegrenzung aktiv ist" UBYTE OneToOne 1 100 0.00 255.0 FORMAT "%5.1" ECU_ADDRESS 0xD0008FE9 /end MEASUREMENT
/begin MEASUREMENT EngDem_stTrqLimPFltErr "Statusmessage f. Ersatzmoment bei Systemfehler_Partikelfilter" UBYTE default 1 100 0.00 255.0 FORMAT "%5.1" ECU_ADDRESS 0xD0008FEA /end MEASUREMENT
/begin MEASUREMENT EngDem_trqInrLim "Begrenzungsmoment (als inneres Motormoment)" SWORD Trq 1 100 -3276.800 3276.700 FORMAT "%8.3" ECU_ADDRESS 0xD0006E22 /end MEASUREMENT
/begin MEASUREMENT EngDem_trqInrLimLead "Inneres Begrenzungsmoment Leadpfad" SWORD Trq 1 100 -3276.800 3276.700 FORMAT "%8.3" ECU_ADDRESS 0xD0006E24 /end MEASUREMENT
/begin MEASUREMENT EngDem_trqInrLimLead1_mp "Torque lead limitation after error condition #1" SWORD Trq 1 100 -3276.800 3276.700 FORMAT "%8.3" ECU_ADDRESS 0xC0000742 /end MEASUREMENT
/begin MEASUREMENT EngDem_trqInrLimLead2_mp "Torque lead limitation after error condition #2" SWORD Trq 1 100 -3276.800 3276.700 FORMAT "%8.3" ECU_ADDRESS 0xC0000744 /end MEASUREMENT
/begin MEASUREMENT EngDem_trqLimErr "Begrenzungsmoment im Fehlerfall" SWORD Trq 1 100 -3276.800 3276.700 FORMAT "%8.3" ECU_ADDRESS 0xD0006E2E /end MEASUREMENT
/begin MEASUREMENT EngDem_trqLimErr1 "Begrenzungsmoment bei fehlerhaften Raildruck" SWORD Trq 1 100 -3276.800 3276.700 FORMAT "%8.3" ECU_ADDRESS 0xD0006E26 /end MEASUREMENT
/begin MEASUREMENT EngDem_trqLimErr1Lead_mp "Begrenzungsmoment Leadpfad bei Momentbegrenzungsfehler 1" SWORD Trq 1 100 -3276.800 3276.700 FORMAT "%8.3" ECU_ADDRESS 0xC0000746 /end MEASUREMENT
/begin MEASUREMENT EngDem_trqLimErr2 "Begrenzungsmoment bei fehlerhafter Luftmenge pro Zylinder" SWORD Trq 1 100 -3276.800 3276.700 FORMAT "%8.3" ECU_ADDRESS 0xD0006E28 /end MEASUREMENT
/begin MEASUREMENT EngDem_trqLimErr2Lead_mp "Begrenzungsmoment Leadpfad bei Momentbegrenzungsfehler 2" SWORD Trq 1 100 -3276.800 3276.700 FORMAT "%8.3" ECU_ADDRESS 0xC0000748 /end MEASUREMENT
/begin MEASUREMENT EngDem_trqLimErr3 "Begrenzungsmoment bei fehler" SWORD Trq 1 100 -3276.800 3276.700 FORMAT "%8.3" ECU_ADDRESS 0xD0006E2A /end MEASUREMENT
/begin MEASUREMENT EngDem_trqLimErr3Lead_mp "Begrenzungsmoment Leadpfad bei Momentbegrenzungsfehler 3" SWORD Trq 1 100 -3276.800 3276.700 FORMAT "%8.3" ECU_ADDRESS 0xC000074A /end MEASUREMENT
/begin MEASUREMENT EngDem_trqLimErr4 "Begrenzungsmoment bei fehler" SWORD Trq 1 100 -3276.800 3276.700 FORMAT "%8.3" ECU_ADDRESS 0xD0006E2C /end MEASUREMENT
/begin MEASUREMENT EngDem_trqLimErr4Lead_mp "Begrenzungsmoment Leadpfad bei Momentbegrenzungsfehler 4" SWORD Trq 1 100 -3276.800 3276.700 FORMAT "%8.3" ECU_ADDRESS 0xC000074C /end MEASUREMENT
/begin MEASUREMENT EngDem_trqLimErrLeadMin1_mp "Begrenzungsmoment Leadpfad nach Minimumbildung 1" SWORD Trq 1 100 -3276.800 3276.700 FORMAT "%8.3" ECU_ADDRESS 0xC000074E /end MEASUREMENT
/begin MEASUREMENT EngDem_trqLimErrLeadMin2_mp "Begrenzungsmoment Leadpfad nach Minimumbildung 2" SWORD Trq 1 100 -3276.800 3276.700 FORMAT "%8.3" ECU_ADDRESS 0xC0000750 /end MEASUREMENT
/begin MEASUREMENT EngDem_trqLimErrLeadMin3_mp "Begrenzungsmoment Leadpfad nach Minimumbildung 3" SWORD Trq 1 100 -3276.800 3276.700 FORMAT "%8.3" ECU_ADDRESS 0xC0000752 /end MEASUREMENT
/begin MEASUREMENT EngDem_trqLimErrLead_mp "Begrenzungsmoment Leadpfad bei Momentbegrenzungsfehler" SWORD Trq 1 100 -3276.800 3276.700 FORMAT "%8.3" ECU_ADDRESS 0xC0000754 /end MEASUREMENT
/begin MEASUREMENT EngDem_trqLimMin1_mp "Wirksames Begrenzungsmoment aus CSF Motorschutz" SWORD Trq 1 100 -3276.800 3276.700 FORMAT "%8.3" ECU_ADDRESS 0xC0000756 /end MEASUREMENT
/begin MEASUREMENT EngDem_trqLimMinEEPVal_mp "Minimum aus Begrenzungsmoment bei CSF Motorschutz" SWORD Trq 1 100 -3276.800 3276.700 FORMAT "%8.3" ECU_ADDRESS 0xC0000758 /end MEASUREMENT
/begin MEASUREMENT EngDem_trqLimPDiff "Begrenzungsmoment aufgrund Abgasgegendruck" SWORD Trq 1 100 -3276.800 3276.700 FORMAT "%8.3" ECU_ADDRESS 0xD0006E30 /end MEASUREMENT
/begin MEASUREMENT EngDem_trqLimPDiffNOffsAdd_mp "Drehzahlabhängiges Moment zur Gewährleistung sicherer Motorstarts." SWORD Trq 1 100 -3276.800 3276.700 FORMAT "%8.3" ECU_ADDRESS 0xC000075A /end MEASUREMENT
/begin MEASUREMENT EngDem_trqLimPDiffNOffs_mp "n-Teil des Moments zur Verbesserung des Motorstarts" SWORD Trq 1 100 -3276.800 3276.700 FORMAT "%8.3" ECU_ADDRESS 0xC000075C /end MEASUREMENT
/begin MEASUREMENT EngDem_trqLimPFlt1_mp "Begrenzungsmoment aus Differenzdruck bei CSF Motorschutz" SWORD Trq 1 100 -3276.800 3276.700 FORMAT "%8.3" ECU_ADDRESS 0xC000075E /end MEASUREMENT
/begin MEASUREMENT EngDem_trqLimRslt0_mp "Begrenzungsmoment resultierend 0" SWORD Trq 1 100 -3276.800 3276.700 FORMAT "%8.3" ECU_ADDRESS 0xC0000760 /end MEASUREMENT
/begin MEASUREMENT EngDem_trqLimRslt1_mp "Begrenzungsmoment resultierend 1" SWORD Trq 1 100 -3276.800 3276.700 FORMAT "%8.3" ECU_ADDRESS 0xC0000762 /end MEASUREMENT
/begin MEASUREMENT EngDem_trqLimRslt2_mp "Begrenzungsmoment resultierend 2" SWORD Trq 1 100 -3276.800 3276.700 FORMAT "%8.3" ECU_ADDRESS 0xC0000764 /end MEASUREMENT
/begin MEASUREMENT EngDem_trqLimRslt_mp "Begrenzungsmoment resultierend" SWORD Trq 1 100 -3276.800 3276.700 FORMAT "%8.3" ECU_ADDRESS 0xC0000766 /end MEASUREMENT
/begin MEASUREMENT EngDem_trqLimSwt "Begrenzungsmoment" SWORD Trq 1 100 -3276.800 3276.700 FORMAT "%8.3" ECU_ADDRESS 0xD0006E32 /end MEASUREMENT
/begin MEASUREMENT EngDem_trqLimSwt1_mp "Begrenzungsmoment 1" SWORD Trq 1 100 -3276.800 3276.700 FORMAT "%8.3" ECU_ADDRESS 0xC0000768 /end MEASUREMENT
/begin MEASUREMENT EngDem_trqLimSwt2_mp "Begrenzungsmoment 2" SWORD Trq 1 100 -3276.800 3276.700 FORMAT "%8.3" ECU_ADDRESS 0xC000076A /end MEASUREMENT
/begin MEASUREMENT EngDem_trqLimSwt3_mp "Begrenzungsmoment 3" SWORD Trq 1 100 -3276.800 3276.700 FORMAT "%8.3" ECU_ADDRESS 0xC000076C /end MEASUREMENT
/begin MEASUREMENT EngDem_trqLimSwt4_mp "Begrenzungsmoment 4" SWORD Trq 1 100 -3276.800 3276.700 FORMAT "%8.3" ECU_ADDRESS 0xC000076E /end MEASUREMENT
/begin MEASUREMENT EngDem_trqLimSwt5_mp "Begrenzungsmoment 5" SWORD Trq 1 100 -3276.800 3276.700 FORMAT "%8.3" ECU_ADDRESS 0xC0000770 /end MEASUREMENT
/begin MEASUREMENT EngDem_trqLimSwtMinAdj_mp "Inneres Begrenzungsmoment vor Overfuelling Korrektur" SWORD Trq 1 100 -3276.800 3276.700 FORMAT "%8.3" ECU_ADDRESS 0xC0000772 /end MEASUREMENT
/begin MEASUREMENT EngDem_trqLimSwtMin_mp "Inneres Begrenzungsmoment vor Abgleichwert Korrektur" SWORD Trq 1 100 -3276.800 3276.700 FORMAT "%8.3" ECU_ADDRESS 0xC0000774 /end MEASUREMENT
/begin MEASUREMENT EngDem_trqOvrFul "Overfueling Menge nach Rampe" SWORD Trq 1 100 -3276.800 3276.700 FORMAT "%8.3" ECU_ADDRESS 0xD0006E34 /end MEASUREMENT
/begin MEASUREMENT Exh_pAdapPFltDiff "Vorhergesagter Differenzdruck über Partikelfilter" SWORD Pres_hPa 1 100 -32768.00 3500.00 FORMAT "%8.2" ECU_ADDRESS 0xD0006E8C /end MEASUREMENT
/begin MEASUREMENT PFltLd_resFlow "Strömungswiderstand des Partikelfilters" SWORD Res_hPaHrPerCM 1 100 -3.276800 3.276700 FORMAT "%8.6" ECU_ADDRESS 0xD000743A /end MEASUREMENT
/begin FUNCTION dsched_auto ""
 /begin DEF_CHARACTERISTIC DSCHED_AsgnCheck.FId_InhibitAlways_C DSCHED_AsgnCheck.FId_CoordALS_C DSCHED_AsgnCheck.FId_CoordFBC_C DSCHED_AsgnCheck.FId_CoordTAA_C DSCHED_AsgnCheck.FId_CoordZFC_C DSCHED_BsPrio.FId_InhibitAlways_C DSCHED_BsPrio.FId_CoordALS_C DSCHED_BsPrio.FId_CoordFBC_C DSCHED_BsPrio.FId_CoordTAA_C DSCHED_BsPrio.FId_CoordZFC_C DSCHED_DrvModeMsk.FId_InhibitAlways_C DSCHED_DrvModeMsk.FId_CoordALS_C DSCHED_DrvModeMsk.FId_CoordFBC_C DSCHED_DrvModeMsk.FId_CoordTAA_C DSCHED_DrvModeMsk.FId_CoordZFC_C DSCHED_Excl.FId_InhibitAlways_CA DSCHED_Excl.FId_CoordALS_CA DSCHED_Excl.FId_CoordFBC_CA DSCHED_Excl.FId_CoordTAA_CA DSCHED_Excl.FId_CoordZFC_CA DSCHED_FacPhys.FId_InhibitAlways_C DSCHED_FacPhys.FId_CoordALS_C DSCHED_FacPhys.FId_CoordFBC_C DSCHED_FacPhys.FId_CoordTAA_C DSCHED_FacPhys.FId_CoordZFC_C DSCHED_JmpActvPrio.FId_InhibitAlways_C DSCHED_JmpActvPrio.FId_CoordALS_C DSCHED_JmpActvPrio.FId_CoordFBC_C DSCHED_JmpActvPrio.FId_CoordTAA_C DSCHED_JmpActvPrio.FId_CoordZFC_C DSCHED_OpModeMsk.FId_InhibitAlways_C DSCHED_OpModeMsk.FId_CoordALS_C DSCHED_OpModeMsk.FId_CoordFBC_C DSCHED_OpModeMsk.FId_CoordTAA_C DSCHED_OpModeMsk.FId_CoordZFC_C DSCHED_RmpIniPrio.FId_InhibitAlways_C DSCHED_RmpIniPrio.FId_CoordALS_C DSCHED_RmpIniPrio.FId_CoordFBC_C DSCHED_RmpIniPrio.FId_CoordTAA_C DSCHED_RmpIniPrio.FId_CoordZFC_C DSCHED_RmpSlpActv.FId_InhibitAlways_C DSCHED_RmpSlpActv.FId_CoordALS_C DSCHED_RmpSlpActv.FId_CoordFBC_C DSCHED_RmpSlpActv.FId_CoordTAA_C DSCHED_RmpSlpActv.FId_CoordZFC_C DSCHED_RmpSlpPas.FId_InhibitAlways_C DSCHED_RmpSlpPas.FId_CoordALS_C DSCHED_RmpSlpPas.FId_CoordFBC_C DSCHED_RmpSlpPas.FId_CoordTAA_C DSCHED_RmpSlpPas.FId_CoordZFC_C DSCHED_RmpUpLim.FId_InhibitAlways_C DSCHED_RmpUpLim.FId_CoordALS_C DSCHED_RmpUpLim.FId_CoordFBC_C DSCHED_RmpUpLim.FId_CoordTAA_C DSCHED_RmpUpLim.FId_CoordZFC_C DSCHED_SetPointRateActv.FId_InhibitAlways_C DSCHED_SetPointRateActv.FId_CoordALS_C DSCHED_SetPointRateActv.FId_CoordFBC_C DSCHED_SetPointRateActv.FId_CoordTAA_C DSCHED_SetPointRateActv.FId_CoordZFC_C DSCHED_SetPointRatePas.FId_InhibitAlways_C DSCHED_SetPointRatePas.FId_CoordALS_C DSCHED_SetPointRatePas.FId_CoordFBC_C DSCHED_SetPointRatePas.FId_CoordTAA_C DSCHED_SetPointRatePas.FId_CoordZFC_C DSCHED_tiWTT_CA DSCHED_UpLimRateLow.FId_InhibitAlways_C DSCHED_UpLimRateLow.FId_CoordALS_C DSCHED_UpLimRateLow.FId_CoordFBC_C DSCHED_UpLimRateLow.FId_CoordTAA_C DSCHED_UpLimRateLow.FId_CoordZFC_C DSCHED_UpLimRateOk.FId_InhibitAlways_C DSCHED_UpLimRateOk.FId_CoordALS_C DSCHED_UpLimRateOk.FId_CoordFBC_C DSCHED_UpLimRateOk.FId_CoordTAA_C DSCHED_UpLimRateOk.FId_CoordZFC_C DSCHED_xWTTFId_CA /end DEF_CHARACTERISTIC
 /begin OUT_MEASUREMENT DSCHED_DynPrio.FId_Unused DSCHED_DynPrio.FId_InhibitAlways DSCHED_DynPrio.FId_CoordALS DSCHED_DynPrio.FId_CoordFBC DSCHED_DynPrio.FId_CoordTAA DSCHED_DynPrio.FId_CoordZFC DSCHED_PhysPrio.FId_Unused DSCHED_PhysPrio.FId_InhibitAlways DSCHED_PhysPrio.FId_CoordALS DSCHED_PhysPrio.FId_CoordFBC DSCHED_PhysPrio.FId_CoordTAA DSCHED_PhysPrio.FId_CoordZFC DSCHED_RmpPrio.FId_Unused DSCHED_RmpPrio.FId_InhibitAlways DSCHED_RmpPrio.FId_CoordALS DSCHED_RmpPrio.FId_CoordFBC DSCHED_RmpPrio.FId_CoordTAA DSCHED_RmpPrio.FId_CoordZFC DSCHED_St.FId_Unused DSCHED_St.FId_InhibitAlways DSCHED_St.FId_CoordALS DSCHED_St.FId_CoordFBC DSCHED_St.FId_CoordTAA DSCHED_St.FId_CoordZFC DSCHED_TiActv.FId_Unused DSCHED_TiActv.FId_InhibitAlways DSCHED_TiActv.FId_CoordALS DSCHED_TiActv.FId_CoordFBC DSCHED_TiActv.FId_CoordTAA DSCHED_TiActv.FId_CoordZFC DSCHED_TiPas.FId_Unused DSCHED_TiPas.FId_InhibitAlways DSCHED_TiPas.FId_CoordALS DSCHED_TiPas.FId_CoordFBC DSCHED_TiPas.FId_CoordTAA DSCHED_TiPas.FId_CoordZFC DSCHED_WhyExcl.FId_Unused DSCHED_WhyExcl.FId_InhibitAlways DSCHED_WhyExcl.FId_CoordALS DSCHED_WhyExcl.FId_CoordFBC DSCHED_WhyExcl.FId_CoordTAA DSCHED_WhyExcl.FId_CoordZFC /end OUT_MEASUREMENT
/end FUNCTION
/begin FUNCTION DSM ""
 /begin SUB_FUNCTION DDRC DFC DFES DFP DINH DSCHED DSMAux DSMDur DSMRdy DSQ DTR DIUMPR DSM_Conf /end SUB_FUNCTION
/end FUNCTION
/begin FUNCTION DSMAux ""
 /begin DEF_CHARACTERISTIC DSMAUX_dtWUCMin_C DSMAUX_tWUCMin_C DSMAUX_xClearMode_C DSMAUX_xClearTrg_C /end DEF_CHARACTERISTIC
/end FUNCTION
/begin FUNCTION dsmaux_auto ""
 /begin OUT_MEASUREMENT DSMAUX_DTRG.DTRG_Time200ms DSMAUX_DTRG.DTRG_SimilarCondHLC DSMAUX_DTRG.DTRG_AlwaysTrue DSMAUX_DTRG.DTRG_DrivingCycleFLC DSMAUX_DTRG.DTRG_DrivingCycleHLC DSMAUX_DTRG.DTRG_NoTrigger DSMAUX_DTRG.DTRG_WarmUpCycle /end OUT_MEASUREMENT
/end FUNCTION
/begin FUNCTION DSMDur "" /begin DEF_CHARACTERISTIC DSMDur_valEvntQntDist_C DSMDur_valEvntQntTi_C /end DEF_CHARACTERISTIC /end FUNCTION
/begin FUNCTION dsmdur_auto ""
 /begin DEF_CHARACTERISTIC DSMDur_xEnaDFES_CA DSMDur_xEnaGlb_CA DSMDur_xRstDFES_CA DSMDur_xRstGlb_CA DSMDur_xSelEvntDFES_CA DSMDur_xSelEvntGlb_CA /end DEF_CHARACTERISTIC
 /begin OUT_MEASUREMENT DSMDur_ctDFES0 DSMDur_ctDFES1 DSMDur_ctDFES2 DSMDur_ctGlb DSMDur_stGlb /end OUT_MEASUREMENT
/end FUNCTION
/begin FUNCTION DSMRdy ""
 /begin DEF_CHARACTERISTIC DSMRdy_Grp.Misf_CA DSMRdy_Grp.FlSys_CA DSMRdy_Grp.ComprCmpnt_CA DSMRdy_Grp.Cat_CA DSMRdy_Grp.HtCat_CA DSMRdy_Grp.EvpSys_CA DSMRdy_Grp.SecAirSys_CA DSMRdy_Grp.AC_CA DSMRdy_Grp.O2Sens_CA DSMRdy_Grp.O2SensHt_CA DSMRdy_Grp.EGR_CA DSMRdy_X.PID1ForceLowMsk_C DSMRdy_X.PID1ForceHighMsk_C DSMRdy_X.PID41ForceLowMsk_C DSMRdy_X.PID41ForceHighMsk_C DSMRdy_X.DFESSetMode_C /end DEF_CHARACTERISTIC
 /begin OUT_MEASUREMENT DSMRdy_Ct.RdyMisf_mp DSMRdy_Ct.RdyFlSys_mp DSMRdy_Ct.RdyComprCmpnt_mp DSMRdy_Ct.RdyCat_mp DSMRdy_Ct.RdyHtCat_mp DSMRdy_Ct.RdyEvpSys_mp DSMRdy_Ct.RdySecAirSys_mp DSMRdy_Ct.RdyAC_mp DSMRdy_Ct.RdyO2Sens_mp DSMRdy_Ct.RdyO2SensHt_mp DSMRdy_Ct.RdyEGR_mp DSMRdy_Ct.CyclCmplMisf_mp DSMRdy_Ct.CyclCmplFlSys_mp DSMRdy_Ct.CyclCmplComprCmpnt_mp DSMRdy_Ct.CyclCmplCat_mp DSMRdy_Ct.CyclCmplHtCat_mp DSMRdy_Ct.CyclCmplEvpSys_mp DSMRdy_Ct.CyclCmplSecAirSys_mp DSMRdy_Ct.CyclCmplAC_mp DSMRdy_Ct.CyclCmplO2Sens_mp DSMRdy_Ct.CyclCmplO2SensHt_mp DSMRdy_Ct.CyclCmplEGR_mp DSMRdy_Ct.LockMisf_mp DSMRdy_Ct.LockFlSys_mp DSMRdy_Ct.LockComprCmpnt_mp DSMRdy_Ct.LockCat_mp DSMRdy_Ct.LockHtCat_mp DSMRdy_Ct.LockEvpSys_mp DSMRdy_Ct.LockSecAirSys_mp DSMRdy_Ct.LockAC_mp DSMRdy_Ct.LockO2Sens_mp DSMRdy_Ct.LockO2SensHt_mp DSMRdy_Ct.LockEGR_mp DSMRdy_Ct.SupMisf_mp DSMRdy_Ct.SupFlSys_mp DSMRdy_Ct.SupComprCmpnt_mp DSMRdy_Ct.SupCat_mp DSMRdy_Ct.SupHtCat_mp DSMRdy_Ct.SupEvpSys_mp DSMRdy_Ct.SupSecAirSys_mp DSMRdy_Ct.SupAC_mp DSMRdy_Ct.SupO2Sens_mp DSMRdy_Ct.SupO2SensHt_mp DSMRdy_Ct.SupEGR_mp DSMRdy_stGrpAct DSMRdy_stGrpLock DSMRdy_stGrpRdy DSMRdy_stGrpRdyDFES DSMRdy_stGrpRdyScan DSMRdy_stGrpSup DSMRdy_Why.RdyMisf_mp DSMRdy_Why.RdyFlSys_mp DSMRdy_Why.RdyComprCmpnt_mp DSMRdy_Why.RdyCat_mp DSMRdy_Why.RdyHtCat_mp DSMRdy_Why.RdyEvpSys_mp DSMRdy_Why.RdySecAirSys_mp DSMRdy_Why.RdyAC_mp DSMRdy_Why.RdyO2Sens_mp DSMRdy_Why.RdyO2SensHt_mp DSMRdy_Why.RdyEGR_mp DSMRdy_Why.CyclCmplMisf_mp DSMRdy_Why.CyclCmplFlSys_mp DSMRdy_Why.CyclCmplComprCmpnt_mp DSMRdy_Why.CyclCmplCat_mp DSMRdy_Why.CyclCmplHtCat_mp DSMRdy_Why.CyclCmplEvpSys_mp DSMRdy_Why.CyclCmplSecAirSys_mp DSMRdy_Why.CyclCmplAC_mp DSMRdy_Why.CyclCmplO2Sens_mp DSMRdy_Why.CyclCmplO2SensHt_mp DSMRdy_Why.CyclCmplEGR_mp DSMRdy_Why.LockMisf_mp DSMRdy_Why.LockFlSys_mp DSMRdy_Why.LockComprCmpnt_mp DSMRdy_Why.LockCat_mp DSMRdy_Why.LockHtCat_mp DSMRdy_Why.LockEvpSys_mp DSMRdy_Why.LockSecAirSys_mp DSMRdy_Why.LockAC_mp DSMRdy_Why.LockO2Sens_mp DSMRdy_Why.LockO2SensHt_mp DSMRdy_Why.LockEGR_mp DSMRdy_xPId1 DSMRdy_xPId41 /end OUT_MEASUREMENT
/end FUNCTION
/begin FUNCTION dsmrdy_auto "" /end FUNCTION
/begin FUNCTION DSM_Conf ""
 /begin OUT_MEASUREMENT DSM_DisblMode_mp DSM_ECUId_mp DSM_nEng_mp DSM_pEnv_mp DSM_rAPP_mp DSM_stStrEnd_mp DSM_stWiggle_mp DSM_tEngDS_mp DSM_tEnv_mp DSM_vVeh_mp /end OUT_MEASUREMENT
/end FUNCTION
/begin FUNCTION DsplECU_Can ""
 /begin DEF_CHARACTERISTIC Com_swtMileageRange_C Com_swtStKombi_C Com_swtTempRelTime_C Com_swtTimeDate_C /end DEF_CHARACTERISTIC
/end FUNCTION
/begin FUNCTION DsplECU_co ""
 /begin LOC_MEASUREMENT Com_dDay Com_dMonth Com_dStKombiCTR Com_dYear Com_lSum Com_stSeason Com_tEnvT Com_volFlTnkQnt /end LOC_MEASUREMENT
/end FUNCTION
/begin FUNCTION DSQ "" /end FUNCTION
/begin FUNCTION DTR "" /end FUNCTION
/begin FUNCTION dtr_auto ""
 /begin DEF_CHARACTERISTIC DTR_numCANOBDId_CA DTR_numCANTstId_CA DTR_xAsgnCANRslt_CA DTR_xAsgnKLineRslt_CA DTR_xKLineCmpnId_CA DTR_xKLineFactor_CA DTR_xKLineOffset_CA DTR_xKLineTstId_CA /end DEF_CHARACTERISTIC
 /begin OUT_MEASUREMENT DTR_valLoLim DTR_valTst DTR_valUpLim /end OUT_MEASUREMENT
/end FUNCTION
/begin FUNCTION ECBVlvAPos_DD "" /begin DEF_CHARACTERISTIC ECBVlv_rTransf_CUR ECBVlv_SRC.uMin_C ECBVlv_SRC.uMax_C /end DEF_CHARACTERISTIC /begin OUT_MEASUREMENT ECBVlv_rSens ECBVlv_uRaw /end OUT_MEASUREMENT /end FUNCTION
/begin FUNCTION ECBVlvAPos_VD ""
 /begin DEF_CHARACTERISTIC ECBVlv_RmpSlp.Pos_C ECBVlv_RmpSlp.Neg_C ECBVlv_TransStg.Dfl_C ECBVlv_TransStg.stSensId_C /end DEF_CHARACTERISTIC
 /begin OUT_MEASUREMENT ECBVlv_rAct /end OUT_MEASUREMENT
/end FUNCTION
/begin FUNCTION ECBVlv_DD ""
 /begin DEF_CHARACTERISTIC ECBVlv_Pwm.tiPer_C ECBVlv_Pwm.stLvl_C ECBVlv_Pwm.rMaxDty_C ECBVlv_Pwm.rPerUn_C ECBVlv_Pwm.tiPh_C ECBVlv_PwmOut.rMin_C ECBVlv_PwmOut.rMax_C ECBVlv_PwmOut.tiBtwTstSCB_C ECBVlv_PwmOut.tiBtwTstOT_C ECBVlv_PwmOut.numTstMax_C ECBVlv_PwmOut.swtBattCor_C ECBVlv_PwmOut.swtPsInv_C ECBVlv_rCnv_CUR ECBVlv_stPsDiaDisbl_C ECBVlv_stPsDisbl_C /end DEF_CHARACTERISTIC
 /begin IN_MEASUREMENT BattU_facCor DevLib_stPwrStgEnaCond /end IN_MEASUREMENT
 /begin OUT_MEASUREMENT ECBVlv_r ECBVlv_rPs /end OUT_MEASUREMENT
/end FUNCTION
/begin FUNCTION ecbvlv_ddvar "" /end FUNCTION
/begin FUNCTION edc2layer_adap ""
 /begin DEF_CHARACTERISTIC edc2layer_bkwdrehtHi_C edc2layer_bkwdrehtLo_C edc2layer_B_ulcp_C edc2layer_nbmsastopt_C edc2layer_nSetPointHigh_C edc2layer_nSetPointLow_C edc2layer_rLoadMax_C edc2layer_rLoadMin_C /end DEF_CHARACTERISTIC
/end FUNCTION
/begin FUNCTION Eec "" /end FUNCTION
/begin FUNCTION Eee "" /begin SUB_FUNCTION Eeebd Eeepdd /end SUB_FUNCTION /end FUNCTION
/begin FUNCTION Eeebd "" /end FUNCTION
/begin FUNCTION Eeepdd "" /end FUNCTION
/begin FUNCTION Eep "" /begin SUB_FUNCTION EepHal Eee /end SUB_FUNCTION /end FUNCTION
/begin FUNCTION eep "" /end FUNCTION
/begin FUNCTION eepcd "" /end FUNCTION
/begin FUNCTION EepHal "" /begin DEF_CHARACTERISTIC Eep_EnFirstInit_CW Eep_EnvRamClr_CW /end DEF_CHARACTERISTIC /begin OUT_MEASUREMENT Eep_EnvRamHist Eep_EnvRamInvld /end OUT_MEASUREMENT /end FUNCTION
/begin FUNCTION Ees "" /begin SUB_FUNCTION Eesbd Eespdd /end SUB_FUNCTION /end FUNCTION
/begin FUNCTION Eesbd "" /end FUNCTION
/begin FUNCTION Eespdd "" /end FUNCTION
/begin FUNCTION egrclg_ctlvalcalc ""
 /begin DEF_CHARACTERISTIC EGRClg_numEngTempCtlVal_C EGRClg_rClgOff_C EGRClg_rClgOn_C EGRClg_rDflVal_CA EGRClg_stBitMskCtlVal_C EGRClg_stPrioMon_CA EGRClg_tEngClgOff_C EGRClg_tEngClgOn_C /end DEF_CHARACTERISTIC
 /begin REF_CHARACTERISTIC HESrv_swtScndFlwActv_C /end REF_CHARACTERISTIC
 /begin IN_MEASUREMENT EngDa_tFld Epm_nEng InjCtl_qCurr /end IN_MEASUREMENT
 /begin OUT_MEASUREMENT EGRClg_stCtlValBits_mp EGRClg_stEGRClgBits_mp EGRClg_stMon /end OUT_MEASUREMENT
 /begin LOC_MEASUREMENT EGRClg_rCtlCor_mp EGRClg_rCtlValNrm_mp EGRClg_stCtlVal_mp EGRClg_stMonBits_mp EGRClg_tEngCtlVal_mp /end LOC_MEASUREMENT
/end FUNCTION
/begin FUNCTION egrclg_ctlvalcalc_inl1 "" /end FUNCTION
/begin FUNCTION egrclg_ctlvalcalc_inl2 "" /begin DEF_CHARACTERISTIC EGRClg_ClgOff_CUR EGRClg_ClgOn_CUR /end DEF_CHARACTERISTIC /begin IN_MEASUREMENT Epm_nEng InjCtl_qCurr PthLead_trqInrCurr /end IN_MEASUREMENT /begin LOC_MEASUREMENT EGRClg_ClgOff_mp EGRClg_ClgOn_mp /end LOC_MEASUREMENT /end FUNCTION
/begin FUNCTION egrclg_ctlvalcalc_inl3 "" /begin DEF_CHARACTERISTIC EGRClg_tCldStrtThres_C EGRClg_tiCldStrt_C /end DEF_CHARACTERISTIC /begin IN_MEASUREMENT CoEng_st /end IN_MEASUREMENT /end FUNCTION
/begin FUNCTION EGRClg_CtlValCalc_Inl4 ""
 /begin DEF_CHARACTERISTIC EGRClg_numAirTempCtlVal_C EGRClg_rAirCtlClgOff_C EGRClg_tAirClgOff_C EGRClg_tAirClgOn_C EGRClg_tEngLowClgOff_C EGRClg_tEngLowClgOn_C /end DEF_CHARACTERISTIC
 /begin REF_CHARACTERISTIC EGRClg_numEngTempCtlVal_C /end REF_CHARACTERISTIC
 /begin IN_MEASUREMENT EGRVlv_r /end IN_MEASUREMENT
 /begin LOC_MEASUREMENT EGRClg_tAirCtlVal_mp EGRClg_tEngCtlVal1_mp /end LOC_MEASUREMENT
/end FUNCTION
/begin FUNCTION egrclg_ctlvalcalc_inl5 "" /begin DEF_CHARACTERISTIC EGRClg_stShOffEOMMsk_C /end DEF_CHARACTERISTIC /begin IN_MEASUREMENT CoEOM_stOpModeAct /end IN_MEASUREMENT /end FUNCTION
/begin FUNCTION egrclg_ctlvalcalc_inl6 "" /end FUNCTION
/begin FUNCTION egrclg_ctlvalcalc_inl7 ""
 /begin DEF_CHARACTERISTIC EGRClg_stBitMskEOM_CA EGRClg_stMonEOMMsk_CA EGRClg_tiMonEOM_CA /end DEF_CHARACTERISTIC
 /begin IN_MEASUREMENT CoEOM_stOpModeAct /end IN_MEASUREMENT
 /begin LOC_MEASUREMENT EGRClg_numEOMMode_mp EGRClg_stBitMskEOM_mp EGRClg_stSelBitMskEOM_mp EGRClg_tiMonEOM_mp /end LOC_MEASUREMENT
/end FUNCTION
/begin FUNCTION egrvlv_dd ""
 /begin DEF_CHARACTERISTIC EGRVlv_facCorStrt_C EGRVlv_Pwm.tiPer_C EGRVlv_Pwm.stLvl_C EGRVlv_Pwm.rMaxDty_C EGRVlv_Pwm.rPerUn_C EGRVlv_Pwm.tiPh_C EGRVlv_PwmOut.rMin_C EGRVlv_PwmOut.rMax_C EGRVlv_PwmOut.tiBtwTstSCB_C EGRVlv_PwmOut.tiBtwTstOT_C EGRVlv_PwmOut.numTstMax_C EGRVlv_PwmOut.swtBattCor_C EGRVlv_PwmOut.swtPsInv_C EGRVlv_rCnv_MAP EGRVlv_rOutDfl_C EGRVlv_stPwrStgDiaDis_C EGRVlv_stPwrStgDis_C EGRVlv_swtHwSel_C EGRVlv_swtLMSPwrStgOn_C EGRVlv_tiBattCorFacFlt_C /end DEF_CHARACTERISTIC
 /begin IN_MEASUREMENT BattU_facCor CoEng_st DevLib_stPwrStgEnaCond EGRVlv_rEGR EGRVlv_rOfsLrnVlv EGRVlv_stAdap EGRVlv_stMon Epm_nEng /end IN_MEASUREMENT
 /begin OUT_MEASUREMENT EGRVlv_rPs /end OUT_MEASUREMENT
 /begin LOC_MEASUREMENT EGRVlv_facCorFlt_mp EGRVlv_rCnv_mp /end LOC_MEASUREMENT
/end FUNCTION
/begin FUNCTION egrvlv_ddsens ""
 /begin DEF_CHARACTERISTIC EGRVlv_rTransf_CUR EGRVlv_SRC.uMin_C EGRVlv_SRC.uMax_C EGRVlv_swtSensPrs_C /end DEF_CHARACTERISTIC
 /begin OUT_MEASUREMENT EGRVlv_rSens EGRVlv_uRaw /end OUT_MEASUREMENT
/end FUNCTION
/begin FUNCTION egrvlv_vdmon ""
 /begin DEF_CHARACTERISTIC EGRVlv_numEngTempMon_C EGRVlv_PullDwnIKi_C EGRVlv_rDvtMax_C EGRVlv_rDvtMin_C EGRVlv_rJamVlvOpnDemMax_C EGRVlv_rJamVlvOpnHi_C EGRVlv_rJamVlvOpnLo_C EGRVlv_rLMSActThresDwn_C EGRVlv_rLMSThresDwn_C EGRVlv_rLMSThresUp_C EGRVlv_RlsIKi_C EGRVlv_rPullDwnMax_C EGRVlv_rRlsMax_C EGRVlv_rStpThres_C EGRVlv_swtGovByp_C EGRVlv_tEngHi_C EGRVlv_tEngLo_C EGRVlv_tiPullDwn_C EGRVlv_tiRepRls_C EGRVlv_tiRls_C /end DEF_CHARACTERISTIC
 /begin IN_MEASUREMENT CoEng_st EGRVlv_r EGRVlv_rAct EGRVlv_rGovDvt EGRVlv_stAdap EngDa_tFld /end IN_MEASUREMENT
 /begin OUT_MEASUREMENT EGRVlv_rPullDwnEGR EGRVlv_rRlsEGR EGRVlv_stMon /end OUT_MEASUREMENT
/end FUNCTION
/begin FUNCTION egrvlv_vdposgov ""
 /begin DEF_CHARACTERISTIC EGRVlv_DKdNgv_C EGRVlv_DKdPsv_C EGRVlv_drActNgv_C EGRVlv_iEff_CUR EGRVlv_IKiNgv_C EGRVlv_IKiPsv_C EGRVlv_PKpNgv_C EGRVlv_PKpPsv_C EGRVlv_rActNgv_C EGRVlv_rGovDvtThres_C EGRVlv_rGovMax_CUR EGRVlv_rGovMin_CUR EGRVlv_rIniStp_C EGRVlv_rOutDMax_C EGRVlv_rOutIMax_C EGRVlv_rPIDWinNgv_C EGRVlv_rPIDWinPsv_C EGRVlv_SlwClsDKd_C EGRVlv_SlwClsIKi_C EGRVlv_SlwClsPKp_C EGRVlv_SmlSigNgvDKd_C EGRVlv_SmlSigNgvIKi_C EGRVlv_SmlSigNgvPKp_C EGRVlv_SmlSigPsvDKd_C EGRVlv_SmlSigPsvIKi_C EGRVlv_SmlSigPsvPKp_C EGRVlv_swtSelDT1In_C EGRVlv_tiCrntEffFlt_C EGRVlv_tiGovDT1_C EGRVlv_tiParDT1_C /end DEF_CHARACTERISTIC
 /begin IN_MEASUREMENT BattU_facCor EGRVlv_rAct EGRVlv_rActNoErrHdl EGRVlv_rPs EGRVlv_rPullDwnEGR EGRVlv_rRlsEGR EGRVlv_stAdap EGRVlv_stMon /end IN_MEASUREMENT
 /begin OUT_MEASUREMENT EGRVlv_r EGRVlv_rEGR EGRVlv_rGovDvt EGRVlv_rGovDvtRel EGRVlv_rGovEGR /end OUT_MEASUREMENT
 /begin LOC_MEASUREMENT EGRVlv_drAct_mp EGRVlv_iEffFlt_mp EGRVlv_iEff_mp EGRVlv_rAbsEGR_mp EGRVlv_rGovMax_mp EGRVlv_rGovMin_mp EGRVlv_rOutD_mp EGRVlv_rOutI_mp EGRVlv_rOutP_mp EGRVlv_stSlwCls_mp /end LOC_MEASUREMENT
/end FUNCTION
/begin FUNCTION egrvlv_vdsens ""
 /begin DEF_CHARACTERISTIC EGRVlv_facAdapClsStrt_C EGRVlv_facAdapPosCls_C EGRVlv_IKiOfsLrnDwn_C EGRVlv_IKiOfsLrnUp_C EGRVlv_numAdapClsMax_C EGRVlv_numTempSel_C EGRVlv_rActMax_C EGRVlv_rActMin_C EGRVlv_rActOfs_C EGRVlv_rAdapAgOpnMax_C EGRVlv_rAdapAgOpnMin_C EGRVlv_rAdapDiffPlausLgT_C EGRVlv_rAdapDiffPlausShT_C EGRVlv_rAdapDiffPlaus_C EGRVlv_rAdapIniOpn0_C EGRVlv_rAdapIniOpn_C EGRVlv_rAdapOpnBnd_C EGRVlv_rCmpNewCtlUn_C EGRVlv_RmpSlp.Pos_C EGRVlv_RmpSlp.Neg_C EGRVlv_rOfsLrnVlvMax_C EGRVlv_rOfsLrnVlvMin_C EGRVlv_rSensVlvThres_C EGRVlv_stNewVlvTrg_C EGRVlv_stOfsLrnTrg_C EGRVlv_swtActOfs_C EGRVlv_swtOfsLrnActv_C EGRVlv_tEngMax_C EGRVlv_tEngMin_C EGRVlv_tiAdapJamVlv_C EGRVlv_tiAdapPullDwn_C EGRVlv_tiClsJamVlv_C EGRVlv_TransStg.Dfl_C EGRVlv_TransStg.stSensId_C EGRVlv_uBattMax_C EGRVlv_uBattMin_C /end DEF_CHARACTERISTIC
 /begin IN_MEASUREMENT BattU_u CoEng_st EGRVlv_rEGR EGRVlv_rSens EGRVlv_stMon EngDa_tFld SyC_stSub /end IN_MEASUREMENT
 /begin OUT_MEASUREMENT EGRVlv_rAct EGRVlv_rActNoErrHdl EGRVlv_rOfsLrnFrst EGRVlv_rOfsLrnLst EGRVlv_rOfsLrnNew EGRVlv_rOfsLrnVlv EGRVlv_stAdap EGRVlv_stOfsLrn EGRVlv_stOfsLrnStrt /end OUT_MEASUREMENT
 /begin LOC_MEASUREMENT EGRVlv_ctAdapCls_mp EGRVlv_rActUnCorOld_mp EGRVlv_rActUnCor_mp EGRVlv_rAdapLrn_mp EGRVlv_rAdapPos_mp EGRVlv_rLinOfs_mp EGRVlv_rOfs_mp EGRVlv_rPlausLgT_mp EGRVlv_rPlausShT_mp EGRVlv_rPlausVal_mp EGRVlv_rPosLrnMax_mp EGRVlv_rPosLrnMin_mp EGRVlv_rPosRef_mp EGRVlv_rSum_mp EGRVlv_stAdapActv_mp EGRVlv_stAdapVlv_mp EGRVlv_stEdgOpn_mp EGRVlv_stFrstOpn_mp EGRVlv_stMovFin_mp EGRVlv_stNewVlvTrg_mp EGRVlv_stOfsLrnRls_mp EGRVlv_stOfsLrnStMch_mp EGRVlv_stStrStMch_mp EGRVlv_stStr_mp EGRVlv_stTPullDwn_mp EGRVlv_stTrg_mp EGRVlv_stVlvClsBuf_mp EGRVlv_stVlvClsd_mp EGRVlv_stVlvDiff_mp EGRVlv_stVlvJamBuf_mp EGRVlv_stVlvOpnBuf_mp EGRVlv_stVlvStkCls_mp EGRVlv_stVlvStk_mp /end LOC_MEASUREMENT
/end FUNCTION
/begin FUNCTION egt "" /end FUNCTION
/begin FUNCTION egt_comp "" /end FUNCTION
/begin FUNCTION egt_corgn "" /begin DEF_CHARACTERISTIC EGT_swtEGTActv_C EGT_swtSetEndRmpBit_C /end DEF_CHARACTERISTIC
 /begin OUT_MEASUREMENT EGT_facRmpVal EGT_st EGT_stCoRgn EGT_stEndRmp_mp EGT_stLck EGT_swtEGTActv EGT_tiRgn /end OUT_MEASUREMENT
/end FUNCTION
/begin FUNCTION egt_corgntsync ""
 /begin DEF_CHARACTERISTIC EGT_stRgnLckMsk_C EGT_swtRgnLckRst_C EGT_swtServiceVal_C EGT_tiRgnOilDilMax_C EGT_tiRgnOilDilSubs_C EGT_tiRmpSlpMax_C /end DEF_CHARACTERISTIC
 /begin OUT_MEASUREMENT EGT_stCoRgnOld_mp EGT_stCoRgnTSync EGT_stRgnOilDil_mp EGT_stTSync EGT_stTSyncChngRls_mp EGT_stTSyncDes_mp EGT_stTSyncLck EGT_stTSyncTmp_mp EGT_swtRgnLck_mp EGT_tiRgnOilDil EGT_tiRgnTSync EGT_tiRmpSlpMax /end OUT_MEASUREMENT
/end FUNCTION
/begin FUNCTION egt_lib "" /end FUNCTION
/begin FUNCTION EMCtl_ValCalc ""
 /begin DEF_CHARACTERISTIC EMCtl_nEngHysDelta_C EMCtl_nEngHysHi_CUR EMCtl_nEngLim_C EMCtl_rOutHard_C EMCtl_rOutSoft_C EMCtl_tiHardAftrGear_C EMCtl_tiSoftAftrStrt_C EMCtl_vXHysHi_C EMCtl_vXHysLo_C /end DEF_CHARACTERISTIC
 /begin IN_MEASUREMENT CoEng_st EMDmp_r0 EngDa_tEng Epm_nEng GlbDa_vX PT_numTraGear /end IN_MEASUREMENT
 /begin LOC_MEASUREMENT EMCtl_nEngHysHi_mp EMCtl_nEngHysLo_mp EMCtl_rEMDmp_mp EMCtl_stValCalc_mp /end LOC_MEASUREMENT
/end FUNCTION
/begin FUNCTION EMDmp_DD ""
 /begin DEF_CHARACTERISTIC EMDmp_DigOut.tiBtwTstSCB_C EMDmp_DigOut.tiBtwTstOT_C EMDmp_DigOut.numTstMax_C EMDmp_Pwm.tiPer_C EMDmp_Pwm.stLvl_C EMDmp_Pwm.rMaxDty_C EMDmp_Pwm.rPerUn_C EMDmp_Pwm.tiPh_C EMDmp_PwmOut.rMin_C EMDmp_PwmOut.rMax_C EMDmp_PwmOut.tiBtwTstSCB_C EMDmp_PwmOut.tiBtwTstOT_C EMDmp_PwmOut.numTstMax_C EMDmp_PwmOut.swtBattCor_C EMDmp_PwmOut.swtPsInv_C EMDmp_rCnv0_CUR EMDmp_rCnv1_CUR EMDmp_rThresHi_CA EMDmp_rThresLo_CA EMDmp_stPsDiaDisbl_CA EMDmp_stPwrStgDis_CA EMDmp_swtHWsel_C /end DEF_CHARACTERISTIC
 /begin IN_MEASUREMENT BattU_facCor DevLib_stPwrStgEnaCond /end IN_MEASUREMENT
 /begin OUT_MEASUREMENT EMDmp_r0 EMDmp_r1 EMDmp_rPs EMDmp_stPs /end OUT_MEASUREMENT
/end FUNCTION
/begin FUNCTION EngDa_TEng "" /begin DEF_CHARACTERISTIC EngDa_tEng_C /end DEF_CHARACTERISTIC /begin IN_MEASUREMENT CEngDsT_t Oil_tSwmp /end IN_MEASUREMENT /begin OUT_MEASUREMENT EngDa_tEng EngDa_tFld EngDa_tStrt /end OUT_MEASUREMENT /end FUNCTION
/begin FUNCTION EngDa_TiEngOn "" /begin DEF_CHARACTERISTIC EngDa_lEepUpd_C /end DEF_CHARACTERISTIC /begin IN_MEASUREMENT CoEng_st Epm_nEng GlbDa_lTotDst /end IN_MEASUREMENT /begin OUT_MEASUREMENT EngDa_tiEngOn /end OUT_MEASUREMENT /end FUNCTION
/begin FUNCTION EngDem_TrqLimCoord ""
 /begin DEF_CHARACTERISTIC EngDem_dnOvrFulMax_C EngDem_dnOvrFulMin_C EngDem_dtrqEngPrtRgnMon.Pos_C EngDem_dtrqEngPrtRgnMon.Neg_C EngDem_dtrqOvrFulDown_C EngDem_dtrqOvrFulUp_C EngDem_EpmNEngDT1.T1_C EngDem_EpmNEngDT1.Kd_C EngDem_facAdjMax_C EngDem_facAdjMin_C EngDem_nOvrFulMax_C EngDem_nOvrFulMin_C EngDem_RmpLimErr.Pos_C EngDem_RmpLimErr.Neg_C EngDem_RmpLimErr1.Pos_C EngDem_RmpLimErr1.Neg_C EngDem_RmpLimErr2.Pos_C EngDem_RmpLimErr2.Neg_C EngDem_RmpLimErr3.Pos_C EngDem_RmpLimErr3.Neg_C EngDem_RmpLimErr4.Pos_C EngDem_RmpLimErr4.Neg_C EngDem_RmpOvrFul.Pos_C EngDem_RmpOvrFul.Neg_C EngDem_rOvrFulMax_C EngDem_rOvrFulMin_C EngDem_swtPPreCat_C EngDem_tiPFltdVolPT1_C EngDem_tiPFltResFlowPT1_C EngDem_tiRepOvrFul_C EngDem_trqLimErr1_CUR EngDem_trqLimErr2_CUR EngDem_trqLimErr3_CUR EngDem_trqLimErr4_CUR EngDem_trqLimErrLeadMax_C EngDem_trqLimErr_CUR EngDem_trqLimPDiff1_CUR EngDem_trqLimPDiffNOffs_CUR EngDem_trqLimPDiff_MAP EngDem_trqOvrFulMax_C EngDem_trqOvrFulMin_C EngDem_vOvrFulMax_C EngDem_vOvrFulMin_C /end DEF_CHARACTERISTIC
 /begin IN_MEASUREMENT Epm_nEng /end IN_MEASUREMENT
 /begin OUT_MEASUREMENT EngDem_facAdj EngDem_stTrqLimErr EngDem_stTrqLimErr1 EngDem_stTrqLimErr2 EngDem_stTrqLimErr3 EngDem_stTrqLimErr4 EngDem_stTrqLimErrActv EngDem_trqInrLim EngDem_trqInrLimLead EngDem_trqLimErr EngDem_trqLimErr1 EngDem_trqLimErr2 EngDem_trqLimErr3 EngDem_trqLimErr4 EngDem_trqLimPDiff EngDem_trqLimSwt EngDem_trqOvrFul /end OUT_MEASUREMENT
 /begin LOC_MEASUREMENT ASMod_dVolPFltEG EngDem_dnEngnAvrg_mp EngDem_dVolFlt_mp EngDem_pDiffPFltPrdc2_mp EngDem_pDiffPFltPrdc_mp EngDem_resFlowFlt_mp EngDem_stOvrFul_mp EngDem_stTrqLimPFltErr EngDem_trqInrLimLead1_mp EngDem_trqInrLimLead2_mp EngDem_trqLimErr1Lead_mp EngDem_trqLimErr2Lead_mp EngDem_trqLimErr3Lead_mp EngDem_trqLimErr4Lead_mp EngDem_trqLimErrLeadMin1_mp EngDem_trqLimErrLeadMin2_mp EngDem_trqLimErrLeadMin3_mp EngDem_trqLimErrLead_mp EngDem_trqLimMin1_mp EngDem_trqLimMinEEPVal_mp EngDem_trqLimPDiffNOffsAdd_mp EngDem_trqLimPDiffNOffs_mp EngDem_trqLimPFlt1_mp EngDem_trqLimRslt0_mp EngDem_trqLimRslt1_mp EngDem_trqLimRslt2_mp EngDem_trqLimRslt_mp EngDem_trqLimSwt1_mp EngDem_trqLimSwt2_mp EngDem_trqLimSwt3_mp EngDem_trqLimSwt4_mp EngDem_trqLimSwt5_mp EngDem_trqLimSwtMinAdj_mp EngDem_trqLimSwtMin_mp Exh_pAdapPFltDiff PFltLd_resFlow /end LOC_MEASUREMENT
/end FUNCTION
/begin FUNCTION EngECU_Can ""
 /begin DEF_CHARACTERISTIC Com_dTestMsg_C Com_dTestSig_C Com_stTxEvent_C Com_swtEngineRpm_C Com_swtEngine_C Com_swtHeatFlowEngine_C Com_swtStatusMSA_C Com_swtTest_C Com_swtTorque1_C Com_swtTorque2_C Com_swtTorque3_C /end DEF_CHARACTERISTIC
 /begin OUT_MEASUREMENT Com_dTestMsg Com_dTestSig /end OUT_MEASUREMENT
/end FUNCTION
/begin COMPU_METHOD AirTempFldSel "" TAB_VERB "%6.3" "-" COMPU_TAB_REF AirTempFldSel /end COMPU_METHOD
/begin COMPU_METHOD DEFAULT_FORMULA "DEFAULT_FORMULA" RAT_FUNC "%7.0" "" COEFFS 0 1 0 0 0 1 /end COMPU_METHOD
/begin COMPU_METHOD DEFAULT_FORMULA "DEFAULT_FORMULA" RAT_FUNC "%7.0" "" COEFFS 0 1 0 0 0 1 /end COMPU_METHOD
/begin COMPU_METHOD DEFAULT_FORMULA "DEFAULT_FORMULA" RAT_FUNC "%7.0" "" COEFFS 0 1 0 0 0 1 /end COMPU_METHOD
/begin COMPU_METHOD DEFAULT_FORMULA "DEFAULT_FORMULA" RAT_FUNC "%7.0" "" COEFFS 0 1 0 0 0 1 /end COMPU_METHOD
/begin COMPU_METHOD DEFAULT_FORMULA "DEFAULT_FORMULA" RAT_FUNC "%7.0" "" COEFFS 0 1 0 0 0 1 /end COMPU_METHOD
/begin COMPU_METHOD DEFAULT_FORMULA "DEFAULT_FORMULA" RAT_FUNC "%7.0" "" COEFFS 0 1 0 0 0 1 /end COMPU_METHOD
/begin COMPU_METHOD DEFAULT_FORMULA "DEFAULT_FORMULA" RAT_FUNC "%7.0" "" COEFFS 0 1 0 0 0 1 /end COMPU_METHOD
/begin COMPU_VTAB AirTempFldSel "" TAB_VERB 3 0 "Air_tCACDs" 1 "Air_tAFS" 2 "EnvT_t" /end COMPU_VTAB
/begin COMPU_METHOD CubMtrPerHr "" RAT_FUNC "%6.3" "m^3/h" COEFFS 0 10 0 0 0 1 /end COMPU_METHOD
/begin COMPU_METHOD Curr_A "" RAT_FUNC "%6.4" "A" COEFFS 0 100 0 0 0 1 /end COMPU_METHOD
/begin COMPU_METHOD DFCDSQ_Verb "" TAB_VERB "%2.1" "-" COMPU_TAB_REF DFCDSQ_Verb /end COMPU_METHOD
/begin COMPU_VTAB DFCDSQ_Verb "" TAB_VERB 657 0 "NoInhibit" 1 "DFC_AirCtlGovDvtEOMMax" 2 "DFC_AirCtlGovDvtEOMMin" 3 "DFC_AirCtlGovDvtMax" 4 "DFC_AirCtlGovDvtMin" 5 "DFC_Cj945SpiCom1" 6 "DFC_ComButtonMSASig" 7 "DFC_ComButtonMSATo" 8 "DFC_ComGearboxData2Sig" 9 "DFC_ComGearboxData2To" 10 "DFC_ComGearboxDataSig" 11 "DFC_ComGearboxDataTo" 12 "DFC_ComHeatACSig" 13 "DFC_ComHeatACTo" 14 "DFC_ComLenkradwinkelSig" 15 "DFC_ComLenkradwinkelTo" 16 "DFC_ComMileageRangeSig" 17 "DFC_ComMileageRangeTo" 18 "DFC_ComPspSig" 19 "DFC_ComPspTo" 20 "DFC_ComShutOffPSPSig" 21 "DFC_ComShutOffPSPTo" 22 "DFC_ComStKombiCtr" 23 "DFC_ComStKombiSig" 24 "DFC_ComStKombiTo" 25 "DFC_ComStateARSCtr" 26 "DFC_ComStateARSSig" 27 "DFC_ComStateARSTo" 28 "DFC_ComStateDscSig" 29 "DFC_ComStateDscTo" 30 "DFC_ComStateSeatSig" 31 "DFC_ComStateSeatTo" 32 "DFC_ComTempRelTimeSig" 33 "DFC_ComTempRelTimeTo" 34 "DFC_ComTerminalChk" 35 "DFC_ComTerminalCtr" 36 "DFC_ComTerminalSig" 37 "DFC_ComTerminalTo" 38 "DFC_ComTimeDateSig" 39 "DFC_ComTimeDateTo" 40 "DFC_ComTrailerSig" 41 "DFC_ComTrailerTo" 42 "DFC_ComTrqDemandAfsChk" 43 "DFC_ComTrqDemandAfsCtr" 44 "DFC_ComTrqDemandAfsSig" 45 "DFC_ComTrqDemandAfsTo" 46 "DFC_ComTrqDemandDscChk" 47 "DFC_ComTrqDemandDscCtr" 48 "DFC_ComTrqDemandDscSig" 49 "DFC_ComTrqDemandDscTo" 50 "DFC_ComTrqDemandGbxChk" 51 "DFC_ComTrqDemandGbxCtr" 52 "DFC_ComTrqDemandGbxSig" 53 "DFC_ComTrqDemandGbxTo" 54 "DFC_ComVelocitySig" 55 "DFC_ComVelocityTo" 56 "DFC_ComWheelSpeedSig" 57 "DFC_ComWheelSpeedTo" 58 "DFC_ComZvKlappenSig" 59 "DFC_ComZvKlappenTo" 60 "DFC_Cy150SpiCom" 61 "DFC_Cy320SpiCom" 62 "DFC_ETCtlDvtInrMax" 63 "DFC_ETCtlDvtInrMin" 64 "DFC_ETCtlDvtOutrMax" 65 "DFC_ETCtlDvtOutrMin" 66 "DFC_Fan4WinErr1" 67 "DFC_Fan4WinErr2" 68 "DFC_Fan4WinErr3" 69 "DFC_Fan4WinErr4" 70 "DFC_FanSCG" 71 "DFC_PCRGovDvtLPMax" 72 "DFC_PCRGovDvtLPMin" 73 "DFC_PCRGovDvtMax" 74 "DFC_PCRGovDvtMin" 75 "DFC_RailCPC1" 76 "DFC_RailCPC3" 77 "DFC_RailCPC4" 78 "DFC_RailMeUn0" 79 "DFC_RailMeUn1" 80 "DFC_RailMeUn2" 81 "DFC_RailMeUn3" 82 "DFC_RailMeUn4" 83 "DFC_RailPCV0" 84 "DFC_RailPCV1" 85 "DFC_RailPCV2" 86 "DFC_RailPCV3" 87 "DFC_RailPCV4" 88 "DFC_RailPMonStrt" 89 "DFC_SSpMon1" 90 "DFC_SSpMon2" 91 "DFC_SSpMon3" 92 "DFC_Sia_E1" 93 "DFC_Sia_E10" 94 "DFC_Sia_E11" 95 "DFC_Sia_E12" 96 "DFC_Sia_E13" 97 "DFC_Sia_E14" 98 "DFC_Sia_E15" 99 "DFC_Sia_E2" 100 "DFC_Sia_E3" 101 "DFC_Sia_E4" 102 "DFC_Sia_E5" 103 "DFC_Sia_E6" 104 "DFC_Sia_E7" 105 "DFC_Sia_E8" 106 "DFC_Sia_E9" 107 "DFC_ThrVlv4WinErr1" 108 "DFC_ThrVlv4WinErr2" 109 "DFC_ThrVlv4WinErr3" 110 "DFC_ThrVlv4WinErr4" 111 "DFC_ThrVlvSCG" 112 "DFC_TrbCh4WinErr1" 113 "DFC_TrbCh4WinErr2" 114 "DFC_TrbCh4WinErr3" 115 "DFC_TrbCh4WinErr4" 116 "DFC_TrbChSCG" 117 "DFC_TrbChSRCMax" 118 "DFC_TrbChSRCMin" 119 "DFC_WaHtEl4WinErr1" 120 "DFC_WaHtEl4WinErr2" 121 "DFC_WaHtEl4WinErr3" 122 "DFC_WaHtEl4WinErr4" 123 "DFC_WaHtElSCG" 124 "DFC_ETClbETFltMax" 125 "DFC_ETClbETFltMin" 126 "DFC_InjCrvInjLimChrgBal" 127 "DFC_InjCrvInjLimQntBal" 128 "DFC_InjCrvInjLimSys" 129 "DFC_InjCrvNumInjRtmLim" 130 "DFC_LSUHtCoupSig_0" 131 "DFC_LSUHtCoupSig_1" 132 "DFC_LSUHtCoupSig_2" 133 "DFC_LSUHtCoupSig_3" 134 "DFC_CtT" 135 "DFC_DSMDummy" 136 "DFC_MeUnOL" 137 "DFC_MeUnSCB" 138 "DFC_MeUnSRCMax" 139 "DFC_MeUnSRCMin" 140 "DFC_PCVOL" 141 "DFC_PCVSCB" 142 "DFC_PCVSRCMax" 143 "DFC_PCVSRCMin" 144 "DFC_RailPSRCMax" 145 "DFC_RailPSRCMin" 146 "DFC_IVActrVltgSRCMax" 147 "DFC_IVActrVltgSRCMin" 148 "DFC_IVPSplyDCDC" 149 "DFC_IVPSplyVltgSRCMax" 150 "DFC_IVPSplyVltgSRCMin" 151 "DFC_AFSOffsDrftMax" 152 "DFC_AFSOffsDrftMin" 153 "DFC_AFSSRCCorMax" 154 "DFC_AFSSRCCorMin" 155 "DFC_AFSSRCRawMax" 156 "DFC_AFSSRCRawMin" 157 "DFC_AFSSetyDrftMax" 158 "DFC_AFSSetyDrftMin" 159 "DFC_AirCClntPAnaSRCMax" 160 "DFC_AirCClntPAnaSRCMin" 161 "DFC_AirCClntPPerSRCMax" 162 "DFC_AirCClntPPerSRCMin" 163 "DFC_AirCClntPdcycSRCMax" 164 "DFC_AirCClntPdcycSRCMin" 165 "DFC_AirCCmprOL" 166 "DFC_AirCCmprRedTrqOL" 167 "DFC_AirCCmprRedTrqSCB" 168 "DFC_AirCCmprRedTrqSCG" 169 "DFC_AirCCmprSCB" 170 "DFC_AirCCmprSCG" 171 "DFC_AirCSwtNpl" 172 "DFC_AirCSwtSig" 173 "DFC_BattUSRCMax" 174 "DFC_BattUSRCMin" 175 "DFC_BrkNpl" 176 "DFC_BrkPSRCMax" 177 "DFC_BrkPSRCMin" 178 "DFC_BrkSig" 179 "DFC_CByVlvOL" 180 "DFC_CByVlvSCB" 181 "DFC_CByVlvSCG" 182 "DFC_CEngDsTSRCMax" 183 "DFC_CEngDsTSRCMin" 184 "DFC_CEngDsTSig" 185 "DFC_CEngUsTSRCMax" 186 "DFC_CEngUsTSRCMin" 187 "DFC_CThmstOL" 188 "DFC_CThmstSCB" 189 "DFC_CThmstSCG" 190 "DFC_ClthSig" 191 "DFC_ECBVlvOL" 192 "DFC_ECBVlvSCB" 193 "DFC_ECBVlvSCG" 194 "DFC_ECBVlvSRCMax" 195 "DFC_ECBVlvSRCMin" 196 "DFC_EGRVlvGovDvtMax" 197 "DFC_EGRVlvGovDvtMin" 198 "DFC_EGRVlvOL" 199 "DFC_EGRVlvSCB" 200 "DFC_EGRVlvSCG" 201 "DFC_EGRVlvSRCMax" 202 "DFC_EGRVlvSRCMin" 203 "DFC_EMDmpOL_0" 204 "DFC_EMDmpOL_1" 205 "DFC_EMDmpSCB_0" 206 "DFC_EMDmpSCB_1" 207 "DFC_EMDmpSCG_0" 208 "DFC_EMDmpSCG_1" 209 "DFC_EngStAOL" 210 "DFC_EngStASCB" 211 "DFC_EngStASCG" 212 "DFC_EnvPSRCMax" 213 "DFC_EnvPSRCMin" 214 "DFC_EnvPSig" 215 "DFC_EnvTSRCMax" 216 "DFC_EnvTSRCMin" 217 "DFC_FanOL" 218 "DFC_FanSCB" 219 "DFC_FlFltSig" 220 "DFC_FuelTSRCMax" 221 "DFC_FuelTSRCMin" 222 "DFC_GbxNPosPPerSRCMax" 223 "DFC_GbxNPosPPerSRCMin" 224 "DFC_GbxNPosPdcycSRCMax" 225 "DFC_GbxNPosPdcycSRCMin" 226 "DFC_GbxNPosSig" 227 "DFC_GlwPlgBSDOL_0" 228 "DFC_GlwPlgBSDOL_1" 229 "DFC_GlwPlgBSDOL_2" 230 "DFC_GlwPlgBSDOL_3" 231 "DFC_GlwPlgBSDOL_4" 232 "DFC_GlwPlgBSDOL_5" 233 "DFC_GlwPlgBSDOL_6" 234 "DFC_GlwPlgBSDOL_7" 235 "DFC_GlwPlgBSDOT_0" 236 "DFC_GlwPlgBSDOT_1" 237 "DFC_GlwPlgBSDOT_2" 238 "DFC_GlwPlgBSDOT_3" 239 "DFC_GlwPlgBSDOT_4" 240 "DFC_GlwPlgBSDOT_5" 241 "DFC_GlwPlgBSDOT_6" 242 "DFC_GlwPlgBSDOT_7" 243 "DFC_GlwPlgBSDSC_0" 244 "DFC_GlwPlgBSDSC_1" 245 "DFC_GlwPlgBSDSC_2" 246 "DFC_GlwPlgBSDSC_3" 247 "DFC_GlwPlgBSDSC_4" 248 "DFC_GlwPlgBSDSC_5" 249 "DFC_GlwPlgBSDSC_6" 250 "DFC_GlwPlgBSDSC_7" 251 "DFC_GlwPlgComErr" 252 "DFC_InjVlvPresMin" 253 "DFC_LSUCircNernstMax_0" 254 "DFC_LSUCircNernstMax_1" 255 "DFC_LSUCircNernstMax_2" 256 "DFC_LSUCircNernstMax_3" 257 "DFC_LSUCircNernstMin_0" 258 "DFC_LSUCircNernstMin_1" 259 "DFC_LSUCircNernstMin_2" 260 "DFC_LSUCircNernstMin_3" 261 "DFC_LSUCircNernstSig_0" 262 "DFC_LSUCircNernstSig_1" 263 "DFC_LSUCircNernstSig_2" 264 "DFC_LSUCircNernstSig_3" 265 "DFC_LSUCircPmpCurMax_0" 266 "DFC_LSUCircPmpCurMax_1" 267 "DFC_LSUCircPmpCurMax_2" 268 "DFC_LSUCircPmpCurMax_3" 269 "DFC_LSUCircPmpCurMin_0" 270 "DFC_LSUCircPmpCurMin_1" 271 "DFC_LSUCircPmpCurMin_2" 272 "DFC_LSUCircPmpCurMin_3" 273 "DFC_LSUCircPmpCurSig_0" 274 "DFC_LSUCircPmpCurSig_1" 275 "DFC_LSUCircPmpCurSig_2" 276 "DFC_LSUCircPmpCurSig_3" 277 "DFC_LSUCircVirtGndMax_0" 278 "DFC_LSUCircVirtGndMax_1" 279 "DFC_LSUCircVirtGndMax_2" 280 "DFC_LSUCircVirtGndMax_3" 281 "DFC_LSUCircVirtGndMin_0" 282 "DFC_LSUCircVirtGndMin_1" 283 "DFC_LSUCircVirtGndMin_2" 284 "DFC_LSUCircVirtGndMin_3" 285 "DFC_LSUCircVirtGndSig_0" 286 "DFC_LSUCircVirtGndSig_1" 287 "DFC_LSUCircVirtGndSig_2" 288 "DFC_LSUCircVirtGndSig_3" 289 "DFC_LSUHtrMax_0" 290 "DFC_LSUHtrMax_1" 291 "DFC_LSUHtrMax_2" 292 "DFC_LSUHtrMax_3" 293 "DFC_LSUHtrMin_0" 294 "DFC_LSUHtrMin_1" 295 "DFC_LSUHtrMin_2" 296 "DFC_LSUHtrMin_3" 297 "DFC_LSUHtrSig_0" 298 "DFC_LSUHtrSig_1" 299 "DFC_LSUHtrSig_2" 300 "DFC_LSUHtrSig_3" 301 "DFC_LSUO2Max_0" 302 "DFC_LSUO2Max_1" 303 "DFC_LSUO2Max_2" 304 "DFC_LSUO2Max_3" 305 "DFC_LSUO2Min_0" 306 "DFC_LSUO2Min_1" 307 "DFC_LSUO2Min_2" 308 "DFC_LSUO2Min_3" 309 "DFC_LSUSPIBattLowMin_0" 310 "DFC_LSUSPIBattLowMin_1" 311 "DFC_LSUSPIBattLowMin_2" 312 "DFC_LSUSPIBattLowMin_3" 313 "DFC_LSUSPISig_0" 314 "DFC_LSUSPISig_1" 315 "DFC_LSUSPISig_2" 316 "DFC_LSUSPISig_3" 317 "DFC_LSUtExcMax_0" 318 "DFC_LSUtExcMax_1" 319 "DFC_LSUtExcMax_2" 320 "DFC_LSUtExcMax_3" 321 "DFC_LSUtExcMin_0" 322 "DFC_LSUtExcMin_1" 323 "DFC_LSUtExcMin_2" 324 "DFC_LSUtExcMin_3" 325 "DFC_MILOL" 326 "DFC_MILSCB" 327 "DFC_MILSCG" 328 "DFC_MeUnSCG" 329 "DFC_NplHsChngPPFltDiff" 330 "DFC_NplPAirFltDs" 331 "DFC_NplTPFltUs" 332 "DFC_OilComErr" 333 "DFC_OilPLmpOL" 334 "DFC_OilPLmpSCB" 335 "DFC_OilPLmpSCG" 336 "DFC_OilPNpl" 337 "DFC_OilTNpl" 338 "DFC_OilTSRCMax" 339 "DFC_OilTSRCMin" 340 "DFC_PCACDsEnvPPls" 341 "DFC_PCACDsSRCMax" 342 "DFC_PCACDsSRCMin" 343 "DFC_PCVSCG" 344 "DFC_PFltCharPDiffMin" 345 "DFC_PFltDstrMin" 346 "DFC_PFltEngPrt" 347 "DFC_PFltLmpOL" 348 "DFC_PFltLmpSCB" 349 "DFC_PFltLmpSCG" 350 "DFC_PFltRgnPerm" 351 "DFC_PFltSRCMaxFlwRstn" 352 "DFC_PFltSRCMinFlwRstn" 353 "DFC_PFltSotMsDvtMax" 354 "DFC_PFltSotMsDvtMin" 355 "DFC_PFltSotMsMax" 356 "DFC_PSPOL" 357 "DFC_PSPSCB" 358 "DFC_PSPSCG" 359 "DFC_SRCHighAPP1" 360 "DFC_SRCHighAPP2" 361 "DFC_SRCLowAPP1" 362 "DFC_SRCLowAPP2" 363 "DFC_SRCMaxPAirFltDs" 364 "DFC_SRCMaxPPFltUs" 365 "DFC_SRCMaxTECU" 366 "DFC_SRCMaxTOxiCatUs" 367 "DFC_SRCMaxTPFltUs" 368 "DFC_SRCMinPAirFltDs" 369 "DFC_SRCMinPPFltUs" 370 "DFC_SRCMinTECU" 371 "DFC_SRCMinTOxiCatUs" 372 "DFC_SRCMinTPFltUs" 373 "DFC_SVSOL" 374 "DFC_SVSSCB" 375 "DFC_SVSSCG" 376 "DFC_StrtOL" 377 "DFC_StrtSCB" 378 "DFC_StrtSCG" 379 "DFC_SyncAPP" 380 "DFC_T15Npl" 381 "DFC_TAFSDtyCycHi" 382 "DFC_TAFSDtyCycLo" 383 "DFC_TAFSPerHi" 384 "DFC_TAFSPerLo" 385 "DFC_TCACDsSRCMax" 386 "DFC_TCACDsSRCMin" 387 "DFC_ThrVlvOL" 388 "DFC_ThrVlvSCB" 389 "DFC_ThrVlvSRCMax" 390 "DFC_ThrVlvSRCMin" 391 "DFC_TrbChLPOL" 392 "DFC_TrbChLPSCB" 393 "DFC_TrbChLPSCG" 394 "DFC_TrbChOL" 395 "DFC_TrbChSCB" 396 "DFC_VSwVlvGovDvtMax" 397 "DFC_VSwVlvGovDvtMin" 398 "DFC_VSwVlvOL" 399 "DFC_VSwVlvSCB" 400 "DFC_VSwVlvSCG" 401 "DFC_VSwVlvSRCMax" 402 "DFC_VSwVlvSRCMin" 403 "DFC_VehVHW" 404 "DFC_VehVMax" 405 "DFC_VehVPlaus" 406 "DFC_VehVSig" 407 "DFC_WaHtElOL" 408 "DFC_WaHtElSCB" 409 "DFC_ClthNpl" 410 "DFC_ETClbETMax_0" 411 "DFC_ETClbETMax_1" 412 "DFC_ETClbETMax_2" 413 "DFC_ETClbETMax_3" 414 "DFC_ETClbETMax_4" 415 "DFC_ETClbETMax_5" 416 "DFC_ETClbETMin_0" 417 "DFC_ETClbETMin_1" 418 "DFC_ETClbETMin_2" 419 "DFC_ETClbETMin_3" 420 "DFC_ETClbETMin_4" 421 "DFC_ETClbETMin_5" 422 "DFC_IVDiaBnkShCirBSH_0" 423 "DFC_IVDiaBnkShCirBSH_1" 424 "DFC_IVDiaBnkShCirChSwt_0" 425 "DFC_IVDiaBnkShCirChSwt_1" 426 "DFC_IVDiaBnkShCirHSBatt_0" 427 "DFC_IVDiaBnkShCirHSBatt_1" 428 "DFC_IVDiaBnkShCirHiRstnc_0" 429 "DFC_IVDiaBnkShCirHiRstnc_1" 430 "DFC_IVDiaBnkShCirLSHSGnd_0" 431 "DFC_IVDiaBnkShCirLSHSGnd_1" 432 "DFC_IVDiaBnkShCirTransfer_0" 433 "DFC_IVDiaBnkShCirTransfer_1" 434 "DFC_IVDiaCylNoCls_0" 435 "DFC_IVDiaCylNoCls_1" 436 "DFC_IVDiaCylNoCls_2" 437 "DFC_IVDiaCylNoCls_3" 438 "DFC_IVDiaCylNoCls_4" 439 "DFC_IVDiaCylNoCls_5" 440 "DFC_IVDiaCylNoLd_0" 441 "DFC_IVDiaCylNoLd_1" 442 "DFC_IVDiaCylNoLd_2" 443 "DFC_IVDiaCylNoLd_3" 444 "DFC_IVDiaCylNoLd_4" 445 "DFC_IVDiaCylNoLd_5" 446 "DFC_IVDiaCylShCirHiRstnc_0" 447 "DFC_IVDiaCylShCirHiRstnc_1" 448 "DFC_IVDiaCylShCirHiRstnc_2" 449 "DFC_IVDiaCylShCirHiRstnc_3" 450 "DFC_IVDiaCylShCirHiRstnc_4" 451 "DFC_IVDiaCylShCirHiRstnc_5" 452 "DFC_IVDiaCylShCirLSBatt_0" 453 "DFC_IVDiaCylShCirLSBatt_1" 454 "DFC_IVDiaCylShCirLSBatt_2" 455 "DFC_IVDiaCylShCirLSBatt_3" 456 "DFC_IVDiaCylShCirLSBatt_4" 457 "DFC_IVDiaCylShCirLSBatt_5" 458 "DFC_IVDiaCylShCirLSHS_0" 459 "DFC_IVDiaCylShCirLSHS_1" 460 "DFC_IVDiaCylShCirLSHS_2" 461 "DFC_IVDiaCylShCirLSHS_3" 462 "DFC_IVDiaCylShCirLSHS_4" 463 "DFC_IVDiaCylShCirLSHS_5" 464 "DFC_IVDiaCylShCirLsLs_0" 465 "DFC_IVDiaCylShCirLsLs_1" 466 "DFC_IVDiaCylShCirLsLs_2" 467 "DFC_IVDiaCylShCirLsLs_3" 468 "DFC_IVDiaCylShCirLsLs_4" 469 "DFC_IVDiaCylShCirLsLs_5" 470 "DFC_IVDiaSPICfg" 471 "DFC_IVDiaSPIColl" 472 "DFC_IVDiaSPICtrl" 473 "DFC_IVDiaSPIRam" 474 "DFC_IVDiaSPITrans" 475 "DFC_LSUCmpChk_0" 476 "DFC_LSUCmpChk_1" 477 "DFC_LSUCmpChk_2" 478 "DFC_LSUCmpChk_3" 479 "DFC_LSUCmpChk_4" 480 "DFC_LSUCmpChk_5" 481 "DFC_LSUDynChk_0" 482 "DFC_LSUDynChk_1" 483 "DFC_LSUDynChk_2" 484 "DFC_LSUDynChk_3" 485 "DFC_LSUO2ClbMax_0" 486 "DFC_LSUO2ClbMax_1" 487 "DFC_LSUO2ClbMax_2" 488 "DFC_LSUO2ClbMax_3" 489 "DFC_LSUO2ClbMin_0" 490 "DFC_LSUO2ClbMin_1" 491 "DFC_LSUO2ClbMin_2" 492 "DFC_LSUO2ClbMin_3" 493 "DFC_LSUO2PlausMax_0" 494 "DFC_LSUO2PlausMax_1" 495 "DFC_LSUO2PlausMax_2" 496 "DFC_LSUO2PlausMax_3" 497 "DFC_LSUO2PlausMin_0" 498 "DFC_LSUO2PlausMin_1" 499 "DFC_LSUO2PlausMin_2" 500 "DFC_LSUO2PlausMin_3" 501 "DFC_LSURiClbMax_0" 502 "DFC_LSURiClbMax_1" 503 "DFC_LSURiClbMax_2" 504 "DFC_LSURiClbMax_3" 505 "DFC_LSURiClbMin_0" 506 "DFC_LSURiClbMin_1" 507 "DFC_LSURiClbMin_2" 508 "DFC_LSURiClbMin_3" 509 "DFC_LSUWireIPSig_0" 510 "DFC_LSUWireIPSig_1" 511 "DFC_LSUWireIPSig_2" 512 "DFC_LSUWireIPSig_3" 513 "DFC_AFSDrftIdlAdjVal" 514 "DFC_AFSDrftLdAdjVal" 515 "DFC_AdcI_ADC0_Cal" 516 "DFC_AdcI_ADC0_Conv" 517 "DFC_CmbChbMisfireMax_0" 518 "DFC_CmbChbMisfireMax_1" 519 "DFC_CmbChbMisfireMax_2" 520 "DFC_CmbChbMisfireMax_3" 521 "DFC_CmbChbMisfireMax_4" 522 "DFC_CmbChbMisfireMax_5" 523 "DFC_CmbChbMisfireMul" 524 "DFC_INJVLVBUSY" 525 "DFC_IVAdjIVA_0" 526 "DFC_IVAdjIVA_1" 527 "DFC_IVAdjIVA_2" 528 "DFC_IVAdjIVA_3" 529 "DFC_IVAdjIVA_4" 530 "DFC_IVAdjIVA_5" 531 "DFC_InjCtlAdjQntEEPCS" 532 "DFC_InjCtlDriftEEPCS" 533 "DFC_MRlyErlyOpng" 534 "DFC_MRlyStk" 535 "DFC_SensFrzPPFltUs" 536 "DFC_T15Sig" 537 "DFC_AirCtlRmpTOut" 538 "DFC_CEngDsTDynTst" 539 "DFC_EGRVlvJamVlvClsd" 540 "DFC_EGRVlvJamVlvOpn" 541 "DFC_EGRVlvLgTDrft" 542 "DFC_EGRVlvOfsLrnJamVlv" 543 "DFC_EGRVlvShTDrft" 544 "DFC_EGTRgnOilDilMax" 545 "DFC_EngICO" 546 "DFC_EpmCaSI1ErrSig" 547 "DFC_EpmCaSI1NoSig" 548 "DFC_EpmCaSI1OfsErr" 549 "DFC_EpmCrSErrSig" 550 "DFC_EpmCrSNoSig" 551 "DFC_MoCADCCmp" 552 "DFC_MoCADCTst" 553 "DFC_MoCADCVltgRatio" 554 "DFC_MoCSOPLoLi" 555 "DFC_MoCSOPMM" 556 "DFC_MoCSOPTimeOut" 557 "DFC_MoCSOPUpLi" 558 "DFC_MoFAPP" 559 "DFC_MoFESpd" 560 "DFC_MoFInjDatPhi" 561 "DFC_MoFInjDatQnt" 562 "DFC_MoFInjQnt" 563 "DFC_MoFOvR" 564 "DFC_MoFQntCor" 565 "DFC_MoFTrqCmp" 566 "DFC_NplTOxiCatUs" 567 "DFC_PhyModNonMonMapNpl" 568 "DFC_RailPOfsTstMax" 569 "DFC_RailPOfsTstMin" 570 "DFC_SWReset_0" 571 "DFC_SWReset_1" 572 "DFC_SWReset_2" 573 "DFC_VSwVlvJamVlv" 574 "DFC_VSwVlvLgTDrft" 575 "DFC_VSwVlvOfsLrnJamVlv" 576 "DFC_VSwVlvShTDrft" 577 "DSQ_AFS" 578 "DSQ_BattU" 579 "DSQ_BrkP" 580 "DSQ_CByVlvActr" 581 "DSQ_CEngDsT" 582 "DSQ_CEngUsT" 583 "DSQ_CThmstActr" 584 "DSQ_Com_aDirect" 585 "DSQ_Com_aSide" 586 "DSQ_Com_nTSC" 587 "DSQ_Com_pBrkSys" 588 "DSQ_Com_stButtonMSA" 589 "DSQ_Com_stClCtr" 590 "DSQ_Com_stDSC" 591 "DSQ_Com_stDecellDSC" 592 "DSQ_Com_stDrWghSeat" 593 "DSQ_Com_stGear" 594 "DSQ_Com_stKeyVld" 595 "DSQ_Com_stReqMSA" 596 "DSQ_Com_stT15" 597 "DSQ_Com_stT50" 598 "DSQ_Com_stTrqDSCDes" 599 "DSQ_Com_swtDrBltb" 600 "DSQ_Com_tEnvT" 601 "DSQ_Com_tGbxOil" 602 "DSQ_Com_trqAC" 603 "DSQ_Com_trqARSCur" 604 "DSQ_Com_trqARSDes" 605 "DSQ_Com_trqAvlAFS" 606 "DSQ_Com_trqDSCDes" 607 "DSQ_Com_trqGbxDes" 608 "DSQ_Com_trqGbxFrc" 609 "DSQ_Com_trqGbxMax" 610 "DSQ_Com_trqTarAFS" 611 "DSQ_Com_v" 612 "DSQ_Com_vBd" 613 "DSQ_DSMInhibitAlways" 614 "DSQ_ECBVlvActr" 615 "DSQ_ECBVlvSens" 616 "DSQ_EGRVlvActr" 617 "DSQ_EGRVlvSens" 618 "DSQ_EMDmp_0" 619 "DSQ_EMDmp_1" 620 "DSQ_EngPrtFWOsc" 621 "DSQ_EnvP" 622 "DSQ_EnvT" 623 "DSQ_FanActr" 624 "DSQ_FuelT" 625 "DSQ_LAYER2EDCMSAStp" 626 "DSQ_LSUO2_0" 627 "DSQ_LSUO2_1" 628 "DSQ_LSUO2_2" 629 "DSQ_LSUO2_3" 630 "DSQ_MeUnActr" 631 "DSQ_NSCDsRLamO2" 632 "DSQ_OilStSens" 633 "DSQ_OilT" 634 "DSQ_PAirFltDs" 635 "DSQ_PCACDs" 636 "DSQ_PCVActr" 637 "DSQ_PPFltUs" 638 "DSQ_TAFS" 639 "DSQ_TCACDs" 640 "DSQ_TECU" 641 "DSQ_TOxiCatUs" 642 "DSQ_TPFltUs" 643 "DSQ_ThrVlvActr" 644 "DSQ_ThrVlvSens" 645 "DSQ_TrbChActr" 646 "DSQ_TrbChLPActr" 647 "DSQ_TrbChSens" 648 "DSQ_TrbnDsRLamO2" 649 "DSQ_VSwVlvActr" 650 "DSQ_VSwVlvSens" 651 "DSQ_VehV" 652 "DSQ_WaHtElActr" 653 "DSQ_stAPP" 654 "DSQ_stAPP1" 655 "DSQ_stAPP2" 656 "DSQ_stLSUSrvTstDem" DEFAULT_VALUE "---" /end COMPU_VTAB
/begin COMPU_METHOD DFC_OneToOne "" RAT_FUNC "%8.3" "-" COEFFS 0 1 0 0 0 1 /end COMPU_METHOD
/begin COMPU_METHOD DFC_Verb "" TAB_VERB "%2.1" "-" COMPU_TAB_REF DFC_Verb /end COMPU_METHOD
/begin COMPU_VTAB DFC_Verb "" TAB_VERB 577 0 "DFC_Unused" 1 "DFC_AirCtlGovDvtEOMMax" 2 "DFC_AirCtlGovDvtEOMMin" 3 "DFC_AirCtlGovDvtMax" 4 "DFC_AirCtlGovDvtMin" 5 "DFC_Cj945SpiCom1" 6 "DFC_ComButtonMSASig" 7 "DFC_ComButtonMSATo" 8 "DFC_ComGearboxData2Sig" 9 "DFC_ComGearboxData2To" 10 "DFC_ComGearboxDataSig" 11 "DFC_ComGearboxDataTo" 12 "DFC_ComHeatACSig" 13 "DFC_ComHeatACTo" 14 "DFC_ComLenkradwinkelSig" 15 "DFC_ComLenkradwinkelTo" 16 "DFC_ComMileageRangeSig" 17 "DFC_ComMileageRangeTo" 18 "DFC_ComPspSig" 19 "DFC_ComPspTo" 20 "DFC_ComShutOffPSPSig" 21 "DFC_ComShutOffPSPTo" 22 "DFC_ComStKombiCtr" 23 "DFC_ComStKombiSig" 24 "DFC_ComStKombiTo" 25 "DFC_ComStateARSCtr" 26 "DFC_ComStateARSSig" 27 "DFC_ComStateARSTo" 28 "DFC_ComStateDscSig" 29 "DFC_ComStateDscTo" 30 "DFC_ComStateSeatSig" 31 "DFC_ComStateSeatTo" 32 "DFC_ComTempRelTimeSig" 33 "DFC_ComTempRelTimeTo" 34 "DFC_ComTerminalChk" 35 "DFC_ComTerminalCtr" 36 "DFC_ComTerminalSig" 37 "DFC_ComTerminalTo" 38 "DFC_ComTimeDateSig" 39 "DFC_ComTimeDateTo" 40 "DFC_ComTrailerSig" 41 "DFC_ComTrailerTo" 42 "DFC_ComTrqDemandAfsChk" 43 "DFC_ComTrqDemandAfsCtr" 44 "DFC_ComTrqDemandAfsSig" 45 "DFC_ComTrqDemandAfsTo" 46 "DFC_ComTrqDemandDscChk" 47 "DFC_ComTrqDemandDscCtr" 48 "DFC_ComTrqDemandDscSig" 49 "DFC_ComTrqDemandDscTo" 50 "DFC_ComTrqDemandGbxChk" 51 "DFC_ComTrqDemandGbxCtr" 52 "DFC_ComTrqDemandGbxSig" 53 "DFC_ComTrqDemandGbxTo" 54 "DFC_ComVelocitySig" 55 "DFC_ComVelocityTo" 56 "DFC_ComWheelSpeedSig" 57 "DFC_ComWheelSpeedTo" 58 "DFC_ComZvKlappenSig" 59 "DFC_ComZvKlappenTo" 60 "DFC_Cy150SpiCom" 61 "DFC_Cy320SpiCom" 62 "DFC_ETCtlDvtInrMax" 63 "DFC_ETCtlDvtInrMin" 64 "DFC_ETCtlDvtOutrMax" 65 "DFC_ETCtlDvtOutrMin" 66 "DFC_Fan4WinErr1" 67 "DFC_Fan4WinErr2" 68 "DFC_Fan4WinErr3" 69 "DFC_Fan4WinErr4" 70 "DFC_FanSCG" 71 "DFC_PCRGovDvtLPMax" 72 "DFC_PCRGovDvtLPMin" 73 "DFC_PCRGovDvtMax" 74 "DFC_PCRGovDvtMin" 75 "DFC_RailCPC1" 76 "DFC_RailCPC3" 77 "DFC_RailCPC4" 78 "DFC_RailMeUn0" 79 "DFC_RailMeUn1" 80 "DFC_RailMeUn2" 81 "DFC_RailMeUn3" 82 "DFC_RailMeUn4" 83 "DFC_RailPCV0" 84 "DFC_RailPCV1" 85 "DFC_RailPCV2" 86 "DFC_RailPCV3" 87 "DFC_RailPCV4" 88 "DFC_RailPMonStrt" 89 "DFC_SSpMon1" 90 "DFC_SSpMon2" 91 "DFC_SSpMon3" 92 "DFC_Sia_E1" 93 "DFC_Sia_E10" 94 "DFC_Sia_E11" 95 "DFC_Sia_E12" 96 "DFC_Sia_E13" 97 "DFC_Sia_E14" 98 "DFC_Sia_E15" 99 "DFC_Sia_E2" 100 "DFC_Sia_E3" 101 "DFC_Sia_E4" 102 "DFC_Sia_E5" 103 "DFC_Sia_E6" 104 "DFC_Sia_E7" 105 "DFC_Sia_E8" 106 "DFC_Sia_E9" 107 "DFC_ThrVlv4WinErr1" 108 "DFC_ThrVlv4WinErr2" 109 "DFC_ThrVlv4WinErr3" 110 "DFC_ThrVlv4WinErr4" 111 "DFC_ThrVlvSCG" 112 "DFC_TrbCh4WinErr1" 113 "DFC_TrbCh4WinErr2" 114 "DFC_TrbCh4WinErr3" 115 "DFC_TrbCh4WinErr4" 116 "DFC_TrbChSCG" 117 "DFC_TrbChSRCMax" 118 "DFC_TrbChSRCMin" 119 "DFC_WaHtEl4WinErr1" 120 "DFC_WaHtEl4WinErr2" 121 "DFC_WaHtEl4WinErr3" 122 "DFC_WaHtEl4WinErr4" 123 "DFC_WaHtElSCG" 124 "DFC_ETClbETFltMax" 125 "DFC_ETClbETFltMin" 126 "DFC_InjCrvInjLimChrgBal" 127 "DFC_InjCrvInjLimQntBal" 128 "DFC_InjCrvInjLimSys" 129 "DFC_InjCrvNumInjRtmLim" 130 "DFC_LSUHtCoupSig_0" 131 "DFC_LSUHtCoupSig_1" 132 "DFC_LSUHtCoupSig_2" 133 "DFC_LSUHtCoupSig_3" 134 "DFC_CtT" 135 "DFC_DSMDummy" 136 "DFC_MeUnOL" 137 "DFC_MeUnSCB" 138 "DFC_MeUnSRCMax" 139 "DFC_MeUnSRCMin" 140 "DFC_PCVOL" 141 "DFC_PCVSCB" 142 "DFC_PCVSRCMax" 143 "DFC_PCVSRCMin" 144 "DFC_RailPSRCMax" 145 "DFC_RailPSRCMin" 146 "DFC_IVActrVltgSRCMax" 147 "DFC_IVActrVltgSRCMin" 148 "DFC_IVPSplyDCDC" 149 "DFC_IVPSplyVltgSRCMax" 150 "DFC_IVPSplyVltgSRCMin" 151 "DFC_AFSOffsDrftMax" 152 "DFC_AFSOffsDrftMin" 153 "DFC_AFSSRCCorMax" 154 "DFC_AFSSRCCorMin" 155 "DFC_AFSSRCRawMax" 156 "DFC_AFSSRCRawMin" 157 "DFC_AFSSetyDrftMax" 158 "DFC_AFSSetyDrftMin" 159 "DFC_AirCClntPAnaSRCMax" 160 "DFC_AirCClntPAnaSRCMin" 161 "DFC_AirCClntPPerSRCMax" 162 "DFC_AirCClntPPerSRCMin" 163 "DFC_AirCClntPdcycSRCMax" 164 "DFC_AirCClntPdcycSRCMin" 165 "DFC_AirCCmprOL" 166 "DFC_AirCCmprRedTrqOL" 167 "DFC_AirCCmprRedTrqSCB" 168 "DFC_AirCCmprRedTrqSCG" 169 "DFC_AirCCmprSCB" 170 "DFC_AirCCmprSCG" 171 "DFC_AirCSwtNpl" 172 "DFC_AirCSwtSig" 173 "DFC_BattUSRCMax" 174 "DFC_BattUSRCMin" 175 "DFC_BrkNpl" 176 "DFC_BrkPSRCMax" 177 "DFC_BrkPSRCMin" 178 "DFC_BrkSig" 179 "DFC_CByVlvOL" 180 "DFC_CByVlvSCB" 181 "DFC_CByVlvSCG" 182 "DFC_CEngDsTSRCMax" 183 "DFC_CEngDsTSRCMin" 184 "DFC_CEngDsTSig" 185 "DFC_CEngUsTSRCMax" 186 "DFC_CEngUsTSRCMin" 187 "DFC_CThmstOL" 188 "DFC_CThmstSCB" 189 "DFC_CThmstSCG" 190 "DFC_ClthSig" 191 "DFC_ECBVlvOL" 192 "DFC_ECBVlvSCB" 193 "DFC_ECBVlvSCG" 194 "DFC_ECBVlvSRCMax" 195 "DFC_ECBVlvSRCMin" 196 "DFC_EGRVlvGovDvtMax" 197 "DFC_EGRVlvGovDvtMin" 198 "DFC_EGRVlvOL" 199 "DFC_EGRVlvSCB" 200 "DFC_EGRVlvSCG" 201 "DFC_EGRVlvSRCMax" 202 "DFC_EGRVlvSRCMin" 203 "DFC_EMDmpOL_0" 204 "DFC_EMDmpOL_1" 205 "DFC_EMDmpSCB_0" 206 "DFC_EMDmpSCB_1" 207 "DFC_EMDmpSCG_0" 208 "DFC_EMDmpSCG_1" 209 "DFC_EngStAOL" 210 "DFC_EngStASCB" 211 "DFC_EngStASCG" 212 "DFC_EnvPSRCMax" 213 "DFC_EnvPSRCMin" 214 "DFC_EnvPSig" 215 "DFC_EnvTSRCMax" 216 "DFC_EnvTSRCMin" 217 "DFC_FanOL" 218 "DFC_FanSCB" 219 "DFC_FlFltSig" 220 "DFC_FuelTSRCMax" 221 "DFC_FuelTSRCMin" 222 "DFC_GbxNPosPPerSRCMax" 223 "DFC_GbxNPosPPerSRCMin" 224 "DFC_GbxNPosPdcycSRCMax" 225 "DFC_GbxNPosPdcycSRCMin" 226 "DFC_GbxNPosSig" 227 "DFC_GlwPlgBSDOL_0" 228 "DFC_GlwPlgBSDOL_1" 229 "DFC_GlwPlgBSDOL_2" 230 "DFC_GlwPlgBSDOL_3" 231 "DFC_GlwPlgBSDOL_4" 232 "DFC_GlwPlgBSDOL_5" 233 "DFC_GlwPlgBSDOL_6" 234 "DFC_GlwPlgBSDOL_7" 235 "DFC_GlwPlgBSDOT_0" 236 "DFC_GlwPlgBSDOT_1" 237 "DFC_GlwPlgBSDOT_2" 238 "DFC_GlwPlgBSDOT_3" 239 "DFC_GlwPlgBSDOT_4" 240 "DFC_GlwPlgBSDOT_5" 241 "DFC_GlwPlgBSDOT_6" 242 "DFC_GlwPlgBSDOT_7" 243 "DFC_GlwPlgBSDSC_0" 244 "DFC_GlwPlgBSDSC_1" 245 "DFC_GlwPlgBSDSC_2" 246 "DFC_GlwPlgBSDSC_3" 247 "DFC_GlwPlgBSDSC_4" 248 "DFC_GlwPlgBSDSC_5" 249 "DFC_GlwPlgBSDSC_6" 250 "DFC_GlwPlgBSDSC_7" 251 "DFC_GlwPlgComErr" 252 "DFC_InjVlvPresMin" 253 "DFC_LSUCircNernstMax_0" 254 "DFC_LSUCircNernstMax_1" 255 "DFC_LSUCircNernstMax_2" 256 "DFC_LSUCircNernstMax_3" 257 "DFC_LSUCircNernstMin_0" 258 "DFC_LSUCircNernstMin_1" 259 "DFC_LSUCircNernstMin_2" 260 "DFC_LSUCircNernstMin_3" 261 "DFC_LSUCircNernstSig_0" 262 "DFC_LSUCircNernstSig_1" 263 "DFC_LSUCircNernstSig_2" 264 "DFC_LSUCircNernstSig_3" 265 "DFC_LSUCircPmpCurMax_0" 266 "DFC_LSUCircPmpCurMax_1" 267 "DFC_LSUCircPmpCurMax_2" 268 "DFC_LSUCircPmpCurMax_3" 269 "DFC_LSUCircPmpCurMin_0" 270 "DFC_LSUCircPmpCurMin_1" 271 "DFC_LSUCircPmpCurMin_2" 272 "DFC_LSUCircPmpCurMin_3" 273 "DFC_LSUCircPmpCurSig_0" 274 "DFC_LSUCircPmpCurSig_1" 275 "DFC_LSUCircPmpCurSig_2" 276 "DFC_LSUCircPmpCurSig_3" 277 "DFC_LSUCircVirtGndMax_0" 278 "DFC_LSUCircVirtGndMax_1" 279 "DFC_LSUCircVirtGndMax_2" 280 "DFC_LSUCircVirtGndMax_3" 281 "DFC_LSUCircVirtGndMin_0" 282 "DFC_LSUCircVirtGndMin_1" 283 "DFC_LSUCircVirtGndMin_2" 284 "DFC_LSUCircVirtGndMin_3" 285 "DFC_LSUCircVirtGndSig_0" 286 "DFC_LSUCircVirtGndSig_1" 287 "DFC_LSUCircVirtGndSig_2" 288 "DFC_LSUCircVirtGndSig_3" 289 "DFC_LSUHtrMax_0" 290 "DFC_LSUHtrMax_1" 291 "DFC_LSUHtrMax_2" 292 "DFC_LSUHtrMax_3" 293 "DFC_LSUHtrMin_0" 294 "DFC_LSUHtrMin_1" 295 "DFC_LSUHtrMin_2" 296 "DFC_LSUHtrMin_3" 297 "DFC_LSUHtrSig_0" 298 "DFC_LSUHtrSig_1" 299 "DFC_LSUHtrSig_2" 300 "DFC_LSUHtrSig_3" 301 "DFC_LSUO2Max_0" 302 "DFC_LSUO2Max_1" 303 "DFC_LSUO2Max_2" 304 "DFC_LSUO2Max_3" 305 "DFC_LSUO2Min_0" 306 "DFC_LSUO2Min_1" 307 "DFC_LSUO2Min_2" 308 "DFC_LSUO2Min_3" 309 "DFC_LSUSPIBattLowMin_0" 310 "DFC_LSUSPIBattLowMin_1" 311 "DFC_LSUSPIBattLowMin_2" 312 "DFC_LSUSPIBattLowMin_3" 313 "DFC_LSUSPISig_0" 314 "DFC_LSUSPISig_1" 315 "DFC_LSUSPISig_2" 316 "DFC_LSUSPISig_3" 317 "DFC_LSUtExcMax_0" 318 "DFC_LSUtExcMax_1" 319 "DFC_LSUtExcMax_2" 320 "DFC_LSUtExcMax_3" 321 "DFC_LSUtExcMin_0" 322 "DFC_LSUtExcMin_1" 323 "DFC_LSUtExcMin_2" 324 "DFC_LSUtExcMin_3" 325 "DFC_MILOL" 326 "DFC_MILSCB" 327 "DFC_MILSCG" 328 "DFC_MeUnSCG" 329 "DFC_NplHsChngPPFltDiff" 330 "DFC_NplPAirFltDs" 331 "DFC_NplTPFltUs" 332 "DFC_OilComErr" 333 "DFC_OilPLmpOL" 334 "DFC_OilPLmpSCB" 335 "DFC_OilPLmpSCG" 336 "DFC_OilPNpl" 337 "DFC_OilTNpl" 338 "DFC_OilTSRCMax" 339 "DFC_OilTSRCMin" 340 "DFC_PCACDsEnvPPls" 341 "DFC_PCACDsSRCMax" 342 "DFC_PCACDsSRCMin" 343 "DFC_PCVSCG" 344 "DFC_PFltCharPDiffMin" 345 "DFC_PFltDstrMin" 346 "DFC_PFltEngPrt" 347 "DFC_PFltLmpOL" 348 "DFC_PFltLmpSCB" 349 "DFC_PFltLmpSCG" 350 "DFC_PFltRgnPerm" 351 "DFC_PFltSRCMaxFlwRstn" 352 "DFC_PFltSRCMinFlwRstn" 353 "DFC_PFltSotMsDvtMax" 354 "DFC_PFltSotMsDvtMin" 355 "DFC_PFltSotMsMax" 356 "DFC_PSPOL" 357 "DFC_PSPSCB" 358 "DFC_PSPSCG" 359 "DFC_SRCHighAPP1" 360 "DFC_SRCHighAPP2" 361 "DFC_SRCLowAPP1" 362 "DFC_SRCLowAPP2" 363 "DFC_SRCMaxPAirFltDs" 364 "DFC_SRCMaxPPFltUs" 365 "DFC_SRCMaxTECU" 366 "DFC_SRCMaxTOxiCatUs" 367 "DFC_SRCMaxTPFltUs" 368 "DFC_SRCMinPAirFltDs" 369 "DFC_SRCMinPPFltUs" 370 "DFC_SRCMinTECU" 371 "DFC_SRCMinTOxiCatUs" 372 "DFC_SRCMinTPFltUs" 373 "DFC_SVSOL" 374 "DFC_SVSSCB" 375 "DFC_SVSSCG" 376 "DFC_StrtOL" 377 "DFC_StrtSCB" 378 "DFC_StrtSCG" 379 "DFC_SyncAPP" 380 "DFC_T15Npl" 381 "DFC_TAFSDtyCycHi" 382 "DFC_TAFSDtyCycLo" 383 "DFC_TAFSPerHi" 384 "DFC_TAFSPerLo" 385 "DFC_TCACDsSRCMax" 386 "DFC_TCACDsSRCMin" 387 "DFC_ThrVlvOL" 388 "DFC_ThrVlvSCB" 389 "DFC_ThrVlvSRCMax" 390 "DFC_ThrVlvSRCMin" 391 "DFC_TrbChLPOL" 392 "DFC_TrbChLPSCB" 393 "DFC_TrbChLPSCG" 394 "DFC_TrbChOL" 395 "DFC_TrbChSCB" 396 "DFC_VSwVlvGovDvtMax" 397 "DFC_VSwVlvGovDvtMin" 398 "DFC_VSwVlvOL" 399 "DFC_VSwVlvSCB" 400 "DFC_VSwVlvSCG" 401 "DFC_VSwVlvSRCMax" 402 "DFC_VSwVlvSRCMin" 403 "DFC_VehVHW" 404 "DFC_VehVMax" 405 "DFC_VehVPlaus" 406 "DFC_VehVSig" 407 "DFC_WaHtElOL" 408 "DFC_WaHtElSCB" 409 "DFC_ClthNpl" 410 "DFC_ETClbETMax_0" 411 "DFC_ETClbETMax_1" 412 "DFC_ETClbETMax_2" 413 "DFC_ETClbETMax_3" 414 "DFC_ETClbETMax_4" 415 "DFC_ETClbETMax_5" 416 "DFC_ETClbETMin_0" 417 "DFC_ETClbETMin_1" 418 "DFC_ETClbETMin_2" 419 "DFC_ETClbETMin_3" 420 "DFC_ETClbETMin_4" 421 "DFC_ETClbETMin_5" 422 "DFC_IVDiaBnkShCirBSH_0" 423 "DFC_IVDiaBnkShCirBSH_1" 424 "DFC_IVDiaBnkShCirChSwt_0" 425 "DFC_IVDiaBnkShCirChSwt_1" 426 "DFC_IVDiaBnkShCirHSBatt_0" 427 "DFC_IVDiaBnkShCirHSBatt_1" 428 "DFC_IVDiaBnkShCirHiRstnc_0" 429 "DFC_IVDiaBnkShCirHiRstnc_1" 430 "DFC_IVDiaBnkShCirLSHSGnd_0" 431 "DFC_IVDiaBnkShCirLSHSGnd_1" 432 "DFC_IVDiaBnkShCirTransfer_0" 433 "DFC_IVDiaBnkShCirTransfer_1" 434 "DFC_IVDiaCylNoCls_0" 435 "DFC_IVDiaCylNoCls_1" 436 "DFC_IVDiaCylNoCls_2" 437 "DFC_IVDiaCylNoCls_3" 438 "DFC_IVDiaCylNoCls_4" 439 "DFC_IVDiaCylNoCls_5" 440 "DFC_IVDiaCylNoLd_0" 441 "DFC_IVDiaCylNoLd_1" 442 "DFC_IVDiaCylNoLd_2" 443 "DFC_IVDiaCylNoLd_3" 444 "DFC_IVDiaCylNoLd_4" 445 "DFC_IVDiaCylNoLd_5" 446 "DFC_IVDiaCylShCirHiRstnc_0" 447 "DFC_IVDiaCylShCirHiRstnc_1" 448 "DFC_IVDiaCylShCirHiRstnc_2" 449 "DFC_IVDiaCylShCirHiRstnc_3" 450 "DFC_IVDiaCylShCirHiRstnc_4" 451 "DFC_IVDiaCylShCirHiRstnc_5" 452 "DFC_IVDiaCylShCirLSBatt_0" 453 "DFC_IVDiaCylShCirLSBatt_1" 454 "DFC_IVDiaCylShCirLSBatt_2" 455 "DFC_IVDiaCylShCirLSBatt_3" 456 "DFC_IVDiaCylShCirLSBatt_4" 457 "DFC_IVDiaCylShCirLSBatt_5" 458 "DFC_IVDiaCylShCirLSHS_0" 459 "DFC_IVDiaCylShCirLSHS_1" 460 "DFC_IVDiaCylShCirLSHS_2" 461 "DFC_IVDiaCylShCirLSHS_3" 462 "DFC_IVDiaCylShCirLSHS_4" 463 "DFC_IVDiaCylShCirLSHS_5" 464 "DFC_IVDiaCylShCirLsLs_0" 465 "DFC_IVDiaCylShCirLsLs_1" 466 "DFC_IVDiaCylShCirLsLs_2" 467 "DFC_IVDiaCylShCirLsLs_3" 468 "DFC_IVDiaCylShCirLsLs_4" 469 "DFC_IVDiaCylShCirLsLs_5" 470 "DFC_IVDiaSPICfg" 471 "DFC_IVDiaSPIColl" 472 "DFC_IVDiaSPICtrl" 473 "DFC_IVDiaSPIRam" 474 "DFC_IVDiaSPITrans" 475 "DFC_LSUCmpChk_0" 476 "DFC_LSUCmpChk_1" 477 "DFC_LSUCmpChk_2" 478 "DFC_LSUCmpChk_3" 479 "DFC_LSUCmpChk_4" 480 "DFC_LSUCmpChk_5" 481 "DFC_LSUDynChk_0" 482 "DFC_LSUDynChk_1" 483 "DFC_LSUDynChk_2" 484 "DFC_LSUDynChk_3" 485 "DFC_LSUO2ClbMax_0" 486 "DFC_LSUO2ClbMax_1" 487 "DFC_LSUO2ClbMax_2" 488 "DFC_LSUO2ClbMax_3" 489 "DFC_LSUO2ClbMin_0" 490 "DFC_LSUO2ClbMin_1" 491 "DFC_LSUO2ClbMin_2" 492 "DFC_LSUO2ClbMin_3" 493 "DFC_LSUO2PlausMax_0" 494 "DFC_LSUO2PlausMax_1" 495 "DFC_LSUO2PlausMax_2" 496 "DFC_LSUO2PlausMax_3" 497 "DFC_LSUO2PlausMin_0" 498 "DFC_LSUO2PlausMin_1" 499 "DFC_LSUO2PlausMin_2" 500 "DFC_LSUO2PlausMin_3" 501 "DFC_LSURiClbMax_0" 502 "DFC_LSURiClbMax_1" 503 "DFC_LSURiClbMax_2" 504 "DFC_LSURiClbMax_3" 505 "DFC_LSURiClbMin_0" 506 "DFC_LSURiClbMin_1" 507 "DFC_LSURiClbMin_2" 508 "DFC_LSURiClbMin_3" 509 "DFC_LSUWireIPSig_0" 510 "DFC_LSUWireIPSig_1" 511 "DFC_LSUWireIPSig_2" 512 "DFC_LSUWireIPSig_3" 513 "DFC_AFSDrftIdlAdjVal" 514 "DFC_AFSDrftLdAdjVal" 515 "DFC_AdcI_ADC0_Cal" 516 "DFC_AdcI_ADC0_Conv" 517 "DFC_CmbChbMisfireMax_0" 518 "DFC_CmbChbMisfireMax_1" 519 "DFC_CmbChbMisfireMax_2" 520 "DFC_CmbChbMisfireMax_3" 521 "DFC_CmbChbMisfireMax_4" 522 "DFC_CmbChbMisfireMax_5" 523 "DFC_CmbChbMisfireMul" 524 "DFC_INJVLVBUSY" 525 "DFC_IVAdjIVA_0" 526 "DFC_IVAdjIVA_1" 527 "DFC_IVAdjIVA_2" 528 "DFC_IVAdjIVA_3" 529 "DFC_IVAdjIVA_4" 530 "DFC_IVAdjIVA_5" 531 "DFC_InjCtlAdjQntEEPCS" 532 "DFC_InjCtlDriftEEPCS" 533 "DFC_MRlyErlyOpng" 534 "DFC_MRlyStk" 535 "DFC_SensFrzPPFltUs" 536 "DFC_T15Sig" 537 "DFC_AirCtlRmpTOut" 538 "DFC_CEngDsTDynTst" 539 "DFC_EGRVlvJamVlvClsd" 540 "DFC_EGRVlvJamVlvOpn" 541 "DFC_EGRVlvLgTDrft" 542 "DFC_EGRVlvOfsLrnJamVlv" 543 "DFC_EGRVlvShTDrft" 544 "DFC_EGTRgnOilDilMax" 545 "DFC_EngICO" 546 "DFC_EpmCaSI1ErrSig" 547 "DFC_EpmCaSI1NoSig" 548 "DFC_EpmCaSI1OfsErr" 549 "DFC_EpmCrSErrSig" 550 "DFC_EpmCrSNoSig" 551 "DFC_MoCADCCmp" 552 "DFC_MoCADCTst" 553 "DFC_MoCADCVltgRatio" 554 "DFC_MoCSOPLoLi" 555 "DFC_MoCSOPMM" 556 "DFC_MoCSOPTimeOut" 557 "DFC_MoCSOPUpLi" 558 "DFC_MoFAPP" 559 "DFC_MoFESpd" 560 "DFC_MoFInjDatPhi" 561 "DFC_MoFInjDatQnt" 562 "DFC_MoFInjQnt" 563 "DFC_MoFOvR" 564 "DFC_MoFQntCor" 565 "DFC_MoFTrqCmp" 566 "DFC_NplTOxiCatUs" 567 "DFC_PhyModNonMonMapNpl" 568 "DFC_RailPOfsTstMax" 569 "DFC_RailPOfsTstMin" 570 "DFC_SWReset_0" 571 "DFC_SWReset_1" 572 "DFC_SWReset_2" 573 "DFC_VSwVlvJamVlv" 574 "DFC_VSwVlvLgTDrft" 575 "DFC_VSwVlvOfsLrnJamVlv" 576 "DFC_VSwVlvShTDrft" DEFAULT_VALUE "---" /end COMPU_VTAB
/begin COMPU_METHOD DFES_OneToOne "" RAT_FUNC "%6.2" "-" COEFFS 0 1 0 0 0 1 /end COMPU_METHOD
/begin COMPU_METHOD dn_dZ20 "" RAT_FUNC "%6.2" "rpm/s" COEFFS 0 0.2 0 0 0 1 /end COMPU_METHOD
/begin COMPU_METHOD DSCHED_FIdExcCauseVerb "" TAB_VERB "%2.1" "-" COMPU_TAB_REF DSCHED_FIdExcCauseVerb /end COMPU_METHOD
/begin COMPU_VTAB DSCHED_FIdExcCauseVerb "" TAB_VERB 9 0 "No_exclusion" 1 "FId_InhibitAlways" 2 "FId_CoordALS" 3 "FId_CoordFBC" 4 "FId_CoordTAA" 5 "FId_CoordZFC" 253 "NO_PRIO" 254 "MODE_IMPOSSIBLE" 255 "NO_RUN" DEFAULT_VALUE "---" /end COMPU_VTAB
/begin COMPU_METHOD DSCHED_FIdExcVerb "" TAB_VERB "%2.1" "-" COMPU_TAB_REF DSCHED_FIdExcVerb /end COMPU_METHOD
/begin COMPU_VTAB DSCHED_FIdExcVerb "" TAB_VERB 6 0 "FId_Unused" 1 "FId_InhibitAlways" 2 "FId_CoordALS" 3 "FId_CoordFBC" 4 "FId_CoordTAA" 5 "FId_CoordZFC" DEFAULT_VALUE "---" /end COMPU_VTAB
/begin COMPU_METHOD DSCHED_FIdWTTVerb "" TAB_VERB "%2.1" "-" COMPU_TAB_REF DSCHED_FIdWTTVerb /end COMPU_METHOD
/begin COMPU_VTAB DSCHED_FIdWTTVerb "" TAB_VERB 11 0 "FId_Unused" 1 "FId_InhibitAlways_Reset" 2 "FId_CoordALS_Reset" 3 "FId_CoordFBC_Reset" 4 "FId_CoordTAA_Reset" 5 "FId_CoordZFC_Reset" 32769 "FId_InhibitAlways_Activate" 32770 "FId_CoordALS_Activate" 32771 "FId_CoordFBC_Activate" 32772 "FId_CoordTAA_Activate" 32773 "FId_CoordZFC_Activate" DEFAULT_VALUE "---" /end COMPU_VTAB
/begin COMPU_METHOD DSCHED_RmpSlp "" RAT_FUNC "%8.3" "counts/s " COEFFS 0 1 0 0 0 5 /end COMPU_METHOD
/begin COMPU_METHOD DSCHED_StVerb "" TAB_VERB "%2.1" "-" COMPU_TAB_REF DSCHED_StVerb /end COMPU_METHOD
/begin COMPU_VTAB DSCHED_StVerb "" TAB_VERB 64 0 "____________________________" 2 "_____________________RawPerm" 4 "_________________Act________" 6 "_________________Act_RawPerm" 8 "_____________Lck____________" 10 "_____________Lck_____RawPerm" 12 "_____________Lck_Act________" 14 "_____________Lck_Act_RawPerm" 32 "_________Val________________" 34 "_________Val_________RawPerm" 36 "_________Val_____Act________" 38 "_________Val_____Act_RawPerm" 40 "_________Val_Lck____________" 42 "_________Val_Lck_____RawPerm" 44 "_________Val_Lck_Act________" 46 "_________Val_Lck_Act_RawPerm" 64 "____Perm____________________" 66 "____Perm_____________RawPerm" 68 "____Perm_________Act________" 70 "____Perm_________Act_RawPerm" 72 "____Perm_____Lck____________" 74 "____Perm_____Lck_____RawPerm" 76 "____Perm_____Lck_Act________" 78 "____Perm_____Lck_Act_RawPerm" 96 "____Perm_Val________________" 98 "____Perm_Val_________RawPerm" 100 "____Perm_Val_____Act________" 102 "____Perm_Val_____Act_RawPerm" 104 "____Perm_Val_Lck____________" 106 "____Perm_Val_Lck_____RawPerm" 108 "____Perm_Val_Lck_Act________" 110 "____Perm_Val_Lck_Act_RawPerm" 128 "Rdy_________________________" 130 "Rdy__________________RawPerm" 132 "Rdy______________Act________" 134 "Rdy______________Act_RawPerm" 136 "Rdy__________Lck____________" 138 "Rdy__________Lck_____RawPerm" 140 "Rdy__________Lck_Act________" 142 "Rdy__________Lck_Act_RawPerm" 160 "Rdy______Val________________" 162 "Rdy______Val_________RawPerm" 164 "Rdy______Val_____Act________" 166 "Rdy______Val_____Act_RawPerm" 168 "Rdy______Val_Lck____________" 170 "Rdy______Val_Lck_____RawPerm" 172 "Rdy______Val_Lck_Act________" 174 "Rdy______Val_Lck_Act_RawPerm" 192 "Rdy_Perm____________________" 194 "Rdy_Perm_____________RawPerm" 196 "Rdy_Perm_________Act________" 198 "Rdy_Perm_________Act_RawPerm" 200 "Rdy_Perm_____Lck____________" 202 "Rdy_Perm_____Lck_____RawPerm" 204 "Rdy_Perm_____Lck_Act________" 206 "Rdy_Perm_____Lck_Act_RawPerm" 224 "Rdy_Perm_Val________________" 226 "Rdy_Perm_Val_________RawPerm" 228 "Rdy_Perm_Val_____Act________" 230 "Rdy_Perm_Val_____Act_RawPerm" 232 "Rdy_Perm_Val_Lck____________" 234 "Rdy_Perm_Val_Lck_____RawPerm" 236 "Rdy_Perm_Val_Lck_Act________" 238 "Rdy_Perm_Val_Lck_Act_RawPerm" /end COMPU_VTAB
/begin COMPU_METHOD DSCHED_Time100ms "" RAT_FUNC "%8.4" "s" COEFFS 0 10 0 0 0 1 /end COMPU_METHOD
/begin COMPU_METHOD DSCHED_Time200ms "" RAT_FUNC "%8.4" "s" COEFFS 0 5 0 0 0 1 /end COMPU_METHOD
/begin COMPU_METHOD DSMDur_EvntSel_Verb "" TAB_VERB "%2.1" "-" COMPU_TAB_REF DSMDur_EvntSel_Verb /end COMPU_METHOD
/begin COMPU_VTAB DSMDur_EvntSel_Verb "" TAB_VERB 4 0 "NoCountEvent" 1 "DistanceEvents" 2 "TimeEvents" 4 "WarmUpCycleEvents" /end COMPU_VTAB
/begin COMPU_METHOD DSMDur_StDispl_Verb "" TAB_VERB "%2.1" "-" COMPU_TAB_REF DSMDur_StDispl_Verb /end COMPU_METHOD
/begin COMPU_VTAB DSMDur_StDispl_Verb "" TAB_VERB 3 0 "NotEnabled" 1 "CountingEnabled" 2 "ResetCondition" /end COMPU_VTAB
/begin COMPU_METHOD DSMRdy_Mode3ModeVerb "" TAB_VERB "%2.1" "-" COMPU_TAB_REF DSMRdy_Mode3ModeVerb /end COMPU_METHOD
/begin COMPU_VTAB DSMRdy_Mode3ModeVerb "" TAB_VERB 2 0 "SetGroupOnlyOnMode3" 1 "SetAllGroupsOnMode3" /end COMPU_VTAB
/begin COMPU_METHOD DSMRdy_OneToOne "" RAT_FUNC "%8.3" "-" COEFFS 0 1 0 0 0 1 /end COMPU_METHOD
/begin COMPU_METHOD DTR_Fact "" RAT_FUNC "%5.4" "-" COEFFS 0 8192 0 0 0 1 /end COMPU_METHOD
/begin COMPU_METHOD DTR_Verb "" TAB_VERB "%2.1" "-" COMPU_TAB_REF DTR_Verb /end COMPU_METHOD
/begin COMPU_VTAB DTR_Verb "" TAB_VERB 7 0 "DTR_CEngDsTDynTstDTMin" 1 "DTR_CEngDsTDynTstTMin" 2 "DTR_CEngDsTDynTstTiMax" 3 "DTR_Dummy" 4 "DTR_PFltCharPDiffMin" 5 "DTR_PFltDstrMin" 255 "DTR_Unused" DEFAULT_VALUE "FALSE" /end COMPU_VTAB
/begin COMPU_METHOD DtyCyc "" RAT_FUNC "%6.4" "%" COEFFS 0 100 0 0 0 1 /end COMPU_METHOD
/begin COMPU_METHOD EGTSwt_S16 "" RAT_FUNC "%7.6" "-" COEFFS 0 16384 0 0 0 1 /end COMPU_METHOD
/begin COMPU_METHOD EGT_swtVAL "" TAB_VERB "%6.3" "-" COMPU_TAB_REF EGT_swtVAL /end COMPU_METHOD
/begin COMPU_VTAB EGT_swtVAL "" TAB_VERB 4 0 "EGT_SWT_DISABLED" 1 "EGT_SWT_ENABLED" 2 "EGT_NSC_ENABLED" 3 "EGT_PFLTNSC_ENABLED" /end COMPU_VTAB
/begin COMPU_METHOD EngN "" RAT_FUNC "%6.3" "rpm" COEFFS 0 2 0 0 0 1 /end COMPU_METHOD
/begin COMPU_METHOD EngTempFldSel "" TAB_VERB "%6.3" "-" COMPU_TAB_REF EngTempFldSel /end COMPU_METHOD
/begin COMPU_VTAB EngTempFldSel "" TAB_VERB 3 0 "Coolant_Temperature" 1 "Oil_Temperature" 2 "EngDa_tEng" /end COMPU_VTAB
/begin COMPU_METHOD Fact "" RAT_FUNC "%6.5" "-" COEFFS 0 8192 0 0 0 1 /end COMPU_METHOD
/begin COMPU_METHOD InjMass "" RAT_FUNC "%6.4" "mg/hub" COEFFS 0 100 0 0 0 1 /end COMPU_METHOD
/begin COMPU_METHOD Kd "" RAT_FUNC "%7.6" "1/1" COEFFS 0 65536 0 0 0 1 /end COMPU_METHOD
/begin COMPU_METHOD Kd_rpm2dndt "" RAT_FUNC "%7.6" "rpm/s/rpm" COEFFS 0 65536 0 0 0 1 /end COMPU_METHOD
/begin COMPU_METHOD Ki "" RAT_FUNC "%6.5" "1/s" COEFFS 0 2147.483648 0 0 0 1 /end COMPU_METHOD
/begin COMPU_METHOD Ki_EGRVlv "" RAT_FUNC "%6.5" "1/s" COEFFS 0 5368.70912 0 0 0 1 /end COMPU_METHOD
/begin COMPU_METHOD Kp "" RAT_FUNC "%7.6" "1/1" COEFFS 0 32768 0 0 0 1 /end COMPU_METHOD
/begin COMPU_METHOD Length "" RAT_FUNC "%6.2" "m" COEFFS 0 1 0 0 0 1 /end COMPU_METHOD
/begin COMPU_METHOD OneToOne "" RAT_FUNC "%6.2" "-" COEFFS 0 1 0 0 0 1 /end COMPU_METHOD
/begin COMPU_METHOD OneToOne_km "" RAT_FUNC "%6.2" "km" COEFFS 0 1 0 0 0 1 /end COMPU_METHOD
/begin COMPU_METHOD OneToOne_l "" RAT_FUNC "%6.2" "l" COEFFS 0 1 0 0 0 1 /end COMPU_METHOD
/begin COMPU_METHOD Period "" RAT_FUNC "%6.3" "ms" COEFFS 0 10 0 0 0 1 /end COMPU_METHOD
/begin COMPU_METHOD Prc "" RAT_FUNC "%6.4" "%" COEFFS 0 81.92 0 0 0 1 /end COMPU_METHOD
/begin COMPU_METHOD Pres_hPa "" RAT_FUNC "%6.2" "hPa" COEFFS 0 1 0 0 0 1 /end COMPU_METHOD
/begin COMPU_METHOD Res_hPaHrPerCM "" RAT_FUNC "%7.6" "hPa/(m^3/h)" COEFFS 0 10000 0 0 0 1 /end COMPU_METHOD
/begin COMPU_METHOD RmpPrc "" RAT_FUNC "%6.5" "%/s" COEFFS 0 5368.70912 0 0 0 1 /end COMPU_METHOD
/begin COMPU_METHOD RmpTrq "" RAT_FUNC "%6.4" "Nm/s" COEFFS 0 655.36 0 0 0 1 /end COMPU_METHOD
/begin COMPU_METHOD Temp_Cels "" RAT_FUNC "%6.1" "deg C" COEFFS 0 10 2731.4 0 0 1 /end COMPU_METHOD
/begin COMPU_METHOD Temp_Kelv "" RAT_FUNC "%6.3" "K" COEFFS 0 10 0 0 0 1 /end COMPU_METHOD
/begin COMPU_METHOD TimeDeb "" RAT_FUNC "%6.1" "ms" COEFFS 0 0.1 0 0 0 1 /end COMPU_METHOD
/begin COMPU_METHOD TimeDelay_s "" RAT_FUNC "%12.4" "s" COEFFS 0 0 1 0 0.00023283064365387 0 /end COMPU_METHOD
/begin COMPU_METHOD TimeEGTRmp "" RAT_FUNC "%6.3" "s" COEFFS 0 0 1 0 0.0152587890625 0 /end COMPU_METHOD
/begin COMPU_METHOD TimeEngOn "" RAT_FUNC "%6.2" "s" COEFFS 0 1 0 0 0 1 /end COMPU_METHOD
/begin COMPU_METHOD Time_ms "" RAT_FUNC "%6.1" "ms" COEFFS 0 0.1 0 0 0 1 /end COMPU_METHOD
/begin COMPU_METHOD Time_s "" RAT_FUNC "%6.4" "s" COEFFS 0 100 0 0 0 1 /end COMPU_METHOD
/begin COMPU_METHOD Trq "" RAT_FUNC "%6.3" "Nm" COEFFS 0 10 0 0 0 1 /end COMPU_METHOD
/begin COMPU_METHOD Vel "" RAT_FUNC "%6.4" "km/h" COEFFS 0 100 0 0 0 1 /end COMPU_METHOD
/begin COMPU_METHOD VlvVel "" RAT_FUNC "%6.3" "%/s" COEFFS 0 8.192 0 0 0 1 /end COMPU_METHOD
/begin COMPU_METHOD Volt "" RAT_FUNC "%6.3" "mV" COEFFS 0 5 0 0 0 1 /end COMPU_METHOD
/begin COMPU_METHOD Volt_Batt "" RAT_FUNC "%6.1" "mV" COEFFS 0 0.05 0 0 0 1 /end COMPU_METHOD
/begin COMPU_METHOD default "" RAT_FUNC "%6.2" "-" COEFFS 0 1 0 0 0 1 /end COMPU_METHOD
/begin RECORD_LAYOUT Cur_Xs16Ws16 NO_AXIS_PTS_X 1 SWORD AXIS_PTS_X 2 SWORD INDEX_INCR DIRECT FNC_VALUES 3 SWORD COLUMN_DIR DIRECT /end RECORD_LAYOUT
/begin RECORD_LAYOUT Kl_Xs16_Ws16 NO_AXIS_PTS_X 1 SWORD AXIS_PTS_X 2 SWORD INDEX_INCR DIRECT FNC_VALUES 3 SWORD COLUMN_DIR DIRECT /end RECORD_LAYOUT
/begin RECORD_LAYOUT Kw_Ws16 FNC_VALUES 1 SWORD COLUMN_DIR DIRECT /end RECORD_LAYOUT
/begin RECORD_LAYOUT Kw_Ws32 FNC_VALUES 1 SLONG COLUMN_DIR DIRECT /end RECORD_LAYOUT
/begin RECORD_LAYOUT Kw_Wu16 FNC_VALUES 1 UWORD COLUMN_DIR DIRECT /end RECORD_LAYOUT
/begin RECORD_LAYOUT Kw_Wu32 FNC_VALUES 1 ULONG COLUMN_DIR DIRECT /end RECORD_LAYOUT
/begin RECORD_LAYOUT Kw_Wu8 FNC_VALUES 1 UBYTE COLUMN_DIR DIRECT /end RECORD_LAYOUT
/begin RECORD_LAYOUT Map_Xs16Ys16Ws16 NO_AXIS_PTS_X 1 SWORD NO_AXIS_PTS_Y 2 SWORD AXIS_PTS_X 3 SWORD INDEX_INCR DIRECT AXIS_PTS_Y 4 SWORD INDEX_INCR DIRECT FNC_VALUES 5 SWORD COLUMN_DIR DIRECT /end RECORD_LAYOUT
/begin RECORD_LAYOUT ValA_Ws16 FNC_VALUES 1 SWORD COLUMN_DIR DIRECT /end RECORD_LAYOUT
/begin RECORD_LAYOUT ValA_Wu16 FNC_VALUES 1 UWORD COLUMN_DIR DIRECT /end RECORD_LAYOUT
/begin RECORD_LAYOUT ValA_Wu32 FNC_VALUES 1 ULONG COLUMN_DIR DIRECT /end RECORD_LAYOUT
/begin RECORD_LAYOUT ValA_Wu8 FNC_VALUES 1 UBYTE COLUMN_DIR DIRECT /end RECORD_LAYOUT
/begin RECORD_LAYOUT Val_Ws16 FNC_VALUES 1 SWORD COLUMN_DIR DIRECT /end RECORD_LAYOUT
/begin RECORD_LAYOUT Val_Ws32 FNC_VALUES 1 SLONG COLUMN_DIR DIRECT /end RECORD_LAYOUT
/begin RECORD_LAYOUT Val_Wu16 FNC_VALUES 1 UWORD COLUMN_DIR DIRECT /end RECORD_LAYOUT
/begin RECORD_LAYOUT Val_Wu32 FNC_VALUES 1 ULONG COLUMN_DIR DIRECT /end RECORD_LAYOUT
/begin RECORD_LAYOUT Val_Wu8 FNC_VALUES 1 UBYTE COLUMN_DIR DIRECT /end RECORD_LAYOUT
/end MODULE
/end PROJECT
