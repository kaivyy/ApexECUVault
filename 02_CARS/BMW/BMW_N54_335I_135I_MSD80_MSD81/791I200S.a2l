ASAP2_VERSION 1 41
/begin PROJECT MSD85 "Spray Guided DI-System with Piezo Injectors for 8-Cylinder"
/begin HEADER "_default_HeaderComment" PROJECT_NO _91 /end HEADER
/begin MODULE _default_ModuleName "_default_ModuleLongIdentifier"
/begin MOD_COMMON "_default_ModCommonComment" DEPOSIT ABSOLUTE BYTE_ORDER MSB_LAST ALIGNMENT_BYTE 1 ALIGNMENT_WORD 2 ALIGNMENT_LONG 2 ALIGNMENT_FLOAT32_IEEE 2 ALIGNMENT_FLOAT64_IEEE 4 /end MOD_COMMON
/begin AXIS_PTS ldpm_n_32_1_ensd "" 0xa080253c n_32 _REC_AXS_20_u1 8160. _CNV_A_R_LINEAR_____10_CM 16 0. 8160. FORMAT "%4.0" /end AXIS_PTS
/begin AXIS_PTS ldpm_n_32_2_ensd "" 0xa080254e n_32 _REC_AXS_20_u1 8160. _CNV_A_R_LINEAR_____10_CM 6 0. 8160. FORMAT "%4.0" /end AXIS_PTS
/begin MEASUREMENT n_grd_h_res "High resolution engine speed gradient" SWORD _CNV_A_R_ENSD_LINEA_391_CM 1 100. -4096. 4095. DISPLAY_IDENTIFIER N_GRD_H_RES ECU_ADDRESS 0xd00066a6 FORMAT "%6.2" /end MEASUREMENT
/begin MEASUREMENT n_mmv "Engine speed- moving mean value" UWORD _CNV_A_R_LINEAR_____14_CM 1 100. 0. 8160. DISPLAY_IDENTIFIER N_MMV ECU_ADDRESS 0xd00066a8 FORMAT "%4.0" /end MEASUREMENT
/begin MEASUREMENT n_grd "Engine speed gradient" SBYTE _CNV_A_R_LINEAR_____30_CM 1 100. -4096. 4064. DISPLAY_IDENTIFIER N_GRD ECU_ADDRESS 0xd00074bd FORMAT "%5.0" /end MEASUREMENT
/begin MEASUREMENT seg_ctr "Continuous segment counter (saturated at maximum value)" UWORD _CNV_A_R_LINEAR_____0_CM 1 100. 0. 65535. DISPLAY_IDENTIFIER SEG_CTR ECU_ADDRESS 0xd00066ba FORMAT "%5.0" /end MEASUREMENT
/begin MEASUREMENT psn_eng_syn_min "Minimum engine position during crankshaft synchronization phase" UWORD _CNV_A_R_LINEAR_____200_CM 1 100. 0. 719.625 DISPLAY_IDENTIFIER PSN_ENG_SYN_MIN ECU_ADDRESS 0xd00066b8 FORMAT "%8.3" /end MEASUREMENT
/begin MEASUREMENT psn_eng_syn_max "Maximum engine position during crankshaft synchronization phase" UWORD _CNV_A_R_LINEAR_____200_CM 1 100. 0. 719.625 DISPLAY_IDENTIFIER PSN_ENG_SYN_MAX ECU_ADDRESS 0xd00066b6 FORMAT "%8.3" /end MEASUREMENT
/begin AXIS_PTS ldp_n_32_id_crk_pha_cor "" 0xa0802524 n_32 _REC_AXS_20_u1 8160. _CNV_A_R_LINEAR_____10_CM 16 0. 8160. FORMAT "%4.0" /end AXIS_PTS
/begin MEASUREMENT n_32 "Engine speed- resolution 32rpm" UBYTE _CNV_A_R_LINEAR_____10_CM 1 100. 0. 8160. DISPLAY_IDENTIFIER N_32 ECU_ADDRESS 0xd00074bc FORMAT "%4.0" /end MEASUREMENT
/begin MEASUREMENT n_tooth "Engine speed calculated on last crankshaft tooth period (update rate 10ms)" UWORD _CNV_A_R_LINEAR_____14_CM 1 100. 0. 8160. DISPLAY_IDENTIFIER N_TOOTH ECU_ADDRESS 0xd00066aa FORMAT "%4.0" /end MEASUREMENT
/begin MEASUREMENT t_seg_half_av "Half-segment period" UWORD _CNV_A_R_LINEAR_____392_CM 1 100. 0. 0.26214 DISPLAY_IDENTIFIER T_SEG_HALF_AV ECU_ADDRESS 0xd00066c0 FORMAT "%8.6" /end MEASUREMENT
/begin MEASUREMENT t_crk_win "Crankshaft tooth window at end of segment" UWORD _CNV_A_R_LINEAR_____392_CM 1 100. 0. 0.26214 DISPLAY_IDENTIFIER T_CRK_WIN ECU_ADDRESS 0xd00066bc FORMAT "%8.6" /end MEASUREMENT
/begin MEASUREMENT seg_nr "Actual segment number (from 0 to NC_CYL_NR-1)" UBYTE _CNV_A_R_LINEAR_____0_CM 1 100. 0. 7. DISPLAY_IDENTIFIER SEG_NR ECU_ADDRESS 0xd00074be FORMAT "%3.0" /end MEASUREMENT
/begin MEASUREMENT n "Engine speed- resolution 1rpm" UWORD _CNV_A_R_LINEAR_____14_CM 1 100. 0. 8160. DISPLAY_IDENTIFIER N ECU_ADDRESS 0xd00066a2 FORMAT "%4.0" /end MEASUREMENT
/begin MEASUREMENT n_fast "Fast engine speed- resolution 1rpm" UWORD _CNV_A_R_LINEAR_____14_CM 1 100. 0. 8160. DISPLAY_IDENTIFIER N_FAST ECU_ADDRESS 0xd00066a4 FORMAT "%4.0" /end MEASUREMENT
/begin CHARACTERISTIC c_n_tooth_end "Engine speed threshold for N_TOOTH calculation (engine start)" VALUE 0xa08025a0 _REC_VAL_20_u1 8160. _CNV_A_R_LINEAR_____10_CM 0. 8160. DISPLAY_IDENTIFIER C_N_TOOTH_END FORMAT "%4.0" /end CHARACTERISTIC
/begin CHARACTERISTIC c_n_fast_swi "Switch case choice for N_FAST calculation mode" VALUE 0xa080259e _REC_VAL_20_u1 4. _CNV_A_R_LINEAR_____0_CM 0. 4. DISPLAY_IDENTIFIER C_N_FAST_SWI FORMAT "%3.0" /end CHARACTERISTIC
/begin CHARACTERISTIC c_fac_n_fast "Factor for fast speed prediction" VALUE 0xa080259b _REC_VAL_20_u1 0.99609375 _CNV_A_R_LINEAR_____28_CM 0. 0.99609375 DISPLAY_IDENTIFIER C_FAC_N_FAST FORMAT "%5.3" /end CHARACTERISTIC
/begin MEASUREMENT t_seg_av "Exported segment period" UWORD _CNV_A_R_LINEAR_____392_CM 1 100. 0. 0.26214 DISPLAY_IDENTIFIER T_SEG_AV ECU_ADDRESS 0xd00066be FORMAT "%8.6" /end MEASUREMENT
/begin MEASUREMENT id_seg_nr[0] "Segment number array" UBYTE _CNV_A_R_LINEAR_____0_CM 1 100. 0. 255. DISPLAY_IDENTIFIER id_seg_nr_0 ECU_ADDRESS 0xd00074b4 FORMAT "%3.0" /end MEASUREMENT
/begin MEASUREMENT id_seg_nr[1] "Segment number array" UBYTE _CNV_A_R_LINEAR_____0_CM 1 100. 0. 255. DISPLAY_IDENTIFIER id_seg_nr_1 ECU_ADDRESS 0xd00074b5 FORMAT "%3.0" /end MEASUREMENT
/begin MEASUREMENT id_seg_nr[2] "Segment number array" UBYTE _CNV_A_R_LINEAR_____0_CM 1 100. 0. 255. DISPLAY_IDENTIFIER id_seg_nr_2 ECU_ADDRESS 0xd00074b6 FORMAT "%3.0" /end MEASUREMENT
/begin MEASUREMENT id_seg_nr[3] "Segment number array" UBYTE _CNV_A_R_LINEAR_____0_CM 1 100. 0. 255. DISPLAY_IDENTIFIER id_seg_nr_3 ECU_ADDRESS 0xd00074b7 FORMAT "%3.0" /end MEASUREMENT
/begin MEASUREMENT id_seg_nr[4] "Segment number array" UBYTE _CNV_A_R_LINEAR_____0_CM 1 100. 0. 255. DISPLAY_IDENTIFIER id_seg_nr_4 ECU_ADDRESS 0xd00074b8 FORMAT "%3.0" /end MEASUREMENT
/begin MEASUREMENT id_seg_nr[5] "Segment number array" UBYTE _CNV_A_R_LINEAR_____0_CM 1 100. 0. 255. DISPLAY_IDENTIFIER id_seg_nr_5 ECU_ADDRESS 0xd00074b9 FORMAT "%3.0" /end MEASUREMENT
/begin MEASUREMENT id_seg_nr[6] "Segment number array" UBYTE _CNV_A_R_LINEAR_____0_CM 1 100. 0. 255. DISPLAY_IDENTIFIER id_seg_nr_6 ECU_ADDRESS 0xd00074ba FORMAT "%3.0" /end MEASUREMENT
/begin MEASUREMENT id_seg_nr[7] "Segment number array" UBYTE _CNV_A_R_LINEAR_____0_CM 1 100. 0. 255. DISPLAY_IDENTIFIER id_seg_nr_7 ECU_ADDRESS 0xd00074bb FORMAT "%3.0" /end MEASUREMENT
/begin CHARACTERISTIC id_crk_pha_cor "Table for crankshaft transmitter phase offset correction" CURVE 0xa0802578 _REC_CUR_20_u1_u1 15.9375 _CNV_A_R_LINEAR_____188_CM 0. 15.9375 DISPLAY_IDENTIFIER ID_CRK_PHA_COR FORMAT "%7.4"
 /begin AXIS_DESCR COM_AXIS n_32 _CNV_A_R_LINEAR_____10_CM 16 0. 8160. FORMAT "%4.0" AXIS_PTS_REF ldp_n_32_id_crk_pha_cor /end AXIS_DESCR
/end CHARACTERISTIC
/begin CHARACTERISTIC c_grd_ad_max_cam_in "Max permissible drift of reference edge position for continuous adaptation" VALUE 0xa08025dc _REC_VAL_20_u1 15.9375 _CNV_A_R_LINEAR_____188_CM 0. 15.9375 DISPLAY_IDENTIFIER C_GRD_AD_MAX_CAM_IN FORMAT "%7.4" /end CHARACTERISTIC
/begin CHARACTERISTIC c_grd_ad_max_cam_ex "Max permissible drift of reference edge position for continuous adaptation" VALUE 0xa0802608 _REC_VAL_20_u1 15.9375 _CNV_A_R_LINEAR_____188_CM 0. 15.9375 DISPLAY_IDENTIFIER C_GRD_AD_MAX_CAM_EX FORMAT "%7.4" /end CHARACTERISTIC
/begin CHARACTERISTIC c_grd_ad_ref_max_cam_in "Max permissible drift of reference edge position for reference position adaptation" VALUE 0xa08025dd _REC_VAL_20_u1 15.9375 _CNV_A_R_LINEAR_____188_CM 0. 15.9375 DISPLAY_IDENTIFIER C_GRD_AD_REF_MAX_CAM_IN FORMAT "%7.4" /end CHARACTERISTIC
/begin CHARACTERISTIC c_grd_ad_ref_max_cam_ex "Max permissible drift of reference edge position for reference position adaptation" VALUE 0xa0802609 _REC_VAL_20_u1 15.9375 _CNV_A_R_LINEAR_____188_CM 0. 15.9375 DISPLAY_IDENTIFIER C_GRD_AD_REF_MAX_CAM_EX FORMAT "%7.4" /end CHARACTERISTIC
/begin MEASUREMENT idx_psn_edge_ad_cam_ex_1[0] "adapted exhaust camshaft i signal z position" UWORD _CNV_A_R_ENSD_LINEA_393_CM 1 100. -32. 31.9375 DISPLAY_IDENTIFIER PSN_EDGE_1_AD_CAM_EX_1 ECU_ADDRESS 0xd0006704 FORMAT "%8.4" /end MEASUREMENT
/begin MEASUREMENT idx_psn_edge_ad_cam_ex_1[1] "adapted exhaust camshaft i signal z position" UWORD _CNV_A_R_ENSD_LINEA_393_CM 1 100. -32. 31.9375 DISPLAY_IDENTIFIER PSN_EDGE_2_AD_CAM_EX_1 ECU_ADDRESS 0xd0006706 FORMAT "%8.4" /end MEASUREMENT
/begin MEASUREMENT idx_psn_edge_ad_cam_ex_1[2] "adapted exhaust camshaft i signal z position" UWORD _CNV_A_R_ENSD_LINEA_393_CM 1 100. -32. 31.9375 DISPLAY_IDENTIFIER PSN_EDGE_3_AD_CAM_EX_1 ECU_ADDRESS 0xd0006708 FORMAT "%8.4" /end MEASUREMENT
/begin MEASUREMENT idx_psn_edge_ad_cam_ex_1[3] "adapted exhaust camshaft i signal z position" UWORD _CNV_A_R_ENSD_LINEA_393_CM 1 100. -32. 31.9375 DISPLAY_IDENTIFIER PSN_EDGE_4_AD_CAM_EX_1 ECU_ADDRESS 0xd000670a FORMAT "%8.4" /end MEASUREMENT
/begin MEASUREMENT idx_psn_edge_ad_cam_ex_1[4] "adapted exhaust camshaft i signal z position" UWORD _CNV_A_R_ENSD_LINEA_393_CM 1 100. -32. 31.9375 DISPLAY_IDENTIFIER PSN_EDGE_5_AD_CAM_EX_1 ECU_ADDRESS 0xd000670c FORMAT "%8.4" /end MEASUREMENT
/begin MEASUREMENT idx_psn_edge_ad_cam_ex_1[5] "adapted exhaust camshaft i signal z position" UWORD _CNV_A_R_ENSD_LINEA_393_CM 1 100. -32. 31.9375 DISPLAY_IDENTIFIER PSN_EDGE_6_AD_CAM_EX_1 ECU_ADDRESS 0xd000670e FORMAT "%8.4" /end MEASUREMENT
/begin MEASUREMENT idx_psn_edge_ad_cam_ex_1[6] "adapted exhaust camshaft i signal z position" UWORD _CNV_A_R_ENSD_LINEA_393_CM 1 100. -32. 31.9375 DISPLAY_IDENTIFIER PSN_EDGE_7_AD_CAM_EX_1 ECU_ADDRESS 0xd0006710 FORMAT "%8.4" /end MEASUREMENT
/begin MEASUREMENT idx_psn_edge_ad_cam_ex_1[7] "adapted exhaust camshaft i signal z position" UWORD _CNV_A_R_ENSD_LINEA_393_CM 1 100. -32. 31.9375 DISPLAY_IDENTIFIER PSN_EDGE_8_AD_CAM_EX_1 ECU_ADDRESS 0xd0006712 FORMAT "%8.4" /end MEASUREMENT
/begin MEASUREMENT idx_psn_edge_ad_cam_ex_2[0] "adapted exhaust camshaft i signal z position" UWORD _CNV_A_R_ENSD_LINEA_393_CM 1 100. -32. 31.9375 DISPLAY_IDENTIFIER PSN_EDGE_1_AD_CAM_EX_2 ECU_ADDRESS 0xd0006724 FORMAT "%8.4" /end MEASUREMENT
/begin MEASUREMENT idx_psn_edge_ad_cam_ex_2[1] "adapted exhaust camshaft i signal z position" UWORD _CNV_A_R_ENSD_LINEA_393_CM 1 100. -32. 31.9375 DISPLAY_IDENTIFIER PSN_EDGE_2_AD_CAM_EX_2 ECU_ADDRESS 0xd0006726 FORMAT "%8.4" /end MEASUREMENT
/begin MEASUREMENT idx_psn_edge_ad_cam_ex_2[2] "adapted exhaust camshaft i signal z position" UWORD _CNV_A_R_ENSD_LINEA_393_CM 1 100. -32. 31.9375 DISPLAY_IDENTIFIER PSN_EDGE_3_AD_CAM_EX_2 ECU_ADDRESS 0xd0006728 FORMAT "%8.4" /end MEASUREMENT
/begin MEASUREMENT idx_psn_edge_ad_cam_ex_2[3] "adapted exhaust camshaft i signal z position" UWORD _CNV_A_R_ENSD_LINEA_393_CM 1 100. -32. 31.9375 DISPLAY_IDENTIFIER PSN_EDGE_4_AD_CAM_EX_2 ECU_ADDRESS 0xd000672a FORMAT "%8.4" /end MEASUREMENT
/begin MEASUREMENT idx_psn_edge_ad_cam_ex_2[4] "adapted exhaust camshaft i signal z position" UWORD _CNV_A_R_ENSD_LINEA_393_CM 1 100. -32. 31.9375 DISPLAY_IDENTIFIER PSN_EDGE_5_AD_CAM_EX_2 ECU_ADDRESS 0xd000672c FORMAT "%8.4" /end MEASUREMENT
/begin MEASUREMENT idx_psn_edge_ad_cam_ex_2[5] "adapted exhaust camshaft i signal z position" UWORD _CNV_A_R_ENSD_LINEA_393_CM 1 100. -32. 31.9375 DISPLAY_IDENTIFIER PSN_EDGE_6_AD_CAM_EX_2 ECU_ADDRESS 0xd000672e FORMAT "%8.4" /end MEASUREMENT
/begin MEASUREMENT idx_psn_edge_ad_cam_ex_2[6] "adapted exhaust camshaft i signal z position" UWORD _CNV_A_R_ENSD_LINEA_393_CM 1 100. -32. 31.9375 DISPLAY_IDENTIFIER PSN_EDGE_7_AD_CAM_EX_2 ECU_ADDRESS 0xd0006730 FORMAT "%8.4" /end MEASUREMENT
/begin MEASUREMENT idx_psn_edge_ad_cam_ex_2[7] "adapted exhaust camshaft i signal z position" UWORD _CNV_A_R_ENSD_LINEA_393_CM 1 100. -32. 31.9375 DISPLAY_IDENTIFIER PSN_EDGE_8_AD_CAM_EX_2 ECU_ADDRESS 0xd0006732 FORMAT "%8.4" /end MEASUREMENT
/begin MEASUREMENT idx_psn_edge_ad_cam_in_1[0] "adapted intake camshaft i signal z position" UWORD _CNV_A_R_ENSD_LINEA_393_CM 1 100. -32. 31.9375 DISPLAY_IDENTIFIER PSN_EDGE_1_AD_CAM_IN_1 ECU_ADDRESS 0xd00066c4 FORMAT "%8.4" /end MEASUREMENT
/begin MEASUREMENT idx_psn_edge_ad_cam_in_1[1] "adapted intake camshaft i signal z position" UWORD _CNV_A_R_ENSD_LINEA_393_CM 1 100. -32. 31.9375 DISPLAY_IDENTIFIER PSN_EDGE_2_AD_CAM_IN_1 ECU_ADDRESS 0xd00066c6 FORMAT "%8.4" /end MEASUREMENT
/begin MEASUREMENT idx_psn_edge_ad_cam_in_1[2] "adapted intake camshaft i signal z position" UWORD _CNV_A_R_ENSD_LINEA_393_CM 1 100. -32. 31.9375 DISPLAY_IDENTIFIER PSN_EDGE_3_AD_CAM_IN_1 ECU_ADDRESS 0xd00066c8 FORMAT "%8.4" /end MEASUREMENT
/begin MEASUREMENT idx_psn_edge_ad_cam_in_1[3] "adapted intake camshaft i signal z position" UWORD _CNV_A_R_ENSD_LINEA_393_CM 1 100. -32. 31.9375 DISPLAY_IDENTIFIER PSN_EDGE_4_AD_CAM_IN_1 ECU_ADDRESS 0xd00066ca FORMAT "%8.4" /end MEASUREMENT
/begin MEASUREMENT idx_psn_edge_ad_cam_in_1[4] "adapted intake camshaft i signal z position" UWORD _CNV_A_R_ENSD_LINEA_393_CM 1 100. -32. 31.9375 DISPLAY_IDENTIFIER PSN_EDGE_5_AD_CAM_IN_1 ECU_ADDRESS 0xd00066cc FORMAT "%8.4" /end MEASUREMENT
/begin MEASUREMENT idx_psn_edge_ad_cam_in_1[5] "adapted intake camshaft i signal z position" UWORD _CNV_A_R_ENSD_LINEA_393_CM 1 100. -32. 31.9375 DISPLAY_IDENTIFIER PSN_EDGE_6_AD_CAM_IN_1 ECU_ADDRESS 0xd00066ce FORMAT "%8.4" /end MEASUREMENT
/begin MEASUREMENT idx_psn_edge_ad_cam_in_1[6] "adapted intake camshaft i signal z position" UWORD _CNV_A_R_ENSD_LINEA_393_CM 1 100. -32. 31.9375 DISPLAY_IDENTIFIER PSN_EDGE_7_AD_CAM_IN_1 ECU_ADDRESS 0xd00066d0 FORMAT "%8.4" /end MEASUREMENT
/begin MEASUREMENT idx_psn_edge_ad_cam_in_1[7] "adapted intake camshaft i signal z position" UWORD _CNV_A_R_ENSD_LINEA_393_CM 1 100. -32. 31.9375 DISPLAY_IDENTIFIER PSN_EDGE_8_AD_CAM_IN_1 ECU_ADDRESS 0xd00066d2 FORMAT "%8.4" /end MEASUREMENT
/begin MEASUREMENT idx_psn_edge_ad_cam_in_2[0] "adapted intake camshaft i signal z position" UWORD _CNV_A_R_ENSD_LINEA_393_CM 1 100. -32. 31.9375 DISPLAY_IDENTIFIER PSN_EDGE_1_AD_CAM_IN_2 ECU_ADDRESS 0xd00066e4 FORMAT "%8.4" /end MEASUREMENT
/begin MEASUREMENT idx_psn_edge_ad_cam_in_2[1] "adapted intake camshaft i signal z position" UWORD _CNV_A_R_ENSD_LINEA_393_CM 1 100. -32. 31.9375 DISPLAY_IDENTIFIER PSN_EDGE_2_AD_CAM_IN_2 ECU_ADDRESS 0xd00066e6 FORMAT "%8.4" /end MEASUREMENT
/begin MEASUREMENT idx_psn_edge_ad_cam_in_2[2] "adapted intake camshaft i signal z position" UWORD _CNV_A_R_ENSD_LINEA_393_CM 1 100. -32. 31.9375 DISPLAY_IDENTIFIER PSN_EDGE_3_AD_CAM_IN_2 ECU_ADDRESS 0xd00066e8 FORMAT "%8.4" /end MEASUREMENT
/begin MEASUREMENT idx_psn_edge_ad_cam_in_2[3] "adapted intake camshaft i signal z position" UWORD _CNV_A_R_ENSD_LINEA_393_CM 1 100. -32. 31.9375 DISPLAY_IDENTIFIER PSN_EDGE_4_AD_CAM_IN_2 ECU_ADDRESS 0xd00066ea FORMAT "%8.4" /end MEASUREMENT
/begin MEASUREMENT idx_psn_edge_ad_cam_in_2[4] "adapted intake camshaft i signal z position" UWORD _CNV_A_R_ENSD_LINEA_393_CM 1 100. -32. 31.9375 DISPLAY_IDENTIFIER PSN_EDGE_5_AD_CAM_IN_2 ECU_ADDRESS 0xd00066ec FORMAT "%8.4" /end MEASUREMENT
/begin MEASUREMENT idx_psn_edge_ad_cam_in_2[5] "adapted intake camshaft i signal z position" UWORD _CNV_A_R_ENSD_LINEA_393_CM 1 100. -32. 31.9375 DISPLAY_IDENTIFIER PSN_EDGE_6_AD_CAM_IN_2 ECU_ADDRESS 0xd00066ee FORMAT "%8.4" /end MEASUREMENT
/begin MEASUREMENT idx_psn_edge_ad_cam_in_2[6] "adapted intake camshaft i signal z position" UWORD _CNV_A_R_ENSD_LINEA_393_CM 1 100. -32. 31.9375 DISPLAY_IDENTIFIER PSN_EDGE_7_AD_CAM_IN_2 ECU_ADDRESS 0xd00066f0 FORMAT "%8.4" /end MEASUREMENT
/begin MEASUREMENT idx_psn_edge_ad_cam_in_2[7] "adapted intake camshaft i signal z position" UWORD _CNV_A_R_ENSD_LINEA_393_CM 1 100. -32. 31.9375 DISPLAY_IDENTIFIER PSN_EDGE_8_AD_CAM_IN_2 ECU_ADDRESS 0xd00066f2 FORMAT "%8.4" /end MEASUREMENT
/begin MEASUREMENT idx_psn_edge_cam_ex_1[0] "" UWORD _CNV_A_R_ENSD_LINEA_394_CM 1 100. -128. 127.9375 DISPLAY_IDENTIFIER PSN_EDGE_1_CAM_EX_1 ECU_ADDRESS 0xd0006714 FORMAT "%9.4" /end MEASUREMENT
/begin MEASUREMENT idx_psn_edge_cam_ex_1[1] "" UWORD _CNV_A_R_ENSD_LINEA_394_CM 1 100. -128. 127.9375 DISPLAY_IDENTIFIER PSN_EDGE_2_CAM_EX_1 ECU_ADDRESS 0xd0006716 FORMAT "%9.4" /end MEASUREMENT
/begin MEASUREMENT idx_psn_edge_cam_ex_1[2] "" UWORD _CNV_A_R_ENSD_LINEA_394_CM 1 100. -128. 127.9375 DISPLAY_IDENTIFIER PSN_EDGE_3_CAM_EX_1 ECU_ADDRESS 0xd0006718 FORMAT "%9.4" /end MEASUREMENT
/begin MEASUREMENT idx_psn_edge_cam_ex_1[3] "" UWORD _CNV_A_R_ENSD_LINEA_394_CM 1 100. -128. 127.9375 DISPLAY_IDENTIFIER PSN_EDGE_4_CAM_EX_1 ECU_ADDRESS 0xd000671a FORMAT "%9.4" /end MEASUREMENT
/begin MEASUREMENT idx_psn_edge_cam_ex_1[4] "" UWORD _CNV_A_R_ENSD_LINEA_394_CM 1 100. -128. 127.9375 DISPLAY_IDENTIFIER PSN_EDGE_5_CAM_EX_1 ECU_ADDRESS 0xd000671c FORMAT "%9.4" /end MEASUREMENT
/begin MEASUREMENT idx_psn_edge_cam_ex_1[5] "" UWORD _CNV_A_R_ENSD_LINEA_394_CM 1 100. -128. 127.9375 DISPLAY_IDENTIFIER PSN_EDGE_6_CAM_EX_1 ECU_ADDRESS 0xd000671e FORMAT "%9.4" /end MEASUREMENT
/begin MEASUREMENT idx_psn_edge_cam_ex_1[6] "" UWORD _CNV_A_R_ENSD_LINEA_394_CM 1 100. -128. 127.9375 DISPLAY_IDENTIFIER PSN_EDGE_7_CAM_EX_1 ECU_ADDRESS 0xd0006720 FORMAT "%9.4" /end MEASUREMENT
/begin MEASUREMENT idx_psn_edge_cam_ex_1[7] "" UWORD _CNV_A_R_ENSD_LINEA_394_CM 1 100. -128. 127.9375 DISPLAY_IDENTIFIER PSN_EDGE_8_CAM_EX_1 ECU_ADDRESS 0xd0006722 FORMAT "%9.4" /end MEASUREMENT
/begin MEASUREMENT idx_psn_edge_cam_ex_2[0] "" UWORD _CNV_A_R_ENSD_LINEA_394_CM 1 100. -128. 127.9375 DISPLAY_IDENTIFIER PSN_EDGE_1_CAM_EX_2 ECU_ADDRESS 0xd0006734 FORMAT "%9.4" /end MEASUREMENT
/begin MEASUREMENT idx_psn_edge_cam_ex_2[1] "" UWORD _CNV_A_R_ENSD_LINEA_394_CM 1 100. -128. 127.9375 DISPLAY_IDENTIFIER PSN_EDGE_2_CAM_EX_2 ECU_ADDRESS 0xd0006736 FORMAT "%9.4" /end MEASUREMENT
/begin MEASUREMENT idx_psn_edge_cam_ex_2[2] "" UWORD _CNV_A_R_ENSD_LINEA_394_CM 1 100. -128. 127.9375 DISPLAY_IDENTIFIER PSN_EDGE_3_CAM_EX_2 ECU_ADDRESS 0xd0006738 FORMAT "%9.4" /end MEASUREMENT
/begin MEASUREMENT idx_psn_edge_cam_ex_2[3] "" UWORD _CNV_A_R_ENSD_LINEA_394_CM 1 100. -128. 127.9375 DISPLAY_IDENTIFIER PSN_EDGE_4_CAM_EX_2 ECU_ADDRESS 0xd000673a FORMAT "%9.4" /end MEASUREMENT
/begin MEASUREMENT idx_psn_edge_cam_ex_2[4] "" UWORD _CNV_A_R_ENSD_LINEA_394_CM 1 100. -128. 127.9375 DISPLAY_IDENTIFIER PSN_EDGE_5_CAM_EX_2 ECU_ADDRESS 0xd000673c FORMAT "%9.4" /end MEASUREMENT
/begin MEASUREMENT idx_psn_edge_cam_ex_2[5] "" UWORD _CNV_A_R_ENSD_LINEA_394_CM 1 100. -128. 127.9375 DISPLAY_IDENTIFIER PSN_EDGE_6_CAM_EX_2 ECU_ADDRESS 0xd000673e FORMAT "%9.4" /end MEASUREMENT
/begin MEASUREMENT idx_psn_edge_cam_ex_2[6] "" UWORD _CNV_A_R_ENSD_LINEA_394_CM 1 100. -128. 127.9375 DISPLAY_IDENTIFIER PSN_EDGE_7_CAM_EX_2 ECU_ADDRESS 0xd0006740 FORMAT "%9.4" /end MEASUREMENT
/begin MEASUREMENT idx_psn_edge_cam_ex_2[7] "" UWORD _CNV_A_R_ENSD_LINEA_394_CM 1 100. -128. 127.9375 DISPLAY_IDENTIFIER PSN_EDGE_8_CAM_EX_2 ECU_ADDRESS 0xd0006742 FORMAT "%9.4" /end MEASUREMENT
/begin MEASUREMENT idx_psn_edge_cam_in_1[0] "" UWORD _CNV_A_R_ENSD_LINEA_394_CM 1 100. -128. 127.9375 DISPLAY_IDENTIFIER PSN_EDGE_1_CAM_IN_1 ECU_ADDRESS 0xd00066d4 FORMAT "%9.4" /end MEASUREMENT
/begin MEASUREMENT idx_psn_edge_cam_in_1[1] "" UWORD _CNV_A_R_ENSD_LINEA_394_CM 1 100. -128. 127.9375 DISPLAY_IDENTIFIER PSN_EDGE_2_CAM_IN_1 ECU_ADDRESS 0xd00066d6 FORMAT "%9.4" /end MEASUREMENT
/begin MEASUREMENT idx_psn_edge_cam_in_1[2] "" UWORD _CNV_A_R_ENSD_LINEA_394_CM 1 100. -128. 127.9375 DISPLAY_IDENTIFIER PSN_EDGE_3_CAM_IN_1 ECU_ADDRESS 0xd00066d8 FORMAT "%9.4" /end MEASUREMENT
/begin MEASUREMENT idx_psn_edge_cam_in_1[3] "" UWORD _CNV_A_R_ENSD_LINEA_394_CM 1 100. -128. 127.9375 DISPLAY_IDENTIFIER PSN_EDGE_4_CAM_IN_1 ECU_ADDRESS 0xd00066da FORMAT "%9.4" /end MEASUREMENT
/begin MEASUREMENT idx_psn_edge_cam_in_1[4] "" UWORD _CNV_A_R_ENSD_LINEA_394_CM 1 100. -128. 127.9375 DISPLAY_IDENTIFIER PSN_EDGE_5_CAM_IN_1 ECU_ADDRESS 0xd00066dc FORMAT "%9.4" /end MEASUREMENT
/begin MEASUREMENT idx_psn_edge_cam_in_1[5] "" UWORD _CNV_A_R_ENSD_LINEA_394_CM 1 100. -128. 127.9375 DISPLAY_IDENTIFIER PSN_EDGE_6_CAM_IN_1 ECU_ADDRESS 0xd00066de FORMAT "%9.4" /end MEASUREMENT
/begin MEASUREMENT idx_psn_edge_cam_in_1[6] "" UWORD _CNV_A_R_ENSD_LINEA_394_CM 1 100. -128. 127.9375 DISPLAY_IDENTIFIER PSN_EDGE_7_CAM_IN_1 ECU_ADDRESS 0xd00066e0 FORMAT "%9.4" /end MEASUREMENT
/begin MEASUREMENT idx_psn_edge_cam_in_1[7] "" UWORD _CNV_A_R_ENSD_LINEA_394_CM 1 100. -128. 127.9375 DISPLAY_IDENTIFIER PSN_EDGE_8_CAM_IN_1 ECU_ADDRESS 0xd00066e2 FORMAT "%9.4" /end MEASUREMENT
/begin CHARACTERISTIC c_crlc_ad_cam_in "Averaging constant for continuous adaptation" VALUE 0xa08025d4 _REC_VAL_20_u1 0.99609375 _CNV_A_R_LINEAR_____28_CM 0. 0.99609375 DISPLAY_IDENTIFIER C_CRLC_AD_CAM_IN FORMAT "%5.3" /end CHARACTERISTIC
/begin CHARACTERISTIC c_crlc_ad_cam_ex "Averaging constant for continuous adaptation" VALUE 0xa0802600 _REC_VAL_20_u1 0.99609375 _CNV_A_R_LINEAR_____28_CM 0. 0.99609375 DISPLAY_IDENTIFIER C_CRLC_AD_CAM_EX FORMAT "%5.3" /end CHARACTERISTIC
/begin CHARACTERISTIC c_crlc_ad_ref_cam_ex "Averaging constant for reference position adaptation" VALUE 0xa0802601 _REC_VAL_20_u1 0.99609375 _CNV_A_R_LINEAR_____28_CM 0. 0.99609375 DISPLAY_IDENTIFIER C_CRLC_AD_REF_CAM_EX FORMAT "%5.3" /end CHARACTERISTIC
/begin CHARACTERISTIC c_crlc_ad_ref_cam_in "Averaging constant for reference position adaptation" VALUE 0xa08025d5 _REC_VAL_20_u1 0.99609375 _CNV_A_R_LINEAR_____28_CM 0. 0.99609375 DISPLAY_IDENTIFIER C_CRLC_AD_REF_CAM_IN FORMAT "%5.3" /end CHARACTERISTIC
/begin CHARACTERISTIC c_nr_rev_ad_ref_cam_ex "Number of camshaft revolutions for reference position adaptation" VALUE 0xa080260b _REC_VAL_20_u1 255. _CNV_A_R_LINEAR_____0_CM 0. 255. DISPLAY_IDENTIFIER C_NR_REV_AD_REF_CAM_EX FORMAT "%3.0" /end CHARACTERISTIC
/begin CHARACTERISTIC c_nr_rev_ad_ref_cam_in "Number of camshaft revolutions for reference position adaptation" VALUE 0xa08025df _REC_VAL_20_u1 255. _CNV_A_R_LINEAR_____0_CM 0. 255. DISPLAY_IDENTIFIER C_NR_REV_AD_REF_CAM_IN FORMAT "%3.0" /end CHARACTERISTIC
/begin MEASUREMENT idx_cam_ad_ex[0].psn_ad_cam "adapted exhaust camshaft position relative to designed passive position" UBYTE _CNV_A_R_LINEAR_____198_CM 1 100. -48. 47.625 DISPLAY_IDENTIFIER PSN_AD_CAM_EX_1 ECU_ADDRESS 0xd000ad54 FORMAT "%7.3" /end MEASUREMENT
/begin MEASUREMENT idx_cam_ad_ex[0].ctr_rev_ad_ref_cam "Exhaust camshaft reference position adaptation revolution counter" UBYTE _CNV_A_R_LINEAR_____0_CM 1 100. 0. 255. DISPLAY_IDENTIFIER CTR_REV_AD_REF_CAM_EX_1 ECU_ADDRESS 0xd000ad55 FORMAT "%3.0" /end MEASUREMENT
/begin MEASUREMENT idx_cam_ad_ex[0].psn_cam "Actual exhaust camshaft position relative to adapted passive position" UWORD _CNV_A_R_LINEAR_____395_CM 1 100. -96. 95.625 DISPLAY_IDENTIFIER PSN_CAM_EX_1 ECU_ADDRESS 0xd000ad50 FORMAT "%7.3" /end MEASUREMENT
/begin MEASUREMENT idx_cam_ad_ex[0].psn_dif_edge_cam "crankshaft angle between the previous and the current exhaust camshaft position determination" UWORD _CNV_A_R_LINEAR_____200_CM 1 100. 0. 1535.625 DISPLAY_IDENTIFIER PSN_DIF_EDGE_CAM_EX_1 ECU_ADDRESS 0xd000ad44 FORMAT "%8.3" /end MEASUREMENT
/begin MEASUREMENT idx_cam_ad_ex[0].psn_edge_cam_old "" UWORD _CNV_A_R_ENSD_LINEA_394_CM 1 100. -128. 127.9375 DISPLAY_IDENTIFIER psn_edge_cam_old_ex_1 ECU_ADDRESS 0xd000ad46 FORMAT "%9.4" /end MEASUREMENT
/begin MEASUREMENT idx_cam_ad_ex[0].ptr_psn_edge_cam "" UWORD _CNV_A_R_LINEAR_____50_CM 1 100. 0. 65535. DISPLAY_IDENTIFIER PTR_PSN_EDGE_CAM ECU_ADDRESS 0xd000ad48 /end MEASUREMENT
/begin MEASUREMENT idx_cam_ad_ex[0].ptr_psn_edge_ad_cam "" UWORD _CNV_A_R_LINEAR_____50_CM 1 100. 0. 65535. DISPLAY_IDENTIFIER PTR_PSN_EDGE_AD_CAM ECU_ADDRESS 0xd000ad4c /end MEASUREMENT
/begin MEASUREMENT idx_cam_ad_ex[0].t_dif_edge_cam "Time between the previous and current camshaft signal edge" ULONG _CNV_A_R_LINEAR_____392_CM 1 100. 0. 17179.86918 DISPLAY_IDENTIFIER T_DIF_EDGE_CAM_EX_1 ECU_ADDRESS 0xd000ad40 FORMAT "%12.6" /end MEASUREMENT
/begin MEASUREMENT idx_cam_ad_ex[0].lv_ad_end_cam "Exhaust camshaft reference position adaptation successful" UBYTE _CNV_S_2_RANGE__0___1_CM 1 100. 0. 1. DISPLAY_IDENTIFIER LV_AD_END_CAM_EX_1 ECU_ADDRESS 0xd000ad56 BIT_MASK 0x1 /end MEASUREMENT
/begin MEASUREMENT idx_cam_ad_ex[0].lv_tooth_off_det_ena "Confirmation that a reference adaptation occurred after the very first one, to allow the one_tooth_off detection (exhaust i)" UBYTE _CNV_S_2_RANGE__0___1_CM 1 100. 0. 1. DISPLAY_IDENTIFIER LV_TOOTH_OFF_DET_ENA_EX_1 ECU_ADDRESS 0xd000ad58 BIT_MASK 0x1 /end MEASUREMENT
/begin MEASUREMENT idx_cam_ad_ex[0].lv_cam_ad_save "Confirmation that adaptative values at exhaust i have already been store" UBYTE _CNV_S_2_RANGE__0___1_CM 1 100. 0. 1. DISPLAY_IDENTIFIER LV_CAM_AD_SAVE_EX_1 ECU_ADDRESS 0xd000ad57 BIT_MASK 0x1 /end MEASUREMENT
/begin MEASUREMENT idx_cam_ad_ex[0].cam_psn_lst_ref_ad "Adapted exhaust camshaft i signal position after last correct reference adaptation" UWORD _CNV_A_R_ENSD_LINEA_393_CM 1 100. -32. 31.9375 DISPLAY_IDENTIFIER CAM_PSN_LST_REF_AD_EX_1 ECU_ADDRESS 0xd000ad52 FORMAT "%8.4" /end MEASUREMENT
/begin MEASUREMENT idx_cam_ad_ex[1].psn_ad_cam "adapted exhaust camshaft position relative to designed passive position" UBYTE _CNV_A_R_LINEAR_____198_CM 1 100. -48. 47.625 DISPLAY_IDENTIFIER PSN_AD_CAM_EX_2 ECU_ADDRESS 0xd000ad70 FORMAT "%7.3" /end MEASUREMENT
/begin MEASUREMENT idx_cam_ad_ex[1].ctr_rev_ad_ref_cam "Exhaust camshaft reference position adaptation revolution counter" UBYTE _CNV_A_R_LINEAR_____0_CM 1 100. 0. 255. DISPLAY_IDENTIFIER CTR_REV_AD_REF_CAM_EX_2 ECU_ADDRESS 0xd000ad71 FORMAT "%3.0" /end MEASUREMENT
/begin MEASUREMENT idx_cam_ad_ex[1].psn_cam "Actual exhaust camshaft position relative to adapted passive position" UWORD _CNV_A_R_LINEAR_____395_CM 1 100. -96. 95.625 DISPLAY_IDENTIFIER PSN_CAM_EX_2 ECU_ADDRESS 0xd000ad6c FORMAT "%7.3" /end MEASUREMENT
/begin MEASUREMENT idx_cam_ad_ex[1].psn_dif_edge_cam "crankshaft angle between the previous and the current exhaust camshaft position determination" UWORD _CNV_A_R_LINEAR_____200_CM 1 100. 0. 1535.625 DISPLAY_IDENTIFIER PSN_DIF_EDGE_CAM_EX_2 ECU_ADDRESS 0xd000ad60 FORMAT "%8.3" /end MEASUREMENT
/begin MEASUREMENT idx_cam_ad_ex[1].psn_edge_cam_old "" UWORD _CNV_A_R_ENSD_LINEA_394_CM 1 100. -128. 127.9375 DISPLAY_IDENTIFIER psn_edge_cam_old_ex_2 ECU_ADDRESS 0xd000ad62 FORMAT "%9.4" /end MEASUREMENT
/begin MEASUREMENT idx_cam_ad_ex[1].ptr_psn_edge_cam "" UWORD _CNV_A_R_LINEAR_____50_CM 1 100. 0. 65535. DISPLAY_IDENTIFIER PTR_PSN_EDGE_CAM ECU_ADDRESS 0xd000ad64 /end MEASUREMENT
/begin MEASUREMENT idx_cam_ad_ex[1].ptr_psn_edge_ad_cam "" UWORD _CNV_A_R_LINEAR_____50_CM 1 100. 0. 65535. DISPLAY_IDENTIFIER PTR_PSN_EDGE_AD_CAM ECU_ADDRESS 0xd000ad68 /end MEASUREMENT
/begin MEASUREMENT idx_cam_ad_ex[1].t_dif_edge_cam "Time between the previous and current camshaft signal edge" ULONG _CNV_A_R_LINEAR_____392_CM 1 100. 0. 17179.86918 DISPLAY_IDENTIFIER T_DIF_EDGE_CAM_EX_2 ECU_ADDRESS 0xd000ad5c FORMAT "%12.6" /end MEASUREMENT
/begin MEASUREMENT idx_cam_ad_ex[1].lv_ad_end_cam "Exhaust camshaft reference position adaptation successful" UBYTE _CNV_S_2_RANGE__0___1_CM 1 100. 0. 1. DISPLAY_IDENTIFIER LV_AD_END_CAM_EX_2 ECU_ADDRESS 0xd000ad72 BIT_MASK 0x1 /end MEASUREMENT
/begin MEASUREMENT idx_cam_ad_ex[1].lv_tooth_off_det_ena "Confirmation that a reference adaptation occurred after the very first one, to allow the one_tooth_off detection (exhaust i)" UBYTE _CNV_S_2_RANGE__0___1_CM 1 100. 0. 1. DISPLAY_IDENTIFIER LV_TOOTH_OFF_DET_ENA_EX_2 ECU_ADDRESS 0xd000ad74 BIT_MASK 0x1 /end MEASUREMENT
/begin MEASUREMENT idx_cam_ad_ex[1].lv_cam_ad_save "Confirmation that adaptative values at exhaust i have already been store" UBYTE _CNV_S_2_RANGE__0___1_CM 1 100. 0. 1. DISPLAY_IDENTIFIER LV_CAM_AD_SAVE_EX_2 ECU_ADDRESS 0xd000ad73 BIT_MASK 0x1 /end MEASUREMENT
/begin MEASUREMENT idx_cam_ad_ex[1].cam_psn_lst_ref_ad "Adapted exhaust camshaft i signal position after last correct reference adaptation" UWORD _CNV_A_R_ENSD_LINEA_393_CM 1 100. -32. 31.9375 DISPLAY_IDENTIFIER CAM_PSN_LST_REF_AD_EX_2 ECU_ADDRESS 0xd000ad6e FORMAT "%8.4" /end MEASUREMENT
/begin MEASUREMENT idx_cam_ad_in[0].psn_ad_cam "adapted intake camshaft position relative to designed passive position" UBYTE _CNV_A_R_LINEAR_____198_CM 1 100. -48. 47.625 DISPLAY_IDENTIFIER PSN_AD_CAM_IN_1 ECU_ADDRESS 0xd000ad1c FORMAT "%7.3" /end MEASUREMENT
/begin MEASUREMENT idx_cam_ad_in[0].ctr_rev_ad_ref_cam "Intake camshaft reference position adaptation revolution counter" UBYTE _CNV_A_R_LINEAR_____0_CM 1 100. 0. 255. DISPLAY_IDENTIFIER CTR_REV_AD_REF_CAM_IN_1 ECU_ADDRESS 0xd000ad1d FORMAT "%3.0" /end MEASUREMENT
/begin MEASUREMENT idx_cam_ad_in[0].psn_cam "Actual intake camshaft position relative to adapted passive position" UWORD _CNV_A_R_LINEAR_____395_CM 1 100. -96. 95.625 DISPLAY_IDENTIFIER PSN_CAM_IN_1 ECU_ADDRESS 0xd000ad18 FORMAT "%7.3" /end MEASUREMENT
/begin MEASUREMENT idx_cam_ad_in[0].psn_dif_edge_cam "crankshaft angle between the previous and the current intake camshaft position determination" UWORD _CNV_A_R_LINEAR_____200_CM 1 100. 0. 1535.625 DISPLAY_IDENTIFIER PSN_DIF_EDGE_CAM_IN_1 ECU_ADDRESS 0xd000ad0c FORMAT "%8.3" /end MEASUREMENT
/begin MEASUREMENT idx_cam_ad_in[0].psn_edge_cam_old "" UWORD _CNV_A_R_ENSD_LINEA_394_CM 1 100. -128. 127.9375 DISPLAY_IDENTIFIER psn_edge_cam_old_in_1 ECU_ADDRESS 0xd000ad0e FORMAT "%9.4" /end MEASUREMENT
/begin MEASUREMENT idx_cam_ad_in[0].ptr_psn_edge_cam "" UWORD _CNV_A_R_LINEAR_____50_CM 1 100. 0. 65535. DISPLAY_IDENTIFIER PTR_PSN_EDGE_CAM ECU_ADDRESS 0xd000ad10 /end MEASUREMENT
/begin MEASUREMENT idx_cam_ad_in[0].ptr_psn_edge_ad_cam "" UWORD _CNV_A_R_LINEAR_____50_CM 1 100. 0. 65535. DISPLAY_IDENTIFIER PTR_PSN_EDGE_AD_CAM ECU_ADDRESS 0xd000ad14 /end MEASUREMENT
/begin MEASUREMENT idx_cam_ad_in[0].t_dif_edge_cam "Time between the previous and current camshaft signal edge" ULONG _CNV_A_R_LINEAR_____392_CM 1 100. 0. 17179.86918 DISPLAY_IDENTIFIER T_DIF_EDGE_CAM_IN_1 ECU_ADDRESS 0xd000ad08 FORMAT "%12.6" /end MEASUREMENT
/begin MEASUREMENT idx_cam_ad_in[0].lv_ad_end_cam "Intake camshaft reference position adaptation successful" UBYTE _CNV_S_2_RANGE__0___1_CM 1 100. 0. 1. DISPLAY_IDENTIFIER LV_AD_END_CAM_IN_1 ECU_ADDRESS 0xd000ad1e BIT_MASK 0x1 /end MEASUREMENT
/begin MEASUREMENT idx_cam_ad_in[0].lv_tooth_off_det_ena "Confirmation that a reference adaptation occurred after the very first one, to allow the one_tooth_off detection (intake i)" UBYTE _CNV_S_2_RANGE__0___1_CM 1 100. 0. 1. DISPLAY_IDENTIFIER LV_TOOTH_OFF_DET_ENA_IN_1 ECU_ADDRESS 0xd000ad20 BIT_MASK 0x1 /end MEASUREMENT
/begin MEASUREMENT idx_cam_ad_in[0].lv_cam_ad_save "Confirmation that adaptative values at intake i have already been store" UBYTE _CNV_S_2_RANGE__0___1_CM 1 100. 0. 1. DISPLAY_IDENTIFIER LV_CAM_AD_SAVE_IN_1 ECU_ADDRESS 0xd000ad1f BIT_MASK 0x1 /end MEASUREMENT
/begin MEASUREMENT idx_cam_ad_in[0].cam_psn_lst_ref_ad "Adapted intake camshaft i signal position after last correct reference adaptation" UWORD _CNV_A_R_ENSD_LINEA_393_CM 1 100. -32. 31.9375 DISPLAY_IDENTIFIER CAM_PSN_LST_REF_AD_IN_1 ECU_ADDRESS 0xd000ad1a FORMAT "%8.4" /end MEASUREMENT
/begin MEASUREMENT idx_cam_ad_in[1].psn_ad_cam "adapted intake camshaft position relative to designed passive position" UBYTE _CNV_A_R_LINEAR_____198_CM 1 100. -48. 47.625 DISPLAY_IDENTIFIER PSN_AD_CAM_IN_2 ECU_ADDRESS 0xd000ad38 FORMAT "%7.3" /end MEASUREMENT
/begin MEASUREMENT idx_cam_ad_in[1].ctr_rev_ad_ref_cam "Intake camshaft reference position adaptation revolution counter" UBYTE _CNV_A_R_LINEAR_____0_CM 1 100. 0. 255. DISPLAY_IDENTIFIER CTR_REV_AD_REF_CAM_IN_2 ECU_ADDRESS 0xd000ad39 FORMAT "%3.0" /end MEASUREMENT
/begin MEASUREMENT idx_cam_ad_in[1].psn_cam "Actual intake camshaft position relative to adapted passive position" UWORD _CNV_A_R_LINEAR_____395_CM 1 100. -96. 95.625 DISPLAY_IDENTIFIER PSN_CAM_IN_2 ECU_ADDRESS 0xd000ad34 FORMAT "%7.3" /end MEASUREMENT
/begin MEASUREMENT idx_cam_ad_in[1].psn_dif_edge_cam "crankshaft angle between the previous and the current intake camshaft position determination" UWORD _CNV_A_R_LINEAR_____200_CM 1 100. 0. 1535.625 DISPLAY_IDENTIFIER PSN_DIF_EDGE_CAM_IN_2 ECU_ADDRESS 0xd000ad28 FORMAT "%8.3" /end MEASUREMENT
/begin MEASUREMENT idx_cam_ad_in[1].psn_edge_cam_old "" UWORD _CNV_A_R_ENSD_LINEA_394_CM 1 100. -128. 127.9375 DISPLAY_IDENTIFIER psn_edge_cam_old_in_2 ECU_ADDRESS 0xd000ad2a FORMAT "%9.4" /end MEASUREMENT
/begin MEASUREMENT idx_cam_ad_in[1].ptr_psn_edge_cam "" UWORD _CNV_A_R_LINEAR_____50_CM 1 100. 0. 65535. DISPLAY_IDENTIFIER PTR_PSN_EDGE_CAM ECU_ADDRESS 0xd000ad2c /end MEASUREMENT
/begin MEASUREMENT idx_cam_ad_in[1].ptr_psn_edge_ad_cam "" UWORD _CNV_A_R_LINEAR_____50_CM 1 100. 0. 65535. DISPLAY_IDENTIFIER PTR_PSN_EDGE_AD_CAM ECU_ADDRESS 0xd000ad30 /end MEASUREMENT
/begin MEASUREMENT idx_cam_ad_in[1].t_dif_edge_cam "Time between the previous and current camshaft signal edge" ULONG _CNV_A_R_LINEAR_____392_CM 1 100. 0. 17179.86918 DISPLAY_IDENTIFIER T_DIF_EDGE_CAM_IN_2 ECU_ADDRESS 0xd000ad24 FORMAT "%12.6" /end MEASUREMENT
/begin MEASUREMENT idx_cam_ad_in[1].lv_ad_end_cam "Intake camshaft reference position adaptation successful" UBYTE _CNV_S_2_RANGE__0___1_CM 1 100. 0. 1. DISPLAY_IDENTIFIER LV_AD_END_CAM_IN_2 ECU_ADDRESS 0xd000ad3a BIT_MASK 0x1 /end MEASUREMENT
/begin MEASUREMENT idx_cam_ad_in[1].lv_tooth_off_det_ena "Confirmation that a reference adaptation occurred after the very first one, to allow the one_tooth_off detection (intake i)" UBYTE _CNV_S_2_RANGE__0___1_CM 1 100. 0. 1. DISPLAY_IDENTIFIER LV_TOOTH_OFF_DET_ENA_IN_2 ECU_ADDRESS 0xd000ad3c BIT_MASK 0x1 /end MEASUREMENT
/begin MEASUREMENT idx_cam_ad_in[1].lv_cam_ad_save "Confirmation that adaptative values at intake i have already been store" UBYTE _CNV_S_2_RANGE__0___1_CM 1 100. 0. 1. DISPLAY_IDENTIFIER LV_CAM_AD_SAVE_IN_2 ECU_ADDRESS 0xd000ad3b BIT_MASK 0x1 /end MEASUREMENT
/begin MEASUREMENT idx_cam_ad_in[1].cam_psn_lst_ref_ad "Adapted intake camshaft i signal position after last correct reference adaptation" UWORD _CNV_A_R_ENSD_LINEA_393_CM 1 100. -32. 31.9375 DISPLAY_IDENTIFIER CAM_PSN_LST_REF_AD_IN_2 ECU_ADDRESS 0xd000ad36 FORMAT "%8.4" /end MEASUREMENT
/begin AXIS_PTS ldp_n_32_id_cam_pha_cor "" 0xa0802510 n_32 _REC_AXS_20_u1 8160. _CNV_A_R_LINEAR_____10_CM 16 0. 8160. FORMAT "%4.0" /end AXIS_PTS
/begin CHARACTERISTIC id_cam_pha_cor "Table for camshaft transmitter phase offset correction" CURVE 0xa0802558 _REC_CUR_20_u2_u1 95.9375 _CNV_A_R_ENSD_LINEA_396_CM -48. 47.9375 DISPLAY_IDENTIFIER ID_CAM_PHA_COR FORMAT "%8.4"
 /begin AXIS_DESCR COM_AXIS n_32 _CNV_A_R_LINEAR_____10_CM 16 0. 8160. FORMAT "%4.0" AXIS_PTS_REF ldp_n_32_id_cam_pha_cor /end AXIS_DESCR
/end CHARACTERISTIC
/begin MEASUREMENT idx_psn_edge_cam_in_2[0] "" UWORD _CNV_A_R_ENSD_LINEA_394_CM 1 100. -128. 127.9375 DISPLAY_IDENTIFIER PSN_EDGE_1_CAM_IN_2 ECU_ADDRESS 0xd00066f4 FORMAT "%9.4" /end MEASUREMENT
/begin MEASUREMENT idx_psn_edge_cam_in_2[1] "" UWORD _CNV_A_R_ENSD_LINEA_394_CM 1 100. -128. 127.9375 DISPLAY_IDENTIFIER PSN_EDGE_2_CAM_IN_2 ECU_ADDRESS 0xd00066f6 FORMAT "%9.4" /end MEASUREMENT
/begin MEASUREMENT idx_psn_edge_cam_in_2[2] "" UWORD _CNV_A_R_ENSD_LINEA_394_CM 1 100. -128. 127.9375 DISPLAY_IDENTIFIER PSN_EDGE_3_CAM_IN_2 ECU_ADDRESS 0xd00066f8 FORMAT "%9.4" /end MEASUREMENT
/begin MEASUREMENT idx_psn_edge_cam_in_2[3] "" UWORD _CNV_A_R_ENSD_LINEA_394_CM 1 100. -128. 127.9375 DISPLAY_IDENTIFIER PSN_EDGE_4_CAM_IN_2 ECU_ADDRESS 0xd00066fa FORMAT "%9.4" /end MEASUREMENT
/begin MEASUREMENT idx_psn_edge_cam_in_2[4] "" UWORD _CNV_A_R_ENSD_LINEA_394_CM 1 100. -128. 127.9375 DISPLAY_IDENTIFIER PSN_EDGE_5_CAM_IN_2 ECU_ADDRESS 0xd00066fc FORMAT "%9.4" /end MEASUREMENT
/begin MEASUREMENT idx_psn_edge_cam_in_2[5] "" UWORD _CNV_A_R_ENSD_LINEA_394_CM 1 100. -128. 127.9375 DISPLAY_IDENTIFIER PSN_EDGE_6_CAM_IN_2 ECU_ADDRESS 0xd00066fe FORMAT "%9.4" /end MEASUREMENT
/begin MEASUREMENT idx_psn_edge_cam_in_2[6] "" UWORD _CNV_A_R_ENSD_LINEA_394_CM 1 100. -128. 127.9375 DISPLAY_IDENTIFIER PSN_EDGE_7_CAM_IN_2 ECU_ADDRESS 0xd0006700 FORMAT "%9.4" /end MEASUREMENT
/begin MEASUREMENT idx_psn_edge_cam_in_2[7] "" UWORD _CNV_A_R_ENSD_LINEA_394_CM 1 100. -128. 127.9375 DISPLAY_IDENTIFIER PSN_EDGE_8_CAM_IN_2 ECU_ADDRESS 0xd0006702 FORMAT "%9.4" /end MEASUREMENT
/begin CHARACTERISTIC c_tol_tooth_off_cam_in "Reference position tolerance for tooth off detection for intake camshaft" VALUE 0xa08025e2 _REC_VAL_20_u2 31.9375 _CNV_A_R_LINEAR_____188_CM 0. 31.9375 DISPLAY_IDENTIFIER C_TOL_TOOTH_OFF_CAM_IN FORMAT "%7.4" /end CHARACTERISTIC
/begin CHARACTERISTIC c_tol_tooth_off_cam_ex "Reference position tolerance for tooth off detection for exhaust camshaft" VALUE 0xa080260e _REC_VAL_20_u2 31.9375 _CNV_A_R_LINEAR_____188_CM 0. 31.9375 DISPLAY_IDENTIFIER C_TOL_TOOTH_OFF_CAM_EX FORMAT "%7.4" /end CHARACTERISTIC
/begin CHARACTERISTIC c_tol_ref_crk_cam_in "Reference position tolerance range for intake camshaft" VALUE 0xa08025e0 _REC_VAL_20_u2 31.9375 _CNV_A_R_LINEAR_____188_CM 0. 31.9375 DISPLAY_IDENTIFIER C_TOL_REF_CRK_CAM_IN FORMAT "%7.4" /end CHARACTERISTIC
/begin MEASUREMENT lv_err_ref_crk_cam_ex_2 "Present exhaust camshaft 2 failure reference violation" UBYTE _CNV_S_2_RANGE__0___1_CM 1 100. 0. 1. DISPLAY_IDENTIFIER LV_ERR_REF_CRK_CAM_EX_2 ECU_ADDRESS 0xd0007f54 BIT_MASK 0x1 /end MEASUREMENT
/begin MEASUREMENT lv_err_ref_crk_cam_in_1 "Present intake camshaft 1 failure reference violation" UBYTE _CNV_S_2_RANGE__0___1_CM 1 100. 0. 1. DISPLAY_IDENTIFIER LV_ERR_REF_CRK_CAM_IN_1 ECU_ADDRESS 0xd0007f4d BIT_MASK 0x1 /end MEASUREMENT
/begin MEASUREMENT lv_err_ref_crk_cam_in_2 "Present intake camshaft 2 failure reference violation" UBYTE _CNV_S_2_RANGE__0___1_CM 1 100. 0. 1. DISPLAY_IDENTIFIER LV_ERR_REF_CRK_CAM_IN_2 ECU_ADDRESS 0xd0007f53 BIT_MASK 0x1 /end MEASUREMENT
/begin CHARACTERISTIC c_tol_ref_crk_cam_ex "Reference position tolerance range for exhaust camshaft" VALUE 0xa080260c _REC_VAL_20_u2 31.9375 _CNV_A_R_LINEAR_____188_CM 0. 31.9375 DISPLAY_IDENTIFIER C_TOL_REF_CRK_CAM_EX FORMAT "%7.4" /end CHARACTERISTIC
/begin MEASUREMENT lv_err_ref_crk_cam_ex_1 "Present exhaust camshaft 1 failure reference violation" UBYTE _CNV_S_2_RANGE__0___1_CM 1 100. 0. 1. DISPLAY_IDENTIFIER LV_ERR_REF_CRK_CAM_EX_1 ECU_ADDRESS 0xd0007f4e BIT_MASK 0x1 /end MEASUREMENT
/begin MEASUREMENT lv_err_tooth_off_in_2 "present intake camshaft i-one-tooth failure" UBYTE _CNV_S_2_RANGE__0___1_CM 1 100. 0. 1. DISPLAY_IDENTIFIER LV_ERR_TOOTH_OFF_IN_2 ECU_ADDRESS 0xd0007f63 BIT_MASK 0x1 /end MEASUREMENT
/begin MEASUREMENT lv_err_tooth_off_in_1 "present intake camshaft i-one-tooth failure" UBYTE _CNV_S_2_RANGE__0___1_CM 1 100. 0. 1. DISPLAY_IDENTIFIER LV_ERR_TOOTH_OFF_IN_1 ECU_ADDRESS 0xd0007f5d BIT_MASK 0x1 /end MEASUREMENT
/begin MEASUREMENT lv_err_tooth_off_ex_1 "present exhaust camshaft i-one-tooth failure" UBYTE _CNV_S_2_RANGE__0___1_CM 1 100. 0. 1. DISPLAY_IDENTIFIER LV_ERR_TOOTH_OFF_EX_1 ECU_ADDRESS 0xd0007f5e BIT_MASK 0x1 /end MEASUREMENT
/begin MEASUREMENT lv_err_tooth_off_ex_2 "present exhaust camshaft i-one-tooth failure" UBYTE _CNV_S_2_RANGE__0___1_CM 1 100. 0. 1. DISPLAY_IDENTIFIER LV_ERR_TOOTH_OFF_EX_2 ECU_ADDRESS 0xd0007f64 BIT_MASK 0x1 /end MEASUREMENT
/begin MEASUREMENT lv_err_crk_plaus "Present crankshaft failure synchronization impossible" UBYTE _CNV_S_2_RANGE__0___1_CM 1 100. 0. 1. DISPLAY_IDENTIFIER LV_ERR_CRK_PLAUS ECU_ADDRESS 0xd0007f58 BIT_MASK 0x1 /end MEASUREMENT
/begin MEASUREMENT lv_err_plaus_cam_in_2 "Present camshaft failure synchronization impossible" UBYTE _CNV_S_2_RANGE__0___1_CM 1 100. 0. 1. DISPLAY_IDENTIFIER LV_ERR_PLAUS_CAM_IN_2 ECU_ADDRESS 0xd0007f5f BIT_MASK 0x1 /end MEASUREMENT
/begin MEASUREMENT lv_err_plaus_cam_ex_1 "Present camshaft failure synchronization impossible" UBYTE _CNV_S_2_RANGE__0___1_CM 1 100. 0. 1. DISPLAY_IDENTIFIER LV_ERR_PLAUS_CAM_EX_1 ECU_ADDRESS 0xd0007f5a BIT_MASK 0x1 /end MEASUREMENT
/begin MEASUREMENT lv_err_plaus_cam_ex_2 "Present camshaft failure synchronization impossible" UBYTE _CNV_S_2_RANGE__0___1_CM 1 100. 0. 1. DISPLAY_IDENTIFIER LV_ERR_PLAUS_CAM_EX_2 ECU_ADDRESS 0xd0007f60 BIT_MASK 0x1 /end MEASUREMENT
/begin MEASUREMENT lv_err_plaus_cam_in_1 "Present camshaft failure synchronization impossible" UBYTE _CNV_S_2_RANGE__0___1_CM 1 100. 0. 1. DISPLAY_IDENTIFIER LV_ERR_PLAUS_CAM_IN_1 ECU_ADDRESS 0xd0007f59 BIT_MASK 0x1 /end MEASUREMENT
/begin MEASUREMENT ctr_cyc_eng_plaus_cam_ex_1 "Engine cycle counter for camshaft signal plausibility diagnosis" UBYTE _CNV_A_R_LINEAR_____0_CM 1 100. 0. 255. DISPLAY_IDENTIFIER CTR_CYC_ENG_PLAUS_CAM_EX_1 ECU_ADDRESS 0xd000751c FORMAT "%3.0" /end MEASUREMENT
/begin MEASUREMENT ctr_cyc_eng_plaus_cam_ex_2 "Engine cycle counter for camshaft signal plausibility diagnosis" UBYTE _CNV_A_R_LINEAR_____0_CM 1 100. 0. 255. DISPLAY_IDENTIFIER CTR_CYC_ENG_PLAUS_CAM_EX_2 ECU_ADDRESS 0xd0007548 FORMAT "%3.0" /end MEASUREMENT
/begin MEASUREMENT ctr_cyc_eng_plaus_cam_in_1 "Engine cycle counter for camshaft signal plausibility diagnosis" UBYTE _CNV_A_R_LINEAR_____0_CM 1 100. 0. 255. DISPLAY_IDENTIFIER CTR_CYC_ENG_PLAUS_CAM_IN_1 ECU_ADDRESS 0xd00074ec FORMAT "%3.0" /end MEASUREMENT
/begin MEASUREMENT ctr_cyc_eng_plaus_cam_in_2 "Engine cycle counter for camshaft signal plausibility diagnosis" UBYTE _CNV_A_R_LINEAR_____0_CM 1 100. 0. 255. DISPLAY_IDENTIFIER CTR_CYC_ENG_PLAUS_CAM_IN_2 ECU_ADDRESS 0xd0007518 FORMAT "%3.0" /end MEASUREMENT
/begin MEASUREMENT lv_err_syn_crk_cam_ex_1 "Present exhaust camshaft failure for crankshaft synchronization" UBYTE _CNV_S_2_RANGE__0___1_CM 1 100. 0. 1. DISPLAY_IDENTIFIER LV_ERR_SYN_CRK_CAM_EX_1 ECU_ADDRESS 0xd0007f5c BIT_MASK 0x1 /end MEASUREMENT
/begin MEASUREMENT lv_err_syn_crk_cam_ex_2 "Present exhaust camshaft failure for crankshaft synchronization" UBYTE _CNV_S_2_RANGE__0___1_CM 1 100. 0. 1. DISPLAY_IDENTIFIER LV_ERR_SYN_CRK_CAM_EX_2 ECU_ADDRESS 0xd0007f62 BIT_MASK 0x1 /end MEASUREMENT
/begin MEASUREMENT lv_err_syn_crk_cam_in_1 "Present intake camshaft failure for crankshaft synchronization" UBYTE _CNV_S_2_RANGE__0___1_CM 1 100. 0. 1. DISPLAY_IDENTIFIER LV_ERR_SYN_CRK_CAM_IN_1 ECU_ADDRESS 0xd0007f5b BIT_MASK 0x1 /end MEASUREMENT
/begin MEASUREMENT lv_err_syn_crk_cam_in_2 "Present intake camshaft failure for crankshaft synchronization" UBYTE _CNV_S_2_RANGE__0___1_CM 1 100. 0. 1. DISPLAY_IDENTIFIER LV_ERR_SYN_CRK_CAM_IN_2 ECU_ADDRESS 0xd0007f61 BIT_MASK 0x1 /end MEASUREMENT
/begin MEASUREMENT ctr_orng_cam_syn_crk "failure counter to detect camshaft error for crankshaft synchronization" UBYTE _CNV_A_R_LINEAR_____0_CM 1 100. 0. 255. DISPLAY_IDENTIFIER CTR_ORNG_CAM_SYN_CRK ECU_ADDRESS 0xd00025c4 FORMAT "%3.0" /end MEASUREMENT
/begin CHARACTERISTIC c_nr_edge_cam_ex_syn_crk_max "Number of exhaust camshaft signal edges to detect crankshaft plausibility error before synchronization" VALUE 0xa08025a2 _REC_VAL_20_u1 254. _CNV_A_R_LINEAR_____0_CM 1. 255. DISPLAY_IDENTIFIER C_NR_EDGE_CAM_EX_SYN_CRK_MAX FORMAT "%3.0" /end CHARACTERISTIC
/begin CHARACTERISTIC c_nr_edge_cam_in_syn_crk_max "Number of intake camshaft signal edges to detect crankshaft plausibility error before synchronization" VALUE 0xa08025a3 _REC_VAL_20_u1 254. _CNV_A_R_LINEAR_____0_CM 1. 255. DISPLAY_IDENTIFIER C_NR_EDGE_CAM_IN_SYN_CRK_MAX FORMAT "%3.0" /end CHARACTERISTIC
/begin CHARACTERISTIC c_nr_cyc_eng_plaus_cam_max "Number of engine cycles to detect camshaft plausibility error" VALUE 0xa08025a1 _REC_VAL_20_u1 127. _CNV_A_R_LINEAR_____0_CM 0. 127. DISPLAY_IDENTIFIER C_NR_CYC_ENG_PLAUS_CAM_MAX FORMAT "%3.0" /end CHARACTERISTIC
/begin CHARACTERISTIC c_ctr_orng_cam_syn_crk_max "Failure count to detect camshaft error for crankshaft synchronization" VALUE 0xa080259a _REC_VAL_20_u1 255. _CNV_A_R_LINEAR_____0_CM 0. 255. DISPLAY_IDENTIFIER C_CTR_ORNG_CAM_SYN_CRK_MAX FORMAT "%3.0" /end CHARACTERISTIC
/begin CHARACTERISTIC lc_cam_err_ena_vvt "Switch to enable camshaft error debouncing for VVT reactivation" VALUE 0xa08025b2 _REC_VAL_20_u1 1. _CNV_S_2_RANGE__0___1_CM 0. 1. DISPLAY_IDENTIFIER LC_CAM_ERR_ENA_VVT /end CHARACTERISTIC
/begin CHARACTERISTIC lc_ctr_dec_plaus_cam "Switch to enable camshaft plausibility debouncing" VALUE 0xa08025b4 _REC_VAL_20_u1 1. _CNV_S_2_RANGE__0___1_CM 0. 1. DISPLAY_IDENTIFIER LC_CTR_DEC_PLAUS_CAM /end CHARACTERISTIC
/begin MEASUREMENT lv_err_cam_tot "Failure of at least one camshaft sensor on a camshaft with IVVT actuator" UBYTE _CNV_S_2_RANGE__0___1_CM 1 100. 0. 1. DISPLAY_IDENTIFIER LV_ERR_CAM_TOT ECU_ADDRESS 0xd00074d0 BIT_MASK 0x1 /end MEASUREMENT
/begin MEASUREMENT lv_err_crk "Crankshaft sensor failure" UBYTE _CNV_S_2_RANGE__0___1_CM 1 100. 0. 1. DISPLAY_IDENTIFIER LV_ERR_CRK ECU_ADDRESS 0xd00074d1 BIT_MASK 0x1 /end MEASUREMENT
/begin MEASUREMENT lv_inh_diag_crk_syn "Inhibition of crankshaft sensor synchronization diagnosis" UBYTE _CNV_S_2_RANGE__0___1_CM 1 100. 0. 1. DISPLAY_IDENTIFIER LV_INH_DIAG_CRK_SYN ECU_ADDRESS 0xd00074d6 BIT_MASK 0x1 /end MEASUREMENT
/begin MEASUREMENT lv_inh_diag_crk_tooth "Inhibition of crankshaft sensor tooth number diagnosis" UBYTE _CNV_S_2_RANGE__0___1_CM 1 100. 0. 1. DISPLAY_IDENTIFIER LV_INH_DIAG_CRK_TOOTH ECU_ADDRESS 0xd00074d7 BIT_MASK 0x1 /end MEASUREMENT
/begin MEASUREMENT lv_inh_diag_crk_tooth_per "Inhibition of crankshaft sensor tooth peirod diagnosis" UBYTE _CNV_S_2_RANGE__0___1_CM 1 100. 0. 1. DISPLAY_IDENTIFIER LV_INH_DIAG_CRK_TOOTH_PER ECU_ADDRESS 0xd00074d8 BIT_MASK 0x1 /end MEASUREMENT
/begin MEASUREMENT lv_inh_diag_crk_plaus "Inhibition of crankshaft sensor plausibility diagnosis" UBYTE _CNV_S_2_RANGE__0___1_CM 1 100. 0. 1. DISPLAY_IDENTIFIER LV_INH_DIAG_CRK_PLAUS ECU_ADDRESS 0xd00074d5 BIT_MASK 0x1 /end MEASUREMENT
/begin MEASUREMENT lv_inh_diag_crk_oc "Inhibition of crankshaft sensor circuit diagnosis" UBYTE _CNV_S_2_RANGE__0___1_CM 1 100. 0. 1. DISPLAY_IDENTIFIER LV_INH_DIAG_CRK_OC ECU_ADDRESS 0xd00074d4 BIT_MASK 0x1 /end MEASUREMENT
/begin MEASUREMENT lv_inh_diag_ensd "Inhibition of cam/crk diagnosis during fail safe delay" UBYTE _CNV_S_2_RANGE__0___1_CM 1 100. 0. 1. DISPLAY_IDENTIFIER LV_INH_DIAG_ENSD ECU_ADDRESS 0xd00074d9 BIT_MASK 0x1 /end MEASUREMENT
/begin CHARACTERISTIC c_t_dly_rest_igk "Delay time for diagnosis reactivation after key-off at low engine speed" VALUE 0xa08025a8 _REC_VAL_20_u1 2.55 _CNV_A_R_LINEAR_____3_CM 0. 2.55 DISPLAY_IDENTIFIER C_T_DLY_REST_IGK FORMAT "%4.2" /end CHARACTERISTIC
/begin CHARACTERISTIC c_t_dly_rest_stall "Delay time for diagnosis reactivation after engine stalling" VALUE 0xa08025aa _REC_VAL_20_u2 655.35 _CNV_A_R_LINEAR_____3_CM 0. 655.35 DISPLAY_IDENTIFIER C_T_DLY_REST_STALL FORMAT "%6.2" /end CHARACTERISTIC
/begin MEASUREMENT idx_diag_mng_ex[0].lv_err_cam "Failure of exhaust camshaft sensor 1" UBYTE _CNV_S_2_RANGE__0___1_CM 1 100. 0. 1. DISPLAY_IDENTIFIER LV_ERR_CAM_EX_1 ECU_ADDRESS 0xd0007524 BIT_MASK 0x1 /end MEASUREMENT
/begin MEASUREMENT idx_diag_mng_ex[0].lv_inh_diag_syn_cam "Inhibition of exhaust camshaft 1 synchronization diagnosis" UBYTE _CNV_S_2_RANGE__0___1_CM 1 100. 0. 1. DISPLAY_IDENTIFIER LV_INH_DIAG_SYN_CAM_EX_1 ECU_ADDRESS 0xd0007525 BIT_MASK 0x1 /end MEASUREMENT
/begin MEASUREMENT idx_diag_mng_ex[0].lv_inh_diag_per_cam "Inhibition of exhaust camshaft 1 period diagnosis" UBYTE _CNV_S_2_RANGE__0___1_CM 1 100. 0. 1. DISPLAY_IDENTIFIER LV_INH_DIAG_PER_CAM_EX_1 ECU_ADDRESS 0xd0007526 BIT_MASK 0x1 /end MEASUREMENT
/begin MEASUREMENT idx_diag_mng_ex[0].lv_inh_diag_plaus_cam "Inhibition of exhaust camshaft 1 plausibility diagnosis" UBYTE _CNV_S_2_RANGE__0___1_CM 1 100. 0. 1. DISPLAY_IDENTIFIER LV_INH_DIAG_PLAUS_CAM_EX_1 ECU_ADDRESS 0xd0007527 BIT_MASK 0x1 /end MEASUREMENT
/begin MEASUREMENT idx_diag_mng_ex[0].lv_inh_diag_ref_crk_cam "Inhibition of exhaust camshaft 1 position diagnosis" UBYTE _CNV_S_2_RANGE__0___1_CM 1 100. 0. 1. DISPLAY_IDENTIFIER LV_INH_DIAG_REF_CRK_CAM_EX_1 ECU_ADDRESS 0xd0007528 BIT_MASK 0x1 /end MEASUREMENT
/begin MEASUREMENT idx_diag_mng_ex[0].lv_inh_diag_tooth_off "" UBYTE _CNV_S_2_RANGE__0___1_CM 1 100. 0. 1. DISPLAY_IDENTIFIER LV_INH_DIAG_TOOTH_OFF_EX_1 ECU_ADDRESS 0xd0007529 BIT_MASK 0x1 /end MEASUREMENT
/begin MEASUREMENT idx_diag_mng_ex[0].lv_inh_diag_syn_crk_cam "Inhibition of exhaust camshaft sensor diagnosis for crankshaft synchronization" UBYTE _CNV_S_2_RANGE__0___1_CM 1 100. 0. 1. DISPLAY_IDENTIFIER LV_INH_DIAG_SYN_CRK_CAM_EX_1 ECU_ADDRESS 0xd000752a BIT_MASK 0x1 /end MEASUREMENT
/begin MEASUREMENT idx_diag_mng_ex[1].lv_err_cam "Failure of exhaust camshaft sensor 2" UBYTE _CNV_S_2_RANGE__0___1_CM 1 100. 0. 1. DISPLAY_IDENTIFIER LV_ERR_CAM_EX_2 ECU_ADDRESS 0xd000752c BIT_MASK 0x1 /end MEASUREMENT
/begin MEASUREMENT idx_diag_mng_ex[1].lv_inh_diag_syn_cam "Inhibition of exhaust camshaft 2 synchronization diagnosis" UBYTE _CNV_S_2_RANGE__0___1_CM 1 100. 0. 1. DISPLAY_IDENTIFIER LV_INH_DIAG_SYN_CAM_EX_2 ECU_ADDRESS 0xd000752d BIT_MASK 0x1 /end MEASUREMENT
/begin MEASUREMENT idx_diag_mng_ex[1].lv_inh_diag_per_cam "Inhibition of exhaust camshaft 2 period diagnosis" UBYTE _CNV_S_2_RANGE__0___1_CM 1 100. 0. 1. DISPLAY_IDENTIFIER LV_INH_DIAG_PER_CAM_EX_2 ECU_ADDRESS 0xd000752e BIT_MASK 0x1 /end MEASUREMENT
/begin MEASUREMENT idx_diag_mng_ex[1].lv_inh_diag_plaus_cam "Inhibition of exhaust camshaft 2 plausibility diagnosis" UBYTE _CNV_S_2_RANGE__0___1_CM 1 100. 0. 1. DISPLAY_IDENTIFIER LV_INH_DIAG_PLAUS_CAM_EX_2 ECU_ADDRESS 0xd000752f BIT_MASK 0x1 /end MEASUREMENT
/begin MEASUREMENT idx_diag_mng_ex[1].lv_inh_diag_ref_crk_cam "Inhibition of exhaust camshaft 2 position diagnosis" UBYTE _CNV_S_2_RANGE__0___1_CM 1 100. 0. 1. DISPLAY_IDENTIFIER LV_INH_DIAG_REF_CRK_CAM_EX_2 ECU_ADDRESS 0xd0007530 BIT_MASK 0x1 /end MEASUREMENT
/begin MEASUREMENT idx_diag_mng_ex[1].lv_inh_diag_tooth_off "" UBYTE _CNV_S_2_RANGE__0___1_CM 1 100. 0. 1. DISPLAY_IDENTIFIER LV_INH_DIAG_TOOTH_OFF_EX_2 ECU_ADDRESS 0xd0007531 BIT_MASK 0x1 /end MEASUREMENT
/begin MEASUREMENT idx_diag_mng_ex[1].lv_inh_diag_syn_crk_cam "Inhibition of exhaust camshaft sensor diagnosis for crankshaft synchronization" UBYTE _CNV_S_2_RANGE__0___1_CM 1 100. 0. 1. DISPLAY_IDENTIFIER LV_INH_DIAG_SYN_CRK_CAM_EX_2 ECU_ADDRESS 0xd0007532 BIT_MASK 0x1 /end MEASUREMENT
/begin MEASUREMENT idx_diag_mng_in[0].lv_err_cam "Failure of intake camshaft sensor 1" UBYTE _CNV_S_2_RANGE__0___1_CM 1 100. 0. 1. DISPLAY_IDENTIFIER LV_ERR_CAM_IN_1 ECU_ADDRESS 0xd00074f4 BIT_MASK 0x1 /end MEASUREMENT
/begin MEASUREMENT idx_diag_mng_in[0].lv_inh_diag_syn_cam "Inhibition of intake camshaft 1 synchronization diagnosis" UBYTE _CNV_S_2_RANGE__0___1_CM 1 100. 0. 1. DISPLAY_IDENTIFIER LV_INH_DIAG_SYN_CAM_IN_1 ECU_ADDRESS 0xd00074f5 BIT_MASK 0x1 /end MEASUREMENT
/begin MEASUREMENT idx_diag_mng_in[0].lv_inh_diag_per_cam "Inhibition of intake camshaft 1 period diagnosis" UBYTE _CNV_S_2_RANGE__0___1_CM 1 100. 0. 1. DISPLAY_IDENTIFIER LV_INH_DIAG_PER_CAM_IN_1 ECU_ADDRESS 0xd00074f6 BIT_MASK 0x1 /end MEASUREMENT
/begin MEASUREMENT idx_diag_mng_in[0].lv_inh_diag_plaus_cam "Inhibition of intake camshaft 1 plausibility diagnosis" UBYTE _CNV_S_2_RANGE__0___1_CM 1 100. 0. 1. DISPLAY_IDENTIFIER LV_INH_DIAG_PLAUS_CAM_IN_1 ECU_ADDRESS 0xd00074f7 BIT_MASK 0x1 /end MEASUREMENT
/begin MEASUREMENT idx_diag_mng_in[0].lv_inh_diag_ref_crk_cam "Inhibition of intake camshaft 1 position diagnosis" UBYTE _CNV_S_2_RANGE__0___1_CM 1 100. 0. 1. DISPLAY_IDENTIFIER LV_INH_DIAG_REF_CRK_CAM_IN_1 ECU_ADDRESS 0xd00074f8 BIT_MASK 0x1 /end MEASUREMENT
/begin MEASUREMENT idx_diag_mng_in[0].lv_inh_diag_tooth_off "" UBYTE _CNV_S_2_RANGE__0___1_CM 1 100. 0. 1. DISPLAY_IDENTIFIER LV_INH_DIAG_TOOTH_OFF_IN_1 ECU_ADDRESS 0xd00074f9 BIT_MASK 0x1 /end MEASUREMENT
/begin MEASUREMENT idx_diag_mng_in[0].lv_inh_diag_syn_crk_cam "Inhibition of intake camshaft sensor diagnosis for crankshaft synchronization" UBYTE _CNV_S_2_RANGE__0___1_CM 1 100. 0. 1. DISPLAY_IDENTIFIER LV_INH_DIAG_SYN_CRK_CAM_IN_1 ECU_ADDRESS 0xd00074fa BIT_MASK 0x1 /end MEASUREMENT
/begin MEASUREMENT idx_diag_mng_in[1].lv_err_cam "Failure of intake camshaft sensor 2" UBYTE _CNV_S_2_RANGE__0___1_CM 1 100. 0. 1. DISPLAY_IDENTIFIER LV_ERR_CAM_IN_2 ECU_ADDRESS 0xd00074fc BIT_MASK 0x1 /end MEASUREMENT
/begin MEASUREMENT idx_diag_mng_in[1].lv_inh_diag_syn_cam "Inhibition of intake camshaft 2 synchronization diagnosis" UBYTE _CNV_S_2_RANGE__0___1_CM 1 100. 0. 1. DISPLAY_IDENTIFIER LV_INH_DIAG_SYN_CAM_IN_2 ECU_ADDRESS 0xd00074fd BIT_MASK 0x1 /end MEASUREMENT
/begin MEASUREMENT idx_diag_mng_in[1].lv_inh_diag_per_cam "Inhibition of intake camshaft 2 period diagnosis" UBYTE _CNV_S_2_RANGE__0___1_CM 1 100. 0. 1. DISPLAY_IDENTIFIER LV_INH_DIAG_PER_CAM_IN_2 ECU_ADDRESS 0xd00074fe BIT_MASK 0x1 /end MEASUREMENT
/begin MEASUREMENT idx_diag_mng_in[1].lv_inh_diag_plaus_cam "Inhibition of intake camshaft 2 plausibility diagnosis" UBYTE _CNV_S_2_RANGE__0___1_CM 1 100. 0. 1. DISPLAY_IDENTIFIER LV_INH_DIAG_PLAUS_CAM_IN_2 ECU_ADDRESS 0xd00074ff BIT_MASK 0x1 /end MEASUREMENT
/begin MEASUREMENT idx_diag_mng_in[1].lv_inh_diag_ref_crk_cam "Inhibition of intake camshaft 2 position diagnosis" UBYTE _CNV_S_2_RANGE__0___1_CM 1 100. 0. 1. DISPLAY_IDENTIFIER LV_INH_DIAG_REF_CRK_CAM_IN_2 ECU_ADDRESS 0xd0007500 BIT_MASK 0x1 /end MEASUREMENT
/begin MEASUREMENT idx_diag_mng_in[1].lv_inh_diag_tooth_off "" UBYTE _CNV_S_2_RANGE__0___1_CM 1 100. 0. 1. DISPLAY_IDENTIFIER LV_INH_DIAG_TOOTH_OFF_IN_2 ECU_ADDRESS 0xd0007501 BIT_MASK 0x1 /end MEASUREMENT
/begin MEASUREMENT idx_diag_mng_in[1].lv_inh_diag_syn_crk_cam "Inhibition of intake camshaft sensor diagnosis for crankshaft synchronization" UBYTE _CNV_S_2_RANGE__0___1_CM 1 100. 0. 1. DISPLAY_IDENTIFIER LV_INH_DIAG_SYN_CRK_CAM_IN_2 ECU_ADDRESS 0xd0007502 BIT_MASK 0x1 /end MEASUREMENT
/begin CHARACTERISTIC c_n_not_rest "Engine speed threshold for cam/crk diagnosis deactivation" VALUE 0xa080259f _REC_VAL_20_u1 8160. _CNV_A_R_LINEAR_____10_CM 0. 8160. DISPLAY_IDENTIFIER C_N_NOT_REST FORMAT "%4.0" /end CHARACTERISTIC
/begin CHARACTERISTIC lc_eng_back_inh "Inhibition of engine backwards rotation detection" VALUE 0xa08025b5 _REC_VAL_20_u1 1. _CNV_A_R_LINEAR_____0_CM 0. 1. DISPLAY_IDENTIFIER LC_ENG_BACK_INH FORMAT "%1.0" /end CHARACTERISTIC
/begin CHARACTERISTIC c_t_min_inh_diag_ensd "Minimum delay before reactivating diagnosis in case of key off to on after engine backwards rotation confirmation" VALUE 0xa08025b0 _REC_VAL_20_u2 655.35 _CNV_A_R_LINEAR_____3_CM 0. 655.35 DISPLAY_IDENTIFIER C_T_MIN_INH_DIAG_ENSD FORMAT "%6.2" /end CHARACTERISTIC
/begin CHARACTERISTIC c_t_max_inh_diag_ensd "Maximum delay before reactivating diagnosis after engine backwards rotation confirmation" VALUE 0xa08025ae _REC_VAL_20_u2 655.35 _CNV_A_R_LINEAR_____3_CM 0. 655.35 DISPLAY_IDENTIFIER C_T_MAX_INH_DIAG_ENSD FORMAT "%6.2" /end CHARACTERISTIC
/begin MEASUREMENT lv_ign_inj_lock_req "Request to lock ignition and/or injection due to backwards rotation detection" UBYTE _CNV_S_2_RANGE__0___1_CM 1 100. 0. 1. DISPLAY_IDENTIFIER LV_IGN_INJ_LOCK_REQ ECU_ADDRESS 0xd00074d3 BIT_MASK 0x1 /end MEASUREMENT
/begin CHARACTERISTIC c_dyw_cam_crk_syn_adc_ex "Tolerance window advance for exhaust camshaft to crankshaft reference in crankshaft synchronization mode" VALUE 0xa0802602 _REC_VAL_20_u2 127.9375 _CNV_A_R_LINEAR_____188_CM 0. 127.9375 DISPLAY_IDENTIFIER C_DYW_CAM_CRK_SYN_ADC_EX FORMAT "%8.4" /end CHARACTERISTIC
/begin CHARACTERISTIC c_dyw_cam_crk_syn_rtd_ex "Tolerance window retard for exhaust camshaft to crankshaft reference in crankshaft synchronization mode" VALUE 0xa0802604 _REC_VAL_20_u2 127.9375 _CNV_A_R_LINEAR_____188_CM 0. 127.9375 DISPLAY_IDENTIFIER C_DYW_CAM_CRK_SYN_RTD_EX FORMAT "%8.4" /end CHARACTERISTIC
/begin CHARACTERISTIC c_dyw_cam_crk_syn_rtd_in "Tolerance window retard for intake camshaft to crankshaft reference in crankshaft synchronization mode" VALUE 0xa08025d8 _REC_VAL_20_u2 127.9375 _CNV_A_R_LINEAR_____188_CM 0. 127.9375 DISPLAY_IDENTIFIER C_DYW_CAM_CRK_SYN_RTD_IN FORMAT "%8.4" /end CHARACTERISTIC
/begin CHARACTERISTIC c_dyw_cam_syn_ex "Tolerance window for angle between exhaust camshaft signal edges in crankshaft synchronization mode" VALUE 0xa0802606 _REC_VAL_20_u2 31.9375 _CNV_A_R_LINEAR_____188_CM 0. 31.9375 DISPLAY_IDENTIFIER C_DYW_CAM_SYN_EX FORMAT "%7.4" /end CHARACTERISTIC
/begin CHARACTERISTIC c_dyw_cam_syn_in "Tolerance window for angle between intake camshaft signal edges in crankshaft synchronization mode" VALUE 0xa08025da _REC_VAL_20_u2 31.9375 _CNV_A_R_LINEAR_____188_CM 0. 31.9375 DISPLAY_IDENTIFIER C_DYW_CAM_SYN_IN FORMAT "%7.4" /end CHARACTERISTIC
/begin CHARACTERISTIC c_crk_ang_dly "Crankshaft angle threshold after start of cranking to reduce the possible engine position range for pre-injection" VALUE 0xa0802598 _REC_VAL_20_u2 719.9375 _CNV_A_R_LINEAR_____188_CM 0. 719.9375 DISPLAY_IDENTIFIER C_CRK_ANG_DLY FORMAT "%8.4" /end CHARACTERISTIC
/begin CHARACTERISTIC c_dyw_cam_crk_syn_adc_in "Tolerance window advance for intake camshaft to crankshaft reference in crankshaft synchronization mode" VALUE 0xa08025d6 _REC_VAL_20_u2 127.9375 _CNV_A_R_LINEAR_____188_CM 0. 127.9375 DISPLAY_IDENTIFIER C_DYW_CAM_CRK_SYN_ADC_IN FORMAT "%8.4" /end CHARACTERISTIC
/begin MEASUREMENT lv_cam_syn_crk "Camshaft acquisition ready for crankshaft synchronization" UBYTE _CNV_S_2_RANGE__0___1_CM 1 100. 0. 1. DISPLAY_IDENTIFIER LV_CAM_SYN_CRK ECU_ADDRESS 0xd00025c8 BIT_MASK 0x1 /end MEASUREMENT
/begin MEASUREMENT lv_orng_cam_syn_crk "Camshaft signal for crankshaft synchronization out of range" UBYTE _CNV_S_2_RANGE__0___1_CM 1 100. 0. 1. DISPLAY_IDENTIFIER LV_ORNG_CAM_SYN_CRK ECU_ADDRESS 0xd00025cb BIT_MASK 0x1 /end MEASUREMENT
/begin MEASUREMENT idx_cam_acq_ex[0].idx_edge_cam "Index of the last camshaft signal edge" UBYTE _CNV_A_R_LINEAR_____397_CM 1 100. 1. 16. DISPLAY_IDENTIFIER IDX_EDGE_CAM_EX_1 ECU_ADDRESS 0xd0005fc8 FORMAT "%3.0" /end MEASUREMENT
/begin MEASUREMENT idx_cam_acq_ex[0].ctr_edge_cam "Continuous camshaft signal edge counter" UBYTE _CNV_A_R_LINEAR_____0_CM 1 100. 0. 255. DISPLAY_IDENTIFIER CTR_EDGE_CAM_EX_1 ECU_ADDRESS 0xd0005fc9 FORMAT "%3.0" /end MEASUREMENT
/begin MEASUREMENT idx_cam_acq_ex[0].lv_vld_psn_cam "Exhaust camshaft position measurement valid" UBYTE _CNV_S_2_RANGE__0___1_CM 1 100. 0. 1. DISPLAY_IDENTIFIER LV_VLD_PSN_CAM_EX_1 ECU_ADDRESS 0xd0005fca BIT_MASK 0x1 /end MEASUREMENT
/begin MEASUREMENT idx_cam_acq_ex[0].lv_syn_cam "Exhaust camshaft synchronized" UBYTE _CNV_S_2_RANGE__0___1_CM 1 100. 0. 1. DISPLAY_IDENTIFIER LV_SYN_CAM_EX_1 ECU_ADDRESS 0xd0005fcb BIT_MASK 0x1 /end MEASUREMENT
/begin MEASUREMENT idx_cam_acq_ex[0].lv_orng_per_cam "Exhaust camshaft segment period out of range" UBYTE _CNV_S_2_RANGE__0___1_CM 1 100. 0. 1. DISPLAY_IDENTIFIER LV_ORNG_PER_CAM_EX_1 ECU_ADDRESS 0xd0005fcc BIT_MASK 0x1 /end MEASUREMENT
/begin MEASUREMENT idx_cam_acq_ex[0].lv_orng_ratio_cam "Exhaust camshaft segment ratio out of range" UBYTE _CNV_S_2_RANGE__0___1_CM 1 100. 0. 1. DISPLAY_IDENTIFIER LV_ORNG_RATIO_CAM_EX_1 ECU_ADDRESS 0xd0005fcd BIT_MASK 0x1 /end MEASUREMENT
/begin MEASUREMENT idx_cam_acq_ex[0].psn_eng_cam "" UWORD _CNV_A_R_LINEAR_____188_CM 1 100. 0. 719.9375 DISPLAY_IDENTIFIER PSN_ENG_CAM_EX_1 ECU_ADDRESS 0xd0005fce FORMAT "%8.4" /end MEASUREMENT
/begin MEASUREMENT idx_cam_acq_ex[0].t_seg_cam "Camshaft segment period" ULONG _CNV_A_R_LINEAR_____385_CM 1 100. 0. 1.9965 DISPLAY_IDENTIFIER T_SEG_CAM_EX_1 ECU_ADDRESS 0xd0005fd0 FORMAT "%8.6" /end MEASUREMENT
/begin MEASUREMENT idx_cam_acq_ex[1].idx_edge_cam "Index of the last camshaft signal edge" UBYTE _CNV_A_R_LINEAR_____397_CM 1 100. 1. 256. DISPLAY_IDENTIFIER IDX_EDGE_CAM_EX_2 ECU_ADDRESS 0xd0005fd4 FORMAT "%3.0" /end MEASUREMENT
/begin MEASUREMENT idx_cam_acq_ex[1].ctr_edge_cam "Continuous camshaft signal edge counter" UBYTE _CNV_A_R_LINEAR_____0_CM 1 100. 0. 255. DISPLAY_IDENTIFIER CTR_EDGE_CAM_EX_2 ECU_ADDRESS 0xd0005fd5 FORMAT "%3.0" /end MEASUREMENT
/begin MEASUREMENT idx_cam_acq_ex[1].lv_vld_psn_cam "Exhaust camshaft position measurement valid" UBYTE _CNV_S_2_RANGE__0___1_CM 1 100. 0. 1. DISPLAY_IDENTIFIER LV_VLD_PSN_CAM_EX_2 ECU_ADDRESS 0xd0005fd6 BIT_MASK 0x1 /end MEASUREMENT
/begin MEASUREMENT idx_cam_acq_ex[1].lv_syn_cam "Exhaust camshaft synchronized" UBYTE _CNV_S_2_RANGE__0___1_CM 1 100. 0. 1. DISPLAY_IDENTIFIER LV_SYN_CAM_EX_2 ECU_ADDRESS 0xd0005fd7 BIT_MASK 0x1 /end MEASUREMENT
/begin MEASUREMENT idx_cam_acq_ex[1].lv_orng_per_cam "Exhaust camshaft segment period out of range" UBYTE _CNV_S_2_RANGE__0___1_CM 1 100. 0. 1. DISPLAY_IDENTIFIER LV_ORNG_PER_CAM_EX_2 ECU_ADDRESS 0xd0005fd8 BIT_MASK 0x1 /end MEASUREMENT
/begin MEASUREMENT idx_cam_acq_ex[1].lv_orng_ratio_cam "Exhaust camshaft segment ratio out of range" UBYTE _CNV_S_2_RANGE__0___1_CM 1 100. 0. 1. DISPLAY_IDENTIFIER LV_ORNG_RATIO_CAM_EX_2 ECU_ADDRESS 0xd0005fd9 BIT_MASK 0x1 /end MEASUREMENT
/begin MEASUREMENT idx_cam_acq_ex[1].psn_eng_cam "" UWORD _CNV_A_R_LINEAR_____188_CM 1 100. 0. 719.9375 DISPLAY_IDENTIFIER PSN_ENG_CAM_EX_2 ECU_ADDRESS 0xd0005fda FORMAT "%8.4" /end MEASUREMENT
/begin MEASUREMENT idx_cam_acq_ex[1].t_seg_cam "Camshaft segment period" ULONG _CNV_A_R_LINEAR_____385_CM 1 100. 0. 1.9965 DISPLAY_IDENTIFIER T_SEG_CAM_EX_2 ECU_ADDRESS 0xd0005fdc FORMAT "%8.6" /end MEASUREMENT
/begin MEASUREMENT idx_cam_acq_in[0].idx_edge_cam "Index of the last camshaft signal edge" UBYTE _CNV_A_R_LINEAR_____397_CM 1 100. 1. 16. DISPLAY_IDENTIFIER IDX_EDGE_CAM_IN_1 ECU_ADDRESS 0xd0005fb0 FORMAT "%3.0" /end MEASUREMENT
/begin MEASUREMENT idx_cam_acq_in[0].ctr_edge_cam "Continuous camshaft signal edge counter" UBYTE _CNV_A_R_LINEAR_____0_CM 1 100. 0. 255. DISPLAY_IDENTIFIER CTR_EDGE_CAM_IN_1 ECU_ADDRESS 0xd0005fb1 FORMAT "%3.0" /end MEASUREMENT
/begin MEASUREMENT idx_cam_acq_in[0].lv_vld_psn_cam "Intake camshaft position measurement valid" UBYTE _CNV_S_2_RANGE__0___1_CM 1 100. 0. 1. DISPLAY_IDENTIFIER LV_VLD_PSN_CAM_IN_1 ECU_ADDRESS 0xd0005fb2 BIT_MASK 0x1 /end MEASUREMENT
/begin MEASUREMENT idx_cam_acq_in[0].lv_syn_cam "intake camshaft synchronized" UBYTE _CNV_S_2_RANGE__0___1_CM 1 100. 0. 1. DISPLAY_IDENTIFIER LV_SYN_CAM_IN_1 ECU_ADDRESS 0xd0005fb3 BIT_MASK 0x1 /end MEASUREMENT
/begin MEASUREMENT idx_cam_acq_in[0].lv_orng_per_cam "intake camshaft segment period out of range" UBYTE _CNV_S_2_RANGE__0___1_CM 1 100. 0. 1. DISPLAY_IDENTIFIER LV_ORNG_PER_CAM_IN_1 ECU_ADDRESS 0xd0005fb4 BIT_MASK 0x1 /end MEASUREMENT
/begin MEASUREMENT idx_cam_acq_in[0].lv_orng_ratio_cam "Intake camshaft segment ratio out of range" UBYTE _CNV_S_2_RANGE__0___1_CM 1 100. 0. 1. DISPLAY_IDENTIFIER LV_ORNG_RATIO_CAM_IN_1 ECU_ADDRESS 0xd0005fb5 BIT_MASK 0x1 /end MEASUREMENT
/begin MEASUREMENT idx_cam_acq_in[0].psn_eng_cam "" UWORD _CNV_A_R_LINEAR_____188_CM 1 100. 0. 719.9375 DISPLAY_IDENTIFIER PSN_ENG_CAM_IN_1 ECU_ADDRESS 0xd0005fb6 FORMAT "%8.4" /end MEASUREMENT
/begin MEASUREMENT idx_cam_acq_in[0].t_seg_cam "Camshaft segment period" ULONG _CNV_A_R_LINEAR_____385_CM 1 100. 0. 1.9965 DISPLAY_IDENTIFIER T_SEG_CAM_IN_1 ECU_ADDRESS 0xd0005fb8 FORMAT "%8.6" /end MEASUREMENT
/begin MEASUREMENT idx_cam_acq_in[1].idx_edge_cam "Index of the last camshaft signal edge" UBYTE _CNV_A_R_LINEAR_____397_CM 1 100. 1. 256. DISPLAY_IDENTIFIER IDX_EDGE_CAM_IN_2 ECU_ADDRESS 0xd0005fbc FORMAT "%3.0" /end MEASUREMENT
/begin MEASUREMENT idx_cam_acq_in[1].ctr_edge_cam "Continuous camshaft signal edge counter" UBYTE _CNV_A_R_LINEAR_____0_CM 1 100. 0. 255. DISPLAY_IDENTIFIER CTR_EDGE_CAM_IN_2 ECU_ADDRESS 0xd0005fbd FORMAT "%3.0" /end MEASUREMENT
/begin MEASUREMENT idx_cam_acq_in[1].lv_vld_psn_cam "Intake camshaft position measurement valid" UBYTE _CNV_S_2_RANGE__0___1_CM 1 100. 0. 1. DISPLAY_IDENTIFIER LV_VLD_PSN_CAM_IN_2 ECU_ADDRESS 0xd0005fbe BIT_MASK 0x1 /end MEASUREMENT
/begin MEASUREMENT idx_cam_acq_in[1].lv_syn_cam "intake camshaft synchronized" UBYTE _CNV_S_2_RANGE__0___1_CM 1 100. 0. 1. DISPLAY_IDENTIFIER LV_SYN_CAM_IN_2 ECU_ADDRESS 0xd0005fbf BIT_MASK 0x1 /end MEASUREMENT
/begin MEASUREMENT idx_cam_acq_in[1].lv_orng_per_cam "intake camshaft segment period out of range" UBYTE _CNV_S_2_RANGE__0___1_CM 1 100. 0. 1. DISPLAY_IDENTIFIER LV_ORNG_PER_CAM_IN_2 ECU_ADDRESS 0xd0005fc0 BIT_MASK 0x1 /end MEASUREMENT
/begin MEASUREMENT idx_cam_acq_in[1].lv_orng_ratio_cam "Intake camshaft segment ratio out of range" UBYTE _CNV_S_2_RANGE__0___1_CM 1 100. 0. 1. DISPLAY_IDENTIFIER LV_ORNG_RATIO_CAM_IN_2 ECU_ADDRESS 0xd0005fc1 BIT_MASK 0x1 /end MEASUREMENT
/begin MEASUREMENT idx_cam_acq_in[1].psn_eng_cam "" UWORD _CNV_A_R_LINEAR_____188_CM 1 100. 0. 719.9375 DISPLAY_IDENTIFIER PSN_ENG_CAM_IN_2 ECU_ADDRESS 0xd0005fc2 FORMAT "%8.4" /end MEASUREMENT
/begin MEASUREMENT idx_cam_acq_in[1].t_seg_cam "Camshaft segment period" ULONG _CNV_A_R_LINEAR_____385_CM 1 100. 0. 1.9965 DISPLAY_IDENTIFIER T_SEG_CAM_IN_2 ECU_ADDRESS 0xd0005fc4 FORMAT "%8.6" /end MEASUREMENT
/begin CHARACTERISTIC id_fac_cam_ex "Period ratio tolerance factor for exhaust camshaft" CURVE 0xa08025e4 _REC_CUR_20_u1_u1 14.9375 _CNV_A_R_EVAC_LINEA_298_CM 1. 15.9375 DISPLAY_IDENTIFIER ID_FAC_CAM_EX FORMAT "%7.4"
 /begin AXIS_DESCR COM_AXIS n_32 _CNV_A_R_LINEAR_____10_CM 16 0. 8160. FORMAT "%4.0" AXIS_PTS_REF ldpm_n_32_1_ensd /end AXIS_DESCR
/end CHARACTERISTIC
/begin CHARACTERISTIC id_fac_cam_in "Period ratio tolerance factor for intake camshaft" CURVE 0xa08025b8 _REC_CUR_20_u1_u1 14.9375 _CNV_A_R_EVAC_LINEA_298_CM 1. 15.9375 DISPLAY_IDENTIFIER ID_FAC_CAM_IN FORMAT "%7.4"
 /begin AXIS_DESCR COM_AXIS n_32 _CNV_A_R_LINEAR_____10_CM 16 0. 8160. FORMAT "%4.0" AXIS_PTS_REF ldpm_n_32_1_ensd /end AXIS_DESCR
/end CHARACTERISTIC
/begin CHARACTERISTIC c_nr_edge_min_vld_cam_ex "Number of exhaust camshaft signal edges for valid position output" VALUE 0xa080260a _REC_VAL_20_u1 255. _CNV_A_R_LINEAR_____0_CM 0. 255. DISPLAY_IDENTIFIER C_NR_EDGE_MIN_VLD_CAM_EX FORMAT "%3.0" /end CHARACTERISTIC
/begin CHARACTERISTIC c_nr_edge_min_vld_cam_in "Number of intake camshaft signal edges for valid position output" VALUE 0xa08025de _REC_VAL_20_u1 255. _CNV_A_R_LINEAR_____0_CM 0. 255. DISPLAY_IDENTIFIER C_NR_EDGE_MIN_VLD_CAM_IN FORMAT "%3.0" /end CHARACTERISTIC
/begin CHARACTERISTIC c_cam_adj_vvt_syn_in "Extension of  tolerance window CAM_DYW_SYN_IN  when VVT is not in locked position at start" VALUE 0xa08025d2 _REC_VAL_20_u2 127.9375 _CNV_A_R_LINEAR_____188_CM 0. 127.9375 DISPLAY_IDENTIFIER C_CAM_ADJ_VVT_SYN_IN FORMAT "%8.4" /end CHARACTERISTIC
/begin CHARACTERISTIC c_cam_adj_vvt_syn_ex "Extension of  tolerance window CAM_DYW_SYN_EX  when VVT is not in locked position at start" VALUE 0xa08025fe _REC_VAL_20_u2 127.9375 _CNV_A_R_LINEAR_____188_CM 0. 127.9375 DISPLAY_IDENTIFIER C_CAM_ADJ_VVT_SYN_EX FORMAT "%8.4" /end CHARACTERISTIC
/begin CHARACTERISTIC c_cam_adj_vvt_syn_crk_adc_in "Extension of  tolerance window CAM_DYW_CRK_SYN_ADC_IN  when VVT is not in locked position at start" VALUE 0xa08025d0 _REC_VAL_20_u2 127.9375 _CNV_A_R_LINEAR_____188_CM 0. 127.9375 DISPLAY_IDENTIFIER C_CAM_ADJ_VVT_SYN_CRK_ADC_IN FORMAT "%8.4" /end CHARACTERISTIC
/begin CHARACTERISTIC c_cam_adj_vvt_syn_crk_rtd_ex "Extension of  tolerance window CAM_DYW_CRK_SYN_RTD_EX  when VVT is not in locked position at start" VALUE 0xa08025fc _REC_VAL_20_u2 127.9375 _CNV_A_R_LINEAR_____188_CM 0. 127.9375 DISPLAY_IDENTIFIER C_CAM_ADJ_VVT_SYN_CRK_RTD_EX FORMAT "%8.4" /end CHARACTERISTIC
/begin CHARACTERISTIC c_crk_ang_dly_lst_cam "Crankshaft angle threshold after last cam edge to reduce the possible engine position range for pre-injection" VALUE 0xa0802610 _REC_VAL_20_u2 719.9375 _CNV_A_R_LINEAR_____188_CM 0. 719.9375 DISPLAY_IDENTIFIER C_CRK_ANG_DLY_LST_CAM FORMAT "%8.4" /end CHARACTERISTIC
/begin CHARACTERISTIC c_t_crk_dly "Sensing delay time after first active crankshaft signal edge" VALUE 0xa08025a4 _REC_VAL_20_u4 3.9999946e-002 _CNV_A_R_ENSD_LINEA_398_CM 0. 3.9999946e-002 DISPLAY_IDENTIFIER C_T_CRK_DLY FORMAT "%8.6" /end CHARACTERISTIC
/begin MEASUREMENT lv_orng_tooth_per_crk "Invalid crankshaft tooth period" UBYTE _CNV_S_2_RANGE__0___1_CM 1 100. 0. 1. DISPLAY_IDENTIFIER LV_ORNG_TOOTH_PER_CRK ECU_ADDRESS 0xd00074e3 BIT_MASK 0x1 /end MEASUREMENT
/begin MEASUREMENT lv_orng_nr_tooth_crk "Crankshaft tooth count incorrect at reference gap" UBYTE _CNV_S_2_RANGE__0___1_CM 1 100. 0. 1. DISPLAY_IDENTIFIER LV_ORNG_NR_TOOTH_CRK ECU_ADDRESS 0xd00074e2 BIT_MASK 0x1 /end MEASUREMENT
/begin MEASUREMENT lv_lost_syn_crk "Crankshaft synchronization lost" UBYTE _CNV_S_2_RANGE__0___1_CM 1 100. 0. 1. DISPLAY_IDENTIFIER LV_LOST_SYN_CRK ECU_ADDRESS 0xd00074e1 BIT_MASK 0x1 /end MEASUREMENT
/begin MEASUREMENT lv_crk_syn "Flag for crankshaft acquisition synchronized" UBYTE _CNV_S_2_RANGE__0___1_CM 1 100. 0. 1. DISPLAY_IDENTIFIER LV_CRK_SYN ECU_ADDRESS 0xd00074cb BIT_MASK 0x1 /end MEASUREMENT
/begin CHARACTERISTIC id_fac_tol_crk_tooth "Factor for calculation of expected tooth period" CURVE 0xa0802588 _REC_CUR_20_u1_u1 0.9375 _CNV_A_R_EVAC_LINEA_298_CM 0. 0.9375 DISPLAY_IDENTIFIER ID_FAC_TOL_CRK_TOOTH FORMAT "%6.4"
 /begin AXIS_DESCR COM_AXIS n_32 _CNV_A_R_LINEAR_____10_CM 6 0. 8160. FORMAT "%4.0" AXIS_PTS_REF ldpm_n_32_2_ensd /end AXIS_DESCR
/end CHARACTERISTIC
/begin MEASUREMENT t_crk_win_ensd "Crankshaft tooth window at end of segment" ULONG _CNV_A_R_LINEAR_____385_CM 1 100. 0. 1.9965 DISPLAY_IDENTIFIER T_CRK_WIN_ENSD ECU_ADDRESS 0xd0005f98 FORMAT "%8.6" /end MEASUREMENT
/begin MEASUREMENT t_seg_er "Crankshaft segment period for misfire detection (ER algorithm)" ULONG _CNV_A_R_LINEAR_____385_CM 1 100. 0. 1.9965 DISPLAY_IDENTIFIER T_SEG_ER ECU_ADDRESS 0xd0005fa4 FORMAT "%8.6" /end MEASUREMENT
/begin MEASUREMENT lv_crk_miss_tooth "At least one missing tooth has been simulated" UBYTE _CNV_S_2_RANGE__0___1_CM 1 100. 0. 1. DISPLAY_IDENTIFIER LV_CRK_MISS_TOOTH ECU_ADDRESS 0xd00074c8 BIT_MASK 0x1 /end MEASUREMENT
/begin MEASUREMENT lv_err_per_cam_ex_1 "Present failure camshaft period too short" UBYTE _CNV_S_2_RANGE__0___1_CM 1 100. 0. 1. DISPLAY_IDENTIFIER LV_ERR_PER_CAM_EX_1 ECU_ADDRESS 0xd0007f4a BIT_MASK 0x1 /end MEASUREMENT
/begin MEASUREMENT lv_err_per_cam_ex_2 "Present failure camshaft period too short" UBYTE _CNV_S_2_RANGE__0___1_CM 1 100. 0. 1. DISPLAY_IDENTIFIER LV_ERR_PER_CAM_EX_2 ECU_ADDRESS 0xd0007f50 BIT_MASK 0x1 /end MEASUREMENT
/begin MEASUREMENT lv_err_per_cam_in_1 "Present failure camshaft period too short" UBYTE _CNV_S_2_RANGE__0___1_CM 1 100. 0. 1. DISPLAY_IDENTIFIER LV_ERR_PER_CAM_IN_1 ECU_ADDRESS 0xd0007f49 BIT_MASK 0x1 /end MEASUREMENT
/begin MEASUREMENT lv_err_per_cam_in_2 "Present failure camshaft period too short" UBYTE _CNV_S_2_RANGE__0___1_CM 1 100. 0. 1. DISPLAY_IDENTIFIER LV_ERR_PER_CAM_IN_2 ECU_ADDRESS 0xd0007f4f BIT_MASK 0x1 /end MEASUREMENT
/begin MEASUREMENT lv_err_syn_cam_ex_1 "Present failure camshaft period too short" UBYTE _CNV_S_2_RANGE__0___1_CM 1 100. 0. 1. DISPLAY_IDENTIFIER LV_ERR_SYN_CAM_EX_1 ECU_ADDRESS 0xd0007f4c BIT_MASK 0x1 /end MEASUREMENT
/begin MEASUREMENT lv_err_syn_cam_ex_2 "Present exhaust camshaft sensor failure" UBYTE _CNV_S_2_RANGE__0___1_CM 1 100. 0. 1. DISPLAY_IDENTIFIER LV_ERR_SYN_CAM_EX_2 ECU_ADDRESS 0xd0007f52 BIT_MASK 0x1 /end MEASUREMENT
/begin MEASUREMENT lv_err_syn_cam_in_1 "Present intake camshaft sensor failure" UBYTE _CNV_S_2_RANGE__0___1_CM 1 100. 0. 1. DISPLAY_IDENTIFIER LV_ERR_SYN_CAM_IN_1 ECU_ADDRESS 0xd0007f4b BIT_MASK 0x1 /end MEASUREMENT
/begin MEASUREMENT lv_err_syn_cam_in_2 "Present intake camshaft sensor failure" UBYTE _CNV_S_2_RANGE__0___1_CM 1 100. 0. 1. DISPLAY_IDENTIFIER LV_ERR_SYN_CAM_IN_2 ECU_ADDRESS 0xd0007f51 BIT_MASK 0x1 /end MEASUREMENT
/begin CHARACTERISTIC c_abc_inc_diag_ref_crk_cam_in "Anti-bounce counter increment for intake camshaft position diagnosis" VALUE 0xa08025c9 _REC_VAL_20_u1 255. _CNV_A_R_LINEAR_____0_CM 0. 255. DISPLAY_IDENTIFIER C_ABC_INC_DIAG_REF_CRK_CAM_IN FORMAT "%3.0" /end CHARACTERISTIC
/begin CHARACTERISTIC c_abc_inc_diag_ref_crk_cam_ex "Anti-bounce counter increment for exhaust camshaft position diagnosis" VALUE 0xa08025f5 _REC_VAL_20_u1 255. _CNV_A_R_LINEAR_____0_CM 0. 255. DISPLAY_IDENTIFIER C_ABC_INC_DIAG_REF_CRK_CAM_EX FORMAT "%3.0" /end CHARACTERISTIC
/begin CHARACTERISTIC c_abc_max_diag_ref_crk_cam_in "Anti-bounce counter maximum for intake camshaft position diagnosis" VALUE 0xa08025cd _REC_VAL_20_u1 254. _CNV_A_R_LINEAR_____0_CM 1. 255. DISPLAY_IDENTIFIER C_ABC_MAX_DIAG_REF_CRK_CAM_IN FORMAT "%3.0" /end CHARACTERISTIC
/begin CHARACTERISTIC c_abc_max_diag_ref_crk_cam_ex "Anti-bounce counter maximum for exhaust camshaft position diagnosis" VALUE 0xa08025f9 _REC_VAL_20_u1 254. _CNV_A_R_LINEAR_____0_CM 1. 255. DISPLAY_IDENTIFIER C_ABC_MAX_DIAG_REF_CRK_CAM_EX FORMAT "%3.0" /end CHARACTERISTIC
/begin CHARACTERISTIC c_abc_inc_diag_per_cam_in "Anti-bounce counter increment for intake camshaft segment period diagnosis" VALUE 0xa08025c8 _REC_VAL_20_u1 255. _CNV_A_R_LINEAR_____0_CM 0. 255. DISPLAY_IDENTIFIER C_ABC_INC_DIAG_PER_CAM_IN FORMAT "%3.0" /end CHARACTERISTIC
/begin CHARACTERISTIC c_abc_max_diag_per_cam_in "Anti-bounce counter maximum for intake camshaft segment period diagnosis" VALUE 0xa08025cc _REC_VAL_20_u1 254. _CNV_A_R_LINEAR_____0_CM 1. 255. DISPLAY_IDENTIFIER C_ABC_MAX_DIAG_PER_CAM_IN FORMAT "%3.0" /end CHARACTERISTIC
/begin CHARACTERISTIC c_abc_inc_diag_syn_cam_ex "Anti-bounce counter increment for exhaust camshaft synchronization diagnosis" VALUE 0xa08025f6 _REC_VAL_20_u1 255. _CNV_A_R_LINEAR_____0_CM 0. 255. DISPLAY_IDENTIFIER C_ABC_INC_DIAG_SYN_CAM_EX FORMAT "%3.0" /end CHARACTERISTIC
/begin CHARACTERISTIC c_abc_inc_diag_syn_cam_in "Anti-bounce counter increment for intake camshaft synchronization diagnosis" VALUE 0xa08025ca _REC_VAL_20_u1 255. _CNV_A_R_LINEAR_____0_CM 0. 255. DISPLAY_IDENTIFIER C_ABC_INC_DIAG_SYN_CAM_IN FORMAT "%3.0" /end CHARACTERISTIC
/begin CHARACTERISTIC c_abc_max_diag_syn_cam_ex "Anti-bounce counter maximum for exhaust camshaft synchronization diagnosis" VALUE 0xa08025fa _REC_VAL_20_u1 254. _CNV_A_R_LINEAR_____0_CM 1. 255. DISPLAY_IDENTIFIER C_ABC_MAX_DIAG_SYN_CAM_EX FORMAT "%3.0" /end CHARACTERISTIC
/begin CHARACTERISTIC c_abc_max_diag_syn_cam_in "Anti-bounce counter maximum for intake camshaft synchronization diagnosis" VALUE 0xa08025ce _REC_VAL_20_u1 254. _CNV_A_R_LINEAR_____0_CM 1. 255. DISPLAY_IDENTIFIER C_ABC_MAX_DIAG_SYN_CAM_IN FORMAT "%3.0" /end CHARACTERISTIC
/begin MEASUREMENT lv_inh_diag_ext_ref_crk_cam_in[0] "Inhibition condition for the camshaft position diagnosis (intake)" UBYTE _CNV_S_2_RANGE__0___1_CM 1 100. 0. 1. DISPLAY_IDENTIFIER LV_INH_DIAG_EXT_REF_CRK_CAM_IN[0] ECU_ADDRESS 0xd0007510 BIT_MASK 0x1 /end MEASUREMENT
/begin MEASUREMENT lv_inh_diag_ext_ref_crk_cam_in[1] "Inhibition condition for the camshaft position diagnosis (intake)" UBYTE _CNV_S_2_RANGE__0___1_CM 1 100. 0. 1. DISPLAY_IDENTIFIER LV_INH_DIAG_EXT_REF_CRK_CAM_IN[1] ECU_ADDRESS 0xd0007511 BIT_MASK 0x1 /end MEASUREMENT
/begin MEASUREMENT lv_inh_diag_ext_syn_cam_in[0] "Inhibition condition for the camshaft self-synchronization diagnosis (intake)" UBYTE _CNV_S_2_RANGE__0___1_CM 1 100. 0. 1. DISPLAY_IDENTIFIER LV_INH_DIAG_EXT_SYN_CAM_IN[0] ECU_ADDRESS 0xd0007512 BIT_MASK 0x1 /end MEASUREMENT
/begin MEASUREMENT lv_inh_diag_ext_syn_cam_in[1] "Inhibition condition for the camshaft self-synchronization diagnosis (intake)" UBYTE _CNV_S_2_RANGE__0___1_CM 1 100. 0. 1. DISPLAY_IDENTIFIER LV_INH_DIAG_EXT_SYN_CAM_IN[1] ECU_ADDRESS 0xd0007513 BIT_MASK 0x1 /end MEASUREMENT
/begin MEASUREMENT lv_inh_diag_ext_syn_cam_ex[0] "Inhibition condition for the camshaft self-synchronization diagnosis (exhaust)" UBYTE _CNV_S_2_RANGE__0___1_CM 1 100. 0. 1. DISPLAY_IDENTIFIER LV_INH_DIAG_EXT_SYN_CAM_EX[0] ECU_ADDRESS 0xd0007542 BIT_MASK 0x1 /end MEASUREMENT
/begin MEASUREMENT lv_inh_diag_ext_syn_cam_ex[1] "Inhibition condition for the camshaft self-synchronization diagnosis (exhaust)" UBYTE _CNV_S_2_RANGE__0___1_CM 1 100. 0. 1. DISPLAY_IDENTIFIER LV_INH_DIAG_EXT_SYN_CAM_EX[1] ECU_ADDRESS 0xd0007543 BIT_MASK 0x1 /end MEASUREMENT
/begin MEASUREMENT lv_inh_diag_ext_per_cam_in[0] "Inhibition condition for the camshaft period diagnosis (intake)" UBYTE _CNV_S_2_RANGE__0___1_CM 1 100. 0. 1. DISPLAY_IDENTIFIER LV_INH_DIAG_EXT_PER_CAM_IN[0] ECU_ADDRESS 0xd000750c BIT_MASK 0x1 /end MEASUREMENT
/begin MEASUREMENT lv_inh_diag_ext_per_cam_in[1] "Inhibition condition for the camshaft period diagnosis (intake)" UBYTE _CNV_S_2_RANGE__0___1_CM 1 100. 0. 1. DISPLAY_IDENTIFIER LV_INH_DIAG_EXT_PER_CAM_IN[1] ECU_ADDRESS 0xd000750d BIT_MASK 0x1 /end MEASUREMENT
/begin MEASUREMENT lv_inh_diag_ext_plaus_cam_ex[0] "Inhibition condition for the camshaft sensor plausibility diagnosis (exhaust)" UBYTE _CNV_S_2_RANGE__0___1_CM 1 100. 0. 1. DISPLAY_IDENTIFIER LV_INH_DIAG_EXT_PLAUS_CAM_EX[0] ECU_ADDRESS 0xd000753e BIT_MASK 0x1 /end MEASUREMENT
/begin MEASUREMENT lv_inh_diag_ext_plaus_cam_ex[1] "Inhibition condition for the camshaft sensor plausibility diagnosis (exhaust)" UBYTE _CNV_S_2_RANGE__0___1_CM 1 100. 0. 1. DISPLAY_IDENTIFIER LV_INH_DIAG_EXT_PLAUS_CAM_EX[1] ECU_ADDRESS 0xd000753f BIT_MASK 0x1 /end MEASUREMENT
/begin MEASUREMENT lv_inh_diag_ext_plaus_cam_in[0] "Inhibition condition for the camshaft sensor plausibility diagnosis (intake)" UBYTE _CNV_S_2_RANGE__0___1_CM 1 100. 0. 1. DISPLAY_IDENTIFIER LV_INH_DIAG_EXT_PLAUS_CAM_IN[0] ECU_ADDRESS 0xd000750e BIT_MASK 0x1 /end MEASUREMENT
/begin MEASUREMENT lv_inh_diag_ext_plaus_cam_in[1] "Inhibition condition for the camshaft sensor plausibility diagnosis (intake)" UBYTE _CNV_S_2_RANGE__0___1_CM 1 100. 0. 1. DISPLAY_IDENTIFIER LV_INH_DIAG_EXT_PLAUS_CAM_IN[1] ECU_ADDRESS 0xd000750f BIT_MASK 0x1 /end MEASUREMENT
/begin MEASUREMENT lv_inh_diag_ext_ref_crk_cam_ex[0] "Inhibition condition for the camshaft position diagnosis (exhaust)" UBYTE _CNV_S_2_RANGE__0___1_CM 1 100. 0. 1. DISPLAY_IDENTIFIER LV_INH_DIAG_EXT_REF_CRK_CAM_EX[0] ECU_ADDRESS 0xd0007540 BIT_MASK 0x1 /end MEASUREMENT
/begin MEASUREMENT lv_inh_diag_ext_ref_crk_cam_ex[1] "Inhibition condition for the camshaft position diagnosis (exhaust)" UBYTE _CNV_S_2_RANGE__0___1_CM 1 100. 0. 1. DISPLAY_IDENTIFIER LV_INH_DIAG_EXT_REF_CRK_CAM_EX[1] ECU_ADDRESS 0xd0007541 BIT_MASK 0x1 /end MEASUREMENT
/begin MEASUREMENT lv_inh_diag_ext_syn_crk_cam_ex[0] "Inhibition condition for the camshaft sensor diagnosis for crankshaft synchronization (exhaust)" UBYTE _CNV_S_2_RANGE__0___1_CM 1 100. 0. 1. DISPLAY_IDENTIFIER LV_INH_DIAG_EXT_SYN_CRK_CAM_EX[0] ECU_ADDRESS 0xd0007544 BIT_MASK 0x1 /end MEASUREMENT
/begin MEASUREMENT lv_inh_diag_ext_syn_crk_cam_ex[1] "Inhibition condition for the camshaft sensor diagnosis for crankshaft synchronization (exhaust)" UBYTE _CNV_S_2_RANGE__0___1_CM 1 100. 0. 1. DISPLAY_IDENTIFIER LV_INH_DIAG_EXT_SYN_CRK_CAM_EX[1] ECU_ADDRESS 0xd0007545 BIT_MASK 0x1 /end MEASUREMENT
/begin MEASUREMENT lv_inh_diag_ext_syn_crk_cam_in[0] "Inhibition condition for the camshaft sensor diagnosis for crankshaft synchronization (intake)" UBYTE _CNV_S_2_RANGE__0___1_CM 1 100. 0. 1. DISPLAY_IDENTIFIER LV_INH_DIAG_EXT_SYN_CRK_CAM_IN[0] ECU_ADDRESS 0xd0007514 BIT_MASK 0x1 /end MEASUREMENT
/begin MEASUREMENT lv_inh_diag_ext_syn_crk_cam_in[1] "Inhibition condition for the camshaft sensor diagnosis for crankshaft synchronization (intake)" UBYTE _CNV_S_2_RANGE__0___1_CM 1 100. 0. 1. DISPLAY_IDENTIFIER LV_INH_DIAG_EXT_SYN_CRK_CAM_IN[1] ECU_ADDRESS 0xd0007515 BIT_MASK 0x1 /end MEASUREMENT
/begin CHARACTERISTIC c_abc_inc_diag_per_cam_ex "Anti-bounce counter increment for exhaust camshaft segment period diagnosis" VALUE 0xa08025f4 _REC_VAL_20_u1 255. _CNV_A_R_LINEAR_____0_CM 0. 255. DISPLAY_IDENTIFIER C_ABC_INC_DIAG_PER_CAM_EX FORMAT "%3.0" /end CHARACTERISTIC
/begin CHARACTERISTIC c_abc_inc_diag_tooth_off_in "Anti-bounce counter increment for intake camshaft one tooth off diagnosis" VALUE 0xa08025cb _REC_VAL_20_u1 255. _CNV_A_R_LINEAR_____0_CM 0. 255. DISPLAY_IDENTIFIER C_ABC_INC_DIAG_TOOTH_OFF_IN FORMAT "%3.0" /end CHARACTERISTIC
/begin CHARACTERISTIC c_abc_inc_diag_tooth_off_ex "Anti-bounce counter increment for exhaust camshaft one tooth off diagnosis" VALUE 0xa08025f7 _REC_VAL_20_u1 255. _CNV_A_R_LINEAR_____0_CM 0. 255. DISPLAY_IDENTIFIER C_ABC_INC_DIAG_TOOTH_OFF_EX FORMAT "%3.0" /end CHARACTERISTIC
/begin CHARACTERISTIC c_abc_max_diag_per_cam_ex "Anti-bounce counter maximum for exhaust camshaft segment period diagnosis" VALUE 0xa08025f8 _REC_VAL_20_u1 254. _CNV_A_R_LINEAR_____0_CM 1. 255. DISPLAY_IDENTIFIER C_ABC_MAX_DIAG_PER_CAM_EX FORMAT "%3.0" /end CHARACTERISTIC
/begin CHARACTERISTIC c_abc_max_diag_tooth_off_in "Anti-bounce counter maximum for intake one tooth off diagnosis" VALUE 0xa08025cf _REC_VAL_20_u1 254. _CNV_A_R_LINEAR_____0_CM 1. 255. DISPLAY_IDENTIFIER C_ABC_MAX_DIAG_TOOTH_OFF_IN FORMAT "%3.0" /end CHARACTERISTIC
/begin CHARACTERISTIC c_abc_max_diag_tooth_off_ex "Anti-bounce counter maximum for exhaust one tooth off diagnosis" VALUE 0xa08025fb _REC_VAL_20_u1 254. _CNV_A_R_LINEAR_____0_CM 1. 255. DISPLAY_IDENTIFIER C_ABC_MAX_DIAG_TOOTH_OFF_EX FORMAT "%3.0" /end CHARACTERISTIC
/begin MEASUREMENT lv_inh_diag_ext_per_cam_ex[0] "Inhibition condition for the camshaft period diagnosis (exhaust)" UBYTE _CNV_S_2_RANGE__0___1_CM 1 100. 0. 1. DISPLAY_IDENTIFIER LV_INH_DIAG_EXT_PER_CAM_EX[0] ECU_ADDRESS 0xd000753c BIT_MASK 0x1 /end MEASUREMENT
/begin MEASUREMENT lv_inh_diag_ext_per_cam_ex[1] "Inhibition condition for the camshaft period diagnosis (exhaust)" UBYTE _CNV_S_2_RANGE__0___1_CM 1 100. 0. 1. DISPLAY_IDENTIFIER LV_INH_DIAG_EXT_PER_CAM_EX[1] ECU_ADDRESS 0xd000753d BIT_MASK 0x1 /end MEASUREMENT
/begin MEASUREMENT lv_inh_diag_ext_tooth_off_ex[0] "Inhibition condition for one tooth-off diagnosis (exhaust_i)" UBYTE _CNV_S_2_RANGE__0___1_CM 1 100. 0. 1. DISPLAY_IDENTIFIER LV_INH_DIAG_EXT_TOOTH_OFF_EX[0] ECU_ADDRESS 0xd0007546 BIT_MASK 0x1 /end MEASUREMENT
/begin MEASUREMENT lv_inh_diag_ext_tooth_off_ex[1] "Inhibition condition for one tooth-off diagnosis (exhaust_i)" UBYTE _CNV_S_2_RANGE__0___1_CM 1 100. 0. 1. DISPLAY_IDENTIFIER LV_INH_DIAG_EXT_TOOTH_OFF_EX[1] ECU_ADDRESS 0xd0007547 BIT_MASK 0x1 /end MEASUREMENT
/begin MEASUREMENT lv_inh_diag_ext_tooth_off_in[0] "Inhibition condition for one tooth-off diagnosis (intake_i)" UBYTE _CNV_S_2_RANGE__0___1_CM 1 100. 0. 1. DISPLAY_IDENTIFIER LV_INH_DIAG_EXT_TOOTH_OFF_IN[0] ECU_ADDRESS 0xd0007516 BIT_MASK 0x1 /end MEASUREMENT
/begin MEASUREMENT lv_inh_diag_ext_tooth_off_in[1] "Inhibition condition for one tooth-off diagnosis (intake_i)" UBYTE _CNV_S_2_RANGE__0___1_CM 1 100. 0. 1. DISPLAY_IDENTIFIER LV_INH_DIAG_EXT_TOOTH_OFF_IN[1] ECU_ADDRESS 0xd0007517 BIT_MASK 0x1 /end MEASUREMENT
/begin MEASUREMENT state_rbm_ref_crk_cam_in[0] "Interface of REF_CRK_CAM_IN[1] monitor with the Rate-Based Monitoring statistics" UBYTE _CNV_A_R_LINEAR_____0_CM 1 100. 0. 7. DISPLAY_IDENTIFIER STATE_RBM_REF_CRK_CAM_IN[0] ECU_ADDRESS 0xd00074ee FORMAT "%3.0" /end MEASUREMENT
/begin MEASUREMENT state_rbm_ref_crk_cam_in[1] "" UBYTE _CNV_A_R_LINEAR_____0_CM 1 100. 0. 7. DISPLAY_IDENTIFIER STATE_RBM_REF_CRK_CAM_IN[1] ECU_ADDRESS 0xd00074ef FORMAT "%3.0" /end MEASUREMENT
/begin MEASUREMENT state_rbm_ref_crk_cam_ex[0] "Interface of REF_CRK_CAM_EX[1] monitor with the Rate-Based Monitoring statistics" UBYTE _CNV_A_R_LINEAR_____0_CM 1 100. 0. 7. DISPLAY_IDENTIFIER STATE_RBM_REF_CRK_CAM_EX[0] ECU_ADDRESS 0xd000751e FORMAT "%3.0" /end MEASUREMENT
/begin MEASUREMENT state_rbm_ref_crk_cam_ex[1] "" UBYTE _CNV_A_R_LINEAR_____0_CM 1 100. 0. 7. DISPLAY_IDENTIFIER STATE_RBM_REF_CRK_CAM_EX[1] ECU_ADDRESS 0xd000751f FORMAT "%3.0" /end MEASUREMENT
/begin MEASUREMENT state_rbm_tooth_off_in[0] "interface of TOOTH_OFF_IN monitor with the rate based monitoring statistics" UBYTE _CNV_A_R_LINEAR_____0_CM 1 100. 0. 7. DISPLAY_IDENTIFIER STATE_RBM_TOOTH_OFF_IN[0] ECU_ADDRESS 0xd00074f0 FORMAT "%3.0" /end MEASUREMENT
/begin MEASUREMENT state_rbm_tooth_off_in[1] "interface of TOOTH_OFF_IN monitor with the rate based monitoring statistics" UBYTE _CNV_A_R_LINEAR_____0_CM 1 100. 0. 7. DISPLAY_IDENTIFIER STATE_RBM_TOOTH_OFF_IN[1] ECU_ADDRESS 0xd00074f1 FORMAT "%3.0" /end MEASUREMENT
/begin MEASUREMENT state_rbm_tooth_off_ex[0] "interface of TOOTH_OFF_EX monitor with the rate based monitoring statistics" UBYTE _CNV_A_R_LINEAR_____0_CM 1 100. 0. 7. DISPLAY_IDENTIFIER STATE_RBM_TOOTH_OFF_EX[0] ECU_ADDRESS 0xd0007520 FORMAT "%3.0" /end MEASUREMENT
/begin MEASUREMENT state_rbm_tooth_off_ex[1] "interface of TOOTH_OFF_EX monitor with the rate based monitoring statistics" UBYTE _CNV_A_R_LINEAR_____0_CM 1 100. 0. 7. DISPLAY_IDENTIFIER STATE_RBM_TOOTH_OFF_EX[1] ECU_ADDRESS 0xd0007521 FORMAT "%3.0" /end MEASUREMENT
/begin MEASUREMENT lv_inh_mis_crk "Inhibition of misfire detection with crankshaft tooth number error" UBYTE _CNV_S_2_RANGE__0___1_CM 1 100. 0. 1. DISPLAY_IDENTIFIER LV_INH_MIS_CRK ECU_ADDRESS 0xd00074df BIT_MASK 0x1 /end MEASUREMENT
/begin MEASUREMENT lv_err_crk_tooth "Present crankshaft failure tooth number error" UBYTE _CNV_S_2_RANGE__0___1_CM 1 100. 0. 1. DISPLAY_IDENTIFIER LV_ERR_CRK_TOOTH ECU_ADDRESS 0xd0007f55 BIT_MASK 0x1 /end MEASUREMENT
/begin MEASUREMENT lv_err_crk_tooth_per "Present crankshaft failure tooth number error" UBYTE _CNV_S_2_RANGE__0___1_CM 1 100. 0. 1. DISPLAY_IDENTIFIER LV_ERR_CRK_TOOTH_PER ECU_ADDRESS 0xd0007f56 BIT_MASK 0x1 /end MEASUREMENT
/begin MEASUREMENT lv_err_crk_syn "Present crankshaft failure with loss of synchronization" UBYTE _CNV_S_2_RANGE__0___1_CM 1 100. 0. 1. DISPLAY_IDENTIFIER LV_ERR_CRK_SYN ECU_ADDRESS 0xd0007f57 BIT_MASK 0x1 /end MEASUREMENT
/begin CHARACTERISTIC c_n_32_max_diag_crk_tooth "Maximum engine speed to enable tooth number diagnosis" VALUE 0xa080259c _REC_VAL_20_u1 8160. _CNV_A_R_LINEAR_____10_CM 0. 8160. DISPLAY_IDENTIFIER C_N_32_MAX_DIAG_CRK_TOOTH FORMAT "%4.0" /end CHARACTERISTIC
/begin CHARACTERISTIC c_abc_inc_diag_crk_tooth_per "Anti-bounce counter increment for crankshaft  tooth period diagnosis" VALUE 0xa0802593 _REC_VAL_20_u1 255. _CNV_A_R_LINEAR_____0_CM 0. 255. DISPLAY_IDENTIFIER C_ABC_INC_DIAG_CRK_TOOTH_PER FORMAT "%3.0" /end CHARACTERISTIC
/begin CHARACTERISTIC c_abc_inc_diag_crk_tooth "Anti-bounce counter increment for crankshaft tooth number diagnosis" VALUE 0xa0802592 _REC_VAL_20_u1 255. _CNV_A_R_LINEAR_____0_CM 0. 255. DISPLAY_IDENTIFIER C_ABC_INC_DIAG_CRK_TOOTH FORMAT "%3.0" /end CHARACTERISTIC
/begin CHARACTERISTIC c_abc_max_diag_crk_tooth "Anti-bounce counter maximum for crankshaft tooth number diagnosis" VALUE 0xa0802596 _REC_VAL_20_u1 254. _CNV_A_R_LINEAR_____0_CM 1. 255. DISPLAY_IDENTIFIER C_ABC_MAX_DIAG_CRK_TOOTH FORMAT "%3.0" /end CHARACTERISTIC
/begin CHARACTERISTIC c_abc_max_diag_crk_tooth_per "Anti-bounce counter maximum for crankshaft tooth period diagnosis " VALUE 0xa0802597 _REC_VAL_20_u1 254. _CNV_A_R_LINEAR_____0_CM 1. 255. DISPLAY_IDENTIFIER C_ABC_MAX_DIAG_CRK_TOOTH_PER FORMAT "%3.0" /end CHARACTERISTIC
/begin CHARACTERISTIC c_abc_max_diag_crk_syn "Anti-bounce counter maximum for crankshaft sensor diagnosis with loss of synchronization" VALUE 0xa0802595 _REC_VAL_20_u1 254. _CNV_A_R_LINEAR_____0_CM 1. 255. DISPLAY_IDENTIFIER C_ABC_MAX_DIAG_CRK_SYN FORMAT "%3.0" /end CHARACTERISTIC
/begin CHARACTERISTIC c_abc_inc_diag_crk_syn "Anti-bounce counter increment for crankshaft sensor diagnosis with loss of synchronization" VALUE 0xa0802591 _REC_VAL_20_u1 255. _CNV_A_R_LINEAR_____0_CM 0. 255. DISPLAY_IDENTIFIER C_ABC_INC_DIAG_CRK_SYN FORMAT "%3.0" /end CHARACTERISTIC
/begin CHARACTERISTIC c_abc_inc_diag_crk_oc "Anti-bounce counter increment for crankshaft sensor circuit diagnosis" VALUE 0xa0802590 _REC_VAL_20_u1 255. _CNV_A_R_LINEAR_____0_CM 0. 255. DISPLAY_IDENTIFIER C_ABC_INC_DIAG_CRK_OC FORMAT "%3.0" /end CHARACTERISTIC
/begin CHARACTERISTIC c_abc_max_diag_crk_oc "Anti-bounce counter maximum for crankshaft sensor circuit diagnosis" VALUE 0xa0802594 _REC_VAL_20_u1 254. _CNV_A_R_LINEAR_____0_CM 1. 255. DISPLAY_IDENTIFIER C_ABC_MAX_DIAG_CRK_OC FORMAT "%3.0" /end CHARACTERISTIC
/begin MEASUREMENT lv_inh_diag_ext_crk_tooth "Inhibition condition for the crankshaft sensor diagnosis with tooth number error" UBYTE _CNV_S_2_RANGE__0___1_CM 1 100. 0. 1. DISPLAY_IDENTIFIER LV_INH_DIAG_EXT_CRK_TOOTH ECU_ADDRESS 0xd00074dd BIT_MASK 0x1 /end MEASUREMENT
/begin MEASUREMENT lv_inh_diag_ext_crk_tooth_per "Inhibition condition for the crankshaft sensor diagnosis with implausible tooth period" UBYTE _CNV_S_2_RANGE__0___1_CM 1 100. 0. 1. DISPLAY_IDENTIFIER LV_INH_DIAG_EXT_CRK_TOOTH_PER ECU_ADDRESS 0xd00074de BIT_MASK 0x1 /end MEASUREMENT
/begin MEASUREMENT lv_inh_diag_ext_crk_syn "Inhibition condition for the crankshaft sensor diagnosis with loss of synchronization" UBYTE _CNV_S_2_RANGE__0___1_CM 1 100. 0. 1. DISPLAY_IDENTIFIER LV_INH_DIAG_EXT_CRK_SYN ECU_ADDRESS 0xd00074dc BIT_MASK 0x1 /end MEASUREMENT
/begin MEASUREMENT lv_inh_diag_ext_crk_oc "Inhibition condition for the crankshaft sensor circuit diagnosis" UBYTE _CNV_S_2_RANGE__0___1_CM 1 100. 0. 1. DISPLAY_IDENTIFIER LV_INH_DIAG_EXT_CRK_OC ECU_ADDRESS 0xd00074da BIT_MASK 0x1 /end MEASUREMENT
/begin MEASUREMENT lv_inh_diag_ext_crk_plaus "Inhibition condition for the diagnosis of crankshaft sensor" UBYTE _CNV_S_2_RANGE__0___1_CM 1 100. 0. 1. DISPLAY_IDENTIFIER LV_INH_DIAG_EXT_CRK_PLAUS ECU_ADDRESS 0xd00074db BIT_MASK 0x1 /end MEASUREMENT
/begin CHARACTERISTIC lc_cam_swi_conf "Logical switch to select 3-tooth or 4-tooth configuration of CAM disk" VALUE 0xa08025b3 _REC_VAL_20_u1 1. _CNV_A_R_LINEAR_____0_CM 0. 1. DISPLAY_IDENTIFIER LC_CAM_SWI_CONF FORMAT "%1.0" /end CHARACTERISTIC
/begin MEASUREMENT lv_cam_lih_ext_ena "" UBYTE _CNV_S_2_RANGE__0___1_CM 1 100. 0. 1. DISPLAY_IDENTIFIER LV_CAM_LIH_EXT_ENA ECU_ADDRESS 0xd00074c5 BIT_MASK 0x1 /end MEASUREMENT
/begin MEASUREMENT lv_seg_nr_upd_req "" UBYTE _CNV_S_2_RANGE__0___1_CM 1 100. 0. 1. DISPLAY_IDENTIFIER LV_SEG_NR_UPD_REQ ECU_ADDRESS 0xd00074e5 BIT_MASK 0x1 /end MEASUREMENT
/begin MEASUREMENT lv_syn_vld_cam_lih "" UBYTE _CNV_S_2_RANGE__0___1_CM 1 100. 0. 1. DISPLAY_IDENTIFIER LV_SYN_VLD_CAM_LIH ECU_ADDRESS 0xd00074e9 BIT_MASK 0x1 /end MEASUREMENT
/begin MEASUREMENT tco_cmn "coolant temperature ( ENSD internal )" UBYTE _CNV_A_R_ENSD_LINEA_399_CM 1 100. -50. 205. DISPLAY_IDENTIFIER TCO_CMN ECU_ADDRESS 0xd00074bf FORMAT "%3.0" /end MEASUREMENT
/begin MEASUREMENT vb_cmn "Battery voltage ( ENSD internal )" UBYTE _CNV_A_R_ENSD_LINEA_400_CM 1 100. 0. 28.8 DISPLAY_IDENTIFIER VB_CMN ECU_ADDRESS 0xd00074c0 FORMAT "%5.3" /end MEASUREMENT
/begin MEASUREMENT lv_puc_det_mis "Fuel Cut-Off dedicated to misfire detection, including a delay time for fuel reactivation" UBYTE _CNV_S_2_RANGE__0___1_CM 1 100. 0. 1. DISPLAY_IDENTIFIER LV_PUC_DET_MIS ECU_ADDRESS 0xd00076ee BIT_MASK 0x1 /end MEASUREMENT
/begin AXIS_PTS ldp_tco_ip_fac_thd_tco_er "" 0xa0806e8c tco _REC_AXS_20_u1 190.5 _CNV_A_R_LINEAR_____17_CM 8 -48. 142.5 FORMAT "%6.2" /end AXIS_PTS
/begin AXIS_PTS ldp_n_32_ip_fac_thd_iv_er "" 0xa0806e0a n_32 _REC_AXS_20_u1 8160. _CNV_A_R_LINEAR_____10_CM 6 0. 8160. FORMAT "%4.0" /end AXIS_PTS
/begin AXIS_PTS ldp_n_32_ip_fac_thd_iv_s_er "" 0xa080727e n_32 _REC_AXS_20_u1 8160. _CNV_A_R_LINEAR_____10_CM 6 0. 8160. FORMAT "%4.0" /end AXIS_PTS
/begin MEASUREMENT mis_state_er "Status carrier byte of actual detected misfire through engine roughness index - 1 bit / cylinder." UWORD _CNV_A_R_LINEAR_____0_CM 1 100. 0. 4095. DISPLAY_IDENTIFIER MIS_STATE_ER ECU_ADDRESS 0xd00035aa FORMAT "%5.0" /end MEASUREMENT
/begin MEASUREMENT lv_det_mis "Single misfire detected and confirmed (after general fade out test)" UBYTE _CNV_S_2_RANGE__0___1_CM 1 100. 0. 1. DISPLAY_IDENTIFIER LV_DET_MIS ECU_ADDRESS 0xd00076d5 BIT_MASK 0x1 /end MEASUREMENT
/begin CHARACTERISTIC lc_mis_inh "Global switch to disable all misfire monitoring related modules (Inhibition with = 1)" VALUE 0xa0807145 _REC_VAL_20_u1 1. _CNV_S_2_RANGE__0___1_CM 0. 1. DISPLAY_IDENTIFIER LC_MIS_INH BIT_MASK 0x1 /end CHARACTERISTIC
/begin MEASUREMENT thd_er "Misfire detection threshold for current ER value" SWORD _CNV_A_R_LINEAR_____410_CM 1 100. -32768. 32767. DISPLAY_IDENTIFIER THD_ER ECU_ADDRESS 0xd000717c FORMAT "%6.0" /end MEASUREMENT
/begin MEASUREMENT thd_er_cyl[0] "Cylinder Misfire detection threshold for current ER value" SWORD _CNV_A_R_LINEAR_____410_CM 1 100. -32768. 32767. DISPLAY_IDENTIFIER THD_ER_CYL[0] ECU_ADDRESS 0xd000718c FORMAT "%6.0" /end MEASUREMENT
/begin MEASUREMENT thd_er_cyl[1] "Cylinder Misfire detection threshold for current ER value" SWORD _CNV_A_R_LINEAR_____410_CM 1 100. -32768. 32767. DISPLAY_IDENTIFIER THD_ER_CYL[1] ECU_ADDRESS 0xd000718e FORMAT "%6.0" /end MEASUREMENT
/begin MEASUREMENT thd_er_cyl[2] "Cylinder Misfire detection threshold for current ER value" SWORD _CNV_A_R_LINEAR_____410_CM 1 100. -32768. 32767. DISPLAY_IDENTIFIER THD_ER_CYL[2] ECU_ADDRESS 0xd0007190 FORMAT "%6.0" /end MEASUREMENT
/begin MEASUREMENT thd_er_cyl[3] "Cylinder Misfire detection threshold for current ER value" SWORD _CNV_A_R_LINEAR_____410_CM 1 100. -32768. 32767. DISPLAY_IDENTIFIER THD_ER_CYL[3] ECU_ADDRESS 0xd0007192 FORMAT "%6.0" /end MEASUREMENT
/begin MEASUREMENT thd_er_cyl[4] "Cylinder Misfire detection threshold for current ER value" SWORD _CNV_A_R_LINEAR_____410_CM 1 100. -32768. 32767. DISPLAY_IDENTIFIER THD_ER_CYL[4] ECU_ADDRESS 0xd0007194 FORMAT "%6.0" /end MEASUREMENT
/begin MEASUREMENT thd_er_cyl[5] "Cylinder Misfire detection threshold for current ER value" SWORD _CNV_A_R_LINEAR_____410_CM 1 100. -32768. 32767. DISPLAY_IDENTIFIER THD_ER_CYL[5] ECU_ADDRESS 0xd0007196 FORMAT "%6.0" /end MEASUREMENT
/begin MEASUREMENT thd_er_cyl[6] "Cylinder Misfire detection threshold for current ER value" SWORD _CNV_A_R_LINEAR_____410_CM 1 100. -32768. 32767. DISPLAY_IDENTIFIER THD_ER_CYL[6] ECU_ADDRESS 0xd0007198 FORMAT "%6.0" /end MEASUREMENT
/begin MEASUREMENT thd_er_cyl[7] "Cylinder Misfire detection threshold for current ER value" SWORD _CNV_A_R_LINEAR_____410_CM 1 100. -32768. 32767. DISPLAY_IDENTIFIER THD_ER_CYL[7] ECU_ADDRESS 0xd000719a FORMAT "%6.0" /end MEASUREMENT
/begin MEASUREMENT lv_det_thd_mis "Single misfire detected based only on threshold criterion (before fade out test)" UBYTE _CNV_S_2_RANGE__0___1_CM 1 100. 0. 1. DISPLAY_IDENTIFIER LV_DET_THD_MIS ECU_ADDRESS 0xd00076d8 BIT_MASK 0x1 /end MEASUREMENT
/begin MEASUREMENT thd_er_buf[0] "Misfire detection threshold stack for ER evaluation" SWORD _CNV_A_R_LINEAR_____410_CM 1 100. -32768. 32767. DISPLAY_IDENTIFIER THD_ER_BUF[0] ECU_ADDRESS 0xd0007180 FORMAT "%6.0" /end MEASUREMENT
/begin MEASUREMENT thd_er_buf[1] "Misfire detection threshold stack for ER evaluation" SWORD _CNV_A_R_LINEAR_____410_CM 1 100. -32768. 32767. DISPLAY_IDENTIFIER THD_ER_BUF[1] ECU_ADDRESS 0xd0007182 FORMAT "%6.0" /end MEASUREMENT
/begin MEASUREMENT thd_er_buf[2] "Misfire detection threshold stack for ER evaluation" SWORD _CNV_A_R_LINEAR_____410_CM 1 100. -32768. 32767. DISPLAY_IDENTIFIER THD_ER_BUF[2] ECU_ADDRESS 0xd0007184 FORMAT "%6.0" /end MEASUREMENT
/begin MEASUREMENT thd_er_buf[3] "Misfire detection threshold stack for ER evaluation" SWORD _CNV_A_R_LINEAR_____410_CM 1 100. -32768. 32767. DISPLAY_IDENTIFIER THD_ER_BUF[3] ECU_ADDRESS 0xd0007186 FORMAT "%6.0" /end MEASUREMENT
/begin MEASUREMENT thd_er_buf[4] "Misfire detection threshold stack for ER evaluation" SWORD _CNV_A_R_LINEAR_____410_CM 1 100. -32768. 32767. DISPLAY_IDENTIFIER THD_ER_BUF[4] ECU_ADDRESS 0xd0007188 FORMAT "%6.0" /end MEASUREMENT
/begin MEASUREMENT thd_er_buf[5] "Misfire detection threshold stack for ER evaluation" SWORD _CNV_A_R_LINEAR_____410_CM 1 100. -32768. 32767. DISPLAY_IDENTIFIER THD_ER_BUF[5] ECU_ADDRESS 0xd000718a FORMAT "%6.0" /end MEASUREMENT
/begin MEASUREMENT lv_inh_det_mis "General misfire detection fade out" UBYTE _CNV_S_2_RANGE__0___1_CM 1 100. 0. 1. DISPLAY_IDENTIFIER LV_INH_DET_MIS ECU_ADDRESS 0xd00076fd BIT_MASK 0x1 /end MEASUREMENT
/begin CHARACTERISTIC ip_fac_thd_tco_er "Temperature-dependent threshold reduction" CURVE 0xa0807014 _REC_CUR_20_u2_u1 1.99609375 _CNV_A_R_LINEAR_____28_CM 0. 1.99609375 DISPLAY_IDENTIFIER IP_FAC_THD_TCO_ER FORMAT "%5.3"
 /begin AXIS_DESCR COM_AXIS tco _CNV_A_R_LINEAR_____17_CM 8 -48. 142.5 FORMAT "%6.2" AXIS_PTS_REF ldp_tco_ip_fac_thd_tco_er /end AXIS_DESCR
/end CHARACTERISTIC
/begin CHARACTERISTIC ip_fac_thd_iv_er "Factor for adaptation of the threshold in case of active cylinder cut-off" CURVE 0xa0807008 _REC_CUR_20_u2_u1 0.9999847412109381 _CNV_A_R_LINEAR_____89_CM 0. 0.9999847412109381 DISPLAY_IDENTIFIER IP_FAC_THD_IV_ER FORMAT "%7.5"
 /begin AXIS_DESCR COM_AXIS n_32 _CNV_A_R_LINEAR_____10_CM 6 0. 8160. FORMAT "%4.0" AXIS_PTS_REF ldp_n_32_ip_fac_thd_iv_er /end AXIS_DESCR
/end CHARACTERISTIC
/begin CHARACTERISTIC ip_fac_thd_iv_s_er "Factor for adaptation of the threshold in case of active cylinder cut-off in stratified combustion mode" CURVE 0xa08072ec _REC_CUR_20_u2_u1 0.9999847412109381 _CNV_A_R_LINEAR_____89_CM 0. 0.9999847412109381 DISPLAY_IDENTIFIER IP_FAC_THD_IV_S_ER FORMAT "%7.5"
 /begin AXIS_DESCR COM_AXIS n_32 _CNV_A_R_LINEAR_____10_CM 6 0. 8160. FORMAT "%4.0" AXIS_PTS_REF ldp_n_32_ip_fac_thd_iv_s_er /end AXIS_DESCR
/end CHARACTERISTIC
/begin MEASUREMENT mis_det_cyl_inh "Cylinder misfiring detection inhibition carrier byte when a fade out condition occurred (after masking & delay)" UWORD _CNV_A_R_LINEAR_____0_CM 1 100. 0. 4095. DISPLAY_IDENTIFIER MIS_DET_CYL_INH ECU_ADDRESS 0xd00035a8 FORMAT "%5.0" /end MEASUREMENT
/begin MEASUREMENT fac_thd_er "Global gain multiplicative correction applied to basic misfire detection thresholds" UWORD _CNV_A_R_LINEAR_____28_CM 1 100. 0. 4. DISPLAY_IDENTIFIER FAC_THD_ER ECU_ADDRESS 0xd00070f2 FORMAT "%10.6" /end MEASUREMENT
/begin MEASUREMENT ctr_tot_mis "Overall misfire detection counter" ULONG _CNV_A_R_LINEAR_____50_CM 1 100. 0. 4294967295. DISPLAY_IDENTIFIER CTR_TOT_MIS ECU_ADDRESS 0xd00070ea FORMAT "%11.0" /end MEASUREMENT
/begin MEASUREMENT fac_thd_app_er "Misfire detection threshold correction gain specific to application" UWORD _CNV_A_R_LINEAR_____28_CM 1 100. 0. 1.99609375 DISPLAY_IDENTIFIER FAC_THD_APP_ER ECU_ADDRESS 0xd00070f0 FORMAT "%5.3" /end MEASUREMENT
/begin MEASUREMENT lv_ftl_l_diag_mis "Request to allow error management of misfire occurence with low fuel tank level" UBYTE _CNV_S_2_RANGE__0___1_CM 1 100. 0. 1. DISPLAY_IDENTIFIER LV_FTL_L_DIAG_MIS ECU_ADDRESS 0xd00076e1 BIT_MASK 0x1 /end MEASUREMENT
/begin MEASUREMENT lv_inh_crk_osc_det "Crankshaft oscillation detection fade out" UBYTE _CNV_S_2_RANGE__0___1_CM 1 100. 0. 1. DISPLAY_IDENTIFIER LV_INH_CRK_OSC_DET ECU_ADDRESS 0xd00076e5 BIT_MASK 0x1 /end MEASUREMENT
/begin MEASUREMENT lv_inh_obd_det_mis "OBD I misfire detection process inhibition flag" UBYTE _CNV_S_2_RANGE__0___1_CM 1 100. 0. 1. DISPLAY_IDENTIFIER LV_INH_OBD_DET_MIS ECU_ADDRESS 0xd00076e9 BIT_MASK 0x1 /end MEASUREMENT
/begin CHARACTERISTIC lc_ftl_l_det_mis "Global switch to disable all misfire monitoring related modules (Inhibition with = 1)" VALUE 0xa0807143 _REC_VAL_20_u1 1. _CNV_S_2_RANGE__0___1_CM 0. 1. DISPLAY_IDENTIFIER LC_FTL_L_DET_MIS BIT_MASK 0x1 /end CHARACTERISTIC
/begin CHARACTERISTIC lc_ftl_l_diag_mis "Enable error management of misfire with low fuel tank level" VALUE 0xa0807144 _REC_VAL_20_u1 1. _CNV_S_2_RANGE__0___1_CM 0. 1. DISPLAY_IDENTIFIER LC_FTL_L_DIAG_MIS BIT_MASK 0x1 /end CHARACTERISTIC
/begin MEASUREMENT lv_inh_app_det_mis "Misfire detection process inhibition flag (application specific)." UBYTE _CNV_S_2_RANGE__0___1_CM 1 100. 0. 1. DISPLAY_IDENTIFIER LV_INH_APP_DET_MIS ECU_ADDRESS 0xd00076e3 BIT_MASK 0x1 /end MEASUREMENT
/begin MEASUREMENT lv_inh_ftl_l_det_mis "Misfire detection inhibition flag in case of low fuel tank level" UBYTE _CNV_S_2_RANGE__0___1_CM 1 100. 0. 1. DISPLAY_IDENTIFIER LV_INH_FTL_L_DET_MIS ECU_ADDRESS 0xd00076e6 BIT_MASK 0x1 /end MEASUREMENT
/begin MEASUREMENT lv_inh_app_rr "Rough Road detection Appli Inci fade out" UBYTE _CNV_S_2_RANGE__0___1_CM 1 100. 0. 1. DISPLAY_IDENTIFIER LV_INH_APP_RR ECU_ADDRESS 0xd00076e4 BIT_MASK 0x1 /end MEASUREMENT
/begin CHARACTERISTIC c_n_thd_mis_inh "Global condition for inhibiting (deactivation) of all misfire modules" VALUE 0xa0807108 _REC_VAL_20_u1 8160. _CNV_A_R_LINEAR_____10_CM 0. 8160. DISPLAY_IDENTIFIER C_N_THD_MIS_INH FORMAT "%4.0" /end CHARACTERISTIC
/begin CHARACTERISTIC c_t_amt_gs_dly_mis "Fade out duration when gearshift of AMT has been detected" VALUE 0xa080711c _REC_VAL_20_u2 655.35 _CNV_A_R_LINEAR_____3_CM 0. 655.35 DISPLAY_IDENTIFIER C_T_AMT_GS_DLY_MIS FORMAT "%5.2" /end CHARACTERISTIC
/begin CHARACTERISTIC ip_fac_thd_er_ch "Threshold correction depending on torque reserve at catalyst heating" CURVE 0xa0807000 _REC_CUR_20_u2_u2 1.99609375 _CNV_A_R_LINEAR_____28_CM 0. 1.99609375 DISPLAY_IDENTIFIER IP_FAC_THD_ER_CH FORMAT "%5.3"
 /begin AXIS_DESCR COM_AXIS tq_add_ch _CNV_A_R_LINEAR_____87_CM 4 -1024. 1023.96875 FORMAT "%11.5" AXIS_PTS_REF ldp_tq_add_ch_fac_thd_er_ch /end AXIS_DESCR
/end CHARACTERISTIC
/begin AXIS_PTS ldp_tq_add_ch_fac_thd_er_ch "" 0xa0806ed0 tq_add_ch _REC_AXS_20_u2 2047.96875 _CNV_A_R_LINEAR_____87_CM 4 -1024. 1023.96875 FORMAT "%11.5" /end AXIS_PTS
/begin CHARACTERISTIC lc_use_ivvt_inh_mis "Enable IVVT diagnosis for inhibition of misfire detection" VALUE 0xa0807148 _REC_VAL_20_u1 1. _CNV_S_2_RANGE__0___1_CM 0. 1. DISPLAY_IDENTIFIER LC_USE_IVVT_INH_MIS BIT_MASK 0x1 /end CHARACTERISTIC
/begin MEASUREMENT fac_gain_load_mis "Correction gain of the normalised engine load for misifre, specific to application" UWORD _CNV_A_R_LINEAR_____28_CM 1 100. 0. 1.99609375 DISPLAY_IDENTIFIER FAC_GAIN_LOAD_MIS ECU_ADDRESS 0xd00070ee FORMAT "%5.3" /end MEASUREMENT
/begin CHARACTERISTIC ip_thd_afs_er_is_mt "ER threshold for misfire detection in AFS combustion mode &  in idle speed, MT vehicle" MAP 0xa0807604 _REC_MAP_20_u2_u2_u2 65535. _CNV_A_R_LINEAR_____411_CM -32768. 32767. DISPLAY_IDENTIFIER IP_THD_AFS_ER_IS_MT FORMAT "%6.0"
 /begin AXIS_DESCR COM_AXIS n _CNV_A_R_LINEAR_____14_CM 4 0. 8160. FORMAT "%4.0" AXIS_PTS_REF ldp_n_ip_thd_afs_er_is_mt /end AXIS_DESCR
 /begin AXIS_DESCR COM_AXIS load_mis _CNV_A_R_LINEAR_____212_CM 6 0. 99.9969482421875 FORMAT "%7.3" AXIS_PTS_REF ldp_load_ip_thd_afs_er_is_mt /end AXIS_DESCR
/end CHARACTERISTIC
/begin CHARACTERISTIC ip_thd_afs_er_mt "ER threshold for misfire detection in AFS, MT vehicle transmission type" MAP 0xa08129cc _REC_MAP_20_u2_u2_u2 65535. _CNV_A_R_LINEAR_____411_CM -32768. 32767. DISPLAY_IDENTIFIER IP_THD_AFS_ER_MT FORMAT "%6.0"
 /begin AXIS_DESCR COM_AXIS n _CNV_A_R_LINEAR_____14_CM 12 0. 8160. FORMAT "%4.0" AXIS_PTS_REF ldp_n_ip_thd_afs_er_mt /end AXIS_DESCR
 /begin AXIS_DESCR COM_AXIS load_mis _CNV_A_R_LINEAR_____212_CM 8 0. 99.9969482421875 FORMAT "%7.3" AXIS_PTS_REF ldp_load_mis_ip_thd_afs_er_mt /end AXIS_DESCR
/end CHARACTERISTIC
/begin CHARACTERISTIC ip_thd_hom_s_er_mt "ER threshold for misfire detection in HOM_S mode, MT vehicle transmission type" MAP 0xa0812bd0 _REC_MAP_20_u2_u2_u2 65535. _CNV_A_R_LINEAR_____411_CM -32768. 32767. DISPLAY_IDENTIFIER IP_THD_HOM_S_ER_MT FORMAT "%6.0"
 /begin AXIS_DESCR COM_AXIS n _CNV_A_R_LINEAR_____14_CM 9 0. 8160. FORMAT "%4.0" AXIS_PTS_REF ldp_n_ip_thd_hom_s_er_mt /end AXIS_DESCR
 /begin AXIS_DESCR COM_AXIS load_mis _CNV_A_R_LINEAR_____212_CM 6 0. 99.9969482421875 FORMAT "%7.3" AXIS_PTS_REF ldp_load_mis_ip_thd_hom_s_er_mt /end AXIS_DESCR
/end CHARACTERISTIC
/begin CHARACTERISTIC ip_thd_s_er_mt "ER threshold for misfire detection in S mode, MT vehicle transmission type" MAP 0xa0812d80 _REC_MAP_20_u2_u2_u2 65535. _CNV_A_R_LINEAR_____411_CM -32768. 32767. DISPLAY_IDENTIFIER IP_THD_S_ER_MT FORMAT "%6.0"
 /begin AXIS_DESCR COM_AXIS n _CNV_A_R_LINEAR_____14_CM 9 0. 8160. FORMAT "%4.0" AXIS_PTS_REF ldp_n_ip_thd_s_er_mt /end AXIS_DESCR
 /begin AXIS_DESCR COM_AXIS load_mis _CNV_A_R_LINEAR_____212_CM 6 0. 99.9969482421875 FORMAT "%7.3" AXIS_PTS_REF ldp_load_mis_ip_thd_s_er_mt /end AXIS_DESCR
/end CHARACTERISTIC
/begin AXIS_PTS ldp_load_ip_thd_afs_er_is_mt "" 0xa080749c load_mis _REC_AXS_20_u2 99.9969482421875 _CNV_A_R_LINEAR_____212_CM 6 0. 99.9969482421875 FORMAT "%7.3" /end AXIS_PTS
/begin AXIS_PTS ldp_n_ip_thd_afs_er_mt "" 0xa0807558 n _REC_AXS_20_u2 8160. _CNV_A_R_LINEAR_____14_CM 12 0. 8160. FORMAT "%4.0" /end AXIS_PTS
/begin AXIS_PTS ldp_load_mis_ip_thd_afs_er_mt "" 0xa08074c0 load_mis _REC_AXS_20_u2 99.9969482421875 _CNV_A_R_LINEAR_____212_CM 8 0. 99.9969482421875 FORMAT "%7.3" /end AXIS_PTS
/begin AXIS_PTS ldp_n_ip_thd_afs_er_is_mt "" 0xa080754c n _REC_AXS_20_u2 8160. _CNV_A_R_LINEAR_____14_CM 4 0. 8160. FORMAT "%4.0" /end AXIS_PTS
/begin MEASUREMENT thd_er_clc "Value of the table used for misfire detection threshold at current segment" SWORD _CNV_A_R_LINEAR_____0_CM 1 100. -32768. 32767. DISPLAY_IDENTIFIER THD_ER_CLC ECU_ADDRESS 0xd00076b0 FORMAT "%6.0" /end MEASUREMENT
/begin MEASUREMENT thd_er_clc_prev "Previous value of the table used for misfire detection threshold at current segment" SWORD _CNV_A_R_LINEAR_____0_CM 1 100. -32768. 32767. DISPLAY_IDENTIFIER THD_ER_CLC_PREV ECU_ADDRESS 0xd00035ae FORMAT "%6.0" /end MEASUREMENT
/begin MEASUREMENT load_min_mis "Normalised engine \"zero\" load for misfire detection" UWORD _CNV_A_R_LINEAR_____212_CM 1 100. 0. 99.9969482421875 DISPLAY_IDENTIFIER LOAD_MIN_MIS ECU_ADDRESS 0xd00070f6 FORMAT "%7.3" /end MEASUREMENT
/begin AXIS_PTS ldp_load_mis_ip_thd_hom_s_er_mt "" 0xa08076a4 load_mis _REC_AXS_20_u2 99.9969482421875 _CNV_A_R_LINEAR_____212_CM 6 0. 99.9969482421875 FORMAT "%7.3" /end AXIS_PTS
/begin AXIS_PTS ldp_load_mis_ip_thd_s_er_mt "" 0xa0807874 load_mis _REC_AXS_20_u2 99.9969482421875 _CNV_A_R_LINEAR_____212_CM 6 0. 99.9969482421875 FORMAT "%7.3" /end AXIS_PTS
/begin AXIS_PTS ldp_n_ip_thd_hom_s_er_mt "" 0xa0807720 n _REC_AXS_20_u2 8160. _CNV_A_R_LINEAR_____14_CM 9 0. 8160. FORMAT "%4.0" /end AXIS_PTS
/begin AXIS_PTS ldp_n_ip_thd_s_er_mt "" 0xa08078f0 n _REC_AXS_20_u2 8160. _CNV_A_R_LINEAR_____14_CM 9 0. 8160. FORMAT "%4.0" /end AXIS_PTS
/begin CHARACTERISTIC c_n_32_max_is_mis "Maximum engine speed to apply specific ER detection threshold in idle speed" VALUE 0xa08070fa _REC_VAL_20_u1 8160. _CNV_A_R_LINEAR_____10_CM 0. 8160. DISPLAY_IDENTIFIER C_N_32_MAX_IS_MIS FORMAT "%4.0" /end CHARACTERISTIC
/begin CHARACTERISTIC c_thd_er_clc_grd "Gradient to limit the misfire detection threshold THD_ER_CLC in positive direction" VALUE 0xa0807132 _REC_VAL_20_u2 32767. _CNV_A_R_LINEAR_____0_CM 0. 32767. DISPLAY_IDENTIFIER C_THD_ER_CLC_GRD FORMAT "%5.0" /end CHARACTERISTIC
/begin MEASUREMENT iga_bas_cor_mv "Mean value of the corrected basic ignition angles" UBYTE _CNV_A_R_LINEAR_____190_CM 1 100. -35.625 60. DISPLAY_IDENTIFIER IGA_BAS_COR_MV ECU_ADDRESS 0xd000769b FORMAT "%7.3" /end MEASUREMENT
/begin CHARACTERISTIC ip_load_min_mis_afs_at "Zero load curve vs engine speed and coolant temperature in AFS combustion mode, with AT vehicle transmission type" MAP 0xa0812334 _REC_MAP_20_u2_u2_u1 99.9969482421875 _CNV_A_R_LINEAR_____212_CM 0. 99.9969482421875 DISPLAY_IDENTIFIER IP_LOAD_MIN_MIS_AFS_AT FORMAT "%7.3"
 /begin AXIS_DESCR COM_AXIS n _CNV_A_R_LINEAR_____14_CM 8 0. 8160. FORMAT "%4.0" AXIS_PTS_REF ldp_n_ip_load_min_mis_afs_at /end AXIS_DESCR
 /begin AXIS_DESCR COM_AXIS tco _CNV_A_R_LINEAR_____17_CM 6 -48. 142.5 FORMAT "%6.2" AXIS_PTS_REF ldp_tco_ip_load_min_mis_afs_at /end AXIS_DESCR
/end CHARACTERISTIC
/begin AXIS_PTS ldp_tco_ip_load_min_mis_afs_at "" 0xa0806e96 tco _REC_AXS_20_u1 190.5 _CNV_A_R_LINEAR_____17_CM 6 -48. 142.5 FORMAT "%6.2" /end AXIS_PTS
/begin AXIS_PTS ldp_n_ip_load_min_mis_afs_at "" 0xa0806e60 n _REC_AXS_20_u2 8160. _CNV_A_R_LINEAR_____14_CM 8 0. 8160. FORMAT "%4.0" /end AXIS_PTS
/begin CHARACTERISTIC ip_load_min_mis_afs_mt "Zero load curve vs engine speed and coolant temperature in AFS combustion mode, with MT" MAP 0xa0812394 _REC_MAP_20_u2_u2_u1 99.9969482421875 _CNV_A_R_LINEAR_____212_CM 0. 99.9969482421875 DISPLAY_IDENTIFIER IP_LOAD_MIN_MIS_AFS_MT FORMAT "%7.3"
 /begin AXIS_DESCR COM_AXIS n _CNV_A_R_LINEAR_____14_CM 8 0. 8160. FORMAT "%4.0" AXIS_PTS_REF ldp_n_ip_load_min_mis_afs_mt /end AXIS_DESCR
 /begin AXIS_DESCR COM_AXIS tco _CNV_A_R_LINEAR_____17_CM 6 -48. 142.5 FORMAT "%6.2" AXIS_PTS_REF ldp_tco_ip_load_min_mis_afs_mt /end AXIS_DESCR
/end CHARACTERISTIC
/begin AXIS_PTS ldp_tco_ip_load_min_mis_afs_mt "" 0xa0806e9e tco _REC_AXS_20_u1 190.5 _CNV_A_R_LINEAR_____17_CM 6 -48. 142.5 FORMAT "%6.2" /end AXIS_PTS
/begin AXIS_PTS ldp_n_ip_load_min_mis_afs_mt "" 0xa0806e74 n _REC_AXS_20_u2 8160. _CNV_A_R_LINEAR_____14_CM 8 0. 8160. FORMAT "%4.0" /end AXIS_PTS
/begin CHARACTERISTIC ip_load_grd_mis_er_mv "Maximum LOAD_MIS gradient for transition" CURVE 0xa08071a0 _REC_CUR_20_u2_u2 99.9969482421875 _CNV_A_R_LINEAR_____212_CM 0. 99.9969482421875 DISPLAY_IDENTIFIER IP_LOAD_GRD_MIS_ER_MV FORMAT "%7.3"
 /begin AXIS_DESCR COM_AXIS load_mis _CNV_A_R_LINEAR_____212_CM 3 0. 99.9969482421875 AXIS_PTS_REF ldp_load_ip_load_grd_mis_er_mv /end AXIS_DESCR
/end CHARACTERISTIC
/begin CHARACTERISTIC ip_load_min_ofs_amp_mis_afs_at "Extra load from zero load curve vs engine speed and atmospheric pressure in AFS with AT vehicle" MAP 0xa08123f4 _REC_MAP_20_u2_u2_u2 99.99694800000002 _CNV_A_R_MISF_LINEA_412_CM -50. 49.996948 DISPLAY_IDENTIFIER IP_LOAD_MIN_OFS_AMP_MIS_AFS_AT FORMAT "%7.3"
 /begin AXIS_DESCR COM_AXIS n _CNV_A_R_LINEAR_____14_CM 8 0. 8160. FORMAT "%4.0" AXIS_PTS_REF ldp_n_ip_load_amp_mis_afs_at /end AXIS_DESCR
 /begin AXIS_DESCR COM_AXIS amp _CNV_A_R_LINEAR_____27_CM 7 0. 5434. FORMAT "%7.2" AXIS_PTS_REF ldp_amp_ip_load_amp_mis_afs_at /end AXIS_DESCR
/end CHARACTERISTIC
/begin AXIS_PTS ldp_n_ip_load_amp_mis_afs_at "" 0xa0806e38 n _REC_AXS_20_u2 8160. _CNV_A_R_LINEAR_____14_CM 8 0. 8160. FORMAT "%4.0" /end AXIS_PTS
/begin AXIS_PTS ldp_amp_ip_load_amp_mis_afs_at "" 0xa0806d10 amp _REC_AXS_20_u2 5434. _CNV_A_R_LINEAR_____27_CM 7 0. 5434. FORMAT "%7.2" /end AXIS_PTS
/begin CHARACTERISTIC ip_load_min_ofs_amp_mis_afs_mt "Extra load from zero load curve vs engine speed and atmospheric pressure in AFS with MT vehicle" MAP 0xa0812464 _REC_MAP_20_u2_u2_u2 99.99694800000002 _CNV_A_R_MISF_LINEA_412_CM -50. 49.996948 DISPLAY_IDENTIFIER IP_LOAD_MIN_OFS_AMP_MIS_AFS_MT FORMAT "%7.3"
 /begin AXIS_DESCR COM_AXIS n _CNV_A_R_LINEAR_____14_CM 8 0. 8160. FORMAT "%4.0" AXIS_PTS_REF ldp_n_ip_load_amp_mis_afs_mt /end AXIS_DESCR
 /begin AXIS_DESCR COM_AXIS amp _CNV_A_R_LINEAR_____27_CM 7 0. 5434. FORMAT "%7.2" AXIS_PTS_REF ldp_amp_ip_load_amp_mis_afs_mt /end AXIS_DESCR
/end CHARACTERISTIC
/begin AXIS_PTS ldp_amp_ip_load_amp_mis_afs_mt "" 0xa0806d20 amp _REC_AXS_20_u2 5434. _CNV_A_R_LINEAR_____27_CM 7 0. 5434. FORMAT "%7.2" /end AXIS_PTS
/begin AXIS_PTS ldp_n_ip_load_amp_mis_afs_mt "" 0xa0806e4c n _REC_AXS_20_u2 8160. _CNV_A_R_LINEAR_____14_CM 8 0. 8160. FORMAT "%4.0" /end AXIS_PTS
/begin CHARACTERISTIC ip_load_min_mis_hom_s_at "Zero load curve vs engine speed and coolant temperature in HOM_S combustion mode, with AT vehicle transmission type" MAP 0xa081260c _REC_MAP_20_u2_u1_u1 99.9969482421875 _CNV_A_R_LINEAR_____212_CM 0. 99.9969482421875 DISPLAY_IDENTIFIER IP_LOAD_MIN_MIS_HOM_S_AT FORMAT "%7.3"
 /begin AXIS_DESCR COM_AXIS n_32 _CNV_A_R_LINEAR_____10_CM 6 0. 8160. FORMAT "%4.0" AXIS_PTS_REF ldp_n_32_ip_load_min_mis_hom_s_at /end AXIS_DESCR
 /begin AXIS_DESCR COM_AXIS tco _CNV_A_R_LINEAR_____17_CM 6 -48. 142.5 FORMAT "%6.2" AXIS_PTS_REF ldp_tco_ip_load_min_mis_hom_s_at /end AXIS_DESCR
/end CHARACTERISTIC
/begin AXIS_PTS ldp_n_32_ip_load_min_mis_hom_s_at "" 0xa080738e n_32 _REC_AXS_20_u1 8160. _CNV_A_R_LINEAR_____10_CM 6 0. 8160. FORMAT "%4.0" /end AXIS_PTS
/begin AXIS_PTS ldp_tco_ip_load_min_mis_hom_s_at "" 0xa08073ae tco _REC_AXS_20_u1 190.5 _CNV_A_R_LINEAR_____17_CM 6 -48. 142.5 FORMAT "%6.2" /end AXIS_PTS
/begin CHARACTERISTIC ip_load_min_mis_hom_s_mt "Zero load curve vs engine speed and coolant temperature in HOM_S combustion mode, with MT vehicle transmission type" MAP 0xa0812654 _REC_MAP_20_u2_u1_u1 99.9969482421875 _CNV_A_R_LINEAR_____212_CM 0. 99.9969482421875 DISPLAY_IDENTIFIER IP_LOAD_MIN_MIS_HOM_S_MT FORMAT "%7.3"
 /begin AXIS_DESCR COM_AXIS n_32 _CNV_A_R_LINEAR_____10_CM 6 0. 8160. FORMAT "%4.0" AXIS_PTS_REF ldp_n_32_ip_load_min_mis_hom_s_mt /end AXIS_DESCR
 /begin AXIS_DESCR COM_AXIS tco _CNV_A_R_LINEAR_____17_CM 6 -48. 142.5 FORMAT "%6.2" AXIS_PTS_REF ldp_tco_ip_load_min_mis_hom_s_mt /end AXIS_DESCR
/end CHARACTERISTIC
/begin AXIS_PTS ldp_n_32_ip_load_min_mis_hom_s_mt "" 0xa0807396 n_32 _REC_AXS_20_u1 8160. _CNV_A_R_LINEAR_____10_CM 6 0. 8160. FORMAT "%4.0" /end AXIS_PTS
/begin AXIS_PTS ldp_tco_ip_load_min_mis_hom_s_mt "" 0xa08073b6 tco _REC_AXS_20_u1 190.5 _CNV_A_R_LINEAR_____17_CM 6 -48. 142.5 FORMAT "%6.2" /end AXIS_PTS
/begin AXIS_PTS ldp_n_32_ip_load_amp_mis_hom_s_at "" 0xa080737e n_32 _REC_AXS_20_u1 8160. _CNV_A_R_LINEAR_____10_CM 6 0. 8160. FORMAT "%4.0" /end AXIS_PTS
/begin AXIS_PTS ldp_n_32_ip_load_amp_mis_hom_s_mt "" 0xa0807386 n_32 _REC_AXS_20_u1 8160. _CNV_A_R_LINEAR_____10_CM 6 0. 8160. FORMAT "%4.0" /end AXIS_PTS
/begin AXIS_PTS ldp_amp_ip_load_amp_mis_hom_s_at "" 0xa0807338 amp _REC_AXS_20_u2 5434. _CNV_A_R_LINEAR_____27_CM 7 0. 5434. FORMAT "%7.2" /end AXIS_PTS
/begin AXIS_PTS ldp_amp_ip_load_amp_mis_hom_s_mt "" 0xa0807348 amp _REC_AXS_20_u2 5434. _CNV_A_R_LINEAR_____27_CM 7 0. 5434. FORMAT "%7.2" /end AXIS_PTS
/begin CHARACTERISTIC ip_load_min_mis_s_at "Zero load curve vs engine speed and coolant temperature in S combustion mode, with AT vehicle transmission type" MAP 0xa08124d4 _REC_MAP_20_u2_u1_u1 99.9969482421875 _CNV_A_R_LINEAR_____212_CM 0. 99.9969482421875 DISPLAY_IDENTIFIER IP_LOAD_MIN_MIS_S_AT FORMAT "%7.3"
 /begin AXIS_DESCR COM_AXIS n_32 _CNV_A_R_LINEAR_____10_CM 6 0. 8160. FORMAT "%4.0" AXIS_PTS_REF ldp_n_32_ip_load_min_mis_s_at /end AXIS_DESCR
 /begin AXIS_DESCR COM_AXIS tco _CNV_A_R_LINEAR_____17_CM 6 -48. 142.5 FORMAT "%6.2" AXIS_PTS_REF ldp_tco_ip_load_min_mis_s_at /end AXIS_DESCR
/end CHARACTERISTIC
/begin CHARACTERISTIC ip_load_min_mis_s_mt "Zero load curve vs engine speed and coolant temperature in S combustion mode, with MT vehicle transmission type" MAP 0xa081251c _REC_MAP_20_u2_u1_u1 99.9969482421875 _CNV_A_R_LINEAR_____212_CM 0. 99.9969482421875 DISPLAY_IDENTIFIER IP_LOAD_MIN_MIS_S_MT FORMAT "%7.3"
 /begin AXIS_DESCR COM_AXIS n_32 _CNV_A_R_LINEAR_____10_CM 6 0. 8160. FORMAT "%4.0" AXIS_PTS_REF ldp_n_32_ip_load_min_mis_s_mt /end AXIS_DESCR
 /begin AXIS_DESCR COM_AXIS tco _CNV_A_R_LINEAR_____17_CM 6 -48. 142.5 FORMAT "%6.2" AXIS_PTS_REF ldp_tco_ip_load_min_mis_s_mt /end AXIS_DESCR
/end CHARACTERISTIC
/begin AXIS_PTS ldp_n_32_ip_load_min_mis_s_at "" 0xa0807296 n_32 _REC_AXS_20_u1 8160. _CNV_A_R_LINEAR_____10_CM 6 0. 8160. FORMAT "%4.0" /end AXIS_PTS
/begin AXIS_PTS ldp_n_32_ip_load_min_mis_s_mt "" 0xa080729e n_32 _REC_AXS_20_u1 8160. _CNV_A_R_LINEAR_____10_CM 6 0. 8160. FORMAT "%4.0" /end AXIS_PTS
/begin AXIS_PTS ldp_tco_ip_load_min_mis_s_mt "" 0xa08072be tco _REC_AXS_20_u1 190.5 _CNV_A_R_LINEAR_____17_CM 6 -48. 142.5 FORMAT "%6.2" /end AXIS_PTS
/begin AXIS_PTS ldp_tco_ip_load_min_mis_s_at "" 0xa08072b6 tco _REC_AXS_20_u1 190.5 _CNV_A_R_LINEAR_____17_CM 6 -48. 142.5 FORMAT "%6.2" /end AXIS_PTS
/begin CHARACTERISTIC ip_load_min_ofs_amp_mis_s_mt "Extra load from zero load curve vs engine speed and atmospheric pressure in S with MT vehicle" MAP 0xa08125b8 _REC_MAP_20_u2_u1_u2 99.99694800000002 _CNV_A_R_MISF_LINEA_412_CM -50. 49.996948 DISPLAY_IDENTIFIER IP_LOAD_MIN_OFS_AMP_MIS_S_MT FORMAT "%7.3"
 /begin AXIS_DESCR COM_AXIS n_32 _CNV_A_R_LINEAR_____10_CM 6 0. 8160. FORMAT "%4.0" AXIS_PTS_REF ldp_n_32_ip_load_amp_mis_s_mt /end AXIS_DESCR
 /begin AXIS_DESCR COM_AXIS amp _CNV_A_R_LINEAR_____27_CM 7 0. 5434. FORMAT "%7.2" AXIS_PTS_REF ldp_amp_ip_load_amp_mis_s_mt /end AXIS_DESCR
/end CHARACTERISTIC
/begin CHARACTERISTIC ip_load_min_ofs_amp_mis_s_at "Extra load from zero load curve vs engine speed and atmospheric pressure in S with AT vehicle" MAP 0xa0812564 _REC_MAP_20_u2_u1_u2 99.99694800000002 _CNV_A_R_MISF_LINEA_412_CM -50. 49.996948 DISPLAY_IDENTIFIER IP_LOAD_MIN_OFS_AMP_MIS_S_AT FORMAT "%7.3"
 /begin AXIS_DESCR COM_AXIS n_32 _CNV_A_R_LINEAR_____10_CM 6 0. 8160. FORMAT "%4.0" AXIS_PTS_REF ldp_n_32_ip_load_amp_mis_s_at /end AXIS_DESCR
 /begin AXIS_DESCR COM_AXIS amp _CNV_A_R_LINEAR_____27_CM 7 0. 5434. FORMAT "%7.2" AXIS_PTS_REF ldp_amp_ip_load_amp_mis_s_at /end AXIS_DESCR
/end CHARACTERISTIC
/begin AXIS_PTS ldp_n_32_ip_load_amp_mis_s_mt "" 0xa080728e n_32 _REC_AXS_20_u1 8160. _CNV_A_R_LINEAR_____10_CM 6 0. 8160. FORMAT "%4.0" /end AXIS_PTS
/begin AXIS_PTS ldp_n_32_ip_load_amp_mis_s_at "" 0xa0807286 n_32 _REC_AXS_20_u1 8160. _CNV_A_R_LINEAR_____10_CM 6 0. 8160. FORMAT "%4.0" /end AXIS_PTS
/begin AXIS_PTS ldp_amp_ip_load_amp_mis_s_mt "" 0xa080722c amp _REC_AXS_20_u2 5434. _CNV_A_R_LINEAR_____27_CM 7 0. 5434. FORMAT "%7.2" /end AXIS_PTS
/begin AXIS_PTS ldp_amp_ip_load_amp_mis_s_at "" 0xa080721c amp _REC_AXS_20_u2 5434. _CNV_A_R_LINEAR_____27_CM 7 0. 5434. FORMAT "%7.2" /end AXIS_PTS
/begin CHARACTERISTIC ip_thd_hom_s_er_is_mt "ER threshold for misfire detection in AFL combustion mode & in idle speed, MT vehicule" MAP 0xa08077c4 _REC_MAP_20_u2_u2_u2 65535. _CNV_A_R_LINEAR_____411_CM -32768. 32767. DISPLAY_IDENTIFIER IP_THD_HOM_S_ER_IS_MT FORMAT "%6.0"
 /begin AXIS_DESCR COM_AXIS n _CNV_A_R_LINEAR_____14_CM 4 0. 8160. FORMAT "%4.0" AXIS_PTS_REF ldp_n_ip_thd_hom_s_er_is_mt /end AXIS_DESCR
 /begin AXIS_DESCR COM_AXIS load_mis _CNV_A_R_LINEAR_____212_CM 6 0. 99.9969482421875 FORMAT "%7.3" AXIS_PTS_REF ldp_load_mis_ip_thd_hom_s_er_is_mt /end AXIS_DESCR
/end CHARACTERISTIC
/begin CHARACTERISTIC ip_thd_s_er_is_mt "ER threshold for misfire detection in S combustion mode & in idle speed, MT vehicule" MAP 0xa0807994 _REC_MAP_20_u2_u2_u2 65535. _CNV_A_R_LINEAR_____411_CM -32768. 32767. DISPLAY_IDENTIFIER IP_THD_S_ER_IS_MT FORMAT "%6.0"
 /begin AXIS_DESCR COM_AXIS n _CNV_A_R_LINEAR_____14_CM 4 0. 8160. FORMAT "%4.0" AXIS_PTS_REF ldp_n_ip_thd_s_er_is_mt /end AXIS_DESCR
 /begin AXIS_DESCR COM_AXIS load_mis _CNV_A_R_LINEAR_____212_CM 6 0. 99.9969482421875 FORMAT "%7.3" AXIS_PTS_REF ldp_load_mis_ip_thd_s_er_is_mt /end AXIS_DESCR
/end CHARACTERISTIC
/begin AXIS_PTS ldp_n_ip_thd_hom_s_er_is_mt "" 0xa0807714 n _REC_AXS_20_u2 8160. _CNV_A_R_LINEAR_____14_CM 4 0. 8160. FORMAT "%4.0" /end AXIS_PTS
/begin AXIS_PTS ldp_load_mis_ip_thd_hom_s_er_is_mt "" 0xa0807694 load_mis _REC_AXS_20_u2 99.9969482421875 _CNV_A_R_LINEAR_____212_CM 6 0. 99.9969482421875 FORMAT "%7.3" /end AXIS_PTS
/begin AXIS_PTS ldp_n_ip_thd_s_er_is_mt "" 0xa08078e4 n _REC_AXS_20_u2 8160. _CNV_A_R_LINEAR_____14_CM 4 0. 8160. FORMAT "%4.0" /end AXIS_PTS
/begin AXIS_PTS ldp_load_mis_ip_thd_s_er_is_mt "" 0xa0807864 load_mis _REC_AXS_20_u2 99.9969482421875 _CNV_A_R_LINEAR_____212_CM 6 0. 99.9969482421875 FORMAT "%7.3" /end AXIS_PTS
/begin CHARACTERISTIC ip_thd_afs_er_at_cc_open "ER threshold for misfire detection in AFS mode, AT vehicle transmission type and converter clutch in state open" MAP 0xa081290c _REC_MAP_20_u2_u2_u2 65535. _CNV_A_R_LINEAR_____411_CM -32768. 32767. DISPLAY_IDENTIFIER IP_THD_AFS_ER_AT_CC_OPEN FORMAT "%6.0"
 /begin AXIS_DESCR COM_AXIS n _CNV_A_R_LINEAR_____14_CM 12 0. 8160. FORMAT "%4.0" AXIS_PTS_REF ldp_n_ip_thd_afs_er_at_open /end AXIS_DESCR
 /begin AXIS_DESCR COM_AXIS load_mis _CNV_A_R_LINEAR_____212_CM 8 0. 99.9969482421875 FORMAT "%7.3" AXIS_PTS_REF ldp_load_mis_ip_thd_afs_er_at_open /end AXIS_DESCR
/end CHARACTERISTIC
/begin AXIS_PTS ldp_n_ip_thd_afs_er_at_open "" 0xa080750c n _REC_AXS_20_u2 8160. _CNV_A_R_LINEAR_____14_CM 12 0. 8160. FORMAT "%4.0" /end AXIS_PTS
/begin AXIS_PTS ldp_load_ip_thd_afs_er_at_open "" 0xa0807478 load_mis _REC_AXS_20_u2 99.9969482421875 _CNV_A_R_LINEAR_____212_CM 8 0. 99.9969482421875 FORMAT "%7.3" /end AXIS_PTS
/begin AXIS_PTS ldp_load_mis_ip_thd_afs_er_at_open "" 0xa08074ac load_mis _REC_AXS_20_u2 99.9969482421875 _CNV_A_R_LINEAR_____212_CM 8 0. 99.9969482421875 FORMAT "%7.3" /end AXIS_PTS
/begin CHARACTERISTIC ip_thd_afs_er_at_cc_ctl "ER threshold for misfire detection in AFS mode, AT vehicle transmission type and converter clutch in state controlled" MAP 0xa081284c _REC_MAP_20_u2_u2_u2 65535. _CNV_A_R_LINEAR_____411_CM -32768. 32767. DISPLAY_IDENTIFIER IP_THD_AFS_ER_AT_CC_CTL FORMAT "%6.0"
 /begin AXIS_DESCR COM_AXIS n _CNV_A_R_LINEAR_____14_CM 12 0. 8160. FORMAT "%4.0" AXIS_PTS_REF ldp_n_ip_thd_afs_er_at_ctl /end AXIS_DESCR
 /begin AXIS_DESCR COM_AXIS load_mis _CNV_A_R_LINEAR_____212_CM 8 0. 99.9969482421875 FORMAT "%7.3" AXIS_PTS_REF ldp_load_ip_thd_afs_er_at_ctl /end AXIS_DESCR
/end CHARACTERISTIC
/begin CHARACTERISTIC ip_thd_afs_er_at_cc_close "ER threshold for misfire detection in AFS mode, AT vehicle transmission type and converter clutch in state closed" MAP 0xa081278c _REC_MAP_20_u2_u2_u2 65535. _CNV_A_R_LINEAR_____411_CM -32768. 32767. DISPLAY_IDENTIFIER IP_THD_AFS_ER_AT_CC_CLOSE FORMAT "%6.0"
 /begin AXIS_DESCR COM_AXIS n _CNV_A_R_LINEAR_____14_CM 12 0. 8160. FORMAT "%4.0" AXIS_PTS_REF ldp_n_ip_thd_afs_er_at_close /end AXIS_DESCR
 /begin AXIS_DESCR COM_AXIS load_mis _CNV_A_R_LINEAR_____212_CM 8 0. 99.9969482421875 FORMAT "%7.3" AXIS_PTS_REF ldp_load_ip_thd_afs_er_at_close /end AXIS_DESCR
/end CHARACTERISTIC
/begin AXIS_PTS ldp_n_ip_thd_afs_er_at_ctl "" 0xa08074f0 n _REC_AXS_20_u2 8160. _CNV_A_R_LINEAR_____14_CM 12 0. 8160. FORMAT "%4.0" /end AXIS_PTS
/begin AXIS_PTS ldp_n_ip_thd_afs_er_at_close "" 0xa08074d4 n _REC_AXS_20_u2 8160. _CNV_A_R_LINEAR_____14_CM 12 0. 8160. FORMAT "%4.0" /end AXIS_PTS
/begin AXIS_PTS ldp_load_ip_thd_afs_er_at_ctl "" 0xa0807464 load_mis _REC_AXS_20_u2 99.9969482421875 _CNV_A_R_LINEAR_____212_CM 8 0. 99.9969482421875 FORMAT "%7.3" /end AXIS_PTS
/begin AXIS_PTS ldp_load_ip_thd_afs_er_at_close "" 0xa0807450 load_mis _REC_AXS_20_u2 99.9969482421875 _CNV_A_R_LINEAR_____212_CM 8 0. 99.9969482421875 FORMAT "%7.3" /end AXIS_PTS
/begin CHARACTERISTIC ip_thd_afs_er_is_at_cc_open "ER threshold for misfire detection in AFS combustion mode & in idle speed, AT vehicle and converter clutch open state." MAP 0xa08075d4 _REC_MAP_20_u2_u2_u2 65535. _CNV_A_R_LINEAR_____411_CM -32768. 32767. DISPLAY_IDENTIFIER IP_THD_AFS_ER_IS_AT_CC_OPEN FORMAT "%6.0"
 /begin AXIS_DESCR COM_AXIS n _CNV_A_R_LINEAR_____14_CM 4 0. 8160. FORMAT "%4.0" AXIS_PTS_REF ldp_n_ip_thd_afs_er_is_at /end AXIS_DESCR
 /begin AXIS_DESCR COM_AXIS load_mis _CNV_A_R_LINEAR_____212_CM 6 0. 99.9969482421875 FORMAT "%7.3" AXIS_PTS_REF ldp_load_ip_thd_afs_er_is_at /end AXIS_DESCR
/end CHARACTERISTIC
/begin AXIS_PTS ldp_n_ip_thd_afs_er_is_at "" 0xa0807528 n _REC_AXS_20_u2 8160. _CNV_A_R_LINEAR_____14_CM 4 0. 8160. FORMAT "%4.0" /end AXIS_PTS
/begin AXIS_PTS ldp_load_ip_thd_afs_er_is_at "" 0xa080748c load_mis _REC_AXS_20_u2 99.9969482421875 _CNV_A_R_LINEAR_____212_CM 6 0. 99.9969482421875 FORMAT "%7.3" /end AXIS_PTS
/begin CHARACTERISTIC ip_thd_afs_er_is_at_cc_ctl "ER threshold for misfire detection in AFS combustion mode & in idle speed, AT vehicle and converter clutch state controlled." MAP 0xa08075a4 _REC_MAP_20_u2_u2_u2 65535. _CNV_A_R_LINEAR_____411_CM -32768. 32767. DISPLAY_IDENTIFIER IP_THD_AFS_ER_IS_AT_CC_CTL FORMAT "%6.0"
 /begin AXIS_DESCR COM_AXIS n _CNV_A_R_LINEAR_____14_CM 4 0. 8160. FORMAT "%4.0" AXIS_PTS_REF ldp_n_ip_thd_afs_er_is_at_ctl /end AXIS_DESCR
 /begin AXIS_DESCR COM_AXIS load_mis _CNV_A_R_LINEAR_____212_CM 6 0. 99.9969482421875 FORMAT "%7.3" AXIS_PTS_REF ldp_load_ip_afs_er_is_at_ctl /end AXIS_DESCR
/end CHARACTERISTIC
/begin CHARACTERISTIC ip_thd_afs_er_is_at_cc_close "ER threshold for misfire detection in AFS combustion mode & in idle speed, AT vehicle and converter clutch state close." MAP 0xa0807574 _REC_MAP_20_u2_u2_u2 65535. _CNV_A_R_LINEAR_____411_CM -32768. 32767. DISPLAY_IDENTIFIER IP_THD_AFS_ER_IS_AT_CC_CLOSE FORMAT "%6.0"
 /begin AXIS_DESCR COM_AXIS n _CNV_A_R_LINEAR_____14_CM 4 0. 8160. FORMAT "%4.0" AXIS_PTS_REF ldp_n_ip_thd_afs_er_is_at_close /end AXIS_DESCR
 /begin AXIS_DESCR COM_AXIS load_mis _CNV_A_R_LINEAR_____212_CM 6 0. 99.9969482421875 FORMAT "%7.3" AXIS_PTS_REF ldp_load_ip_afs_er_is_at_close /end AXIS_DESCR
/end CHARACTERISTIC
/begin AXIS_PTS ldp_n_ip_thd_afs_er_is_at_ctl "" 0xa0807540 n _REC_AXS_20_u2 8160. _CNV_A_R_LINEAR_____14_CM 4 0. 8160. FORMAT "%4.0" /end AXIS_PTS
/begin AXIS_PTS ldp_n_ip_thd_afs_er_is_at_close "" 0xa0807534 n _REC_AXS_20_u2 8160. _CNV_A_R_LINEAR_____14_CM 4 0. 8160. FORMAT "%4.0" /end AXIS_PTS
/begin AXIS_PTS ldp_load_ip_afs_er_is_at_ctl "" 0xa0807440 load_mis _REC_AXS_20_u2 99.9969482421875 _CNV_A_R_LINEAR_____212_CM 6 0. 99.9969482421875 FORMAT "%7.3" /end AXIS_PTS
/begin AXIS_PTS ldp_load_ip_afs_er_is_at_close "" 0xa0807430 load_mis _REC_AXS_20_u2 99.9969482421875 _CNV_A_R_LINEAR_____212_CM 6 0. 99.9969482421875 FORMAT "%7.3" /end AXIS_PTS
/begin CHARACTERISTIC ip_thd_hom_s_er_at_cc_ctl "ER threshold for misfire detection in HOM_S mode, AT vehicle transmission type and converter clutch state controlled." MAP 0xa0812af8 _REC_MAP_20_u2_u2_u2 65535. _CNV_A_R_LINEAR_____411_CM -32768. 32767. DISPLAY_IDENTIFIER IP_THD_HOM_S_ER_AT_CC_CTL FORMAT "%6.0"
 /begin AXIS_DESCR COM_AXIS n _CNV_A_R_LINEAR_____14_CM 9 0. 8160. FORMAT "%4.0" AXIS_PTS_REF ldp_n_ip_thd_hom_s_er_at_ctl /end AXIS_DESCR
 /begin AXIS_DESCR COM_AXIS load_mis _CNV_A_R_LINEAR_____212_CM 6 0. 99.9969482421875 FORMAT "%7.3" AXIS_PTS_REF ldp_load_ip_thd_hom_s_er_at_ctl /end AXIS_DESCR
/end CHARACTERISTIC
/begin AXIS_PTS ldp_n_ip_thd_hom_s_er_at_ctl "" 0xa08076e0 n _REC_AXS_20_u2 8160. _CNV_A_R_LINEAR_____14_CM 9 0. 8160. FORMAT "%4.0" /end AXIS_PTS
/begin AXIS_PTS ldp_load_ip_thd_hom_s_er_at_ctl "" 0xa0807684 load_mis _REC_AXS_20_u2 99.9969482421875 _CNV_A_R_LINEAR_____212_CM 6 0. 99.9969482421875 FORMAT "%7.3" /end AXIS_PTS
/begin CHARACTERISTIC ip_thd_hom_s_er_at_cc_open "ER threshold for misfire detection in HOM_S mode, AT vehicle transmission type and converter clutch state open." MAP 0xa0812b64 _REC_MAP_20_u2_u2_u2 65535. _CNV_A_R_LINEAR_____411_CM -32768. 32767. DISPLAY_IDENTIFIER IP_THD_HOM_S_ER_AT_CC_OPEN FORMAT "%6.0"
 /begin AXIS_DESCR COM_AXIS n _CNV_A_R_LINEAR_____14_CM 9 0. 8160. FORMAT "%4.0" AXIS_PTS_REF ldp_n_ip_thd_hom_s_er_at_open /end AXIS_DESCR
 /begin AXIS_DESCR COM_AXIS load_mis _CNV_A_R_LINEAR_____212_CM 6 0. 99.9969482421875 FORMAT "%7.3" AXIS_PTS_REF ldp_load_ip_hom_s_er_at_open /end AXIS_DESCR
/end CHARACTERISTIC
/begin CHARACTERISTIC ip_thd_hom_s_er_at_cc_close "ER threshold for misfire detection in HOM_S mode, AT vehicle transmission type and converter clutch state closed." MAP 0xa0812a8c _REC_MAP_20_u2_u2_u2 65535. _CNV_A_R_LINEAR_____411_CM -32768. 32767. DISPLAY_IDENTIFIER IP_THD_HOM_S_ER_AT_CC_CLOSE FORMAT "%6.0"
 /begin AXIS_DESCR COM_AXIS n _CNV_A_R_LINEAR_____14_CM 9 0. 8160. FORMAT "%4.0" AXIS_PTS_REF ldp_n_ip_thd_hom_s_er_at_close /end AXIS_DESCR
 /begin AXIS_DESCR COM_AXIS load_mis _CNV_A_R_LINEAR_____212_CM 6 0. 99.9969482421875 FORMAT "%7.3" AXIS_PTS_REF ldp_load_ip_hom_s_er_at_close /end AXIS_DESCR
/end CHARACTERISTIC
/begin AXIS_PTS ldp_n_ip_thd_hom_s_er_at_open "" 0xa08076f4 n _REC_AXS_20_u2 8160. _CNV_A_R_LINEAR_____14_CM 9 0. 8160. FORMAT "%4.0" /end AXIS_PTS
/begin AXIS_PTS ldp_n_ip_thd_hom_s_er_at_close "" 0xa08076cc n _REC_AXS_20_u2 8160. _CNV_A_R_LINEAR_____14_CM 9 0. 8160. FORMAT "%4.0" /end AXIS_PTS
/begin AXIS_PTS ldp_load_ip_hom_s_er_at_open "" 0xa0807644 load_mis _REC_AXS_20_u2 99.9969482421875 _CNV_A_R_LINEAR_____212_CM 6 0. 99.9969482421875 FORMAT "%7.3" /end AXIS_PTS
/begin AXIS_PTS ldp_load_ip_hom_s_er_at_close "" 0xa0807634 load_mis _REC_AXS_20_u2 99.9969482421875 _CNV_A_R_LINEAR_____212_CM 6 0. 99.9969482421875 FORMAT "%7.3" /end AXIS_PTS
/begin CHARACTERISTIC ip_thd_hom_s_er_is_at_cc_open "ER threshold for misfire detection in HOM_S combustion mode & in idle speed, AT vehicle transmission type and converter clutch state open" MAP 0xa0807794 _REC_MAP_20_u2_u2_u2 65535. _CNV_A_R_LINEAR_____411_CM -32768. 32767. DISPLAY_IDENTIFIER IP_THD_HOM_S_ER_IS_AT_CC_OPEN FORMAT "%6.0"
 /begin AXIS_DESCR COM_AXIS n _CNV_A_R_LINEAR_____14_CM 4 0. 8160. FORMAT "%4.0" AXIS_PTS_REF ldp_n_ip_hom_s_er_is_at_open /end AXIS_DESCR
 /begin AXIS_DESCR COM_AXIS load_mis _CNV_A_R_LINEAR_____212_CM 6 0. 99.9969482421875 FORMAT "%7.3" AXIS_PTS_REF ldp_load_ip_hom_s_er_is_at_open /end AXIS_DESCR
/end CHARACTERISTIC
/begin AXIS_PTS ldp_n_ip_hom_s_er_is_at_open "" 0xa08076c0 n _REC_AXS_20_u2 8160. _CNV_A_R_LINEAR_____14_CM 4 0. 8160. FORMAT "%4.0" /end AXIS_PTS
/begin AXIS_PTS ldp_load_ip_hom_s_er_is_at_open "" 0xa0807664 load_mis _REC_AXS_20_u2 99.9969482421875 _CNV_A_R_LINEAR_____212_CM 6 0. 99.9969482421875 FORMAT "%7.3" /end AXIS_PTS
/begin CHARACTERISTIC ip_thd_hom_s_er_is_at_cc_ctl "ER threshold for misfire detection in HOM_S combustion mode & in idle speed, AT vehicle transmission type and converter clutch state controlled" MAP 0xa0807764 _REC_MAP_20_u2_u2_u2 65535. _CNV_A_R_LINEAR_____411_CM -32768. 32767. DISPLAY_IDENTIFIER IP_THD_HOM_S_ER_IS_AT_CC_CTL FORMAT "%6.0"
 /begin AXIS_DESCR COM_AXIS n _CNV_A_R_LINEAR_____14_CM 4 0. 8160. FORMAT "%4.0" AXIS_PTS_REF ldp_n_ip_thd_hom_s_er_is_at_ctl /end AXIS_DESCR
 /begin AXIS_DESCR COM_AXIS load_mis _CNV_A_R_LINEAR_____212_CM 6 0. 99.9969482421875 FORMAT "%7.3" AXIS_PTS_REF ldp_load_ip_hom_s_er_is_at_ctl /end AXIS_DESCR
/end CHARACTERISTIC
/begin CHARACTERISTIC ip_thd_hom_s_er_is_at_cc_close "ER threshold for misfire detection in HOM_S combustion mode & in idle speed, AT vehicle transmission type and converter clutch state closed" MAP 0xa0807734 _REC_MAP_20_u2_u2_u2 65535. _CNV_A_R_LINEAR_____411_CM -32768. 32767. DISPLAY_IDENTIFIER IP_THD_HOM_S_ER_IS_AT_CC_CLOSE FORMAT "%6.0"
 /begin AXIS_DESCR COM_AXIS n _CNV_A_R_LINEAR_____14_CM 4 0. 8160. FORMAT "%4.0" AXIS_PTS_REF ldp_n_ip_hom_s_er_is_at_close /end AXIS_DESCR
 /begin AXIS_DESCR COM_AXIS load_mis _CNV_A_R_LINEAR_____212_CM 6 0. 99.9969482421875 FORMAT "%7.3" AXIS_PTS_REF ldp_load_ip_hom_s_er_is_close /end AXIS_DESCR
/end CHARACTERISTIC
/begin AXIS_PTS ldp_n_ip_thd_hom_s_er_is_at_ctl "" 0xa0807708 n _REC_AXS_20_u2 8160. _CNV_A_R_LINEAR_____14_CM 4 0. 8160. FORMAT "%4.0" /end AXIS_PTS
/begin MEASUREMENT thd_ad_er_mv "Threshold offset for detection during Mean values Learning" SWORD _CNV_A_R_LINEAR_____410_CM 1 100. -32768. 32767. DISPLAY_IDENTIFIER THD_AD_ER_MV ECU_ADDRESS 0xd0007176 FORMAT "%6.0" /end MEASUREMENT
/begin MEASUREMENT fac_n_32_ar "Factor of working point used for ID_ER_MV given N_32" UWORD _CNV_A_R_LINEAR_____165_CM 1 100. 0. 1. DISPLAY_IDENTIFIER FAC_N_32_AR ECU_ADDRESS 0xd0007172 FORMAT "%8.6" /end MEASUREMENT
/begin MEASUREMENT fac_load_mis_ar "Factor of working point used for ID_ER_MV given LOAD_MIS" UWORD _CNV_A_R_LINEAR_____165_CM 1 100. 0. 1. DISPLAY_IDENTIFIER FAC_LOAD_MIS_AR ECU_ADDRESS 0xd0007170 FORMAT "%8.6" /end MEASUREMENT
/begin AXIS_PTS ldpm_load_mis_ip_er_mv "" 0xa080715c load_mis _REC_AXS_20_u2 9.99969482421875 _CNV_A_R_LINEAR_____212_CM 3 0. 99.9969482421875 /end AXIS_PTS
/begin AXIS_PTS ldp_n_ip_hom_s_er_is_at_close "" 0xa08076b4 n _REC_AXS_20_u2 8160. _CNV_A_R_LINEAR_____14_CM 4 0. 8160. FORMAT "%4.0" /end AXIS_PTS
/begin AXIS_PTS ldp_load_ip_hom_s_er_is_at_ctl "" 0xa0807654 load_mis _REC_AXS_20_u2 99.9969482421875 _CNV_A_R_LINEAR_____212_CM 6 0. 99.9969482421875 FORMAT "%7.3" /end AXIS_PTS
/begin AXIS_PTS ldp_load_ip_hom_s_er_is_close "" 0xa0807674 load_mis _REC_AXS_20_u2 99.9969482421875 _CNV_A_R_LINEAR_____212_CM 6 0. 99.9969482421875 FORMAT "%7.3" /end AXIS_PTS
/begin CHARACTERISTIC ip_thd_s_er_at_cc_open "ER threshold for misfire detection in S mode, AT vehicle transmission type and converter clutch state open" MAP 0xa0812d14 _REC_MAP_20_u2_u2_u2 65535. _CNV_A_R_LINEAR_____411_CM -32768. 32767. DISPLAY_IDENTIFIER IP_THD_S_ER_AT_CC_OPEN FORMAT "%6.0"
 /begin AXIS_DESCR COM_AXIS n _CNV_A_R_LINEAR_____14_CM 9 0. 8160. FORMAT "%4.0" AXIS_PTS_REF ldp_n_ip_thd_s_er_at_open /end AXIS_DESCR
 /begin AXIS_DESCR COM_AXIS load_mis _CNV_A_R_LINEAR_____212_CM 6 0. 99.9969482421875 FORMAT "%7.3" AXIS_PTS_REF ldp_load_ip_thd_s_er_at_open /end AXIS_DESCR
/end CHARACTERISTIC
/begin AXIS_PTS ldp_n_ip_thd_s_er_at_open "" 0xa08078ac n _REC_AXS_20_u2 8160. _CNV_A_R_LINEAR_____14_CM 9 0. 8160. FORMAT "%4.0" /end AXIS_PTS
/begin AXIS_PTS ldp_load_ip_thd_s_er_at_open "" 0xa0807814 load_mis _REC_AXS_20_u2 99.9969482421875 _CNV_A_R_LINEAR_____212_CM 6 0. 99.9969482421875 FORMAT "%7.3" /end AXIS_PTS
/begin CHARACTERISTIC ip_thd_ad_er_mv "Threshold offset during Mean Value Learning" MAP 0xa08071ac _REC_MAP_20_u2_u1_u2 65535. _CNV_A_R_LINEAR_____413_CM -32768. 32767. DISPLAY_IDENTIFIER IP_THD_AD_ER_MV FORMAT "%6.0"
 /begin AXIS_DESCR COM_AXIS n_32 _CNV_A_R_LINEAR_____10_CM 8 0. 8160. FORMAT "%4.0" AXIS_PTS_REF ldpm_n_32_ip_er_mv /end AXIS_DESCR
 /begin AXIS_DESCR COM_AXIS load_mis _CNV_A_R_LINEAR_____212_CM 3 0. 99.9969482421875 AXIS_PTS_REF ldpm_load_mis_ip_er_mv /end AXIS_DESCR
/end CHARACTERISTIC
/begin MEASUREMENT er_mv_cyl[0] "Mean value of cylinder normalised engine roughness" SWORD _CNV_A_R_LINEAR_____410_CM 1 100. -32768. 32767. DISPLAY_IDENTIFIER ER_MV_CYL[0] ECU_ADDRESS 0xd0007150 FORMAT "%6.0" /end MEASUREMENT
/begin MEASUREMENT er_mv_cyl[1] "Mean value of cylinder normalised engine roughness" SWORD _CNV_A_R_LINEAR_____410_CM 1 100. -32768. 32767. DISPLAY_IDENTIFIER ER_MV_CYL[1] ECU_ADDRESS 0xd0007152 FORMAT "%6.0" /end MEASUREMENT
/begin MEASUREMENT er_mv_cyl[2] "Mean value of cylinder normalised engine roughness" SWORD _CNV_A_R_LINEAR_____410_CM 1 100. -32768. 32767. DISPLAY_IDENTIFIER ER_MV_CYL[2] ECU_ADDRESS 0xd0007154 FORMAT "%6.0" /end MEASUREMENT
/begin MEASUREMENT er_mv_cyl[3] "Mean value of cylinder normalised engine roughness" SWORD _CNV_A_R_LINEAR_____410_CM 1 100. -32768. 32767. DISPLAY_IDENTIFIER ER_MV_CYL[3] ECU_ADDRESS 0xd0007156 FORMAT "%6.0" /end MEASUREMENT
/begin MEASUREMENT er_mv_cyl[4] "Mean value of cylinder normalised engine roughness" SWORD _CNV_A_R_LINEAR_____410_CM 1 100. -32768. 32767. DISPLAY_IDENTIFIER ER_MV_CYL[4] ECU_ADDRESS 0xd0007158 FORMAT "%6.0" /end MEASUREMENT
/begin MEASUREMENT er_mv_cyl[5] "Mean value of cylinder normalised engine roughness" SWORD _CNV_A_R_LINEAR_____410_CM 1 100. -32768. 32767. DISPLAY_IDENTIFIER ER_MV_CYL[5] ECU_ADDRESS 0xd000715a FORMAT "%6.0" /end MEASUREMENT
/begin MEASUREMENT er_mv_cyl[6] "Mean value of cylinder normalised engine roughness" SWORD _CNV_A_R_LINEAR_____410_CM 1 100. -32768. 32767. DISPLAY_IDENTIFIER ER_MV_CYL[6] ECU_ADDRESS 0xd000715c FORMAT "%6.0" /end MEASUREMENT
/begin MEASUREMENT er_mv_cyl[7] "Mean value of cylinder normalised engine roughness" SWORD _CNV_A_R_LINEAR_____410_CM 1 100. -32768. 32767. DISPLAY_IDENTIFIER ER_MV_CYL[7] ECU_ADDRESS 0xd000715e FORMAT "%6.0" /end MEASUREMENT
/begin MEASUREMENT er_mv_mis_det "Bit x = 1, when misfire seems detected on cylinder x" UBYTE _CNV_A_R_LINEAR_____0_CM 1 100. 0. 255. DISPLAY_IDENTIFIER ER_MV_MIS_DET ECU_ADDRESS 0xd00076bc FORMAT "%3.0" /end MEASUREMENT
/begin MEASUREMENT mis_ctr_grd "Counter for gradient for engine speed and load (increase if under a threshold)" UBYTE _CNV_A_R_LINEAR_____0_CM 1 100. 0. 255. DISPLAY_IDENTIFIER MIS_CTR_GRD ECU_ADDRESS 0xd00076c0 FORMAT "%3.0" /end MEASUREMENT
/begin MEASUREMENT er_mv_mis_det_tra "Bit x = 1, when misfire seems detected on cylinder x and a transistion already occurs" UBYTE _CNV_A_R_LINEAR_____0_CM 1 100. 0. 255. DISPLAY_IDENTIFIER ER_MV_MIS_DET_TRA ECU_ADDRESS 0xd00076bd FORMAT "%3.0" /end MEASUREMENT
/begin MEASUREMENT n_32_tra "Engine speed value during a transition" UBYTE _CNV_A_R_LINEAR_____10_CM 1 100. 0. 8160. DISPLAY_IDENTIFIER N_32_TRA ECU_ADDRESS 0xd00076c1 FORMAT "%4.0" /end MEASUREMENT
/begin MEASUREMENT load_mis_tra "Load value during a transition" UWORD _CNV_A_R_LINEAR_____212_CM 1 100. 0. 99.9969482421875 DISPLAY_IDENTIFIER LOAD_MIS_TRA ECU_ADDRESS 0xd0007174 /end MEASUREMENT
/begin CHARACTERISTIC c_er_thd_ratio_fil_l "Filter gain for ER mean value calculation" VALUE 0xa0807210 _REC_VAL_20_u1 6.0796737670755 _CNV_A_R_MISF_LINEA_414_CM 0. 6.0796737670755 DISPLAY_IDENTIFIER C_ER_THD_RATIO_FIL_L FORMAT "%6.5" /end CHARACTERISTIC
/begin CHARACTERISTIC c_er_fil_l "Normal filter gain for ER mean value calculation" VALUE 0xa080720e _REC_VAL_20_u1 1. _CNV_A_R_ENRD_LINEA_389_CM 0. 1. DISPLAY_IDENTIFIER C_ER_FIL_L FORMAT "%5.3" /end CHARACTERISTIC
/begin CHARACTERISTIC c_er_fil_h "Filter gain for ER mean value calculation during transiants" VALUE 0xa080720d _REC_VAL_20_u1 1. _CNV_A_R_ENRD_LINEA_389_CM 0. 1. DISPLAY_IDENTIFIER C_ER_FIL_H FORMAT "%5.3" /end CHARACTERISTIC
/begin CHARACTERISTIC c_er_fil_det "Filter gain for ER mean value calculation in case of Misfire" VALUE 0xa080720c _REC_VAL_20_u1 1. _CNV_A_R_ENRD_LINEA_389_CM 0. 1. DISPLAY_IDENTIFIER C_ER_FIL_DET FORMAT "%5.3" /end CHARACTERISTIC
/begin CHARACTERISTIC c_nr_mis_grd "Number of tdc's, with low gradients (n_32, load_mis)" VALUE 0xa0807215 _REC_VAL_20_u1 255. _CNV_A_R_LINEAR_____0_CM 0. 255. DISPLAY_IDENTIFIER C_NR_MIS_GRD FORMAT "%3.0" /end CHARACTERISTIC
/begin CHARACTERISTIC c_n_32_ar_tra "Engine speed window around transition to accept to store mean value" VALUE 0xa0807214 _REC_VAL_20_u1 8160. _CNV_A_R_LINEAR_____10_CM 0. 8160. DISPLAY_IDENTIFIER C_N_32_AR_TRA FORMAT "%4.0" /end CHARACTERISTIC
/begin CHARACTERISTIC c_load_mis_tra "Load window around transition to accept to store mean value" VALUE 0xa0807212 _REC_VAL_20_u2 99.9969482421875 _CNV_A_R_LINEAR_____212_CM 0. 99.9969482421875 DISPLAY_IDENTIFIER C_LOAD_MIS_TRA /end CHARACTERISTIC
/begin CHARACTERISTIC ip_thd_s_er_at_cc_ctl "ER threshold for misfire detection in S mode, AT vehicle transmission type and converter clutch state controlled" MAP 0xa0812ca8 _REC_MAP_20_u2_u2_u2 65535. _CNV_A_R_LINEAR_____411_CM -32768. 32767. DISPLAY_IDENTIFIER IP_THD_S_ER_AT_CC_CTL FORMAT "%6.0"
 /begin AXIS_DESCR COM_AXIS n _CNV_A_R_LINEAR_____14_CM 9 0. 8160. FORMAT "%4.0" AXIS_PTS_REF ldp_n_ip_thd_s_er_at_ctl /end AXIS_DESCR
 /begin AXIS_DESCR COM_AXIS load_mis _CNV_A_R_LINEAR_____212_CM 6 0. 99.9969482421875 FORMAT "%7.3" AXIS_PTS_REF ldp_load_mis_ip_thd_s_er_at_ctl /end AXIS_DESCR
/end CHARACTERISTIC
/begin AXIS_PTS ldp_n_32_ip_n_32_grd_mis_er_mv "" 0xa0807154 n_32 _REC_AXS_20_u1 816. _CNV_A_R_LINEAR_____10_CM 6 0. 8160. FORMAT "%4.0" /end AXIS_PTS
/begin AXIS_PTS ldpm_n_32_ip_er_mv "" 0xa0807164 n_32 _REC_AXS_20_u1 816. _CNV_A_R_LINEAR_____10_CM 8 0. 8160. FORMAT "%4.0" /end AXIS_PTS
/begin AXIS_PTS ldp_load_ip_load_grd_mis_er_mv "" 0xa080714c load_mis _REC_AXS_20_u2 9.99969482421875 _CNV_A_R_LINEAR_____212_CM 3 0. 99.9969482421875 /end AXIS_PTS
/begin CHARACTERISTIC ip_thd_s_er_at_cc_close "ER threshold for misfire detection in S mode, AT vehicle transmission type and converter clutch state closed" MAP 0xa0812c3c _REC_MAP_20_u2_u2_u2 65535. _CNV_A_R_LINEAR_____411_CM -32768. 32767. DISPLAY_IDENTIFIER IP_THD_S_ER_AT_CC_CLOSE FORMAT "%6.0"
 /begin AXIS_DESCR COM_AXIS n _CNV_A_R_LINEAR_____14_CM 9 0. 8160. FORMAT "%4.0" AXIS_PTS_REF ldp_n_ip_thd_s_er_at_close /end AXIS_DESCR
 /begin AXIS_DESCR COM_AXIS load_mis _CNV_A_R_LINEAR_____212_CM 6 0. 99.9969482421875 FORMAT "%7.3" AXIS_PTS_REF ldp_load_ip_thd_s_er_at_close /end AXIS_DESCR
/end CHARACTERISTIC
/begin CHARACTERISTIC ip_er_mv "Definition of the size and LDP divisions for Mean Values Calculation" MAP 0xa0807178 _REC_MAP_20_u1_u1_u2 255. _CNV_A_R_LINEAR_____0_CM 0. 255. DISPLAY_IDENTIFIER IP_ER_MV FORMAT "%3.0"
 /begin AXIS_DESCR COM_AXIS n_32 _CNV_A_R_LINEAR_____10_CM 8 0. 8160. FORMAT "%4.0" AXIS_PTS_REF ldpm_n_32_ip_er_mv /end AXIS_DESCR
 /begin AXIS_DESCR COM_AXIS load_mis _CNV_A_R_LINEAR_____212_CM 3 0. 99.9969482421875 AXIS_PTS_REF ldpm_load_mis_ip_er_mv /end AXIS_DESCR
/end CHARACTERISTIC
/begin CHARACTERISTIC ip_n_32_grd_mis_er_mv "Maximum engine speed gradient for transition" CURVE 0xa08071a6 _REC_CUR_20_u1_u1 8160. _CNV_A_R_LINEAR_____10_CM 0. 8160. DISPLAY_IDENTIFIER IP_N_32_GRD_MIS_ER_MV FORMAT "%4.0"
 /begin AXIS_DESCR COM_AXIS n_32 _CNV_A_R_LINEAR_____10_CM 6 0. 8160. FORMAT "%4.0" AXIS_PTS_REF ldp_n_32_ip_n_32_grd_mis_er_mv /end AXIS_DESCR
/end CHARACTERISTIC
/begin AXIS_PTS ldp_n_ip_thd_s_er_at_ctl "" 0xa0807898 n _REC_AXS_20_u2 8160. _CNV_A_R_LINEAR_____14_CM 9 0. 8160. FORMAT "%4.0" /end AXIS_PTS
/begin CHARACTERISTIC id_load_min_er_mv_mem "index minimum for load to store the first mean value" CURVE 0xa0807170 _REC_CUR_20_u1_u1 7. _CNV_A_R_LINEAR_____0_CM 0. 7. DISPLAY_IDENTIFIER ID_LOAD_MIN_ER_MV_MEM FORMAT "%1.0"
 /begin AXIS_DESCR COM_AXIS n_32 _CNV_A_R_LINEAR_____10_CM 8 0. 8160. FORMAT "%4.0" AXIS_PTS_REF ldpm_n_32_ip_er_mv /end AXIS_DESCR
/end CHARACTERISTIC
/begin MEASUREMENT er_delta "Delta engine roughness on same physical segment" SLONG _CNV_A_R_MISF_LINEA_415_CM 1 100. -2000000. 1999999.7 DISPLAY_IDENTIFIER ER_DELTA ECU_ADDRESS 0xd0006380 FORMAT "%13.5" /end MEASUREMENT
/begin AXIS_PTS ldp_n_ip_thd_s_er_at_close "" 0xa0807884 n _REC_AXS_20_u2 8160. _CNV_A_R_LINEAR_____14_CM 9 0. 8160. FORMAT "%4.0" /end AXIS_PTS
/begin MEASUREMENT er_delta_fil_mem "Delta engine roughness on continous mean value and memory mean value" SWORD _CNV_A_R_LINEAR_____410_CM 1 100. -32768. 32767. DISPLAY_IDENTIFIER ER_DELTA_FIL_MEM ECU_ADDRESS 0xd000714e FORMAT "%6.0" /end MEASUREMENT
/begin AXIS_PTS ldp_load_mis_ip_thd_s_er_at_ctl "" 0xa0807854 load_mis _REC_AXS_20_u2 99.9969482421875 _CNV_A_R_LINEAR_____212_CM 6 0. 99.9969482421875 FORMAT "%7.3" /end AXIS_PTS
/begin AXIS_PTS ldp_load_ip_thd_s_er_at_close "" 0xa0807804 load_mis _REC_AXS_20_u2 99.9969482421875 _CNV_A_R_LINEAR_____212_CM 6 0. 99.9969482421875 FORMAT "%7.3" /end AXIS_PTS
/begin MEASUREMENT lv_det_thd_delta_fil_mem "Single misfire detected based only on threshold criterion on delta mean values" UBYTE _CNV_S_2_RANGE__0___1_CM 1 100. 0. 1. DISPLAY_IDENTIFIER LV_DET_THD_DELTA_FIL_MEM ECU_ADDRESS 0xd00076f6 BIT_MASK 0x1 /end MEASUREMENT
/begin CHARACTERISTIC ip_er_mv_max "Limitation for Mean ER Value" CURVE 0xa0807190 _REC_CUR_20_u2_u1 32767. _CNV_A_R_LINEAR_____410_CM 0. 32767. DISPLAY_IDENTIFIER IP_ER_MV_MAX FORMAT "%5.0"
 /begin AXIS_DESCR COM_AXIS n_32 _CNV_A_R_LINEAR_____10_CM 8 0. 8160. FORMAT "%4.0" AXIS_PTS_REF ldpm_n_32_ip_er_mv /end AXIS_DESCR
/end CHARACTERISTIC
/begin CHARACTERISTIC ip_thd_er_fil_mem "Threshold for detection of Misfire based on delta on mean values" MAP 0xa08071dc _REC_MAP_20_u2_u1_u2 65535. _CNV_A_R_LINEAR_____413_CM -32768. 32767. DISPLAY_IDENTIFIER IP_THD_ER_FIL_MEM FORMAT "%6.0"
 /begin AXIS_DESCR COM_AXIS n_32 _CNV_A_R_LINEAR_____10_CM 8 0. 8160. FORMAT "%4.0" AXIS_PTS_REF ldpm_n_32_ip_er_mv /end AXIS_DESCR
 /begin AXIS_DESCR COM_AXIS load_mis _CNV_A_R_LINEAR_____212_CM 3 0. 99.9969482421875 AXIS_PTS_REF ldpm_load_mis_ip_er_mv /end AXIS_DESCR
/end CHARACTERISTIC
/begin CHARACTERISTIC ip_thd_s_er_is_at_cc_open "ER threshold for misfire detection in S combustion mode & in idle speed, AT vehicle transmission type and converter clutch state open" MAP 0xa0807964 _REC_MAP_20_u2_u2_u2 65535. _CNV_A_R_LINEAR_____411_CM -32768. 32767. DISPLAY_IDENTIFIER IP_THD_S_ER_IS_AT_CC_OPEN FORMAT "%6.0"
 /begin AXIS_DESCR COM_AXIS n _CNV_A_R_LINEAR_____14_CM 4 0. 8160. FORMAT "%4.0" AXIS_PTS_REF ldp_n_ip_thd_s_er_is_at_open /end AXIS_DESCR
 /begin AXIS_DESCR COM_AXIS load_mis _CNV_A_R_LINEAR_____212_CM 6 0. 99.9969482421875 FORMAT "%7.3" AXIS_PTS_REF ldp_load_ip_thd_s_er_is_at_open /end AXIS_DESCR
/end CHARACTERISTIC
/begin CHARACTERISTIC lc_thd_er_delta "=1, if misfire detection used ER_DELTA signal" VALUE 0xa0807147 _REC_VAL_20_u1 1. _CNV_A_R_LINEAR_____0_CM 0. 1. DISPLAY_IDENTIFIER LC_THD_ER_DELTA FORMAT "%1.0" /end CHARACTERISTIC
/begin AXIS_PTS ldp_n_ip_thd_s_er_is_at_open "" 0xa08078d8 n _REC_AXS_20_u2 8160. _CNV_A_R_LINEAR_____14_CM 4 0. 8160. FORMAT "%4.0" /end AXIS_PTS
/begin MEASUREMENT er_mv_cyl_ad[0] "Mean value of cylinder normalised engine roughness with used of record values" SWORD _CNV_A_R_LINEAR_____410_CM 1 100. -32768. 32767. DISPLAY_IDENTIFIER ER_MV_CYL_AD[0] ECU_ADDRESS 0xd0007160 FORMAT "%6.0" /end MEASUREMENT
/begin MEASUREMENT er_mv_cyl_ad[1] "Mean value of cylinder normalised engine roughness with used of record values" SWORD _CNV_A_R_LINEAR_____410_CM 1 100. -32768. 32767. DISPLAY_IDENTIFIER ER_MV_CYL_AD[1] ECU_ADDRESS 0xd0007162 FORMAT "%6.0" /end MEASUREMENT
/begin MEASUREMENT er_mv_cyl_ad[2] "Mean value of cylinder normalised engine roughness with used of record values" SWORD _CNV_A_R_LINEAR_____410_CM 1 100. -32768. 32767. DISPLAY_IDENTIFIER ER_MV_CYL_AD[2] ECU_ADDRESS 0xd0007164 FORMAT "%6.0" /end MEASUREMENT
/begin MEASUREMENT er_mv_cyl_ad[3] "Mean value of cylinder normalised engine roughness with used of record values" SWORD _CNV_A_R_LINEAR_____410_CM 1 100. -32768. 32767. DISPLAY_IDENTIFIER ER_MV_CYL_AD[3] ECU_ADDRESS 0xd0007166 FORMAT "%6.0" /end MEASUREMENT
/begin MEASUREMENT er_mv_cyl_ad[4] "Mean value of cylinder normalised engine roughness with used of record values" SWORD _CNV_A_R_LINEAR_____410_CM 1 100. -32768. 32767. DISPLAY_IDENTIFIER ER_MV_CYL_AD[4] ECU_ADDRESS 0xd0007168 FORMAT "%6.0" /end MEASUREMENT
/begin MEASUREMENT er_mv_cyl_ad[5] "Mean value of cylinder normalised engine roughness with used of record values" SWORD _CNV_A_R_LINEAR_____410_CM 1 100. -32768. 32767. DISPLAY_IDENTIFIER ER_MV_CYL_AD[5] ECU_ADDRESS 0xd000716a FORMAT "%6.0" /end MEASUREMENT
/begin MEASUREMENT er_mv_cyl_ad[6] "Mean value of cylinder normalised engine roughness with used of record values" SWORD _CNV_A_R_LINEAR_____410_CM 1 100. -32768. 32767. DISPLAY_IDENTIFIER ER_MV_CYL_AD[6] ECU_ADDRESS 0xd000716c FORMAT "%6.0" /end MEASUREMENT
/begin MEASUREMENT er_mv_cyl_ad[7] "Mean value of cylinder normalised engine roughness with used of record values" SWORD _CNV_A_R_LINEAR_____410_CM 1 100. -32768. 32767. DISPLAY_IDENTIFIER ER_MV_CYL_AD[7] ECU_ADDRESS 0xd000716e FORMAT "%6.0" /end MEASUREMENT
/begin MEASUREMENT ar_tra_mis "Change of area (bit x for cylinder x)" UBYTE _CNV_A_R_LINEAR_____0_CM 1 100. 0. 255. DISPLAY_IDENTIFIER AR_TRA_MIS ECU_ADDRESS 0xd00076b2 FORMAT "%3.0" /end MEASUREMENT
/begin MEASUREMENT er_ad_ar[0] "Bit x =1 when mean value in area 'x' is realized" UBYTE _CNV_A_R_LINEAR_____0_CM 1 100. 0. 255. DISPLAY_IDENTIFIER ER_AD_AR[0] ECU_ADDRESS 0xd00076b4 FORMAT "%3.0" /end MEASUREMENT
/begin MEASUREMENT er_ad_ar[1] "Bit x =1 when mean value in area 'x' is realized" UBYTE _CNV_A_R_LINEAR_____0_CM 1 100. 0. 255. DISPLAY_IDENTIFIER ER_AD_AR[1] ECU_ADDRESS 0xd00076b5 FORMAT "%3.0" /end MEASUREMENT
/begin MEASUREMENT er_ad_ar[2] "Bit x =1 when mean value in area 'x' is realized" UBYTE _CNV_A_R_LINEAR_____0_CM 1 100. 0. 255. DISPLAY_IDENTIFIER ER_AD_AR[2] ECU_ADDRESS 0xd00076b6 FORMAT "%3.0" /end MEASUREMENT
/begin MEASUREMENT er_ad_ar[3] "Bit x =1 when mean value in area 'x' is realized" UBYTE _CNV_A_R_LINEAR_____0_CM 1 100. 0. 255. DISPLAY_IDENTIFIER ER_AD_AR[3] ECU_ADDRESS 0xd00076b7 FORMAT "%3.0" /end MEASUREMENT
/begin MEASUREMENT er_ad_ar[4] "Bit x =1 when mean value in area 'x' is realized" UBYTE _CNV_A_R_LINEAR_____0_CM 1 100. 0. 255. DISPLAY_IDENTIFIER ER_AD_AR[4] ECU_ADDRESS 0xd00076b8 FORMAT "%3.0" /end MEASUREMENT
/begin MEASUREMENT er_ad_ar[5] "Bit x =1 when mean value in area 'x' is realized" UBYTE _CNV_A_R_LINEAR_____0_CM 1 100. 0. 255. DISPLAY_IDENTIFIER ER_AD_AR[5] ECU_ADDRESS 0xd00076b9 FORMAT "%3.0" /end MEASUREMENT
/begin MEASUREMENT er_ad_ar[6] "Bit x =1 when mean value in area 'x' is realized" UBYTE _CNV_A_R_LINEAR_____0_CM 1 100. 0. 255. DISPLAY_IDENTIFIER ER_AD_AR[6] ECU_ADDRESS 0xd00076ba FORMAT "%3.0" /end MEASUREMENT
/begin MEASUREMENT er_ad_ar[7] "Bit x =1 when mean value in area 'x' is realized" UBYTE _CNV_A_R_LINEAR_____0_CM 1 100. 0. 255. DISPLAY_IDENTIFIER ER_AD_AR[7] ECU_ADDRESS 0xd00076bb FORMAT "%3.0" /end MEASUREMENT
/begin MEASUREMENT lv_er_ar_avl "Mean ER Value learned in all engine speed range" UBYTE _CNV_S_2_RANGE__0___1_CM 1 100. 0. 1. DISPLAY_IDENTIFIER LV_ER_AR_AVL ECU_ADDRESS 0xd00076f7 BIT_MASK 0x1 /end MEASUREMENT
/begin CHARACTERISTIC lc_thd_er_delta_fil_mem "=1, if misfire detection used ER_DELTA_FIL_MEM signal" VALUE 0xa0807219 _REC_VAL_20_u1 1. _CNV_A_R_LINEAR_____0_CM 0. 1. DISPLAY_IDENTIFIER LC_THD_ER_DELTA_FIL_MEM FORMAT "%1.0" /end CHARACTERISTIC
/begin MEASUREMENT lv_err_mv_lim "ER Mean Value out of range" UBYTE _CNV_S_2_RANGE__0___1_CM 1 100. 0. 1. DISPLAY_IDENTIFIER LV_ERR_MV_LIM ECU_ADDRESS 0xd00076f8 BIT_MASK 0x1 /end MEASUREMENT
/begin MEASUREMENT ctr_er_ad_ar "Number of learning area for Mean ER value" UBYTE _CNV_A_R_LINEAR_____0_CM 1 100. 0. 255. DISPLAY_IDENTIFIER CTR_ER_AD_AR ECU_ADDRESS 0xd00076f5 FORMAT "%3.0" /end MEASUREMENT
/begin AXIS_PTS ldp_load_ip_thd_s_er_is_at_open "" 0xa0807844 load_mis _REC_AXS_20_u2 99.9969482421875 _CNV_A_R_LINEAR_____212_CM 6 0. 99.9969482421875 FORMAT "%7.3" /end AXIS_PTS
/begin CHARACTERISTIC ip_thd_s_er_is_at_cc_ctl "ER threshold for misfire detection in S combustion mode & in idle speed, AT vehicle transmission type and converter clutch state controlled" MAP 0xa0807934 _REC_MAP_20_u2_u2_u2 65535. _CNV_A_R_LINEAR_____411_CM -32768. 32767. DISPLAY_IDENTIFIER IP_THD_S_ER_IS_AT_CC_CTL FORMAT "%6.0"
 /begin AXIS_DESCR COM_AXIS n _CNV_A_R_LINEAR_____14_CM 4 0. 8160. FORMAT "%4.0" AXIS_PTS_REF ldp_n_ip_thd_s_er_is_at_ctl /end AXIS_DESCR
 /begin AXIS_DESCR COM_AXIS load_mis _CNV_A_R_LINEAR_____212_CM 6 0. 99.9969482421875 FORMAT "%7.3" AXIS_PTS_REF ldp_load_ip_thd_s_er_is_at_ctl /end AXIS_DESCR
/end CHARACTERISTIC
/begin CHARACTERISTIC lc_er_mv_lim_reac "Reset all NVMY data" VALUE 0xa0807217 _REC_VAL_20_u1 1. _CNV_A_R_LINEAR_____0_CM 0. 1. DISPLAY_IDENTIFIER LC_ER_MV_LIM_REAC FORMAT "%1.0" /end CHARACTERISTIC
/begin CHARACTERISTIC er_mv_mem[0] "Recorded mean value" MAP 0xd000e718 _REC_MAP_20_s2_u1_u2 65535. _CNV_A_R_LINEAR_____410_CM -32768. 32767. READ_ONLY DISPLAY_IDENTIFIER ER_MV_MEM[0] FORMAT "%6.0" MAX_REFRESH 4 100
 /begin AXIS_DESCR COM_AXIS n_32 _CNV_A_R_LINEAR_____10_CM 8 0. 8160. FORMAT "%4.0" AXIS_PTS_REF ldpm_n_32_ip_er_mv /end AXIS_DESCR
 /begin AXIS_DESCR COM_AXIS load_mis _CNV_A_R_LINEAR_____212_CM 3 0. 99.9969482421875 AXIS_PTS_REF ldpm_load_mis_ip_er_mv /end AXIS_DESCR
/end CHARACTERISTIC
/begin CHARACTERISTIC er_mv_mem[1] "Recorded mean value" MAP 0xd000e748 _REC_MAP_20_s2_u1_u2 65535. _CNV_A_R_LINEAR_____410_CM -32768. 32767. READ_ONLY DISPLAY_IDENTIFIER ER_MV_MEM[1] FORMAT "%6.0" MAX_REFRESH 4 100
 /begin AXIS_DESCR COM_AXIS n_32 _CNV_A_R_LINEAR_____10_CM 8 0. 8160. FORMAT "%4.0" AXIS_PTS_REF ldpm_n_32_ip_er_mv /end AXIS_DESCR
 /begin AXIS_DESCR COM_AXIS load_mis _CNV_A_R_LINEAR_____212_CM 3 0. 99.9969482421875 AXIS_PTS_REF ldpm_load_mis_ip_er_mv /end AXIS_DESCR
/end CHARACTERISTIC
/begin CHARACTERISTIC er_mv_mem[2] "Recorded mean value" MAP 0xd000e778 _REC_MAP_20_s2_u1_u2 65535. _CNV_A_R_LINEAR_____410_CM -32768. 32767. READ_ONLY DISPLAY_IDENTIFIER ER_MV_MEM[2] FORMAT "%6.0" MAX_REFRESH 4 100
 /begin AXIS_DESCR COM_AXIS n_32 _CNV_A_R_LINEAR_____10_CM 8 0. 8160. FORMAT "%4.0" AXIS_PTS_REF ldpm_n_32_ip_er_mv /end AXIS_DESCR
 /begin AXIS_DESCR COM_AXIS load_mis _CNV_A_R_LINEAR_____212_CM 3 0. 99.9969482421875 AXIS_PTS_REF ldpm_load_mis_ip_er_mv /end AXIS_DESCR
/end CHARACTERISTIC
/begin CHARACTERISTIC er_mv_mem[3] "Recorded mean value" MAP 0xd000e7a8 _REC_MAP_20_s2_u1_u2 65535. _CNV_A_R_LINEAR_____410_CM -32768. 32767. READ_ONLY DISPLAY_IDENTIFIER ER_MV_MEM[3] FORMAT "%6.0" MAX_REFRESH 4 100
 /begin AXIS_DESCR COM_AXIS n_32 _CNV_A_R_LINEAR_____10_CM 8 0. 8160. FORMAT "%4.0" AXIS_PTS_REF ldpm_n_32_ip_er_mv /end AXIS_DESCR
 /begin AXIS_DESCR COM_AXIS load_mis _CNV_A_R_LINEAR_____212_CM 3 0. 99.9969482421875 AXIS_PTS_REF ldpm_load_mis_ip_er_mv /end AXIS_DESCR
/end CHARACTERISTIC
/begin CHARACTERISTIC er_mv_mem[4] "Recorded mean value" MAP 0xd000e7d8 _REC_MAP_20_s2_u1_u2 65535. _CNV_A_R_LINEAR_____410_CM -32768. 32767. READ_ONLY DISPLAY_IDENTIFIER ER_MV_MEM[4] FORMAT "%6.0" MAX_REFRESH 4 100
 /begin AXIS_DESCR COM_AXIS n_32 _CNV_A_R_LINEAR_____10_CM 8 0. 8160. FORMAT "%4.0" AXIS_PTS_REF ldpm_n_32_ip_er_mv /end AXIS_DESCR
 /begin AXIS_DESCR COM_AXIS load_mis _CNV_A_R_LINEAR_____212_CM 3 0. 99.9969482421875 AXIS_PTS_REF ldpm_load_mis_ip_er_mv /end AXIS_DESCR
/end CHARACTERISTIC
/begin CHARACTERISTIC er_mv_mem[5] "Recorded mean value" MAP 0xd000e808 _REC_MAP_20_s2_u1_u2 65535. _CNV_A_R_LINEAR_____410_CM -32768. 32767. READ_ONLY DISPLAY_IDENTIFIER ER_MV_MEM[5] FORMAT "%6.0" MAX_REFRESH 4 100
 /begin AXIS_DESCR COM_AXIS n_32 _CNV_A_R_LINEAR_____10_CM 8 0. 8160. FORMAT "%4.0" AXIS_PTS_REF ldpm_n_32_ip_er_mv /end AXIS_DESCR
 /begin AXIS_DESCR COM_AXIS load_mis _CNV_A_R_LINEAR_____212_CM 3 0. 99.9969482421875 AXIS_PTS_REF ldpm_load_mis_ip_er_mv /end AXIS_DESCR
/end CHARACTERISTIC
/begin CHARACTERISTIC er_mv_mem[6] "Recorded mean value" MAP 0xd000e838 _REC_MAP_20_s2_u1_u2 65535. _CNV_A_R_LINEAR_____410_CM -32768. 32767. READ_ONLY DISPLAY_IDENTIFIER ER_MV_MEM[6] FORMAT "%6.0" MAX_REFRESH 4 100
 /begin AXIS_DESCR COM_AXIS n_32 _CNV_A_R_LINEAR_____10_CM 8 0. 8160. FORMAT "%4.0" AXIS_PTS_REF ldpm_n_32_ip_er_mv /end AXIS_DESCR
 /begin AXIS_DESCR COM_AXIS load_mis _CNV_A_R_LINEAR_____212_CM 3 0. 99.9969482421875 AXIS_PTS_REF ldpm_load_mis_ip_er_mv /end AXIS_DESCR
/end CHARACTERISTIC
/begin CHARACTERISTIC er_mv_mem[7] "Recorded mean value" MAP 0xd000e868 _REC_MAP_20_s2_u1_u2 65535. _CNV_A_R_LINEAR_____410_CM -32768. 32767. READ_ONLY DISPLAY_IDENTIFIER ER_MV_MEM[7] FORMAT "%6.0" MAX_REFRESH 4 100
 /begin AXIS_DESCR COM_AXIS n_32 _CNV_A_R_LINEAR_____10_CM 8 0. 8160. FORMAT "%4.0" AXIS_PTS_REF ldpm_n_32_ip_er_mv /end AXIS_DESCR
 /begin AXIS_DESCR COM_AXIS load_mis _CNV_A_R_LINEAR_____212_CM 3 0. 99.9969482421875 AXIS_PTS_REF ldpm_load_mis_ip_er_mv /end AXIS_DESCR
/end CHARACTERISTIC
/begin CHARACTERISTIC ip_thd_s_er_is_at_cc_close "ER threshold for misfire detection in S combustion mode & in idle speed, AT vehicle transmission type and converter clutch state closed" MAP 0xa0807904 _REC_MAP_20_u2_u2_u2 65535. _CNV_A_R_LINEAR_____411_CM -32768. 32767. DISPLAY_IDENTIFIER IP_THD_S_ER_IS_AT_CC_CLOSE FORMAT "%6.0"
 /begin AXIS_DESCR COM_AXIS n _CNV_A_R_LINEAR_____14_CM 4 0. 8160. FORMAT "%4.0" AXIS_PTS_REF ldp_n_ip_thd_s_er_is_at_close /end AXIS_DESCR
 /begin AXIS_DESCR COM_AXIS load_mis _CNV_A_R_LINEAR_____212_CM 6 0. 99.9969482421875 FORMAT "%7.3" AXIS_PTS_REF ldp_load_ip_s_er_is_at_close /end AXIS_DESCR
/end CHARACTERISTIC
/begin AXIS_PTS ldp_n_ip_thd_s_er_is_at_ctl "" 0xa08078cc n _REC_AXS_20_u2 8160. _CNV_A_R_LINEAR_____14_CM 4 0. 8160. FORMAT "%4.0" /end AXIS_PTS
/begin MEASUREMENT idx_n_32_ar "Index of working point used for ID_ER_MV given N_32" UBYTE _CNV_A_R_LINEAR_____0_CM 1 100. 0. 15. DISPLAY_IDENTIFIER IDX_N_32_AR ECU_ADDRESS 0xd00076bf FORMAT "%2.0" /end MEASUREMENT
/begin MEASUREMENT idx_load_mis_ar "Index of working point used for ID_ER_MV given LOAD_MIS" UBYTE _CNV_A_R_LINEAR_____0_CM 1 100. 0. 7. DISPLAY_IDENTIFIER IDX_LOAD_MIS_AR ECU_ADDRESS 0xd00076be FORMAT "%1.0" /end MEASUREMENT
/begin CHARACTERISTIC c_er_thd_ratio_fil_h "Filter gain for ER mean value calculation during transiants" VALUE 0xa080720f _REC_VAL_20_u1 6.0796737670755 _CNV_A_R_MISF_LINEA_414_CM 0. 6.0796737670755 DISPLAY_IDENTIFIER C_ER_THD_RATIO_FIL_H FORMAT "%6.5" /end CHARACTERISTIC
/begin MEASUREMENT er_fil "Filtered engine roughness" SLONG _CNV_A_R_MISF_LINEA_415_CM 1 100. -2000000. 1999999.7 DISPLAY_IDENTIFIER ER_FIL ECU_ADDRESS 0xd0006384 FORMAT "%13.5" /end MEASUREMENT
/begin AXIS_PTS ldp_n_ip_thd_s_er_is_at_close "" 0xa08078c0 n _REC_AXS_20_u2 8160. _CNV_A_R_LINEAR_____14_CM 4 0. 8160. FORMAT "%4.0" /end AXIS_PTS
/begin AXIS_PTS ldp_load_ip_thd_s_er_is_at_ctl "" 0xa0807834 load_mis _REC_AXS_20_u2 99.9969482421875 _CNV_A_R_LINEAR_____212_CM 6 0. 99.9969482421875 FORMAT "%7.3" /end AXIS_PTS
/begin AXIS_PTS ldp_load_ip_thd_s_er_is_at_close "" 0xa0807824 load_mis _REC_AXS_20_u2 99.9969482421875 _CNV_A_R_LINEAR_____212_CM 6 0. 99.9969482421875 FORMAT "%7.3" /end AXIS_PTS
/begin CHARACTERISTIC lc_er_mv_mem_tra "Used ER_MV_MEM value only after transition detection" VALUE 0xa0807218 _REC_VAL_20_u1 1. _CNV_A_R_LINEAR_____0_CM 0. 1. DISPLAY_IDENTIFIER LC_ER_MV_MEM_TRA FORMAT "%1.0" /end CHARACTERISTIC
/begin CHARACTERISTIC lc_er_mv_cyl_ad "Used ER_MV_MEM value only after transition detection" VALUE 0xa0807216 _REC_VAL_20_u1 1. _CNV_A_R_LINEAR_____0_CM 0. 1. DISPLAY_IDENTIFIER LC_ER_MV_CYL_AD FORMAT "%1.0" /end CHARACTERISTIC
/begin AXIS_PTS ldp_load_ip_s_er_is_at_close "" 0xa08077f4 load_mis _REC_AXS_20_u2 99.9969482421875 _CNV_A_R_LINEAR_____212_CM 6 0. 99.9969482421875 FORMAT "%7.3" /end AXIS_PTS
/begin CHARACTERISTIC ip_load_min_ofs_amp_hom_s_at "Extra load from zero load curve vs engine speed and atmospheric pressure in HOM_S with AT vehicle" MAP 0xa081269c _REC_MAP_20_u2_u1_u2 99.99694800000002 _CNV_A_R_MISF_LINEA_412_CM -50. 49.996948 DISPLAY_IDENTIFIER IP_LOAD_MIN_OFS_AMP_HOM_S_AT FORMAT "%7.3"
 /begin AXIS_DESCR COM_AXIS n_32 _CNV_A_R_LINEAR_____10_CM 6 0. 8160. FORMAT "%4.0" AXIS_PTS_REF ldp_n_32_ip_load_amp_mis_hom_s_at /end AXIS_DESCR
 /begin AXIS_DESCR COM_AXIS amp _CNV_A_R_LINEAR_____27_CM 7 0. 5434. FORMAT "%7.2" AXIS_PTS_REF ldp_amp_ip_load_amp_mis_hom_s_at /end AXIS_DESCR
/end CHARACTERISTIC
/begin CHARACTERISTIC ip_load_min_ofs_amp_hom_s_mt "Extra load from zero load curve vs engine speed and atmospheric pressure in HOM_S with MT vehicle" MAP 0xa08126f0 _REC_MAP_20_u2_u1_u2 99.99694800000002 _CNV_A_R_MISF_LINEA_412_CM -50. 49.996948 DISPLAY_IDENTIFIER IP_LOAD_MIN_OFS_AMP_HOM_S_MT FORMAT "%7.3"
 /begin AXIS_DESCR COM_AXIS n_32 _CNV_A_R_LINEAR_____10_CM 6 0. 8160. FORMAT "%4.0" AXIS_PTS_REF ldp_n_32_ip_load_amp_mis_hom_s_mt /end AXIS_DESCR
 /begin AXIS_DESCR COM_AXIS amp _CNV_A_R_LINEAR_____27_CM 7 0. 5434. FORMAT "%7.2" AXIS_PTS_REF ldp_amp_ip_load_amp_mis_hom_s_mt /end AXIS_DESCR
/end CHARACTERISTIC
/begin MEASUREMENT ctr_mis_tot_nvmy "Overall misfire detection counter" ULONG _CNV_A_R_LINEAR_____0_CM 1 100. 0. 4294967295. DISPLAY_IDENTIFIER CTR_MIS_TOT_NVMY ECU_ADDRESS 0xd00070e0 FORMAT "%10.0" /end MEASUREMENT
/begin MEASUREMENT ctr_mis_tot_dc "Former / current driving cycle overall misfire detection counter" UWORD _CNV_A_R_LINEAR_____0_CM 1 100. 0. 65535. DISPLAY_IDENTIFIER CTR_MIS_TOT_DC ECU_ADDRESS 0xd00070de FORMAT "%5.0" /end MEASUREMENT
/begin MEASUREMENT ctr_mis_dc_cyl[0] "Former / current driving cycle misfire detection cylinder counters (ISO15031 Data $0C) " UWORD _CNV_A_R_LINEAR_____0_CM 1 100. 0. 65535. DISPLAY_IDENTIFIER CTR_MIS_DC_CYL[0] ECU_ADDRESS 0xd00070bc FORMAT "%5.0" /end MEASUREMENT
/begin MEASUREMENT ctr_mis_dc_cyl[1] "Former / current driving cycle misfire detection cylinder counters (ISO15031 Data $0C) " UWORD _CNV_A_R_LINEAR_____0_CM 1 100. 0. 65535. DISPLAY_IDENTIFIER CTR_MIS_DC_CYL[1] ECU_ADDRESS 0xd00070be FORMAT "%5.0" /end MEASUREMENT
/begin MEASUREMENT ctr_mis_dc_cyl[2] "Former / current driving cycle misfire detection cylinder counters (ISO15031 Data $0C) " UWORD _CNV_A_R_LINEAR_____0_CM 1 100. 0. 65535. DISPLAY_IDENTIFIER CTR_MIS_DC_CYL[2] ECU_ADDRESS 0xd00070c0 FORMAT "%5.0" /end MEASUREMENT
/begin MEASUREMENT ctr_mis_dc_cyl[3] "Former / current driving cycle misfire detection cylinder counters (ISO15031 Data $0C) " UWORD _CNV_A_R_LINEAR_____0_CM 1 100. 0. 65535. DISPLAY_IDENTIFIER CTR_MIS_DC_CYL[3] ECU_ADDRESS 0xd00070c2 FORMAT "%5.0" /end MEASUREMENT
/begin MEASUREMENT ctr_mis_dc_cyl[4] "Former / current driving cycle misfire detection cylinder counters (ISO15031 Data $0C) " UWORD _CNV_A_R_LINEAR_____0_CM 1 100. 0. 65535. DISPLAY_IDENTIFIER CTR_MIS_DC_CYL[4] ECU_ADDRESS 0xd00070c4 FORMAT "%5.0" /end MEASUREMENT
/begin MEASUREMENT ctr_mis_dc_cyl[5] "Former / current driving cycle misfire detection cylinder counters (ISO15031 Data $0C) " UWORD _CNV_A_R_LINEAR_____0_CM 1 100. 0. 65535. DISPLAY_IDENTIFIER CTR_MIS_DC_CYL[5] ECU_ADDRESS 0xd00070c6 FORMAT "%5.0" /end MEASUREMENT
/begin MEASUREMENT ctr_mis_dc_cyl[6] "Former / current driving cycle misfire detection cylinder counters (ISO15031 Data $0C) " UWORD _CNV_A_R_LINEAR_____0_CM 1 100. 0. 65535. DISPLAY_IDENTIFIER CTR_MIS_DC_CYL[6] ECU_ADDRESS 0xd00070c8 FORMAT "%5.0" /end MEASUREMENT
/begin MEASUREMENT ctr_mis_dc_cyl[7] "Former / current driving cycle misfire detection cylinder counters (ISO15031 Data $0C) " UWORD _CNV_A_R_LINEAR_____0_CM 1 100. 0. 65535. DISPLAY_IDENTIFIER CTR_MIS_DC_CYL[7] ECU_ADDRESS 0xd00070ca FORMAT "%5.0" /end MEASUREMENT
/begin MEASUREMENT ctr_mis_dc_mmv_cyl[0] "Exponential weighted moving average (EWMA) misfire counters (ISO15031 Data $0B)" UWORD _CNV_A_R_LINEAR_____0_CM 1 100. 0. 65535. DISPLAY_IDENTIFIER CTR_MIS_DC_MMV_CYL[0] ECU_ADDRESS 0xd00070cc FORMAT "%5.0" /end MEASUREMENT
/begin MEASUREMENT ctr_mis_dc_mmv_cyl[1] "Exponential weighted moving average (EWMA) misfire counters (ISO15031 Data $0B)" UWORD _CNV_A_R_LINEAR_____0_CM 1 100. 0. 65535. DISPLAY_IDENTIFIER CTR_MIS_DC_MMV_CYL[1] ECU_ADDRESS 0xd00070ce FORMAT "%5.0" /end MEASUREMENT
/begin MEASUREMENT ctr_mis_dc_mmv_cyl[2] "Exponential weighted moving average (EWMA) misfire counters (ISO15031 Data $0B)" UWORD _CNV_A_R_LINEAR_____0_CM 1 100. 0. 65535. DISPLAY_IDENTIFIER CTR_MIS_DC_MMV_CYL[2] ECU_ADDRESS 0xd00070d0 FORMAT "%5.0" /end MEASUREMENT
/begin MEASUREMENT ctr_mis_dc_mmv_cyl[3] "Exponential weighted moving average (EWMA) misfire counters (ISO15031 Data $0B)" UWORD _CNV_A_R_LINEAR_____0_CM 1 100. 0. 65535. DISPLAY_IDENTIFIER CTR_MIS_DC_MMV_CYL[3] ECU_ADDRESS 0xd00070d2 FORMAT "%5.0" /end MEASUREMENT
/begin MEASUREMENT ctr_mis_dc_mmv_cyl[4] "Exponential weighted moving average (EWMA) misfire counters (ISO15031 Data $0B)" UWORD _CNV_A_R_LINEAR_____0_CM 1 100. 0. 65535. DISPLAY_IDENTIFIER CTR_MIS_DC_MMV_CYL[4] ECU_ADDRESS 0xd00070d4 FORMAT "%5.0" /end MEASUREMENT
/begin MEASUREMENT ctr_mis_dc_mmv_cyl[5] "Exponential weighted moving average (EWMA) misfire counters (ISO15031 Data $0B)" UWORD _CNV_A_R_LINEAR_____0_CM 1 100. 0. 65535. DISPLAY_IDENTIFIER CTR_MIS_DC_MMV_CYL[5] ECU_ADDRESS 0xd00070d6 FORMAT "%5.0" /end MEASUREMENT
/begin MEASUREMENT ctr_mis_dc_mmv_cyl[6] "Exponential weighted moving average (EWMA) misfire counters (ISO15031 Data $0B)" UWORD _CNV_A_R_LINEAR_____0_CM 1 100. 0. 65535. DISPLAY_IDENTIFIER CTR_MIS_DC_MMV_CYL[6] ECU_ADDRESS 0xd00070d8 FORMAT "%5.0" /end MEASUREMENT
/begin MEASUREMENT ctr_mis_dc_mmv_cyl[7] "Exponential weighted moving average (EWMA) misfire counters (ISO15031 Data $0B)" UWORD _CNV_A_R_LINEAR_____0_CM 1 100. 0. 65535. DISPLAY_IDENTIFIER CTR_MIS_DC_MMV_CYL[7] ECU_ADDRESS 0xd00070da FORMAT "%5.0" /end MEASUREMENT
/begin MEASUREMENT n_tooth_cus "fast engine speed generated especially for engine start (independently of C_N_FAST_SWI)" UWORD _CNV_A_R_LINEAR_____14_CM 1 100. 0. 8160. DISPLAY_IDENTIFIER N_TOOTH_CUS ECU_ADDRESS 0xd00066ac FORMAT "%4.0" /end MEASUREMENT
/begin MEASUREMENT lv_err_cam_cus "Customer specific CAM error" UBYTE _CNV_S_2_RANGE__0___1_CM 1 100. 0. 1. DISPLAY_IDENTIFIER LV_ERR_CAM_CUS ECU_ADDRESS 0xd00074cf BIT_MASK 0x1 /end MEASUREMENT
/begin MEASUREMENT lv_t_seg_5_tooth_vld "Flag: acquisition of partial segment times valid" UBYTE _CNV_S_2_RANGE__0___1_CM 1 100. 0. 1. DISPLAY_IDENTIFIER LV_T_SEG_5_TOOTH_VLD ECU_ADDRESS 0xd00074ea BIT_MASK 0x1 /end MEASUREMENT
/begin CHARACTERISTIC c_n_32_max_seg_5_tooth "Maximum engine speed for acquisition of partial segment time over 5 teeth" VALUE 0xa080259d _REC_VAL_20_u1 8160. _CNV_A_R_LINEAR_____10_CM 0. 8160. DISPLAY_IDENTIFIER C_N_32_MAX_SEG_5_TOOTH FORMAT "%4.0" /end CHARACTERISTIC
/begin COMPU_METHOD _CNV_A_R_LINEAR_____0_CM "" RAT_FUNC "%6.3" "-" COEFFS 0 1. 0. 0 0 1 /end COMPU_METHOD
/begin COMPU_METHOD _CNV_S_2_RANGE__0___1_CM "" TAB_VERB "%6.3" "-" COMPU_TAB_REF _CNV_S_2_RANGE__0___1 /end COMPU_METHOD
/begin COMPU_VTAB _CNV_S_2_RANGE__0___1 "" TAB_VERB 2 0 "0" 1 "1" /end COMPU_VTAB
/begin COMPU_METHOD _CNV_A_R_LINEAR_____3_CM "" RAT_FUNC "%6.3" "s" COEFFS 0 100. 0. 0 0 1 /end COMPU_METHOD
/begin COMPU_METHOD _CNV_A_R_LINEAR_____10_CM "" RAT_FUNC "%6.3" "rpm" COEFFS 0 3.125e-002 0. 0 0 1 /end COMPU_METHOD
/begin COMPU_METHOD _CNV_A_R_LINEAR_____14_CM "" RAT_FUNC "%6.3" "rpm" COEFFS 0 1. 0. 0 0 1 /end COMPU_METHOD
/begin COMPU_METHOD _CNV_A_R_LINEAR_____17_CM "" RAT_FUNC "%6.3" "°C" COEFFS 0 1.333333333333333 64. 0 0 1 /end COMPU_METHOD
/begin COMPU_METHOD _CNV_A_R_LINEAR_____27_CM "" RAT_FUNC "%6.3" "hPa" COEFFS 0 12.06017666543982 0. 0 0 1 /end COMPU_METHOD
/begin COMPU_METHOD _CNV_A_R_LINEAR_____28_CM "" RAT_FUNC "%6.3" "-" COEFFS 0 256. 0. 0 0 1 /end COMPU_METHOD
/begin COMPU_METHOD _CNV_A_R_LINEAR_____30_CM "" RAT_FUNC "%6.3" "rpm/s" COEFFS 0 3.125e-002 0. 0 0 1 /end COMPU_METHOD
/begin COMPU_METHOD _CNV_A_R_LINEAR_____50_CM "" RAT_FUNC "%6.3" "" COEFFS 0 1. 0. 0 0 1 /end COMPU_METHOD
/begin COMPU_METHOD _CNV_A_R_LINEAR_____87_CM "" RAT_FUNC "%6.3" "Nm" COEFFS 0 32. 32768. 0 0 1 /end COMPU_METHOD
/begin COMPU_METHOD _CNV_A_R_LINEAR_____89_CM "" RAT_FUNC "%6.3" "-" COEFFS 0 65535.99999999996 0. 0 0 1 /end COMPU_METHOD
/begin COMPU_METHOD _CNV_A_R_LINEAR_____165_CM "" RAT_FUNC "%6.3" "-" COEFFS 0 65535. 0. 0 0 1 /end COMPU_METHOD
/begin COMPU_METHOD _CNV_A_R_LINEAR_____188_CM "" RAT_FUNC "%6.3" "°CRK" COEFFS 0 16. 0. 0 0 1 /end COMPU_METHOD
/begin COMPU_METHOD _CNV_A_R_LINEAR_____190_CM "" RAT_FUNC "%6.3" "°CRK" COEFFS 0 2.666666666666667 95. 0 0 1 /end COMPU_METHOD
/begin COMPU_METHOD _CNV_A_R_LINEAR_____198_CM "" RAT_FUNC "%6.3" "°CRK" COEFFS 0 2.666666666666667 128. 0 0 1 /end COMPU_METHOD
/begin COMPU_METHOD _CNV_A_R_LINEAR_____200_CM "" RAT_FUNC "%6.3" "°CRK" COEFFS 0 2.666666666666667 0. 0 0 1 /end COMPU_METHOD
/begin COMPU_METHOD _CNV_A_R_LINEAR_____212_CM "" RAT_FUNC "%6.3" "%" COEFFS 0 327.68 0. 0 0 1 /end COMPU_METHOD
/begin COMPU_METHOD _CNV_A_R_EVAC_LINEA_298_CM "" RAT_FUNC "%6.3" "-" COEFFS 0 16. 0. 0 0 1 /end COMPU_METHOD
/begin COMPU_METHOD _CNV_A_R_LINEAR_____385_CM "" RAT_FUNC "%6.3" "s" COEFFS 0 4201656.398697721 0. 0 0 1 /end COMPU_METHOD
/begin COMPU_METHOD _CNV_A_R_ENRD_LINEA_389_CM "" RAT_FUNC "%6.3" "-" COEFFS 0 255. 0. 0 0 1 /end COMPU_METHOD
/begin COMPU_METHOD _CNV_A_R_ENSD_LINEA_391_CM "" RAT_FUNC "%6.3" "rpm/s" COEFFS 0 1. 0. 0 0 1 /end COMPU_METHOD
/begin COMPU_METHOD _CNV_A_R_LINEAR_____392_CM "" RAT_FUNC "%6.3" "s" COEFFS 0 250000. 0. 0 0 1 /end COMPU_METHOD
/begin COMPU_METHOD _CNV_A_R_ENSD_LINEA_393_CM "" RAT_FUNC "%6.3" "°CRK" COEFFS 0 16. 512. 0 0 1 /end COMPU_METHOD
/begin COMPU_METHOD _CNV_A_R_ENSD_LINEA_394_CM "" RAT_FUNC "%6.3" "°CRK" COEFFS 0 16. 2048. 0 0 1 /end COMPU_METHOD
/begin COMPU_METHOD _CNV_A_R_LINEAR_____395_CM "" RAT_FUNC "%6.3" "°CRK" COEFFS 0 2.666666666666667 256. 0 0 1 /end COMPU_METHOD
/begin COMPU_METHOD _CNV_A_R_ENSD_LINEA_396_CM "" RAT_FUNC "%6.3" "°CRK" COEFFS 0 16. 768. 0 0 1 /end COMPU_METHOD
/begin COMPU_METHOD _CNV_A_R_LINEAR_____397_CM "" RAT_FUNC "%6.3" "-" COEFFS 0 1. -1. 0 0 1 /end COMPU_METHOD
/begin COMPU_METHOD _CNV_A_R_ENSD_LINEA_398_CM "" RAT_FUNC "%6.3" "s" COEFFS 0 4201678.146825826 0. 0 0 1 /end COMPU_METHOD
/begin COMPU_METHOD _CNV_A_R_ENSD_LINEA_399_CM "" RAT_FUNC "%6.3" "°C" COEFFS 0 1. 50. 0 0 1 /end COMPU_METHOD
/begin COMPU_METHOD _CNV_A_R_ENSD_LINEA_400_CM "" RAT_FUNC "%6.3" "V" COEFFS 0 8.854166666666666 0. 0 0 1 /end COMPU_METHOD
/begin COMPU_METHOD _CNV_A_R_LINEAR_____410_CM "" RAT_FUNC "%6.3" "µs" COEFFS 0 1. 0. 0 0 1 /end COMPU_METHOD
/begin COMPU_METHOD _CNV_A_R_LINEAR_____411_CM "" RAT_FUNC "%6.3" "-" COEFFS 0 1. 32768. 0 0 1 /end COMPU_METHOD
/begin COMPU_METHOD _CNV_A_R_MISF_LINEA_412_CM "" RAT_FUNC "%6.3" "%" COEFFS 0 327.6800007936242 16384.00003968121 0 0 1 /end COMPU_METHOD
/begin COMPU_METHOD _CNV_A_R_LINEAR_____413_CM "" RAT_FUNC "%6.3" "µs" COEFFS 0 1. 32768. 0 0 1 /end COMPU_METHOD
/begin COMPU_METHOD _CNV_A_R_MISF_LINEA_414_CM "" RAT_FUNC "%6.3" "-" COEFFS 0 41.94304000009896 0. 0 0 1 /end COMPU_METHOD
/begin COMPU_METHOD _CNV_A_R_MISF_LINEA_415_CM "" RAT_FUNC "%6.3" "µs" COEFFS 0 4.194304064572805 0.1291456092149019 0 0 1 /end COMPU_METHOD
/begin RECORD_LAYOUT _REC_VAL_20_u1 FNC_VALUES 1 UBYTE COLUMN_DIR DIRECT /end RECORD_LAYOUT
/begin RECORD_LAYOUT _REC_VAL_20_u2 FNC_VALUES 1 UWORD COLUMN_DIR DIRECT /end RECORD_LAYOUT
/begin RECORD_LAYOUT _REC_AXS_20_u1 NO_AXIS_PTS_X 1 UBYTE AXIS_PTS_X 2 UBYTE INDEX_INCR DIRECT /end RECORD_LAYOUT
/begin RECORD_LAYOUT _REC_MAP_20_u2_u1_u1 FNC_VALUES 1 UWORD COLUMN_DIR DIRECT /end RECORD_LAYOUT
/begin RECORD_LAYOUT _REC_CUR_20_u1_u1 FNC_VALUES 1 UBYTE COLUMN_DIR DIRECT /end RECORD_LAYOUT
/begin RECORD_LAYOUT _REC_MAP_20_u2_u2_u1 FNC_VALUES 1 UWORD COLUMN_DIR DIRECT /end RECORD_LAYOUT
/begin RECORD_LAYOUT _REC_AXS_20_u2 NO_AXIS_PTS_X 1 UWORD AXIS_PTS_X 2 UWORD INDEX_INCR DIRECT /end RECORD_LAYOUT
/begin RECORD_LAYOUT _REC_CUR_20_u2_u1 FNC_VALUES 1 UWORD COLUMN_DIR DIRECT /end RECORD_LAYOUT
/begin RECORD_LAYOUT _REC_CUR_20_u2_u2 FNC_VALUES 1 UWORD COLUMN_DIR DIRECT /end RECORD_LAYOUT
/begin RECORD_LAYOUT _REC_MAP_20_u2_u2_u2 FNC_VALUES 1 UWORD COLUMN_DIR DIRECT /end RECORD_LAYOUT
/begin RECORD_LAYOUT _REC_MAP_20_u2_u1_u2 FNC_VALUES 1 UWORD COLUMN_DIR DIRECT /end RECORD_LAYOUT
/begin RECORD_LAYOUT _REC_VAL_20_u4 FNC_VALUES 1 ULONG COLUMN_DIR DIRECT /end RECORD_LAYOUT
/begin RECORD_LAYOUT _REC_MAP_20_u1_u1_u2 FNC_VALUES 1 UBYTE COLUMN_DIR DIRECT /end RECORD_LAYOUT
/begin RECORD_LAYOUT _REC_MAP_20_s2_u1_u2 FNC_VALUES 1 SWORD COLUMN_DIR DIRECT /end RECORD_LAYOUT
/begin FUNCTION ENSD_Engine_pos_speed_calc "Engine_pos_speed_calc"
 /begin DEF_CHARACTERISTIC ldp_n_32_id_crk_pha_cor c_n_tooth_end c_n_fast_swi c_fac_n_fast id_crk_pha_cor c_n_32_max_seg_5_tooth /end DEF_CHARACTERISTIC
 /begin OUT_MEASUREMENT n_grd_h_res n_mmv n_grd seg_ctr psn_eng_syn_min psn_eng_syn_max n_32 n_tooth t_seg_half_av t_crk_win seg_nr n n_fast t_seg_av id_seg_nr[0] id_seg_nr[1] id_seg_nr[2] id_seg_nr[3] id_seg_nr[4] id_seg_nr[5] id_seg_nr[6] id_seg_nr[7] n_tooth_cus lv_err_cam_cus lv_t_seg_5_tooth_vld /end OUT_MEASUREMENT
/end FUNCTION
/begin FUNCTION ENSD_Camshaft_adaptation "Camshaft_adaptation"
 /begin DEF_CHARACTERISTIC c_grd_ad_max_cam_in c_grd_ad_max_cam_ex c_grd_ad_ref_max_cam_in c_grd_ad_ref_max_cam_ex c_crlc_ad_cam_in c_crlc_ad_cam_ex c_crlc_ad_ref_cam_ex c_crlc_ad_ref_cam_in c_nr_rev_ad_ref_cam_ex c_nr_rev_ad_ref_cam_in ldp_n_32_id_cam_pha_cor id_cam_pha_cor c_tol_tooth_off_cam_in c_tol_tooth_off_cam_ex /end DEF_CHARACTERISTIC
 /begin OUT_MEASUREMENT idx_psn_edge_ad_cam_ex_1[0] idx_psn_edge_ad_cam_ex_1[1] idx_psn_edge_ad_cam_ex_1[2] idx_psn_edge_ad_cam_ex_1[3] idx_psn_edge_ad_cam_ex_1[4] idx_psn_edge_ad_cam_ex_1[5] idx_psn_edge_ad_cam_ex_1[6] idx_psn_edge_ad_cam_ex_1[7] idx_psn_edge_ad_cam_ex_2[0] idx_psn_edge_ad_cam_ex_2[1] idx_psn_edge_ad_cam_ex_2[2] idx_psn_edge_ad_cam_ex_2[3] idx_psn_edge_ad_cam_ex_2[4] idx_psn_edge_ad_cam_ex_2[5] idx_psn_edge_ad_cam_ex_2[6] idx_psn_edge_ad_cam_ex_2[7] idx_psn_edge_ad_cam_in_1[0] idx_psn_edge_ad_cam_in_1[1] idx_psn_edge_ad_cam_in_1[2] idx_psn_edge_ad_cam_in_1[3] idx_psn_edge_ad_cam_in_1[4] idx_psn_edge_ad_cam_in_1[5] idx_psn_edge_ad_cam_in_1[6] idx_psn_edge_ad_cam_in_1[7] idx_psn_edge_ad_cam_in_2[0] idx_psn_edge_ad_cam_in_2[1] idx_psn_edge_ad_cam_in_2[2] idx_psn_edge_ad_cam_in_2[3] idx_psn_edge_ad_cam_in_2[4] idx_psn_edge_ad_cam_in_2[5] idx_psn_edge_ad_cam_in_2[6] idx_psn_edge_ad_cam_in_2[7] idx_psn_edge_cam_ex_1[0] idx_psn_edge_cam_ex_1[1] idx_psn_edge_cam_ex_1[2] idx_psn_edge_cam_ex_1[3] idx_psn_edge_cam_ex_1[4] idx_psn_edge_cam_ex_1[5] idx_psn_edge_cam_ex_1[6] idx_psn_edge_cam_ex_1[7] idx_psn_edge_cam_ex_2[0] idx_psn_edge_cam_ex_2[1] idx_psn_edge_cam_ex_2[2] idx_psn_edge_cam_ex_2[3] idx_psn_edge_cam_ex_2[4] idx_psn_edge_cam_ex_2[5] idx_psn_edge_cam_ex_2[6] idx_psn_edge_cam_ex_2[7] idx_psn_edge_cam_in_1[0] idx_psn_edge_cam_in_1[1] idx_psn_edge_cam_in_1[2] idx_psn_edge_cam_in_1[3] idx_psn_edge_cam_in_1[4] idx_psn_edge_cam_in_1[5] idx_psn_edge_cam_in_1[6] idx_psn_edge_cam_in_1[7] idx_cam_ad_ex[0].psn_ad_cam idx_cam_ad_ex[0].ctr_rev_ad_ref_cam idx_cam_ad_ex[0].psn_cam idx_cam_ad_ex[0].psn_dif_edge_cam idx_cam_ad_ex[0].psn_edge_cam_old idx_cam_ad_ex[0].ptr_psn_edge_cam idx_cam_ad_ex[0].ptr_psn_edge_ad_cam idx_cam_ad_ex[0].t_dif_edge_cam idx_cam_ad_ex[0].lv_ad_end_cam idx_cam_ad_ex[0].lv_tooth_off_det_ena idx_cam_ad_ex[0].lv_cam_ad_save idx_cam_ad_ex[0].cam_psn_lst_ref_ad idx_cam_ad_ex[1].psn_ad_cam idx_cam_ad_ex[1].ctr_rev_ad_ref_cam idx_cam_ad_ex[1].psn_cam idx_cam_ad_ex[1].psn_dif_edge_cam idx_cam_ad_ex[1].psn_edge_cam_old idx_cam_ad_ex[1].ptr_psn_edge_cam idx_cam_ad_ex[1].ptr_psn_edge_ad_cam idx_cam_ad_ex[1].t_dif_edge_cam idx_cam_ad_ex[1].lv_ad_end_cam idx_cam_ad_ex[1].lv_tooth_off_det_ena idx_cam_ad_ex[1].lv_cam_ad_save idx_cam_ad_ex[1].cam_psn_lst_ref_ad idx_cam_ad_in[0].psn_ad_cam idx_cam_ad_in[0].ctr_rev_ad_ref_cam idx_cam_ad_in[0].psn_cam idx_cam_ad_in[0].psn_dif_edge_cam idx_cam_ad_in[0].psn_edge_cam_old idx_cam_ad_in[0].ptr_psn_edge_cam idx_cam_ad_in[0].ptr_psn_edge_ad_cam idx_cam_ad_in[0].t_dif_edge_cam idx_cam_ad_in[0].lv_ad_end_cam idx_cam_ad_in[0].lv_tooth_off_det_ena idx_cam_ad_in[0].lv_cam_ad_save idx_cam_ad_in[0].cam_psn_lst_ref_ad idx_cam_ad_in[1].psn_ad_cam idx_cam_ad_in[1].ctr_rev_ad_ref_cam idx_cam_ad_in[1].psn_cam idx_cam_ad_in[1].psn_dif_edge_cam idx_cam_ad_in[1].psn_edge_cam_old idx_cam_ad_in[1].ptr_psn_edge_cam idx_cam_ad_in[1].ptr_psn_edge_ad_cam idx_cam_ad_in[1].t_dif_edge_cam idx_cam_ad_in[1].lv_ad_end_cam idx_cam_ad_in[1].lv_tooth_off_det_ena idx_cam_ad_in[1].lv_cam_ad_save idx_cam_ad_in[1].cam_psn_lst_ref_ad idx_psn_edge_cam_in_2[0] idx_psn_edge_cam_in_2[1] idx_psn_edge_cam_in_2[2] idx_psn_edge_cam_in_2[3] idx_psn_edge_cam_in_2[4] idx_psn_edge_cam_in_2[5] idx_psn_edge_cam_in_2[6] idx_psn_edge_cam_in_2[7] /end OUT_MEASUREMENT
/end FUNCTION
/begin FUNCTION ENSD_Synchro_det_in_Cam_LH "" /begin OUT_MEASUREMENT lv_cam_lih_ext_ena lv_seg_nr_upd_req lv_syn_vld_cam_lih /end OUT_MEASUREMENT /end FUNCTION
/begin FUNCTION C_A_ENSD "C_A_ENSD"
 /begin SUB_FUNCTION ENSD_Eng_pos_speed_diag_manager ENSD_Camshaft_pos_diagnosis ENSD_Camshaft_sensor_diagnosis ENSD_Crank_sensor_diagnosis ENSD_Crank_sensor_plaus_diag ENSD_Crank_sensor_circuit_diag ENSD_Cam_sensor_diag_Appl_inc ENSD_Crank_sensor_diag_Appl_inc /end SUB_FUNCTION
/end FUNCTION
/begin FUNCTION ENSD_Eng_pos_speed_diag_manager "Eng_pos_speed_diag_manager"
 /begin DEF_CHARACTERISTIC c_t_dly_rest_igk c_t_dly_rest_stall c_n_not_rest lc_eng_back_inh c_t_min_inh_diag_ensd c_t_max_inh_diag_ensd /end DEF_CHARACTERISTIC
 /begin OUT_MEASUREMENT lv_err_cam_tot lv_err_crk lv_inh_diag_crk_syn lv_inh_diag_crk_tooth lv_inh_diag_crk_tooth_per lv_inh_diag_crk_plaus lv_inh_diag_crk_oc lv_inh_diag_ensd idx_diag_mng_ex[0].lv_err_cam idx_diag_mng_ex[0].lv_inh_diag_syn_cam idx_diag_mng_ex[0].lv_inh_diag_per_cam idx_diag_mng_ex[0].lv_inh_diag_plaus_cam idx_diag_mng_ex[0].lv_inh_diag_ref_crk_cam idx_diag_mng_ex[0].lv_inh_diag_tooth_off idx_diag_mng_ex[0].lv_inh_diag_syn_crk_cam idx_diag_mng_ex[1].lv_err_cam idx_diag_mng_ex[1].lv_inh_diag_syn_cam idx_diag_mng_ex[1].lv_inh_diag_per_cam idx_diag_mng_ex[1].lv_inh_diag_plaus_cam idx_diag_mng_ex[1].lv_inh_diag_ref_crk_cam idx_diag_mng_ex[1].lv_inh_diag_tooth_off idx_diag_mng_ex[1].lv_inh_diag_syn_crk_cam idx_diag_mng_in[0].lv_err_cam idx_diag_mng_in[0].lv_inh_diag_syn_cam idx_diag_mng_in[0].lv_inh_diag_per_cam idx_diag_mng_in[0].lv_inh_diag_plaus_cam idx_diag_mng_in[0].lv_inh_diag_ref_crk_cam idx_diag_mng_in[0].lv_inh_diag_tooth_off idx_diag_mng_in[0].lv_inh_diag_syn_crk_cam idx_diag_mng_in[1].lv_err_cam idx_diag_mng_in[1].lv_inh_diag_syn_cam idx_diag_mng_in[1].lv_inh_diag_per_cam idx_diag_mng_in[1].lv_inh_diag_plaus_cam idx_diag_mng_in[1].lv_inh_diag_ref_crk_cam idx_diag_mng_in[1].lv_inh_diag_tooth_off idx_diag_mng_in[1].lv_inh_diag_syn_crk_cam lv_ign_inj_lock_req /end OUT_MEASUREMENT
/end FUNCTION
/begin FUNCTION ENSD_Camshaft_pos_diagnosis "Camshaft_position_diagnosis" /begin DEF_CHARACTERISTIC c_tol_ref_crk_cam_in c_tol_ref_crk_cam_ex /end DEF_CHARACTERISTIC
 /begin OUT_MEASUREMENT lv_err_ref_crk_cam_ex_2 lv_err_ref_crk_cam_in_1 lv_err_ref_crk_cam_in_2 lv_err_ref_crk_cam_ex_1 lv_err_tooth_off_in_2 lv_err_tooth_off_in_1 lv_err_tooth_off_ex_1 lv_err_tooth_off_ex_2 /end OUT_MEASUREMENT
/end FUNCTION
/begin FUNCTION ENSD_Camshaft_sensor_diagnosis "Camshaft_sensor_diagnosis"
 /begin OUT_MEASUREMENT lv_err_per_cam_ex_1 lv_err_per_cam_ex_2 lv_err_per_cam_in_1 lv_err_per_cam_in_2 lv_err_syn_cam_ex_1 lv_err_syn_cam_ex_2 lv_err_syn_cam_in_1 lv_err_syn_cam_in_2 /end OUT_MEASUREMENT
/end FUNCTION
/begin FUNCTION ENSD_Crank_sensor_diagnosis "Crankshaft_sensor_diagnosis" /begin DEF_CHARACTERISTIC c_n_32_max_diag_crk_tooth /end DEF_CHARACTERISTIC
 /begin OUT_MEASUREMENT lv_inh_mis_crk lv_err_crk_tooth lv_err_crk_tooth_per lv_err_crk_syn /end OUT_MEASUREMENT
/end FUNCTION
/begin FUNCTION ENSD_Crank_sensor_plaus_diag "Crank_sensor_plaus_diag"
 /begin DEF_CHARACTERISTIC c_nr_edge_cam_ex_syn_crk_max c_nr_edge_cam_in_syn_crk_max c_nr_cyc_eng_plaus_cam_max c_ctr_orng_cam_syn_crk_max lc_cam_err_ena_vvt lc_ctr_dec_plaus_cam /end DEF_CHARACTERISTIC
 /begin OUT_MEASUREMENT lv_err_crk_plaus lv_err_plaus_cam_in_2 lv_err_plaus_cam_ex_1 lv_err_plaus_cam_ex_2 lv_err_plaus_cam_in_1 ctr_cyc_eng_plaus_cam_ex_1 ctr_cyc_eng_plaus_cam_ex_2 ctr_cyc_eng_plaus_cam_in_1 ctr_cyc_eng_plaus_cam_in_2 lv_err_syn_crk_cam_ex_1 lv_err_syn_crk_cam_ex_2 lv_err_syn_crk_cam_in_1 lv_err_syn_crk_cam_in_2 ctr_orng_cam_syn_crk /end OUT_MEASUREMENT
/end FUNCTION
/begin FUNCTION ENSD_Crank_sensor_circuit_diag "Crank_sensor_circuit_diag" /end FUNCTION
/begin FUNCTION ENSD_Cam_sensor_diag_Appl_inc "Camshaft sensor diagnosis ( appl.inci )"
 /begin DEF_CHARACTERISTIC c_abc_inc_diag_ref_crk_cam_in c_abc_inc_diag_ref_crk_cam_ex c_abc_max_diag_ref_crk_cam_in c_abc_max_diag_ref_crk_cam_ex c_abc_inc_diag_per_cam_in c_abc_max_diag_per_cam_in c_abc_inc_diag_syn_cam_ex c_abc_inc_diag_syn_cam_in c_abc_max_diag_syn_cam_ex c_abc_max_diag_syn_cam_in c_abc_inc_diag_per_cam_ex c_abc_inc_diag_tooth_off_in c_abc_inc_diag_tooth_off_ex c_abc_max_diag_per_cam_ex c_abc_max_diag_tooth_off_in c_abc_max_diag_tooth_off_ex /end DEF_CHARACTERISTIC
 /begin OUT_MEASUREMENT lv_inh_diag_ext_ref_crk_cam_in[0] lv_inh_diag_ext_ref_crk_cam_in[1] lv_inh_diag_ext_syn_cam_in[0] lv_inh_diag_ext_syn_cam_in[1] lv_inh_diag_ext_syn_cam_ex[0] lv_inh_diag_ext_syn_cam_ex[1] lv_inh_diag_ext_per_cam_in[0] lv_inh_diag_ext_per_cam_in[1] lv_inh_diag_ext_plaus_cam_ex[0] lv_inh_diag_ext_plaus_cam_ex[1] lv_inh_diag_ext_plaus_cam_in[0] lv_inh_diag_ext_plaus_cam_in[1] lv_inh_diag_ext_ref_crk_cam_ex[0] lv_inh_diag_ext_ref_crk_cam_ex[1] lv_inh_diag_ext_syn_crk_cam_ex[0] lv_inh_diag_ext_syn_crk_cam_ex[1] lv_inh_diag_ext_syn_crk_cam_in[0] lv_inh_diag_ext_syn_crk_cam_in[1] lv_inh_diag_ext_per_cam_ex[0] lv_inh_diag_ext_per_cam_ex[1] lv_inh_diag_ext_tooth_off_ex[0] lv_inh_diag_ext_tooth_off_ex[1] lv_inh_diag_ext_tooth_off_in[0] lv_inh_diag_ext_tooth_off_in[1] state_rbm_ref_crk_cam_in[0] state_rbm_ref_crk_cam_in[1] state_rbm_ref_crk_cam_ex[0] state_rbm_ref_crk_cam_ex[1] state_rbm_tooth_off_in[0] state_rbm_tooth_off_in[1] state_rbm_tooth_off_ex[0] state_rbm_tooth_off_ex[1] /end OUT_MEASUREMENT
/end FUNCTION
/begin FUNCTION ENSD_Crank_sensor_diag_Appl_inc "Crankshaft sensor diagnosis ( Appli.inc )"
 /begin DEF_CHARACTERISTIC c_abc_inc_diag_crk_tooth_per c_abc_inc_diag_crk_tooth c_abc_max_diag_crk_tooth c_abc_max_diag_crk_tooth_per c_abc_max_diag_crk_syn c_abc_inc_diag_crk_syn c_abc_inc_diag_crk_oc c_abc_max_diag_crk_oc /end DEF_CHARACTERISTIC
 /begin OUT_MEASUREMENT lv_inh_diag_ext_crk_tooth lv_inh_diag_ext_crk_tooth_per lv_inh_diag_ext_crk_syn lv_inh_diag_ext_crk_oc lv_inh_diag_ext_crk_plaus /end OUT_MEASUREMENT
/end FUNCTION
/begin FUNCTION C_2_ENSD "C_2_ENSD" /begin SUB_FUNCTION ENSD_Acq_crankshaft_signal ENSD_Acq_camshaft_signal /end SUB_FUNCTION /end FUNCTION
/begin FUNCTION ENSD_Acq_crankshaft_signal "Acq_crankshaft_signal" /begin DEF_CHARACTERISTIC c_t_crk_dly id_fac_tol_crk_tooth /end DEF_CHARACTERISTIC
 /begin OUT_MEASUREMENT lv_orng_tooth_per_crk lv_orng_nr_tooth_crk lv_lost_syn_crk lv_crk_syn t_crk_win_ensd t_seg_er lv_crk_miss_tooth /end OUT_MEASUREMENT
/end FUNCTION
/begin FUNCTION ENSD_Acq_camshaft_signal "Acq_camshaft_signal"
 /begin DEF_CHARACTERISTIC c_dyw_cam_crk_syn_adc_ex c_dyw_cam_crk_syn_rtd_ex c_dyw_cam_crk_syn_rtd_in c_dyw_cam_syn_ex c_dyw_cam_syn_in c_crk_ang_dly c_dyw_cam_crk_syn_adc_in id_fac_cam_ex id_fac_cam_in c_nr_edge_min_vld_cam_ex c_nr_edge_min_vld_cam_in c_cam_adj_vvt_syn_in c_cam_adj_vvt_syn_ex c_cam_adj_vvt_syn_crk_adc_in c_cam_adj_vvt_syn_crk_rtd_ex c_crk_ang_dly_lst_cam lc_cam_swi_conf /end DEF_CHARACTERISTIC
 /begin OUT_MEASUREMENT lv_cam_syn_crk lv_orng_cam_syn_crk idx_cam_acq_ex[0].idx_edge_cam idx_cam_acq_ex[0].ctr_edge_cam idx_cam_acq_ex[0].lv_vld_psn_cam idx_cam_acq_ex[0].lv_syn_cam idx_cam_acq_ex[0].lv_orng_per_cam idx_cam_acq_ex[0].lv_orng_ratio_cam idx_cam_acq_ex[0].psn_eng_cam idx_cam_acq_ex[0].t_seg_cam idx_cam_acq_ex[1].idx_edge_cam idx_cam_acq_ex[1].ctr_edge_cam idx_cam_acq_ex[1].lv_vld_psn_cam idx_cam_acq_ex[1].lv_syn_cam idx_cam_acq_ex[1].lv_orng_per_cam idx_cam_acq_ex[1].lv_orng_ratio_cam idx_cam_acq_ex[1].psn_eng_cam idx_cam_acq_ex[1].t_seg_cam idx_cam_acq_in[0].idx_edge_cam idx_cam_acq_in[0].ctr_edge_cam idx_cam_acq_in[0].lv_vld_psn_cam idx_cam_acq_in[0].lv_syn_cam idx_cam_acq_in[0].lv_orng_per_cam idx_cam_acq_in[0].lv_orng_ratio_cam idx_cam_acq_in[0].psn_eng_cam idx_cam_acq_in[0].t_seg_cam idx_cam_acq_in[1].idx_edge_cam idx_cam_acq_in[1].ctr_edge_cam idx_cam_acq_in[1].lv_vld_psn_cam idx_cam_acq_in[1].lv_syn_cam idx_cam_acq_in[1].lv_orng_per_cam idx_cam_acq_in[1].lv_orng_ratio_cam idx_cam_acq_in[1].psn_eng_cam idx_cam_acq_in[1].t_seg_cam /end OUT_MEASUREMENT
/end FUNCTION
/begin FUNCTION C_1_ENSD "" /begin SUB_FUNCTION ENSD_Interface_adaptation /end SUB_FUNCTION /end FUNCTION
/begin FUNCTION ENSD_Interface_adaptation "" /begin OUT_MEASUREMENT tco_cmn vb_cmn /end OUT_MEASUREMENT /end FUNCTION
/begin FUNCTION C_B_MISF ""
 /begin SUB_FUNCTION MISF__Misfire_Detection MISF__Misf_Detect_Appli_Inci MISF__Gen_Misf_Param_Fdout_Cnd MISF__Lgal_Misf_Detect_Fdout_Cnd MISF__Misf_Rate_Det_ERRM MISF__Misf_Rate_Det_ERRM_Inci MISF__Crankshaft_Oscil_Detect MISF__Rough_Road_Inter_For_Misf /end SUB_FUNCTION
/end FUNCTION
/begin FUNCTION MISF__Misfire_Detection ""
 /begin DEF_CHARACTERISTIC ldp_tco_ip_fac_thd_tco_er ldp_n_32_ip_fac_thd_iv_er ldp_n_32_ip_fac_thd_iv_s_er lc_mis_inh ip_fac_thd_tco_er ip_fac_thd_iv_er ip_fac_thd_iv_s_er ldp_amp_ip_load_amp_mis_afs_at /end DEF_CHARACTERISTIC
 /begin OUT_MEASUREMENT lv_puc_det_mis mis_state_er lv_det_mis thd_er thd_er_cyl[0] thd_er_cyl[1] thd_er_cyl[2] thd_er_cyl[3] thd_er_cyl[4] thd_er_cyl[5] thd_er_cyl[6] thd_er_cyl[7] lv_det_thd_mis thd_er_buf[0] thd_er_buf[1] thd_er_buf[2] thd_er_buf[3] thd_er_buf[4] thd_er_buf[5] lv_inh_det_mis mis_det_cyl_inh fac_thd_er ctr_mis_tot_nvmy ctr_mis_tot_dc ctr_mis_dc_cyl[0] ctr_mis_dc_cyl[1] ctr_mis_dc_cyl[2] ctr_mis_dc_cyl[3] ctr_mis_dc_cyl[4] ctr_mis_dc_cyl[5] ctr_mis_dc_cyl[6] ctr_mis_dc_cyl[7] ctr_mis_dc_mmv_cyl[0] ctr_mis_dc_mmv_cyl[1] ctr_mis_dc_mmv_cyl[2] ctr_mis_dc_mmv_cyl[3] ctr_mis_dc_mmv_cyl[4] ctr_mis_dc_mmv_cyl[5] ctr_mis_dc_mmv_cyl[6] ctr_mis_dc_mmv_cyl[7] /end OUT_MEASUREMENT
/end FUNCTION
/begin FUNCTION MISF__Misf_Detect_Appli_Inci ""
 /begin DEF_CHARACTERISTIC lc_ftl_l_det_mis lc_ftl_l_diag_mis c_n_thd_mis_inh c_t_amt_gs_dly_mis ip_fac_thd_er_ch ldp_tq_add_ch_fac_thd_er_ch lc_use_ivvt_inh_mis ip_thd_afs_er_is_mt ip_thd_afs_er_mt ip_thd_hom_s_er_mt ip_thd_s_er_mt ldp_load_ip_thd_afs_er_is_mt ldp_n_ip_thd_afs_er_mt ldp_load_mis_ip_thd_afs_er_mt ldp_n_ip_thd_afs_er_is_mt ldp_load_mis_ip_thd_hom_s_er_mt ldp_load_mis_ip_thd_s_er_mt ldp_n_ip_thd_hom_s_er_mt ldp_n_ip_thd_s_er_mt c_n_32_max_is_mis c_thd_er_clc_grd ip_load_min_mis_afs_at ldp_tco_ip_load_min_mis_afs_at ldp_n_ip_load_min_mis_afs_at ip_load_min_mis_afs_mt ldp_tco_ip_load_min_mis_afs_mt ldp_n_ip_load_min_mis_afs_mt ip_load_grd_mis_er_mv ip_load_min_ofs_amp_mis_afs_at ldp_n_ip_load_amp_mis_afs_at ip_load_min_ofs_amp_mis_afs_mt ldp_amp_ip_load_amp_mis_afs_mt ip_load_min_mis_hom_s_at ldp_n_32_ip_load_min_mis_hom_s_at ldp_tco_ip_load_min_mis_hom_s_at ip_load_min_mis_hom_s_mt ldp_n_32_ip_load_min_mis_hom_s_mt ldp_tco_ip_load_min_mis_hom_s_mt ldp_n_32_ip_load_amp_mis_hom_s_at ldp_n_32_ip_load_amp_mis_hom_s_mt ldp_amp_ip_load_amp_mis_hom_s_at ldp_amp_ip_load_amp_mis_hom_s_mt ip_load_min_mis_s_at ip_load_min_mis_s_mt ldp_n_32_ip_load_min_mis_s_at ldp_n_32_ip_load_min_mis_s_mt ldp_tco_ip_load_min_mis_s_mt ldp_tco_ip_load_min_mis_s_at ip_load_min_ofs_amp_mis_s_mt ip_load_min_ofs_amp_mis_s_at ldp_n_32_ip_load_amp_mis_s_mt ldp_n_32_ip_load_amp_mis_s_at ldp_amp_ip_load_amp_mis_s_mt ldp_amp_ip_load_amp_mis_s_at ip_thd_hom_s_er_is_mt ip_thd_s_er_is_mt ldp_n_ip_thd_hom_s_er_is_mt ldp_load_mis_ip_thd_hom_s_er_is_mt ldp_n_ip_thd_s_er_is_mt ldp_load_mis_ip_thd_s_er_is_mt ip_thd_afs_er_at_cc_open ldp_n_ip_thd_afs_er_at_open ldp_load_ip_thd_afs_er_at_open ldp_load_mis_ip_thd_afs_er_at_open ip_thd_afs_er_at_cc_ctl ip_thd_afs_er_at_cc_close ldp_n_ip_thd_afs_er_at_ctl ldp_n_ip_thd_afs_er_at_close ldp_load_ip_thd_afs_er_at_ctl ldp_load_ip_thd_afs_er_at_close ip_thd_afs_er_is_at_cc_open ldp_n_ip_thd_afs_er_is_at ldp_load_ip_thd_afs_er_is_at ip_thd_afs_er_is_at_cc_ctl ip_thd_afs_er_is_at_cc_close ldp_n_ip_thd_afs_er_is_at_ctl ldp_n_ip_thd_afs_er_is_at_close ldp_load_ip_afs_er_is_at_ctl ldp_load_ip_afs_er_is_at_close ip_thd_hom_s_er_at_cc_ctl ldp_n_ip_thd_hom_s_er_at_ctl ldp_load_ip_thd_hom_s_er_at_ctl ip_thd_hom_s_er_at_cc_open ip_thd_hom_s_er_at_cc_close ldp_n_ip_thd_hom_s_er_at_open ldp_n_ip_thd_hom_s_er_at_close ldp_load_ip_hom_s_er_at_open ldp_load_ip_hom_s_er_at_close ip_thd_hom_s_er_is_at_cc_open ldp_n_ip_hom_s_er_is_at_open ldp_load_ip_hom_s_er_is_at_open ip_thd_hom_s_er_is_at_cc_ctl ip_thd_hom_s_er_is_at_cc_close ldp_n_ip_thd_hom_s_er_is_at_ctl ldpm_load_mis_ip_er_mv ldp_n_ip_hom_s_er_is_at_close ldp_load_ip_hom_s_er_is_at_ctl ldp_load_ip_hom_s_er_is_close ip_thd_s_er_at_cc_open ldp_n_ip_thd_s_er_at_open ldp_load_ip_thd_s_er_at_open ip_thd_ad_er_mv c_er_thd_ratio_fil_l c_er_fil_l c_er_fil_h c_er_fil_det c_nr_mis_grd c_n_32_ar_tra c_load_mis_tra ip_thd_s_er_at_cc_ctl ldp_n_32_ip_n_32_grd_mis_er_mv ldpm_n_32_ip_er_mv ldp_load_ip_load_grd_mis_er_mv ip_thd_s_er_at_cc_close ip_er_mv ip_n_32_grd_mis_er_mv ldp_n_ip_thd_s_er_at_ctl id_load_min_er_mv_mem ldp_n_ip_thd_s_er_at_close ldp_load_mis_ip_thd_s_er_at_ctl ldp_load_ip_thd_s_er_at_close ip_er_mv_max ip_thd_er_fil_mem ip_thd_s_er_is_at_cc_open lc_thd_er_delta ldp_n_ip_thd_s_er_is_at_open lc_thd_er_delta_fil_mem ldp_load_ip_thd_s_er_is_at_open ip_thd_s_er_is_at_cc_ctl lc_er_mv_lim_reac er_mv_mem[0] er_mv_mem[1] er_mv_mem[2] er_mv_mem[3] er_mv_mem[4] er_mv_mem[5] er_mv_mem[6] er_mv_mem[7] ip_thd_s_er_is_at_cc_close ldp_n_ip_thd_s_er_is_at_ctl c_er_thd_ratio_fil_h ldp_n_ip_thd_s_er_is_at_close ldp_load_ip_thd_s_er_is_at_ctl ldp_load_ip_thd_s_er_is_at_close lc_er_mv_mem_tra lc_er_mv_cyl_ad ldp_load_ip_s_er_is_at_close ip_load_min_ofs_amp_hom_s_at ip_load_min_ofs_amp_hom_s_mt /end DEF_CHARACTERISTIC
 /begin OUT_MEASUREMENT ctr_tot_mis fac_thd_app_er lv_ftl_l_diag_mis lv_inh_crk_osc_det lv_inh_obd_det_mis lv_inh_app_det_mis lv_inh_ftl_l_det_mis lv_inh_app_rr fac_gain_load_mis thd_er_clc thd_er_clc_prev load_min_mis iga_bas_cor_mv thd_ad_er_mv fac_n_32_ar fac_load_mis_ar er_mv_cyl[0] er_mv_cyl[1] er_mv_cyl[2] er_mv_cyl[3] er_mv_cyl[4] er_mv_cyl[5] er_mv_cyl[6] er_mv_cyl[7] er_mv_mis_det mis_ctr_grd er_mv_mis_det_tra n_32_tra load_mis_tra er_delta er_delta_fil_mem lv_det_thd_delta_fil_mem er_mv_cyl_ad[0] er_mv_cyl_ad[1] er_mv_cyl_ad[2] er_mv_cyl_ad[3] er_mv_cyl_ad[4] er_mv_cyl_ad[5] er_mv_cyl_ad[6] er_mv_cyl_ad[7] ar_tra_mis er_ad_ar[0] er_ad_ar[1] er_ad_ar[2] er_ad_ar[3] er_ad_ar[4] er_ad_ar[5] er_ad_ar[6] er_ad_ar[7] lv_er_ar_avl lv_err_mv_lim ctr_er_ad_ar idx_n_32_ar idx_load_mis_ar er_fil /end OUT_MEASUREMENT
/end FUNCTION
/end MODULE
/end PROJECT
