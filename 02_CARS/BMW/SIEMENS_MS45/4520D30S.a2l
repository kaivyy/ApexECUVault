ASAP2_VERSION 1 31
/begin PROJECT MS45 "BMW Motorsteuerung R6"
/begin HEADER "_default_HeaderComment" PROJECT_NO _52 /end HEADER
/begin MODULE _default_ModuleName "_default_ModuleLongIdentifier"
/begin MOD_COMMON "_default_ModCommonComment" DEPOSIT ABSOLUTE BYTE_ORDER MSB_FIRST ALIGNMENT_BYTE 1 ALIGNMENT_WORD 2 ALIGNMENT_LONG 4 ALIGNMENT_FLOAT32_IEEE 4 ALIGNMENT_FLOAT64_IEEE 8 /end MOD_COMMON
/begin MEASUREMENT ERR_INFO_STAT "" UBYTE _CNV_S_2_RANGE______21_R_CM 1 100. 0. 255. ECU_ADDRESS 0x3fd598 /end MEASUREMENT
/begin CHARACTERISTIC LC_CRU_REQ_SWI "Configuration switch between MSW and steering lever" VALUE 0x42b6f _REC_VAL_20_u1 1. _CNV_A_R_LINEAR_____12_CM 0. 1. FORMAT "%1.0" /end CHARACTERISTIC
/begin CHARACTERISTIC C_T_CRUS_ON "Minimum recognition time on actuating the OFF button" VALUE 0x429c4 _REC_VAL_20_u1 2550. _CNV_A_R_LINEAR_____23_CM 0. 2550. FORMAT "%4.0" /end CHARACTERISTIC
/begin MEASUREMENT STATE_MSW_CAN "Status of MSW to the CAN Message" UBYTE _CNV_S_8_RANGE_STAT_24_CM 1 100. 0. 7. ECU_ADDRESS 0x3fd2ca /end MEASUREMENT
/begin MEASUREMENT LV_CRU_MAIN_SWI_ "indicate CRU readiness" UBYTE _CNV_S_2_RANGE______11_CM 1 100. 0. 1. ECU_ADDRESS 0x3fd2cc /end MEASUREMENT
/begin MEASUREMENT REQ_MSW "Evaluated Status of MSW request module" UBYTE _CNV_S_10_RANGE_REQ__25_CM 1 100. 0. 9. ECU_ADDRESS 0x3fd2cb /end MEASUREMENT
/begin CHARACTERISTIC C_T_MIN_MSW "time delay of REQ_MSW" VALUE 0x42a19 _REC_VAL_20_u1 2.54 _CNV_A_R_LINEAR_____27_CM 1.e-002 2.55 FORMAT "%4.2" /end CHARACTERISTIC
/begin CHARACTERISTIC C_T_READY_CRU "Delay time after control unit initialization" VALUE 0x42a29 _REC_VAL_20_u1 1550. _CNV_A_R_LINEAR_____23_CM 1000. 2550. FORMAT "%5.0" /end CHARACTERISTIC
/begin CHARACTERISTIC C_T_CRUS "Minimum time between switch on ready and switch off ready" VALUE 0x429c2 _REC_VAL_20_u1 2550. _CNV_A_R_LINEAR_____23_CM 0. 2550. FORMAT "%4.0" /end CHARACTERISTIC
/begin CHARACTERISTIC C_T_CRUS_OFF "Minimum recognition time on actuating the OFF button to switch off the display for BN2000" VALUE 0x429c3 _REC_VAL_20_u1 2550. _CNV_A_R_LINEAR_____23_CM 0. 2550. FORMAT "%4.0" /end CHARACTERISTIC
/begin MEASUREMENT LV_AT "LV automatic transmission recognized" UBYTE _CNV_S_2_RANGE______11_CM 1 100. 0. 1. ECU_ADDRESS 0x3fcd52 BIT_MASK 0x1 /end MEASUREMENT
/begin MEASUREMENT LV_BYP_ON "" UBYTE _CNV_S_2_RANGE______11_CM 1 100. 0. 1. ECU_ADDRESS 0x3fa4b3 /end MEASUREMENT
/begin CHARACTERISTIC C_BYP_LIH_CNT_MAX_A "" VALUE 0x427f1 _REC_VAL_20_u1 255. _CNV_A_R_LINEAR_____10_CM 0. 255. FORMAT "%3.0" /end CHARACTERISTIC
/begin CHARACTERISTIC C_BYP_LIH_CNT_MAX_B "" VALUE 0x427f2 _REC_VAL_20_u1 255. _CNV_A_R_LINEAR_____10_CM 0. 255. FORMAT "%3.0" /end CHARACTERISTIC
/begin CHARACTERISTIC C_BYP_ON "" VALUE 0x427f3 _REC_VAL_20_u1 255. _CNV_A_R_LINEAR_____10_CM 0. 255. FORMAT "%3.0" /end CHARACTERISTIC
/begin MEASUREMENT BYP_CNT_A "" UBYTE _CNV_A_R_LINEAR_____10_CM 1 100. 0. 255. ECU_ADDRESS 0x3fa4b0 FORMAT "%3.0" /end MEASUREMENT
/begin MEASUREMENT BYP_CNT_B "" UBYTE _CNV_A_R_LINEAR_____10_CM 1 100. 0. 255. ECU_ADDRESS 0x3fa4b1 FORMAT "%3.0" /end MEASUREMENT
/begin MEASUREMENT BYP_ERROR "" UBYTE _CNV_A_R_LINEAR_____10_CM 1 100. 0. 255. ECU_ADDRESS 0x3fa4b2 FORMAT "%3.0" /end MEASUREMENT
/begin CHARACTERISTIC C_BYP_FUNC_A "" VALUE 0x42c3e _REC_VAL_20_u2 65535. _CNV_A_R_LINEAR_____10_CM 0. 65535. FORMAT "%5.0" /end CHARACTERISTIC
/begin CHARACTERISTIC C_BYP_FUNC_B "" VALUE 0x43364 _REC_VAL_20_u4 4294967295. _CNV_A_R_LINEAR_____10_CM 0. 4294967295. FORMAT "%10.0" /end CHARACTERISTIC
/begin CHARACTERISTIC C_BYP_A_OFS_CH1 "" VALUE 0x427c2 _REC_VAL_20_u1 255. _CNV_A_R_LINEAR_____10_CM 0. 255. FORMAT "%3.0" /end CHARACTERISTIC
/begin CHARACTERISTIC C_BYP_A_OFS_CH2 "" VALUE 0x427c9 _REC_VAL_20_u1 255. _CNV_A_R_LINEAR_____10_CM 0. 255. FORMAT "%3.0" /end CHARACTERISTIC
/begin CHARACTERISTIC C_BYP_A_OFS_CH3 "" VALUE 0x427ca _REC_VAL_20_u1 255. _CNV_A_R_LINEAR_____10_CM 0. 255. FORMAT "%3.0" /end CHARACTERISTIC
/begin CHARACTERISTIC C_BYP_A_OFS_CH4 "" VALUE 0x427cb _REC_VAL_20_u1 255. _CNV_A_R_LINEAR_____10_CM 0. 255. FORMAT "%3.0" /end CHARACTERISTIC
/begin CHARACTERISTIC C_BYP_A_OFS_CH5 "" VALUE 0x427cc _REC_VAL_20_u1 255. _CNV_A_R_LINEAR_____10_CM 0. 255. FORMAT "%3.0" /end CHARACTERISTIC
/begin CHARACTERISTIC C_BYP_A_OFS_CH6 "" VALUE 0x427cd _REC_VAL_20_u1 255. _CNV_A_R_LINEAR_____10_CM 0. 255. FORMAT "%3.0" /end CHARACTERISTIC
/begin CHARACTERISTIC C_BYP_A_OFS_CH7 "" VALUE 0x427ce _REC_VAL_20_u1 255. _CNV_A_R_LINEAR_____10_CM 0. 255. FORMAT "%3.0" /end CHARACTERISTIC
/begin CHARACTERISTIC C_BYP_A_OFS_CH8 "" VALUE 0x427cf _REC_VAL_20_u1 255. _CNV_A_R_LINEAR_____10_CM 0. 255. FORMAT "%3.0" /end CHARACTERISTIC
/begin CHARACTERISTIC C_BYP_A_OFS_CH9 "" VALUE 0x427d0 _REC_VAL_20_u1 255. _CNV_A_R_LINEAR_____10_CM 0. 255. FORMAT "%3.0" /end CHARACTERISTIC
/begin CHARACTERISTIC C_BYP_A_OFS_CH10 "" VALUE 0x427c3 _REC_VAL_20_u1 255. _CNV_A_R_LINEAR_____10_CM 0. 255. FORMAT "%3.0" /end CHARACTERISTIC
/begin CHARACTERISTIC C_BYP_A_OFS_CH11 "" VALUE 0x427c4 _REC_VAL_20_u1 255. _CNV_A_R_LINEAR_____10_CM 0. 255. FORMAT "%3.0" /end CHARACTERISTIC
/begin CHARACTERISTIC C_BYP_A_OFS_CH12 "" VALUE 0x427c5 _REC_VAL_20_u1 255. _CNV_A_R_LINEAR_____10_CM 0. 255. FORMAT "%3.0" /end CHARACTERISTIC
/begin CHARACTERISTIC C_BYP_A_OFS_CH13 "" VALUE 0x427c6 _REC_VAL_20_u1 255. _CNV_A_R_LINEAR_____10_CM 0. 255. FORMAT "%3.0" /end CHARACTERISTIC
/begin CHARACTERISTIC C_BYP_A_OFS_CH14 "" VALUE 0x427c7 _REC_VAL_20_u1 255. _CNV_A_R_LINEAR_____10_CM 0. 255. FORMAT "%3.0" /end CHARACTERISTIC
/begin CHARACTERISTIC C_BYP_A_OFS_CH15 "" VALUE 0x427c8 _REC_VAL_20_u1 255. _CNV_A_R_LINEAR_____10_CM 0. 255. FORMAT "%3.0" /end CHARACTERISTIC
/begin CHARACTERISTIC C_BYP_A_OFS_CH0 "" VALUE 0x427c1 _REC_VAL_20_u1 255. _CNV_A_R_LINEAR_____10_CM 0. 255. FORMAT "%3.0" /end CHARACTERISTIC
/begin CHARACTERISTIC C_BYP_B_OFS_CH0 "" VALUE 0x427d1 _REC_VAL_20_u1 255. _CNV_A_R_LINEAR_____10_CM 0. 255. FORMAT "%3.0" /end CHARACTERISTIC
/begin CHARACTERISTIC C_BYP_B_OFS_CH1 "" VALUE 0x427d2 _REC_VAL_20_u1 255. _CNV_A_R_LINEAR_____10_CM 0. 255. FORMAT "%3.0" /end CHARACTERISTIC
/begin CHARACTERISTIC C_BYP_B_OFS_CH2 "" VALUE 0x427dd _REC_VAL_20_u1 255. _CNV_A_R_LINEAR_____10_CM 0. 255. FORMAT "%3.0" /end CHARACTERISTIC
/begin CHARACTERISTIC C_BYP_B_OFS_CH3 "" VALUE 0x427e8 _REC_VAL_20_u1 255. _CNV_A_R_LINEAR_____10_CM 0. 255. FORMAT "%3.0" /end CHARACTERISTIC
/begin CHARACTERISTIC C_BYP_B_OFS_CH4 "" VALUE 0x427eb _REC_VAL_20_u1 255. _CNV_A_R_LINEAR_____10_CM 0. 255. FORMAT "%3.0" /end CHARACTERISTIC
/begin CHARACTERISTIC C_BYP_B_OFS_CH5 "" VALUE 0x427ec _REC_VAL_20_u1 255. _CNV_A_R_LINEAR_____10_CM 0. 255. FORMAT "%3.0" /end CHARACTERISTIC
/begin CHARACTERISTIC C_BYP_B_OFS_CH6 "" VALUE 0x427ed _REC_VAL_20_u1 255. _CNV_A_R_LINEAR_____10_CM 0. 255. FORMAT "%3.0" /end CHARACTERISTIC
/begin CHARACTERISTIC C_BYP_B_OFS_CH7 "" VALUE 0x427ee _REC_VAL_20_u1 255. _CNV_A_R_LINEAR_____10_CM 0. 255. FORMAT "%3.0" /end CHARACTERISTIC
/begin CHARACTERISTIC C_BYP_B_OFS_CH8 "" VALUE 0x427ef _REC_VAL_20_u1 255. _CNV_A_R_LINEAR_____10_CM 0. 255. FORMAT "%3.0" /end CHARACTERISTIC
/begin CHARACTERISTIC C_BYP_B_OFS_CH9 "" VALUE 0x427f0 _REC_VAL_20_u1 255. _CNV_A_R_LINEAR_____10_CM 0. 255. FORMAT "%3.0" /end CHARACTERISTIC
/begin CHARACTERISTIC C_BYP_B_OFS_CH10 "" VALUE 0x427d3 _REC_VAL_20_u1 255. _CNV_A_R_LINEAR_____10_CM 0. 255. FORMAT "%3.0" /end CHARACTERISTIC
/begin CHARACTERISTIC C_BYP_B_OFS_CH11 "" VALUE 0x427d4 _REC_VAL_20_u1 255. _CNV_A_R_LINEAR_____10_CM 0. 255. FORMAT "%3.0" /end CHARACTERISTIC
/begin CHARACTERISTIC C_BYP_B_OFS_CH12 "" VALUE 0x427d5 _REC_VAL_20_u1 255. _CNV_A_R_LINEAR_____10_CM 0. 255. FORMAT "%3.0" /end CHARACTERISTIC
/begin CHARACTERISTIC C_BYP_B_OFS_CH13 "" VALUE 0x427d6 _REC_VAL_20_u1 255. _CNV_A_R_LINEAR_____10_CM 0. 255. FORMAT "%3.0" /end CHARACTERISTIC
/begin CHARACTERISTIC C_BYP_B_OFS_CH14 "" VALUE 0x427d7 _REC_VAL_20_u1 255. _CNV_A_R_LINEAR_____10_CM 0. 255. FORMAT "%3.0" /end CHARACTERISTIC
/begin CHARACTERISTIC C_BYP_B_OFS_CH15 "" VALUE 0x427d8 _REC_VAL_20_u1 255. _CNV_A_R_LINEAR_____10_CM 0. 255. FORMAT "%3.0" /end CHARACTERISTIC
/begin CHARACTERISTIC C_BYP_B_OFS_CH16 "" VALUE 0x427d9 _REC_VAL_20_u1 255. _CNV_A_R_LINEAR_____10_CM 0. 255. FORMAT "%3.0" /end CHARACTERISTIC
/begin CHARACTERISTIC C_BYP_B_OFS_CH17 "" VALUE 0x427da _REC_VAL_20_u1 255. _CNV_A_R_LINEAR_____10_CM 0. 255. FORMAT "%3.0" /end CHARACTERISTIC
/begin CHARACTERISTIC C_BYP_B_OFS_CH18 "" VALUE 0x427db _REC_VAL_20_u1 255. _CNV_A_R_LINEAR_____10_CM 0. 255. FORMAT "%3.0" /end CHARACTERISTIC
/begin CHARACTERISTIC C_BYP_B_OFS_CH19 "" VALUE 0x427dc _REC_VAL_20_u1 255. _CNV_A_R_LINEAR_____10_CM 0. 255. FORMAT "%3.0" /end CHARACTERISTIC
/begin CHARACTERISTIC C_BYP_B_OFS_CH20 "" VALUE 0x427de _REC_VAL_20_u1 255. _CNV_A_R_LINEAR_____10_CM 0. 255. FORMAT "%3.0" /end CHARACTERISTIC
/begin CHARACTERISTIC C_BYP_B_OFS_CH21 "" VALUE 0x427df _REC_VAL_20_u1 255. _CNV_A_R_LINEAR_____10_CM 0. 255. FORMAT "%3.0" /end CHARACTERISTIC
/begin CHARACTERISTIC C_BYP_B_OFS_CH22 "" VALUE 0x427e0 _REC_VAL_20_u1 255. _CNV_A_R_LINEAR_____10_CM 0. 255. FORMAT "%3.0" /end CHARACTERISTIC
/begin CHARACTERISTIC C_BYP_B_OFS_CH23 "" VALUE 0x427e1 _REC_VAL_20_u1 255. _CNV_A_R_LINEAR_____10_CM 0. 255. FORMAT "%3.0" /end CHARACTERISTIC
/begin CHARACTERISTIC C_BYP_B_OFS_CH24 "" VALUE 0x427e2 _REC_VAL_20_u1 255. _CNV_A_R_LINEAR_____10_CM 0. 255. FORMAT "%3.0" /end CHARACTERISTIC
/begin CHARACTERISTIC C_BYP_B_OFS_CH25 "" VALUE 0x427e3 _REC_VAL_20_u1 255. _CNV_A_R_LINEAR_____10_CM 0. 255. FORMAT "%3.0" /end CHARACTERISTIC
/begin CHARACTERISTIC C_BYP_B_OFS_CH26 "" VALUE 0x427e4 _REC_VAL_20_u1 255. _CNV_A_R_LINEAR_____10_CM 0. 255. FORMAT "%3.0" /end CHARACTERISTIC
/begin CHARACTERISTIC C_BYP_B_OFS_CH27 "" VALUE 0x427e5 _REC_VAL_20_u1 255. _CNV_A_R_LINEAR_____10_CM 0. 255. FORMAT "%3.0" /end CHARACTERISTIC
/begin CHARACTERISTIC C_BYP_B_OFS_CH28 "" VALUE 0x427e6 _REC_VAL_20_u1 255. _CNV_A_R_LINEAR_____10_CM 0. 255. FORMAT "%3.0" /end CHARACTERISTIC
/begin CHARACTERISTIC C_BYP_B_OFS_CH29 "" VALUE 0x427e7 _REC_VAL_20_u1 255. _CNV_A_R_LINEAR_____10_CM 0. 255. FORMAT "%3.0" /end CHARACTERISTIC
/begin CHARACTERISTIC C_BYP_B_OFS_CH30 "" VALUE 0x427e9 _REC_VAL_20_u1 255. _CNV_A_R_LINEAR_____10_CM 0. 255. FORMAT "%3.0" /end CHARACTERISTIC
/begin CHARACTERISTIC C_BYP_B_OFS_CH31 "" VALUE 0x427ea _REC_VAL_20_u1 255. _CNV_A_R_LINEAR_____10_CM 0. 255. FORMAT "%3.0" /end CHARACTERISTIC
/begin MEASUREMENT LV_ASR_PLAUS "Logical variable plausibility ASR" UBYTE _CNV_S_2_RANGE______28_CM 1 100. 0. 1. ECU_ADDRESS 0x3fc48f BIT_MASK 0x1 /end MEASUREMENT
/begin MEASUREMENT LV_MSR_PLAUS "Logical variable plausibility MSR" UBYTE _CNV_S_2_RANGE______28_CM 1 100. 0. 1. ECU_ADDRESS 0x3fc490 BIT_MASK 0x1 /end MEASUREMENT
/begin CHARACTERISTIC C_T_CRU_ESP_OFF "minimum time before cut-off CRU in case of ESP intervention" VALUE 0x429c0 _REC_VAL_20_u1 25.5 _CNV_A_R_LINEAR_____14_CM 0. 25.5 FORMAT "%4.1" /end CHARACTERISTIC
/begin CHARACTERISTIC C_T_CRU_ASR_OFF "minimum time before cut-off CRU in case of ASR intervention" VALUE 0x429be _REC_VAL_20_u1 25.5 _CNV_A_R_LINEAR_____14_CM 0. 25.5 FORMAT "%4.1" /end CHARACTERISTIC
/begin CHARACTERISTIC C_T_CRU_ESP_BRAKE_OFF "minimum time before cut-off CRU in case of ESP intervention only with brake" VALUE 0x429bf _REC_VAL_20_u1 25.5 _CNV_A_R_LINEAR_____14_CM 0. 25.5 FORMAT "%4.1" /end CHARACTERISTIC
/begin MEASUREMENT AC_CRU "Vehicle acceleration in CRU" SWORD _CNV_A_R_LINEAR_____123_CM 1 100. -15.719999999972 15.71952 ECU_ADDRESS 0x3fd27c FORMAT "%7.4" /end MEASUREMENT
/begin CHARACTERISTIC C_FAC_VS_FIL "Filter factor" VALUE 0x428c5 _REC_VAL_20_u1 255. _CNV_A_R_LINEAR_____10_CM 0. 255. FORMAT "%3.0" /end CHARACTERISTIC
/begin CHARACTERISTIC C_VS_MAX_DIAG "Max. allowed deviation between VS_FIL and VS" VALUE 0x42b2c _REC_VAL_20_u1 255. _CNV_A_R_LINEAR_____13_CM 0. 255. FORMAT "%3.0" /end CHARACTERISTIC
/begin MEASUREMENT LV_VS_DIAG_NOT_PLAUS "VS_FIL not plausible" UBYTE _CNV_S_2_RANGE______11_CM 1 100. 0. 1. ECU_ADDRESS 0x3fd284 /end MEASUREMENT
/begin MEASUREMENT LV_CRU_OFF_BY_ASR_ESP_CTL "Soft off condition depending on ASC interventions" UBYTE _CNV_S_2_RANGE______11_CM 1 100. 0. 1. ECU_ADDRESS 0x3fd285 /end MEASUREMENT
/begin CHARACTERISTIC C_FAC_TQ_REQ_DRIV_MMV "Filtering of driver demand" VALUE 0x42d4c _REC_VAL_20_u2 0.99998474 _CNV_A_R_LINEAR_____31_CM 0. 0.99998474 FORMAT "%7.5" /end CHARACTERISTIC
/begin MEASUREMENT FAC_TQ_REQ_DRIV_MMV "MMV of driver torque demand" UWORD _CNV_A_R_LINEAR_____45_CM 1 100. 0. 1.99996948 ECU_ADDRESS 0x3fd282 FORMAT "%7.5" /end MEASUREMENT
/begin MEASUREMENT N_VS_CRU "Ratio between engine speed and vehicle speed" UWORD _CNV_A_R_LINEAR_____124_CM 1 100. 0. 16320. ECU_ADDRESS 0x3fd27e FORMAT "%5.0" /end MEASUREMENT
/begin CHARACTERISTIC C_FAC_AC_CRU_MMV "Filtering AC_CRU" VALUE 0x42cfe _REC_VAL_20_u2 0.99998474 _CNV_A_R_LINEAR_____31_CM 0. 0.99998474 FORMAT "%7.5" /end CHARACTERISTIC
/begin CHARACTERISTIC C_DIF_VS_ICL_DISP "Filter factor" VALUE 0x42cc2 _REC_VAL_20_u2 409.4 _CNV_A_R_LINEAR_____61_CM 0. 409.4 FORMAT "%5.1" /end CHARACTERISTIC
/begin MEASUREMENT VS_FIL "Filtered vehicle speed" UWORD _CNV_A_R_LINEAR_____78_CM 1 100. 0. 511.99218 ECU_ADDRESS 0x3fd278 FORMAT "%7.3" /end MEASUREMENT
/begin MEASUREMENT VS_CRU "Filtered vehicle speed" UWORD _CNV_A_R_LINEAR_____78_CM 1 100. 0. 511.99218 ECU_ADDRESS 0x3fd27a FORMAT "%7.3" /end MEASUREMENT
/begin MEASUREMENT REQ_CRU "Request of cruise control functionality" UBYTE _CNV_S_8_RANGE_REQ__125_CM 1 100. 0. 7. ECU_ADDRESS 0x3fd28a /end MEASUREMENT
/begin MEASUREMENT LV_CRU_OFF_IRR "Irreversible cut off conditions for cruise control" UBYTE _CNV_S_2_RANGE______11_CM 1 100. 0. 1. ECU_ADDRESS 0x3fd28d /end MEASUREMENT
/begin CHARACTERISTIC C_VS_MIN_PLAUS_CRU "Vehicle speed condition for VS_FIL" VALUE 0x431d2 _REC_VAL_20_u2 511.99218 _CNV_A_R_LINEAR_____78_CM 0. 511.99218 FORMAT "%7.3" /end CHARACTERISTIC
/begin MEASUREMENT T_DLY_CRU "Time counter overtaking" UWORD _CNV_A_R_LINEAR_____27_CM 1 100. 0. 655.35 ECU_ADDRESS 0x3fe844 FORMAT "%5.2" /end MEASUREMENT
/begin MEASUREMENT LV_CRU_OVER_ACT "Overtaking function active" UBYTE _CNV_S_2_RANGE______11_CM 1 100. 0. 1. ECU_ADDRESS 0x3fd28e /end MEASUREMENT
/begin CHARACTERISTIC C_T_DLY_VS_SP_CRU_MAX "Max .time for VS more than  VS max at CRU" VALUE 0x429f7 _REC_VAL_20_u1 255. _CNV_A_R_LINEAR_____47_CM 0. 255. FORMAT "%3.0" /end CHARACTERISTIC
/begin CHARACTERISTIC C_T_DLY_MAX_CRU "Delay threshold for start of the restart function" VALUE 0x42f96 _REC_VAL_20_u2 655.35 _CNV_A_R_LINEAR_____27_CM 0. 655.35 FORMAT "%6.2" /end CHARACTERISTIC
/begin CHARACTERISTIC C_N_VS_MAX_CRU "Threshold value for hard cut-off" VALUE 0x4296f _REC_VAL_20_u1 99.609375 _CNV_A_R_LINEAR_____4_CM 0. 99.609375 FORMAT "%4.1" /end CHARACTERISTIC
/begin CHARACTERISTIC C_VS_SP_DIF_MIN_CRU "Min. deviation between target and actual speed" VALUE 0x4333e _REC_VAL_20_s2 511.9921875 _CNV_A_R_LINEAR_____126_CM -256. 255.9921875 FORMAT "%7.3" /end CHARACTERISTIC
/begin CHARACTERISTIC C_VS_SP_DIF_MAX_CRU "Max. deviation between target and actual speed" VALUE 0x4333c _REC_VAL_20_s2 511.9921875 _CNV_A_R_LINEAR_____126_CM -256. 255.9921875 FORMAT "%7.3" /end CHARACTERISTIC
/begin MEASUREMENT LV_CRU_ACT "Intervention of cruise control" UBYTE _CNV_S_2_RANGE______11_CM 1 100. 0. 1. ECU_ADDRESS 0x3fd28f /end MEASUREMENT
/begin CHARACTERISTIC C_T_ERR_VS_CAN "minimum threshold time for error of vehicle speed from CAN" VALUE 0x429fa _REC_VAL_20_u1 25.5 _CNV_A_R_LINEAR_____14_CM 0. 25.5 FORMAT "%4.1" /end CHARACTERISTIC
/begin CHARACTERISTIC C_VS_DIF_DLY_CRU_NEG "Max. difference from VS_SP_DRIV_CRU and C_VS_DIF_DLY_CRU" VALUE 0x431bc _REC_VAL_20_u2 255.9921875 _CNV_A_R_LINEAR_____126_CM 0. 255.9921875 FORMAT "%7.3" /end CHARACTERISTIC
/begin CHARACTERISTIC C_FAC_TQ_REQ_HYS_CRU "FAC_TQ_REQ hysteresis for start of the restart function" VALUE 0x42d50 _REC_VAL_20_u2 1.99996948 _CNV_A_R_LINEAR_____45_CM 0. 1.99996948 FORMAT "%7.5" /end CHARACTERISTIC
/begin CHARACTERISTIC C_AC_MAX_CRU "Max. acceleration" VALUE 0x42bfc _REC_VAL_20_u2 15.71952 _CNV_A_R_LINEAR_____127_CM 0. 15.71952 FORMAT "%7.4" /end CHARACTERISTIC
/begin MEASUREMENT STATE_CRU_CAN "Status of cruise control to the CAN- Message" UBYTE _CNV_S_8_RANGE_STAT_128_CM 1 100. 0. 7. ECU_ADDRESS 0x3fd28b /end MEASUREMENT
/begin MEASUREMENT STATE_CRU_OFF_REV "Status switch off conditions reversible" UWORD _CNV_A_R_LINEAR_____12_CM 1 100. 0. 65535. ECU_ADDRESS 0x3fd288 FORMAT "%5.0" /end MEASUREMENT
/begin MEASUREMENT STATE_CRU_OFF_IRR "Status switch off conditions irreversible" UWORD _CNV_A_R_LINEAR_____12_CM 1 100. 0. 65535. ECU_ADDRESS 0x3fd286 FORMAT "%5.0" /end MEASUREMENT
/begin CHARACTERISTIC C_VS_DIF_DLY_CRU_POS "Maximum difference from VS_SP_DRIV_CRU and C_VS_DIF_DLY_CRU" VALUE 0x43330 _REC_VAL_20_s2 255.9922 _CNV_A_R_LINEAR_____129_CM -255.9922 0. FORMAT "%7.3" /end CHARACTERISTIC
/begin CHARACTERISTIC C_VS_DIF_MIN_CRU_OVER "Vs_dif_cru min value vor finished overtaking function" VALUE 0x43338 _REC_VAL_20_s2 511.9921875 _CNV_A_R_LINEAR_____126_CM -256. 255.9921875 FORMAT "%7.3" /end CHARACTERISTIC
/begin MEASUREMENT VS_DIF_I_CRU "Sum of the control deviations" SWORD _CNV_A_R_LINEAR_____126_CM 1 100. -256. 255.9921875 ECU_ADDRESS 0x3fe850 FORMAT "%7.3" /end MEASUREMENT
/begin MEASUREMENT T_CTL_CRU "Time of the controlled acceleration" UBYTE _CNV_A_R_LINEAR_____14_CM 1 100. 0. 25.5 ECU_ADDRESS 0x3fe85a FORMAT "%4.1" /end MEASUREMENT
/begin MEASUREMENT VS_SP_CRU "Reference input variable of the controller" UWORD _CNV_A_R_LINEAR_____78_CM 1 100. 0. 511.99218 ECU_ADDRESS 0x3fd292 FORMAT "%7.3" /end MEASUREMENT
/begin MEASUREMENT VS_SP_DIF_CRU "Target variable/reference input variable difference" SWORD _CNV_A_R_LINEAR_____126_CM 1 100. -256. 255.9921875 ECU_ADDRESS 0x3fe852 FORMAT "%7.3" /end MEASUREMENT
/begin MEASUREMENT VS_SP_INC_CRU "Increment for VS_SP_CRU" UWORD _CNV_A_R_LINEAR_____78_CM 1 100. 0. 511.99218 ECU_ADDRESS 0x3fe856 FORMAT "%7.3" /end MEASUREMENT
/begin MEASUREMENT VS_SP_DEC_CRU "Decrement for VS_SP_CRU" UWORD _CNV_A_R_LINEAR_____78_CM 1 100. 0. 511.99218 ECU_ADDRESS 0x3fe854 FORMAT "%7.3" /end MEASUREMENT
/begin MEASUREMENT VS_SP_DRIV_CRU_ "Driver wish target variable" UWORD _CNV_A_R_LINEAR_____78_CM 1 100. 0. 511.99218 ECU_ADDRESS 0x3fd294 FORMAT "%7.3" /end MEASUREMENT
/begin CHARACTERISTIC C_VS_DIF_MIN_IS_CRU "Threshold of the control deviation for zero setting of PV_CRU" VALUE 0x4333a _REC_VAL_20_s2 511.9921875 _CNV_A_R_LINEAR_____126_CM -256. 255.9921875 FORMAT "%7.3" /end CHARACTERISTIC
/begin CHARACTERISTIC C_VS_DIF_MAX_IS_CRU "Threshold of the control deviation for PUC end" VALUE 0x43334 _REC_VAL_20_s2 511.9921875 _CNV_A_R_LINEAR_____126_CM -256. 255.9921875 FORMAT "%7.3" /end CHARACTERISTIC
/begin CHARACTERISTIC C_VS_DIF_MAX_AC_CRU "Condition for interrupting the incrementation or decrementation" VALUE 0x43332 _REC_VAL_20_s2 511.9921875 _CNV_A_R_LINEAR_____126_CM -256. 255.9921875 FORMAT "%7.3" /end CHARACTERISTIC
/begin CHARACTERISTIC C_VS_DIF_MIN_AC_CRU "Condition for interrupting the incrementation or decrementation" VALUE 0x43336 _REC_VAL_20_s2 511.9921875 _CNV_A_R_LINEAR_____126_CM -256. 255.9921875 FORMAT "%7.3" /end CHARACTERISTIC
/begin CHARACTERISTIC C_VS_AC_MIN_CRU "Vehicle speed threshold for acceleration valuation" VALUE 0x42b1e _REC_VAL_20_u1 255. _CNV_A_R_LINEAR_____13_CM 0. 255. FORMAT "%3.0" /end CHARACTERISTIC
/begin CHARACTERISTIC C_VS_AC_MAX_CRU "Vehicle speed threshold for acceleration valuation" VALUE 0x42b1d _REC_VAL_20_u1 255. _CNV_A_R_LINEAR_____13_CM 0. 255. FORMAT "%3.0" /end CHARACTERISTIC
/begin CHARACTERISTIC C_VS_DIF_MAX_CRU "Control difference threshold for incrementing VS_SP_CRU" VALUE 0x42b20 _REC_VAL_20_u1 31.875 _CNV_A_R_LINEAR_____130_CM 0. 31.875 /end CHARACTERISTIC
/begin CHARACTERISTIC C_AC_POS_CRU_TIP "Positive acceleration for Tip-up" VALUE 0x42c0c _REC_VAL_20_u2 511.9789 _CNV_A_R_LINEAR_____131_CM 0. 511.9789 FORMAT "%6.2" /end CHARACTERISTIC
/begin CHARACTERISTIC C_AC_NEG_CRU_TIP "Negative acceleration for Tip-up" VALUE 0x42c00 _REC_VAL_20_u2 511.9789 _CNV_A_R_LINEAR_____131_CM 0. 511.9789 FORMAT "%6.2" /end CHARACTERISTIC
/begin CHARACTERISTIC C_AC_NEG_CRU_DEACC "Negative acceleration in deceleration" VALUE 0x42bfe _REC_VAL_20_u2 511.9789 _CNV_A_R_LINEAR_____131_CM 0. 511.9789 FORMAT "%6.2" /end CHARACTERISTIC
/begin CHARACTERISTIC C_AC_POS_CRU_DEACC "Positive acceleration" VALUE 0x42c06 _REC_VAL_20_u2 511.9789 _CNV_A_R_LINEAR_____131_CM 0. 511.9789 FORMAT "%6.2" /end CHARACTERISTIC
/begin CHARACTERISTIC IP_FAC_CRU_REST__T_CTL_CRU "Correction factor of in/decrementing (xx = --, CC; yy = REST, AC, DEACC)" CURVE 0x4df35 _REC_CUR_20_u1_u1 1.99220002 _CNV_A_R_LINEAR_____34_CM 0. 1.99220002 FORMAT "%5.3"
 /begin AXIS_DESCR COM_AXIS T_CTL_CRU _CNV_A_R_LINEAR_____14_CM 5 0. 25.5 FORMAT "%4.1" AXIS_PTS_REF ldpm_t_ctl_cru_1 /end AXIS_DESCR
/end CHARACTERISTIC
/begin CHARACTERISTIC IP_FAC_CRU_AC__T_CTL_CRU "Correction factor of in/decrementing (xx = --, CC; yy = REST, AC, DEACC)" CURVE 0x4df2b _REC_CUR_20_u1_u1 1.99220002 _CNV_A_R_LINEAR_____34_CM 0. 1.99220002 FORMAT "%5.3"
 /begin AXIS_DESCR COM_AXIS T_CTL_CRU _CNV_A_R_LINEAR_____14_CM 5 0. 25.5 FORMAT "%4.1" AXIS_PTS_REF ldpm_t_ctl_cru_1 /end AXIS_DESCR
/end CHARACTERISTIC
/begin CHARACTERISTIC IP_FAC_CRU_DECE__T_CTL_CRU "Correction factor of in/decrementing (xx = --, CC; yy = REST, AC, DEACC)" CURVE 0x4df30 _REC_CUR_20_u1_u1 1.99220002 _CNV_A_R_LINEAR_____34_CM 0. 1.99220002 FORMAT "%5.3"
 /begin AXIS_DESCR COM_AXIS T_CTL_CRU _CNV_A_R_LINEAR_____14_CM 5 0. 25.5 FORMAT "%4.1" AXIS_PTS_REF ldpm_t_ctl_cru_1 /end AXIS_DESCR
/end CHARACTERISTIC
/begin CHARACTERISTIC IP_FAC_LGRD_CRU_REST__VS_SP_DIF "Interception factor of the in/decrementing (xx = REST, TIP)" CURVE 0x4e205 _REC_CUR_20_u1_u2 0.9960940000000002 _CNV_A_R_LINEAR_____44_CM 0. 0.996094 FORMAT "%5.3"
 /begin AXIS_DESCR COM_AXIS VS_SP_DIF_CRU _CNV_A_R_LINEAR_____132_CM 5 -256. 255.9921875 FORMAT "%7.3" AXIS_PTS_REF ldpm_vs_sp_dif_cru_1 /end AXIS_DESCR
/end CHARACTERISTIC
/begin CHARACTERISTIC IP_FAC_LGRD_CRU_TIP__VS_SP_DIF "Interception factor of the in/decrementing (xx = REST, TIP)" CURVE 0x4e20a _REC_CUR_20_u1_u2 0.9960940000000002 _CNV_A_R_LINEAR_____44_CM 0. 0.996094 FORMAT "%5.3"
 /begin AXIS_DESCR COM_AXIS VS_SP_DIF_CRU _CNV_A_R_LINEAR_____132_CM 5 -256. 255.9921875 FORMAT "%7.3" AXIS_PTS_REF ldpm_vs_sp_dif_cru_1 /end AXIS_DESCR
/end CHARACTERISTIC
/begin CHARACTERISTIC C_T_MIN_CRU_CON "Time condition for controlled acceleration" VALUE 0x42a18 _REC_VAL_20_u1 25.5 _CNV_A_R_LINEAR_____14_CM 0. 25.5 FORMAT "%4.1" /end CHARACTERISTIC
/begin CHARACTERISTIC IP_FAC_CC_CRU_AC__T_CTL_CRU "Correction factor of in/decrementing (xx = --, CC; yy = REST, AC, DEACC)" CURVE 0x4df21 _REC_CUR_20_u1_u1 1.99220002 _CNV_A_R_LINEAR_____34_CM 0. 1.99220002 FORMAT "%5.3"
 /begin AXIS_DESCR COM_AXIS T_CTL_CRU _CNV_A_R_LINEAR_____14_CM 5 0. 25.5 FORMAT "%4.1" AXIS_PTS_REF ldpm_t_ctl_cru_1 /end AXIS_DESCR
/end CHARACTERISTIC
/begin CHARACTERISTIC IP_FAC_CC_CRU_DECE__T_CTL_CRU "Correction factor of in/decrementing (xx = --, CC; yy = REST, AC, DEACC)" CURVE 0x4df26 _REC_CUR_20_u1_u1 1.99220002 _CNV_A_R_LINEAR_____34_CM 0. 1.99220002 FORMAT "%5.3"
 /begin AXIS_DESCR COM_AXIS T_CTL_CRU _CNV_A_R_LINEAR_____14_CM 5 0. 25.5 FORMAT "%4.1" AXIS_PTS_REF ldpm_t_ctl_cru_1 /end AXIS_DESCR
/end CHARACTERISTIC
/begin CHARACTERISTIC C_VS_DIF_RNG_CRU "Bandwidth for reducing the control deviation" VALUE 0x431be _REC_VAL_20_u2 511.99218 _CNV_A_R_LINEAR_____78_CM 0. 511.99218 FORMAT "%7.3" /end CHARACTERISTIC
/begin MEASUREMENT STATE_CRU "Status of cruise control to the CAN- Message" UBYTE _CNV_S_6_RANGE_STAT_133_CM 1 100. 0. 9. ECU_ADDRESS 0x3fd29c /end MEASUREMENT
/begin MEASUREMENT FAC_VS_LGRD_CRU "Factor for intercepting the reference input variable" UBYTE _CNV_A_R_LINEAR_____20_CM 1 100. 0. 0.99610001 ECU_ADDRESS 0x3fe858 FORMAT "%5.3" /end MEASUREMENT
/begin MEASUREMENT FAC_VS_CTL_CRU "Correction factor for actuating the reference input variable" UBYTE _CNV_A_R_LINEAR_____103_CM 1 100. 0. 1.9921875 ECU_ADDRESS 0x3fe859 FORMAT "%5.3" /end MEASUREMENT
/begin CHARACTERISTIC C_T_MIN_PUC_CRU "Time after entry into controlled constant drive" VALUE 0x42a1c _REC_VAL_20_u1 25.5 _CNV_A_R_LINEAR_____14_CM 0. 25.5 FORMAT "%4.1" /end CHARACTERISTIC
/begin MEASUREMENT VS_DIF_CRU "Control deviation" SWORD _CNV_A_R_LINEAR_____126_CM 1 100. -256. 255.9921875 ECU_ADDRESS 0x3fd296 FORMAT "%7.3" /end MEASUREMENT
/begin MEASUREMENT FAC_TQ_CRU_INI "CRU control variable initialisation value" UWORD _CNV_A_R_LINEAR_____94_CM 1 100. 0. 99.99847412 ECU_ADDRESS 0x3fe84a /end MEASUREMENT
/begin CHARACTERISTIC IP_FAC_PROP_CRU "Proportional coefficient of the PI controller" MAP 0x4763c _REC_MAP_20_u2_u2_u2 49.999237 _CNV_A_R_LINEAR_____134_CM 0. 49.999237 FORMAT "%7.4"
 /begin AXIS_DESCR COM_AXIS VS_SP_CRU _CNV_A_R_LINEAR_____78_CM 5 0. 511.99218 FORMAT "%7.3" AXIS_PTS_REF ldpm_vs_sp_cru_1 /end AXIS_DESCR
 /begin AXIS_DESCR COM_AXIS VS_DIF_CRU _CNV_A_R_LINEAR_____132_CM 4 -256. 255.9921875 FORMAT "%7.3" AXIS_PTS_REF ldp_vs_dif_cru__fac_prop_cru /end AXIS_DESCR
/end CHARACTERISTIC
/begin CHARACTERISTIC IP_FAC_TQ_CRU_INI_ADD_AT "Additive torque based on gear and acceleration" MAP 0x47c0a _REC_MAP_20_u2_u2_u1 400. _CNV_A_R_LINEAR_____135_CM -200. 200. FORMAT "%8.3"
 /begin AXIS_DESCR COM_AXIS AC_CRU _CNV_A_R_LINEAR_____136_CM 6 -15.72 15.71952 FORMAT "%8.4" AXIS_PTS_REF ldpm_ac_cru__fac_tq_cru /end AXIS_DESCR
 /begin AXIS_DESCR COM_AXIS GEAR _CNV_A_R_LINEAR_____10_CM 12 0. 255. FORMAT "%3.0" AXIS_PTS_REF ldpm_gear__fac_tq_cru /end AXIS_DESCR
/end CHARACTERISTIC
/begin CHARACTERISTIC IP_FAC_TQ_CRU_INI_ADD_MT "Additive torque based on gear and acceleration" MAP 0x47c9a _REC_MAP_20_u2_u2_u1 400. _CNV_A_R_LINEAR_____135_CM -200. 200. FORMAT "%8.3"
 /begin AXIS_DESCR COM_AXIS AC_CRU _CNV_A_R_LINEAR_____136_CM 6 -15.72 15.71952 FORMAT "%8.4" AXIS_PTS_REF ldpm_ac_cru__fac_tq_cru /end AXIS_DESCR
 /begin AXIS_DESCR COM_AXIS GEAR _CNV_A_R_LINEAR_____10_CM 12 0. 255. FORMAT "%3.0" AXIS_PTS_REF ldpm_gear__fac_tq_cru /end AXIS_DESCR
/end CHARACTERISTIC
/begin CHARACTERISTIC C_FAC_VS_DIF_RNG_CRU "Reduction factor for the control deviation VS_DIF_CRU" VALUE 0x428c4 _REC_VAL_20_u1 0.99610001 _CNV_A_R_LINEAR_____20_CM 0. 0.99610001 FORMAT "%5.3" /end CHARACTERISTIC
/begin CHARACTERISTIC IP_FAC_TQ_CRU_DEC__N_32 "Decrement of the FAC_TQ_CRU" CURVE 0x47c00 _REC_CUR_20_u2_u1 99.99847412 _CNV_A_R_LINEAR_____94_CM 0. 99.99847412
 /begin AXIS_DESCR COM_AXIS N_32 _CNV_A_R_LINEAR_____5_CM 5 0. 8160. FORMAT "%4.0" AXIS_PTS_REF ldp_n_32__fac_tq_cru /end AXIS_DESCR
/end CHARACTERISTIC
/begin CHARACTERISTIC IP_AC_NEG_CRU_AC__N__FAC_TQ_CRU "negative acceleration in setting" MAP 0x45f68 _REC_MAP_20_u2_u1_u2 511.9789 _CNV_A_R_LINEAR_____131_CM 0. 511.9789 FORMAT "%6.2"
 /begin AXIS_DESCR COM_AXIS N_32 _CNV_A_R_LINEAR_____5_CM 3 0. 8160. FORMAT "%4.0" AXIS_PTS_REF ldpm_n_21 /end AXIS_DESCR
 /begin AXIS_DESCR COM_AXIS FAC_TQ_CRU _CNV_A_R_LINEAR_____94_CM 3 0. 99.99847412 AXIS_PTS_REF ldpm_fac_tq_cru_1 /end AXIS_DESCR
/end CHARACTERISTIC
/begin CHARACTERISTIC IP_FAC_VS_DIF_I_CRU "Delta VS_SP_CRU correction" MAP 0x47f84 _REC_MAP_20_u2_u2_u2 0.99998474 _CNV_A_R_LINEAR_____31_CM 0. 0.99998474 FORMAT "%7.5"
 /begin AXIS_DESCR COM_AXIS VS_SP_CRU _CNV_A_R_LINEAR_____78_CM 5 0. 511.99218 FORMAT "%7.3" AXIS_PTS_REF ldpm_vs_sp_cru_1 /end AXIS_DESCR
 /begin AXIS_DESCR COM_AXIS VS_DIF_CRU _CNV_A_R_LINEAR_____132_CM 4 -256. 255.9921875 FORMAT "%7.3" AXIS_PTS_REF ldp_vs_dif_cru__fac_prop_cru /end AXIS_DESCR
/end CHARACTERISTIC
/begin CHARACTERISTIC IP_FAC_VS_SP_DIF_I_CRU "Delta VS_SP_CRU correction" CURVE 0x47ffc _REC_CUR_20_u2_u2 1.99996948 _CNV_A_R_LINEAR_____45_CM 0. 1.99996948 FORMAT "%7.5"
 /begin AXIS_DESCR COM_AXIS VS_SP_CRU _CNV_A_R_LINEAR_____78_CM 5 0. 511.99218 FORMAT "%7.3" AXIS_PTS_REF ldpm_vs_sp_cru_1 /end AXIS_DESCR
/end CHARACTERISTIC
/begin CHARACTERISTIC C_VS_DIF_DELTA_I "Positive acceleration" VALUE 0x42b1f _REC_VAL_20_u1 63.75 _CNV_A_R_LINEAR_____137_CM 0. 63.75 /end CHARACTERISTIC
/begin CHARACTERISTIC C_FAC_TQ_CRU_LGRD "Control variable limitaion gradiant" VALUE 0x42d38 _REC_VAL_20_u2 99.99847412 _CNV_A_R_LINEAR_____138_CM 0. 99.99847412 /end CHARACTERISTIC
/begin CHARACTERISTIC C_FAC_TQ_CRU_MAX "Maximum request of Cruise Control" VALUE 0x42d3a _REC_VAL_20_u2 99.99847412 _CNV_A_R_LINEAR_____138_CM 0. 99.99847412 /end CHARACTERISTIC
/begin CHARACTERISTIC C_FAC_AC_POS_CRU "Maximum reduction of FAC_VS_LGRD_CRU" VALUE 0x4289a _REC_VAL_20_u1 0.9960940000000002 _CNV_A_R_LINEAR_____44_CM 0. 0.996094 FORMAT "%5.3" /end CHARACTERISTIC
/begin CHARACTERISTIC C_FAC_AC_POS_CRU_RNG_L "Maximum reduction of FAC_VS_LGRD_CRU at RNG_L" VALUE 0x4289b _REC_VAL_20_u1 0.9960940000000002 _CNV_A_R_LINEAR_____44_CM 0. 0.996094 FORMAT "%5.3" /end CHARACTERISTIC
/begin CHARACTERISTIC C_AC_POS_CRU_RESU "Positive acceleration at CRU resume" VALUE 0x42c08 _REC_VAL_20_u2 511.9789 _CNV_A_R_LINEAR_____131_CM 0. 511.9789 FORMAT "%6.2" /end CHARACTERISTIC
/begin CHARACTERISTIC C_AC_POS_CRU_RESU_RNG_L "Positive acceleration at CRU resume at RNG_L" VALUE 0x42c0a _REC_VAL_20_u2 511.9789 _CNV_A_R_LINEAR_____131_CM 0. 511.9789 FORMAT "%6.2" /end CHARACTERISTIC
/begin CHARACTERISTIC C_AC_POS_CRU_AC "Positive acceleration in setting/acceleration" VALUE 0x42c02 _REC_VAL_20_u2 511.9789 _CNV_A_R_LINEAR_____131_CM 0. 511.9789 FORMAT "%6.2" /end CHARACTERISTIC
/begin CHARACTERISTIC C_AC_POS_CRU_AC_RNG_L "Positive acceleration in setting/acceleration at RNG_L" VALUE 0x42c04 _REC_VAL_20_u2 511.9789 _CNV_A_R_LINEAR_____131_CM 0. 511.9789 FORMAT "%6.2" /end CHARACTERISTIC
/begin MEASUREMENT FAC_TQ_CRU "CRU control variable" UWORD _CNV_A_R_LINEAR_____94_CM 1 100. 0. 99.99847412 ECU_ADDRESS 0x3fd290 /end MEASUREMENT
/begin MEASUREMENT STATE_I_CRU "Condition of I Share VS_DIF_I_CRU" UBYTE _CNV_S_4_STATE_I_CR_139_CM 1 100. 0. 3. ECU_ADDRESS 0x3fe85b /end MEASUREMENT
/begin CHARACTERISTIC IP_AC_NEG_CRU_RESU "negative acceleration at CRU resume" MAP 0x45f7a _REC_MAP_20_u2_u1_u2 511.9789 _CNV_A_R_LINEAR_____131_CM 0. 511.9789 FORMAT "%6.2"
 /begin AXIS_DESCR COM_AXIS N_32 _CNV_A_R_LINEAR_____5_CM 3 0. 8160. FORMAT "%4.0" AXIS_PTS_REF ldpm_n_21 /end AXIS_DESCR
 /begin AXIS_DESCR COM_AXIS FAC_TQ_CRU _CNV_A_R_LINEAR_____94_CM 3 0. 99.99847412 AXIS_PTS_REF ldpm_fac_tq_cru_1 /end AXIS_DESCR
/end CHARACTERISTIC
/begin AXIS_PTS ldpm_t_ctl_cru_1 "" 0x43f1f T_CTL_CRU _REC_AXS_20_u1 2.55 _CNV_A_R_LINEAR_____14_CM 5 0. 25.5 FORMAT "%4.1" /end AXIS_PTS
/begin AXIS_PTS ldp_vs_dif_cru__fac_prop_cru "" 0x44e12 VS_DIF_CRU _REC_AXS_20_u2 511.9921875 _CNV_A_R_LINEAR_____132_CM 4 -256. 255.9921875 FORMAT "%7.3" /end AXIS_PTS
/begin AXIS_PTS ldpm_vs_sp_dif_cru_1 "" 0x456a6 VS_SP_DIF_CRU _REC_AXS_20_u2 511.9921875 _CNV_A_R_LINEAR_____132_CM 5 -256. 255.9921875 FORMAT "%7.3" /end AXIS_PTS
/begin AXIS_PTS ldpm_n_21 "" 0x43cae N_32 _REC_AXS_20_u1 8160. _CNV_A_R_LINEAR_____5_CM 3 0. 8160. FORMAT "%4.0" /end AXIS_PTS
/begin AXIS_PTS ldpm_vs_sp_cru_1 "" 0x4569a VS_SP_CRU _REC_AXS_20_u2 511.99218 _CNV_A_R_LINEAR_____78_CM 5 0. 511.99218 FORMAT "%7.3" /end AXIS_PTS
/begin AXIS_PTS ldpm_ac_cru__fac_tq_cru "" 0x44e46 AC_CRU _REC_AXS_20_u2 31.43952 _CNV_A_R_LINEAR_____136_CM 6 -15.72 15.71952 FORMAT "%8.4" /end AXIS_PTS
/begin AXIS_PTS ldpm_gear__fac_tq_cru "" 0x43bbb GEAR _REC_AXS_20_u1 255. _CNV_A_R_LINEAR_____10_CM 12 0. 255. FORMAT "%3.0" /end AXIS_PTS
/begin AXIS_PTS ldp_n_32__fac_tq_cru "" 0x434f5 N_32 _REC_AXS_20_u1 816. _CNV_A_R_LINEAR_____5_CM 5 0. 8160. FORMAT "%4.0" /end AXIS_PTS
/begin AXIS_PTS ldpm_fac_tq_cru_1 "" 0x44f68 FAC_TQ_CRU _REC_AXS_20_u2 99.99847412 _CNV_A_R_LINEAR_____94_CM 3 0. 99.99847412 /end AXIS_PTS
/begin MEASUREMENT NR_STEP_ON "Current vehicle speed step" UBYTE _CNV_A_R_LINEAR_____10_CM 1 100. 0. 255. ECU_ADDRESS 0x3fe868 FORMAT "%3.0" /end MEASUREMENT
/begin MEASUREMENT COUNT_VS_STEP "Number of used vehicle speed steps" UBYTE _CNV_A_R_LINEAR_____10_CM 1 100. 0. 255. ECU_ADDRESS 0x3fe869 FORMAT "%3.0" /end MEASUREMENT
/begin MEASUREMENT VS_DIF_STEP_PROG "Differences between steps" UWORD _CNV_A_R_LINEAR_____61_CM 1 100. 0. 409.4 ECU_ADDRESS 0x3fe860 FORMAT "%5.1" /end MEASUREMENT
/begin MEASUREMENT LV_PROG_STEP_1 "Standing programming on" UBYTE _CNV_S_2_RANGE______28_CM 1 100. 0. 1. ECU_ADDRESS 0x3fd2c8 /end MEASUREMENT
/begin MEASUREMENT LV_STEP_ON "Step display on" UBYTE _CNV_S_2_RANGE______28_CM 1 100. 0. 1. ECU_ADDRESS 0x3fd2c7 /end MEASUREMENT
/begin MEASUREMENT VS_SP_DRIV_STEP "Active vehicle speed step for the controller" UWORD _CNV_A_R_LINEAR_____78_CM 1 100. 0. 511.99218 ECU_ADDRESS 0x3fd2be FORMAT "%7.3" /end MEASUREMENT
/begin MEASUREMENT NR_VS_CRU "Cycle number of message IDX_NO" UBYTE _CNV_A_R_LINEAR_____10_CM 1 100. 0. 255. ECU_ADDRESS 0x3fd2c6 FORMAT "%3.0" /end MEASUREMENT
/begin MEASUREMENT VS_SP_DRIV_CRU_CAN "Driver demand cruise control for INSTR" UWORD _CNV_A_R_LINEAR_____61_CM 1 100. 0. 409.4 ECU_ADDRESS 0x3fd2bc FORMAT "%5.1" /end MEASUREMENT
/begin MEASUREMENT VS_STEP_CAN_1 "Vehicle speed step to the CAN Nr.1" UWORD _CNV_A_R_LINEAR_____61_CM 1 100. 0. 409.4 ECU_ADDRESS 0x3fd2c0 FORMAT "%5.1" /end MEASUREMENT
/begin MEASUREMENT VS_STEP_CAN_2 "Vehicle speed step to the CAN Nr.2" UWORD _CNV_A_R_LINEAR_____61_CM 1 100. 0. 409.4 ECU_ADDRESS 0x3fd2c2 FORMAT "%5.1" /end MEASUREMENT
/begin MEASUREMENT VS_STEP_CAN_3 "Vehicle speed step to the CAN Nr.3" UWORD _CNV_A_R_LINEAR_____61_CM 1 100. 0. 409.4 ECU_ADDRESS 0x3fd2c4 FORMAT "%5.1" /end MEASUREMENT
/begin CHARACTERISTIC C_VS_DIF_STEP_PROG_M "M.p.h step calibration" VALUE 0x431c4 _REC_VAL_20_u2 409.4 _CNV_A_R_LINEAR_____61_CM 0. 409.4 FORMAT "%5.1" /end CHARACTERISTIC
/begin CHARACTERISTIC C_VS_DIF_STEP_PROG_K "Km.p.h step calibration" VALUE 0x431c2 _REC_VAL_20_u2 409.4 _CNV_A_R_LINEAR_____61_CM 0. 409.4 FORMAT "%5.1" /end CHARACTERISTIC
/begin CHARACTERISTIC C_VS_DIF_STEP_MIN "Minimum between steps" VALUE 0x431c0 _REC_VAL_20_u2 409.4 _CNV_A_R_LINEAR_____61_CM 0. 409.4 FORMAT "%5.1" /end CHARACTERISTIC
/begin CHARACTERISTIC C_VS_DIF_TIP_PROG "Difference between tip steps" VALUE 0x431c6 _REC_VAL_20_u2 409.4 _CNV_A_R_LINEAR_____61_CM 0. 409.4 FORMAT "%5.1" /end CHARACTERISTIC
/begin CHARACTERISTIC C_VS_MIN_PROG "VS_CRU threshold stand programming detection" VALUE 0x431d4 _REC_VAL_20_u2 511.99218 _CNV_A_R_LINEAR_____78_CM 0. 511.99218 FORMAT "%7.3" /end CHARACTERISTIC
/begin CHARACTERISTIC C_MAX_STEP "Maximum number of steps" VALUE 0x42908 _REC_VAL_20_u1 255. _CNV_A_R_LINEAR_____10_CM 0. 255. FORMAT "%3.0" /end CHARACTERISTIC
/begin CHARACTERISTIC C_T_CRU_FLASH_LIGHT "Flash light duration time" VALUE 0x429c1 _REC_VAL_20_u1 2.55 _CNV_A_R_LINEAR_____27_CM 0. 2.55 FORMAT "%4.2" /end CHARACTERISTIC
/begin CHARACTERISTIC C_T_DLY_CRU_TIP "Time delay for display vehicle speed pointer" VALUE 0x429d6 _REC_VAL_20_u1 2.55 _CNV_A_R_LINEAR_____27_CM 0. 2.55 FORMAT "%4.2" /end CHARACTERISTIC
/begin CHARACTERISTIC C_T_MIN_PROG "Time for programming detection" VALUE 0x42a1b _REC_VAL_20_u1 2.55 _CNV_A_R_LINEAR_____27_CM 0. 2.55 FORMAT "%4.2" /end CHARACTERISTIC
/begin MEASUREMENT STK_AV_EGR "Actual value of the stroke of EGR valve" UBYTE _CNV_A_R_LINEAR_____4_CM 1 100. 0. 99.609375 ECU_ADDRESS 0x3fc5bc FORMAT "%3.1" /end MEASUREMENT
/begin CHARACTERISTIC C_PSN_LS_1 "byte wich indicates the location of oxygen sensors" VALUE 0x4297f _REC_VAL_20_u1 255. _CNV_A_R_LINEAR_____10_CM 0. 255. FORMAT "%3.0" /end CHARACTERISTIC
/begin CHARACTERISTIC C_MOD_1_PID_2_DIAG "Calibration byte which defines the PIDs supported by mode 01 (09h -10h)" VALUE 0x4290d _REC_VAL_20_u1 255. _CNV_A_R_LINEAR_____10_CM 0. 255. FORMAT "%3.0" /end CHARACTERISTIC
/begin CHARACTERISTIC C_MOD_1_PID_3_DIAG "Calibration byte which defines the PIDs supported by mode 01 (11h -18h)" VALUE 0x4290e _REC_VAL_20_u1 255. _CNV_A_R_LINEAR_____10_CM 0. 255. FORMAT "%3.0" /end CHARACTERISTIC
/begin CHARACTERISTIC C_MOD_1_PID_4_DIAG "Calibration byte which defines the PIDs supported by mode 01 (19h -20h)" VALUE 0x4290f _REC_VAL_20_u1 255. _CNV_A_R_LINEAR_____10_CM 0. 255. FORMAT "%3.0" /end CHARACTERISTIC
/begin CHARACTERISTIC C_MOD_1_PID_5_DIAG "Calibration byte which defines the PIDs supported by mode 01 (21h -28h)" VALUE 0x42910 _REC_VAL_20_u1 255. _CNV_A_R_LINEAR_____10_CM 0. 255. FORMAT "%3.0" /end CHARACTERISTIC
/begin CHARACTERISTIC C_MOD_1_PID_6_DIAG "Calibration byte which defines the PIDs supported by mode 01 (29h -30h)" VALUE 0x42911 _REC_VAL_20_u1 255. _CNV_A_R_LINEAR_____10_CM 0. 255. FORMAT "%3.0" /end CHARACTERISTIC
/begin CHARACTERISTIC C_MOD_1_PID_7_DIAG "Calibration byte which defines the PIDs supported by mode 01 (31h -38h)" VALUE 0x42912 _REC_VAL_20_u1 255. _CNV_A_R_LINEAR_____10_CM 0. 255. FORMAT "%3.0" /end CHARACTERISTIC
/begin CHARACTERISTIC C_MOD_1_PID_8_DIAG "Calibration byte which defines the PIDs supported by mode 01 (39h -40h)" VALUE 0x42913 _REC_VAL_20_u1 255. _CNV_A_R_LINEAR_____10_CM 0. 255. FORMAT "%3.0" /end CHARACTERISTIC
/begin CHARACTERISTIC C_MOD_2_PID_1_DIAG "Calibration byte which defines the PIDs supported by mode 02 (01h -08h)" VALUE 0x42914 _REC_VAL_20_u1 255. _CNV_A_R_LINEAR_____10_CM 0. 255. FORMAT "%3.0" /end CHARACTERISTIC
/begin CHARACTERISTIC C_MOD_2_PID_2_DIAG "Calibration byte which defines the PIDs supported by mode 02 (09h -10h)" VALUE 0x42915 _REC_VAL_20_u1 255. _CNV_A_R_LINEAR_____10_CM 0. 255. FORMAT "%3.0" /end CHARACTERISTIC
/begin CHARACTERISTIC C_MOD_2_PID_3_DIAG "Calibration byte which defines the PIDs supported by mode 02 (11h -18h)" VALUE 0x42916 _REC_VAL_20_u1 255. _CNV_A_R_LINEAR_____10_CM 0. 255. FORMAT "%3.0" /end CHARACTERISTIC
/begin CHARACTERISTIC C_MOD_2_PID_4_DIAG "Calibration byte which defines the PIDs supported by mode 02 (19h -20h)" VALUE 0x42917 _REC_VAL_20_u1 255. _CNV_A_R_LINEAR_____10_CM 0. 255. FORMAT "%3.0" /end CHARACTERISTIC
/begin CHARACTERISTIC C_OBD_REQ "byte wich indicates the OBD requirements" VALUE 0x4297b _REC_VAL_20_u1 255. _CNV_A_R_LINEAR_____10_CM 0. 255. FORMAT "%3.0" /end CHARACTERISTIC
/begin CHARACTERISTIC C_PSN_LS "byte wich indicates the location of oxygen sensors" VALUE 0x4297e _REC_VAL_20_u1 255. _CNV_A_R_LINEAR_____10_CM 0. 255. FORMAT "%3.0" /end CHARACTERISTIC
/begin CHARACTERISTIC C_MOD_1_PID_1_DIAG "Calibration byte which defines the PIDs supported by mode 01 (01h -08h)" VALUE 0x4290c _REC_VAL_20_u1 255. _CNV_A_R_LINEAR_____10_CM 0. 255. FORMAT "%3.0" /end CHARACTERISTIC
/begin CHARACTERISTIC C_MOD_6_TID_2_DIAG "Calibration byte which defines the PIDs supported by mode 02 (19h -20h)" VALUE 0x42919 _REC_VAL_20_u1 255. _CNV_A_R_LINEAR_____10_CM 0. 255. FORMAT "%3.0" /end CHARACTERISTIC
/begin CHARACTERISTIC C_MOD_6_TID_3_DIAG "Calibration byte which defines the PIDs supported by mode 02 (19h -20h)" VALUE 0x4291a _REC_VAL_20_u1 255. _CNV_A_R_LINEAR_____10_CM 0. 255. FORMAT "%3.0" /end CHARACTERISTIC
/begin CHARACTERISTIC C_MOD_6_TID_4_DIAG "Calibration byte which defines the PIDs supported by mode 02 (19h -20h)" VALUE 0x4291b _REC_VAL_20_u1 255. _CNV_A_R_LINEAR_____10_CM 0. 255. FORMAT "%3.0" /end CHARACTERISTIC
/begin CHARACTERISTIC C_MOD_6_TID_1_DIAG "Calibration byte which defines the PIDs supported by mode 02 (19h -20h)" VALUE 0x42918 _REC_VAL_20_u1 255. _CNV_A_R_LINEAR_____10_CM 0. 255. FORMAT "%3.0" /end CHARACTERISTIC
/begin CHARACTERISTIC C_MOD_9_VIT_2_DIAG "Calibration byte which defines the PIDs supported by mode 02 (19h -20h)" VALUE 0x42921 _REC_VAL_20_u1 255. _CNV_A_R_LINEAR_____10_CM 0. 255. FORMAT "%3.0" /end CHARACTERISTIC
/begin CHARACTERISTIC C_MOD_9_VIT_3_DIAG "Calibration byte which defines the PIDs supported by mode 02 (19h -20h)" VALUE 0x42922 _REC_VAL_20_u1 255. _CNV_A_R_LINEAR_____10_CM 0. 255. FORMAT "%3.0" /end CHARACTERISTIC
/begin CHARACTERISTIC C_MOD_9_VIT_4_DIAG "Calibration byte which defines the PIDs supported by mode 02 (19h -20h)" VALUE 0x42923 _REC_VAL_20_u1 255. _CNV_A_R_LINEAR_____10_CM 0. 255. FORMAT "%3.0" /end CHARACTERISTIC
/begin CHARACTERISTIC C_MOD_9_VIT_1_DIAG "Calibration byte which defines the PIDs supported by mode 02 (19h -20h)" VALUE 0x42920 _REC_VAL_20_u1 255. _CNV_A_R_LINEAR_____10_CM 0. 255. FORMAT "%3.0" /end CHARACTERISTIC
/begin CHARACTERISTIC C_MOD_8_TID_2_DIAG "Calibration byte which defines the PIDs supported by mode 02 (19h -20h)" VALUE 0x4291d _REC_VAL_20_u1 255. _CNV_A_R_LINEAR_____10_CM 0. 255. FORMAT "%3.0" /end CHARACTERISTIC
/begin CHARACTERISTIC C_MOD_8_TID_3_DIAG "Calibration byte which defines the PIDs supported by mode 02 (19h -20h)" VALUE 0x4291e _REC_VAL_20_u1 255. _CNV_A_R_LINEAR_____10_CM 0. 255. FORMAT "%3.0" /end CHARACTERISTIC
/begin CHARACTERISTIC C_MOD_8_TID_1_DIAG "Calibration byte which defines the PIDs supported by mode 02 (19h -20h)" VALUE 0x4291c _REC_VAL_20_u1 255. _CNV_A_R_LINEAR_____10_CM 0. 255. FORMAT "%3.0" /end CHARACTERISTIC
/begin CHARACTERISTIC C_MOD_8_TID_4_DIAG "Calibration byte which defines the PIDs supported by mode 02 (19h -20h)" VALUE 0x4291f _REC_VAL_20_u1 255. _CNV_A_R_LINEAR_____10_CM 0. 255. FORMAT "%3.0" /end CHARACTERISTIC
/begin MEASUREMENT RLS_MPL_VALUE_PROG "Release of multiple start value programming" UBYTE _CNV_A_R_LINEAR_____10_CM 1 100. 0. 255. ECU_ADDRESS 0x3fe892 FORMAT "%3.0" BIT_MASK 0x1 /end MEASUREMENT
/begin MEASUREMENT STATE_IMOB "State of the immobilizer" UBYTE _CNV_A_R_LINEAR_____10_CM 1 100. 0. 255. ECU_ADDRESS 0x3fe893 FORMAT "%3.0" BIT_MASK 0x1 /end MEASUREMENT
/begin MEASUREMENT NR_FREE_STARTVALUES "Number of free startvalues bit codet and a release bit" UBYTE _CNV_A_R_LINEAR_____10_CM 1 100. 0. 255. ECU_ADDRESS 0x3fe891 FORMAT "%3.0" BIT_MASK 0x1 /end MEASUREMENT
/begin MEASUREMENT STATE_VLS_EOL "Status of lambda sensor EOL diagnosis confused wired" UBYTE _CNV_S_12_STATE_VLS__325_CM 1 100. 0. 24. ECU_ADDRESS 0x3fe8fe /end MEASUREMENT
/begin MEASUREMENT LAMB_SP_VLS_EOL_2 "Lambda setpoint for lambda sensor EOL diagnosis confused wired" UWORD _CNV_A_R_LINEAR_____148_CM 1 100. 0. 31.99902344 ECU_ADDRESS 0x3fe8ea FORMAT "%7.4" /end MEASUREMENT
/begin MEASUREMENT LV_ACT_VLS_EOL_EXT_ADJ "Activation bit for lambda sensor EOL diagnos confused wired" UBYTE _CNV_S_2_RANGE______28_CM 1 100. 0. 1. ECU_ADDRESS 0x3fe8ff /end MEASUREMENT
/begin CHARACTERISTIC C_TCO_MIN_VLS_EOL "TCO threshold for VLS EOL diagnosis" VALUE 0x42a75 _REC_VAL_20_u1 190.5 _CNV_A_R_LINEAR_____0_CM -48. 142.5 FORMAT "%5.1" /end CHARACTERISTIC
/begin CHARACTERISTIC C_TEG_CAT_DOWN_EOL "TEG_CAT_DOWN threshold for VLS EOL diagnosis" VALUE 0x4305a _REC_VAL_20_u2 1507.3 _CNV_A_R_LINEAR_____269_CM -48. 1459.3 FORMAT "%7.2" /end CHARACTERISTIC
/begin CHARACTERISTIC C_MAF_INT_MIN_VLS_EOL "MAF integral threshold for lambda sensor EOL diagnos confused wired" VALUE 0x42e34 _REC_VAL_20_u2 1820.398 _CNV_A_R_LINEAR_____277_CM 0. 1820.398 FORMAT "%7.2" /end CHARACTERISTIC
/begin CHARACTERISTIC C_LAMB_SP_VLS_EOL_AFR "Lambda setpoint AFR for lambda sensor EOL diagnos confused wired" VALUE 0x42dde _REC_VAL_20_u2 31.99902344 _CNV_A_R_LINEAR_____148_CM 0. 31.99902344 FORMAT "%7.4" /end CHARACTERISTIC
/begin CHARACTERISTIC C_LAMB_SP_VLS_EOL_AFL "Lambda setpoint AFL for lambda sensor EOL diagnos confused wired" VALUE 0x42ddc _REC_VAL_20_u2 31.99902344 _CNV_A_R_LINEAR_____148_CM 0. 31.99902344 FORMAT "%7.4" /end CHARACTERISTIC
/begin CHARACTERISTIC C_VLS_AFR_EOL "Rich VLS threshold for lambda sensor EOL diagnosis" VALUE 0x4316c _REC_VAL_20_u2 4.99511719 _CNV_A_R_LINEAR_____33_CM 0. 4.99511719 FORMAT "%5.3" /end CHARACTERISTIC
/begin CHARACTERISTIC C_VLS_AFL_EOL "Lean VLS threshold for lambda sensor EOL diagnosis" VALUE 0x43162 _REC_VAL_20_u2 4.99511719 _CNV_A_R_LINEAR_____33_CM 0. 4.99511719 FORMAT "%5.3" /end CHARACTERISTIC
/begin MEASUREMENT LAMB_SP_VLS_EOL_1 "Lambda setpoint for lambda sensor EOL diagnosis confused wired" UWORD _CNV_A_R_LINEAR_____148_CM 1 100. 0. 31.99902344 ECU_ADDRESS 0x3fe8e8 FORMAT "%7.4" /end MEASUREMENT
/begin MEASUREMENT LAMB_SP_EXT_ADJ_1 "bank selective external lambda setpoint (EOL test)" UWORD _CNV_A_R_LINEAR_____148_CM 1 100. 0. 31.99902344 ECU_ADDRESS 0x3fe906 FORMAT "%7.4" /end MEASUREMENT
/begin MEASUREMENT LAMB_SP_EXT_ADJ_2 "bank selective external lambda setpoint (EOL test)" UWORD _CNV_A_R_LINEAR_____148_CM 1 100. 0. 31.99902344 ECU_ADDRESS 0x3fe90a FORMAT "%7.4" /end MEASUREMENT
/begin MEASUREMENT LV_LAMB_SP_EXT_ADJ_1 "FL<g to activate bank selective external lambda setpoint (EOL test)" UBYTE _CNV_S_2_RANGE______28_CM 1 100. 0. 1. ECU_ADDRESS 0x3fe904 /end MEASUREMENT
/begin MEASUREMENT LV_LAMB_SP_EXT_ADJ_2 "FL<g to activate bank selective external lambda setpoint (EOL test)" UBYTE _CNV_S_2_RANGE______28_CM 1 100. 0. 1. ECU_ADDRESS 0x3fe908 /end MEASUREMENT
/begin CHARACTERISTIC C_N_OFS_ACC_DRI_MIN "idle speed setpoint offset minimum threshold at LV_ACIN = 1 and LV_DRI = 1" VALUE 0x43354 _REC_VAL_20_s1 510. _CNV_A_R_LINEAR_____374_CM -256. 254. FORMAT "%4.0" /end CHARACTERISTIC
/begin CHARACTERISTIC C_N_OFS_DRI_MAX "idle speed setpoint offset maximum threshold at LV_ACIN = 0 and LV_DRI = 1" VALUE 0x43357 _REC_VAL_20_s1 510. _CNV_A_R_LINEAR_____374_CM -256. 254. FORMAT "%4.0" /end CHARACTERISTIC
/begin CHARACTERISTIC C_N_OFS_DRI_MIN "idle speed setpoint offset minimum threshold at LV_ACIN = 0 and LV_DRI = 1" VALUE 0x43358 _REC_VAL_20_s1 510. _CNV_A_R_LINEAR_____374_CM -256. 254. FORMAT "%4.0" /end CHARACTERISTIC
/begin CHARACTERISTIC C_N_OFS_MAX "idle speed setpoint offset maximum threshold at LV_ACIN = 0 and LV_DRI = 0" VALUE 0x43359 _REC_VAL_20_s1 510. _CNV_A_R_LINEAR_____374_CM -256. 254. FORMAT "%4.0" /end CHARACTERISTIC
/begin CHARACTERISTIC C_N_OFS_MIN "idle speed setpoint offset minimum threshold at LV_ACIN = 0 and LV_DRI = 0" VALUE 0x4335a _REC_VAL_20_s1 510. _CNV_A_R_LINEAR_____374_CM -256. 254. FORMAT "%4.0" /end CHARACTERISTIC
/begin CHARACTERISTIC C_N_OFS_ACC_MAX "idle speed setpoint offset maximum threshold at LV_ACIN = 1 and LV_DRI = 0" VALUE 0x43355 _REC_VAL_20_s1 510. _CNV_A_R_LINEAR_____374_CM -256. 254. FORMAT "%4.0" /end CHARACTERISTIC
/begin CHARACTERISTIC C_N_OFS_ACC_MIN "idle speed setpoint offset minimum threshold at LV_ACIN = 1 and LV_DRI = 0" VALUE 0x43356 _REC_VAL_20_s1 510. _CNV_A_R_LINEAR_____374_CM -256. 254. FORMAT "%4.0" /end CHARACTERISTIC
/begin CHARACTERISTIC C_N_OFS_VB_MAX "idle speed setpoint offset maximum threshold at battery charging is active" VALUE 0x4335b _REC_VAL_20_s1 510. _CNV_A_R_LINEAR_____374_CM -256. 254. FORMAT "%4.0" /end CHARACTERISTIC
/begin MEASUREMENT N_KWP_OFS_ACC "idle speed setpoint offset at LV_ACIN = 1 and LV_DRI = 0" SBYTE _CNV_A_R_LINEAR_____374_CM 1 100. -256. 254. ECU_ADDRESS 0x3fd2d9 FORMAT "%4.0" /end MEASUREMENT
/begin MEASUREMENT N_KWP_OFS "idle speed setpoint offset at LV_ACIN = 0 and LV_DRI = 0" SBYTE _CNV_A_R_LINEAR_____374_CM 1 100. -256. 254. ECU_ADDRESS 0x3fd2d8 FORMAT "%4.0" /end MEASUREMENT
/begin MEASUREMENT N_KWP_OFS_VB_NVMY_ "idle speed setpoint offset at battery charging is active stored in non volatile memory" SBYTE _CNV_A_R_LINEAR_____374_CM 1 100. -256. 254. ECU_ADDRESS 0x3fd2d5 FORMAT "%4.0" /end MEASUREMENT
/begin MEASUREMENT N_KWP_OFS_ACC_NVMY_ "idle speed setpoint offset at LV_ACIN = 1 and LV_DRI = 0 stored in non volatile memory" SBYTE _CNV_A_R_LINEAR_____374_CM 1 100. -256. 254. ECU_ADDRESS 0x3fd2d4 FORMAT "%4.0" /end MEASUREMENT
/begin MEASUREMENT N_KWP_OFS_NVMY_ "idle speed setpoint offset at LV_ACIN = 0 and LV_DRI = 0 stored in non volatile memory" SBYTE _CNV_A_R_LINEAR_____374_CM 1 100. -256. 254. ECU_ADDRESS 0x3fd2d3 FORMAT "%4.0" /end MEASUREMENT
/begin MEASUREMENT N_KWP_OFS_DRI_NVMY_ "idle speed setpoint offset at LV_ACIN = 0 and LV_DRI = 1 stored in non volatile memory" SBYTE _CNV_A_R_LINEAR_____374_CM 1 100. -256. 254. ECU_ADDRESS 0x3fd2d2 FORMAT "%4.0" /end MEASUREMENT
/begin MEASUREMENT N_KWP_OFS_ACC_DRI_NVMY "idle speed setpoint offset at LV_ACIN = 1 and LV_DRI = 1 stored in non volatile memory" SBYTE _CNV_A_R_LINEAR_____374_CM 1 100. -256. 254. ECU_ADDRESS 0x3fd2d1 FORMAT "%4.0" /end MEASUREMENT
/begin CHARACTERISTIC C_N_OFS_VB_MIN "idle speed setpoint offset minimum threshold at battery charging is active" VALUE 0x4335c _REC_VAL_20_s1 510. _CNV_A_R_LINEAR_____374_CM -256. 254. FORMAT "%4.0" /end CHARACTERISTIC
/begin CHARACTERISTIC C_TCO_MIN_N_OFS_KWP "minimum TCO threshold for idle speed setpoint offset by tester" VALUE 0x42a70 _REC_VAL_20_u1 190.5 _CNV_A_R_LINEAR_____0_CM -48. 142.5 FORMAT "%5.1" /end CHARACTERISTIC
/begin CHARACTERISTIC LC_N_OFS_KWP_DISABLE "disable bit for idle speed setpoint offset by tester" VALUE 0x42bb9 _REC_VAL_20_u1 1. _CNV_A_R_LINEAR_____10_CM 0. 1. FORMAT "%2.0" /end CHARACTERISTIC
/begin CHARACTERISTIC C_CHA_CDN_BAT_KWP_MIN "minimum threshold for active battery charging due to enable conditions of idle speed offset by tester" VALUE 0x4280d _REC_VAL_20_u1 127. _CNV_A_R_LINEAR_____375_CM 0. 127. FORMAT "%5.1" /end CHARACTERISTIC
/begin CHARACTERISTIC C_N_OFS_ACC_DRI_MAX "idle speed setpoint offset maximum threshold at LV_ACIN = 1 and LV_DRI = 1" VALUE 0x43353 _REC_VAL_20_s1 510. _CNV_A_R_LINEAR_____374_CM -256. 254. FORMAT "%4.0" /end CHARACTERISTIC
/begin MEASUREMENT LV_KWP_ENA "logical variable for idle speed setpoint offset by tester enabled" UBYTE _CNV_S_2_RANGE______28_CM 1 100. 0. 1. ECU_ADDRESS 0x3fd2dc /end MEASUREMENT
/begin MEASUREMENT N_SP_OFS_KWP "idle speed setpoint offset by tester" SBYTE _CNV_A_R_LINEAR_____374_CM 1 100. -256. 254. ECU_ADDRESS 0x3fd2db FORMAT "%4.0" /end MEASUREMENT
/begin MEASUREMENT N_KWP_OFS_ACC_DRI "idle speed setpoint offset at LV_ACIN = 1 and LV_DRI = 1" SBYTE _CNV_A_R_LINEAR_____374_CM 1 100. -256. 254. ECU_ADDRESS 0x3fd2d6 FORMAT "%4.0" /end MEASUREMENT
/begin MEASUREMENT N_KWP_OFS_DRI "idle speed setpoint offset at LV_ACIN = 0 and LV_DRI = 1" SBYTE _CNV_A_R_LINEAR_____374_CM 1 100. -256. 254. ECU_ADDRESS 0x3fd2d7 FORMAT "%4.0" /end MEASUREMENT
/begin MEASUREMENT N_KWP_OFS_VB "idle speed setpoint offset at battery charging is active" SBYTE _CNV_A_R_LINEAR_____374_CM 1 100. -256. 254. ECU_ADDRESS 0x3fd2da FORMAT "%4.0" /end MEASUREMENT
/begin MEASUREMENT STATE_SAV_DIAG "status of secondary air monitoring" ULONG _CNV_S_8_RANGE_STAT_381_CM 1 100. 0. 7. ECU_ADDRESS 0x3fcd1c /end MEASUREMENT
/begin CHARACTERISTIC LC_AD_CLR_KNK "Logical constant for initializing KNK nvmy data" VALUE 0x42b4d _REC_VAL_20_u1 1. _CNV_A_R_LINEAR_____10_CM 0. 1. FORMAT "%2.0" /end CHARACTERISTIC
/begin CHARACTERISTIC LC_AD_CLR_LAM "Logical constant for initializing LAMBDA nvmy data" VALUE 0x42b4e _REC_VAL_20_u1 1. _CNV_A_R_LINEAR_____10_CM 0. 1. FORMAT "%2.0" /end CHARACTERISTIC
/begin CHARACTERISTIC LC_AD_CLR_EGR "Logical constant for initializing EGR nvmy data" VALUE 0x42b48 _REC_VAL_20_u1 1. _CNV_A_R_LINEAR_____10_CM 0. 1. FORMAT "%2.0" /end CHARACTERISTIC
/begin CHARACTERISTIC LC_AD_CLR_TCO "Logical constant for initializing TCO nvmy data" VALUE 0x42b58 _REC_VAL_20_u1 1. _CNV_A_R_LINEAR_____10_CM 0. 1. FORMAT "%2.0" /end CHARACTERISTIC
/begin CHARACTERISTIC LC_AD_CLR_TPS "Logical constant for initializing TPS nvmy data" VALUE 0x42b5c _REC_VAL_20_u1 1. _CNV_A_R_LINEAR_____10_CM 0. 1. FORMAT "%2.0" /end CHARACTERISTIC
/begin CHARACTERISTIC LC_AD_CLR_MIS "Logical constant for initializing MISFIRE nvmy data" VALUE 0x42b50 _REC_VAL_20_u1 1. _CNV_A_R_LINEAR_____10_CM 0. 1. FORMAT "%2.0" /end CHARACTERISTIC
/begin CHARACTERISTIC LC_AD_CLR_IVVT "Logical constant for initializing IVVT nvmy data" VALUE 0x42b4c _REC_VAL_20_u1 1. _CNV_A_R_LINEAR_____10_CM 0. 1. FORMAT "%2.0" /end CHARACTERISTIC
/begin CHARACTERISTIC LC_AD_CLR_IMM "Logical constant for initializing IMM nvmy data" VALUE 0x42b4b _REC_VAL_20_u1 1. _CNV_A_R_LINEAR_____10_CM 0. 1. FORMAT "%2.0" /end CHARACTERISTIC
/begin CHARACTERISTIC LC_AD_CLR_IDLE "Logical constant for initializing IDLE nvmy data" VALUE 0x42b4a _REC_VAL_20_u1 1. _CNV_A_R_LINEAR_____10_CM 0. 1. FORMAT "%2.0" /end CHARACTERISTIC
/begin CHARACTERISTIC LC_AD_CLR_ATI "Logical constant for initializing ATI nvmy data" VALUE 0x42b44 _REC_VAL_20_u1 1. _CNV_A_R_LINEAR_____10_CM 0. 1. FORMAT "%2.0" /end CHARACTERISTIC
/begin CHARACTERISTIC LC_AD_CLR_TOIL "Logical constant for initializing TOIL nvmy data" VALUE 0x42b5b _REC_VAL_20_u1 1. _CNV_A_R_LINEAR_____10_CM 0. 1. FORMAT "%2.0" /end CHARACTERISTIC
/begin CHARACTERISTIC LC_AD_CLR_ECF "Logical constant for initializing ECF nvmy data" VALUE 0x42b47 _REC_VAL_20_u1 1. _CNV_A_R_LINEAR_____10_CM 0. 1. FORMAT "%2.0" /end CHARACTERISTIC
/begin CHARACTERISTIC LC_AD_CLR_SA "Logical constant for initializing SA nvmy data" VALUE 0x42b56 _REC_VAL_20_u1 1. _CNV_A_R_LINEAR_____10_CM 0. 1. FORMAT "%2.0" /end CHARACTERISTIC
/begin CHARACTERISTIC LC_AD_CLR_N_SP_IS "Logical constant for initializing N_SP_IS nvmy data" VALUE 0x42b52 _REC_VAL_20_u1 1. _CNV_A_R_LINEAR_____10_CM 0. 1. FORMAT "%2.0" /end CHARACTERISTIC
/begin CHARACTERISTIC LC_AD_CLR_RON "Logical constant for initializing RON nvmy data" VALUE 0x42b55 _REC_VAL_20_u1 1. _CNV_A_R_LINEAR_____10_CM 0. 1. FORMAT "%2.0" /end CHARACTERISTIC
/begin CHARACTERISTIC LC_AD_CLR_TECU "Logical constant for initializing TECU nvmy data" VALUE 0x42b59 _REC_VAL_20_u1 1. _CNV_A_R_LINEAR_____10_CM 0. 1. FORMAT "%2.0" /end CHARACTERISTIC
/begin CHARACTERISTIC LC_AD_CLR_VAR "Logical constant for initializing VAR nvmy data" VALUE 0x42b5e _REC_VAL_20_u1 1. _CNV_A_R_LINEAR_____10_CM 0. 1. FORMAT "%2.0" /end CHARACTERISTIC
/begin CHARACTERISTIC LC_AD_CLR_DMTL "Logical constant for initializing DMTL nvmy data" VALUE 0x42b46 _REC_VAL_20_u1 1. _CNV_A_R_LINEAR_____10_CM 0. 1. FORMAT "%2.0" /end CHARACTERISTIC
/begin CHARACTERISTIC LC_AD_CLR_SOF "Logical constant for initializing the sound flap / sport switch" VALUE 0x42b57 _REC_VAL_20_u1 1. _CNV_A_R_LINEAR_____10_CM 0. 1. FORMAT "%2.0" /end CHARACTERISTIC
/begin CHARACTERISTIC LC_AD_CLR_N_MAX "Logical constant for initializing the N_MAX nvmy data" VALUE 0x42b51 _REC_VAL_20_u1 1. _CNV_A_R_LINEAR_____10_CM 0. 1. FORMAT "%2.0" /end CHARACTERISTIC
/begin CHARACTERISTIC LC_AD_CLR_LIF "Logical constant for initializing LIF" VALUE 0x42b4f _REC_VAL_20_u1 1. _CNV_A_R_LINEAR_____10_CM 0. 1. FORMAT "%2.0" /end CHARACTERISTIC
/begin CHARACTERISTIC LC_AD_CLR_OZ "Logical constant for initializing OZ" VALUE 0x42b54 _REC_VAL_20_u1 1. _CNV_A_R_LINEAR_____10_CM 0. 1. FORMAT "%2.0" /end CHARACTERISTIC
/begin CHARACTERISTIC LC_AD_CLR_TQI_LIM "Logical constant for initializing TQI_LIM" VALUE 0x42b5d _REC_VAL_20_u1 1. _CNV_A_R_LINEAR_____10_CM 0. 1. FORMAT "%2.0" /end CHARACTERISTIC
/begin CHARACTERISTIC LC_AD_CLR_FUP "Logical constant for initializing FUP" VALUE 0x42b49 _REC_VAL_20_u1 1. _CNV_A_R_LINEAR_____10_CM 0. 1. FORMAT "%2.0" /end CHARACTERISTIC
/begin CHARACTERISTIC LC_AD_CLR_TEG "Logical constant for initializing TEG" VALUE 0x42b5a _REC_VAL_20_u1 1. _CNV_A_R_LINEAR_____10_CM 0. 1. FORMAT "%2.0" /end CHARACTERISTIC
/begin CHARACTERISTIC LC_AD_CLR "Logical constant for initializing AD" VALUE 0x42b43 _REC_VAL_20_u1 1. _CNV_A_R_LINEAR_____10_CM 0. 1. FORMAT "%2.0" /end CHARACTERISTIC
/begin CHARACTERISTIC LC_AD_CLR_CRU "Logical constant for initializing CRU" VALUE 0x42b45 _REC_VAL_20_u1 1. _CNV_A_R_LINEAR_____10_CM 0. 1. FORMAT "%2.0" /end CHARACTERISTIC
/begin CHARACTERISTIC LC_AD_CLR_OBD2 "Logical constant for initializing OBDII" VALUE 0x42b53 _REC_VAL_20_u1 1. _CNV_A_R_LINEAR_____10_CM 0. 1. FORMAT "%2.0" /end CHARACTERISTIC
/begin MEASUREMENT LV_ERR_VS "Error currently present on vehicle speed signal" UBYTE _CNV_S_2_RANGE______21_R_CM 1 100. 0. 255. ECU_ADDRESS 0x3fd417 /end MEASUREMENT
/begin MEASUREMENT LV_MTC_LIH_ACT "LV limp home request main throttle" UBYTE _CNV_S_2_RANGE______28_CM 1 100. 0. 1. ECU_ADDRESS 0x3fcc62 BIT_MASK 0x1 /end MEASUREMENT
/begin MEASUREMENT TI_EXT_ADJ_1 "Injection Time" UBYTE _CNV_A_R_LINEAR_____438_CM 1 100. 0. 4.08 ECU_ADDRESS 0x3fa13c FORMAT "%4.2" /end MEASUREMENT
/begin MEASUREMENT TI_EXT_ADJ_2 "Injection Time" UBYTE _CNV_A_R_LINEAR_____438_CM 1 100. 0. 4.08 ECU_ADDRESS 0x3fa13d FORMAT "%4.2" /end MEASUREMENT
/begin MEASUREMENT TI_EXT_ADJ_3 "Injection Time" UBYTE _CNV_A_R_LINEAR_____438_CM 1 100. 0. 4.08 ECU_ADDRESS 0x3fa13e FORMAT "%4.2" /end MEASUREMENT
/begin MEASUREMENT TI_EXT_ADJ_4 "Injection Time" UBYTE _CNV_A_R_LINEAR_____438_CM 1 100. 0. 4.08 ECU_ADDRESS 0x3fa13f FORMAT "%4.2" /end MEASUREMENT
/begin MEASUREMENT TI_EXT_ADJ_5 "Injection Time" UBYTE _CNV_A_R_LINEAR_____438_CM 1 100. 0. 4.08 ECU_ADDRESS 0x3fa140 FORMAT "%4.2" /end MEASUREMENT
/begin MEASUREMENT TI_EXT_ADJ_6 "Injection Time" UBYTE _CNV_A_R_LINEAR_____438_CM 1 100. 0. 4.08 ECU_ADDRESS 0x3fa141 FORMAT "%4.2" /end MEASUREMENT
/begin MEASUREMENT TI_PER_EXT_ADJ_1 "Injection Time Period" UBYTE _CNV_A_R_LINEAR_____23_CM 1 100. 0. 2550. ECU_ADDRESS 0x3fa144 FORMAT "%4.0" /end MEASUREMENT
/begin MEASUREMENT TI_PER_EXT_ADJ_2 "Injection Time Period" UBYTE _CNV_A_R_LINEAR_____23_CM 1 100. 0. 2550. ECU_ADDRESS 0x3fa145 FORMAT "%4.0" /end MEASUREMENT
/begin MEASUREMENT TI_PER_EXT_ADJ_3 "Injection Time Period" UBYTE _CNV_A_R_LINEAR_____23_CM 1 100. 0. 2550. ECU_ADDRESS 0x3fa146 FORMAT "%4.0" /end MEASUREMENT
/begin MEASUREMENT TI_PER_EXT_ADJ_4 "Injection Time Period" UBYTE _CNV_A_R_LINEAR_____23_CM 1 100. 0. 2550. ECU_ADDRESS 0x3fa147 FORMAT "%4.0" /end MEASUREMENT
/begin MEASUREMENT TI_PER_EXT_ADJ_5 "Injection Time Period" UBYTE _CNV_A_R_LINEAR_____23_CM 1 100. 0. 2550. ECU_ADDRESS 0x3fa148 FORMAT "%4.0" /end MEASUREMENT
/begin MEASUREMENT TI_PER_EXT_ADJ_6 "Injection Time Period" UBYTE _CNV_A_R_LINEAR_____23_CM 1 100. 0. 2550. ECU_ADDRESS 0x3fa149 FORMAT "%4.0" /end MEASUREMENT
/begin MEASUREMENT LV_TI_EXT_ADJ_1 "Flag to activate the injector test mode" UBYTE _CNV_S_2_RANGE______28_CM 1 100. 0. 1. ECU_ADDRESS 0x3fa134 /end MEASUREMENT
/begin MEASUREMENT LV_TI_EXT_ADJ_2 "Flag to activate the injector test mode" UBYTE _CNV_S_2_RANGE______28_CM 1 100. 0. 1. ECU_ADDRESS 0x3fa135 /end MEASUREMENT
/begin MEASUREMENT LV_TI_EXT_ADJ_3 "Flag to activate the injector test mode" UBYTE _CNV_S_2_RANGE______28_CM 1 100. 0. 1. ECU_ADDRESS 0x3fa136 /end MEASUREMENT
/begin MEASUREMENT LV_TI_EXT_ADJ_4 "Flag to activate the injector test mode" UBYTE _CNV_S_2_RANGE______28_CM 1 100. 0. 1. ECU_ADDRESS 0x3fa137 /end MEASUREMENT
/begin MEASUREMENT LV_TI_EXT_ADJ_5 "Flag to activate the injector test mode" UBYTE _CNV_S_2_RANGE______28_CM 1 100. 0. 1. ECU_ADDRESS 0x3fa138 /end MEASUREMENT
/begin MEASUREMENT LV_TI_EXT_ADJ_6 "Flag to activate the injector test mode" UBYTE _CNV_S_2_RANGE______28_CM 1 100. 0. 1. ECU_ADDRESS 0x3fa139 /end MEASUREMENT
/begin CHARACTERISTIC C_TI_EXT_ADJ_MIN "Minimum injection time to accept a external adjustment - equal for all cylinders" VALUE 0x42aa7 _REC_VAL_20_u1 4.08 _CNV_A_R_LINEAR_____438_CM 0. 4.08 FORMAT "%4.2" /end CHARACTERISTIC
/begin CHARACTERISTIC C_TI_EXT_ADJ_MAX "Maximum injection time to accept a external adjustment - equal for all cylinders" VALUE 0x42aa6 _REC_VAL_20_u1 4.08 _CNV_A_R_LINEAR_____438_CM 0. 4.08 FORMAT "%4.2" /end CHARACTERISTIC
/begin CHARACTERISTIC C_TI_PER_EXT_ADJ_MAX "Maximum injection time period to accept a external adjustment - equal for all cylinders" VALUE 0x42aa8 _REC_VAL_20_u1 2550. _CNV_A_R_LINEAR_____23_CM 0. 2550. FORMAT "%4.0" /end CHARACTERISTIC
/begin CHARACTERISTIC C_TI_PER_EXT_ADJ_MIN "Minimum injection time period to accept a external adjustment - equal for all cylinders" VALUE 0x42aa9 _REC_VAL_20_u1 2550. _CNV_A_R_LINEAR_____23_CM 0. 2550. FORMAT "%4.0" /end CHARACTERISTIC
/begin CHARACTERISTIC C_N_DIF_AJ_AC_1 "Engine speed difference threshold for acitvation anti jerk function at acceleration - first wave trigger" VALUE 0x432a2 _REC_VAL_20_s2 65535. _CNV_A_R_LINEAR_____17_CM -32768. 32767. FORMAT "%6.0" /end CHARACTERISTIC
/begin CHARACTERISTIC C_N_DIF_AJ_AC_2 "Engine speed difference threshold for acitvation anti jerk function at acceleration - second wave trigger" VALUE 0x432a4 _REC_VAL_20_s2 65535. _CNV_A_R_LINEAR_____17_CM -32768. 32767. FORMAT "%6.0" /end CHARACTERISTIC
/begin CHARACTERISTIC C_N_DIF_AJ_DEACC_1 "Engine speed difference threshold for acitvation anti jerk function at deacceleration - first wave trigger" VALUE 0x432a6 _REC_VAL_20_s2 65535. _CNV_A_R_LINEAR_____17_CM -32768. 32767. FORMAT "%6.0" /end CHARACTERISTIC
/begin CHARACTERISTIC C_N_DIF_AJ_DEACC_2 "Engine speed difference threshold for acitvation anti jerk function at deacceleration - second wave trigger" VALUE 0x432a8 _REC_VAL_20_s2 65535. _CNV_A_R_LINEAR_____17_CM -32768. 32767. FORMAT "%6.0" /end CHARACTERISTIC
/begin CHARACTERISTIC C_N_THD_MAX_AJ "Maximum engine speed threshold for anti jerk function" VALUE 0x42ece _REC_VAL_20_u2 8160. _CNV_A_R_LINEAR_____17_CM 0. 8160. FORMAT "%4.0" /end CHARACTERISTIC
/begin CHARACTERISTIC C_N_THD_MIN_AJ "Minimum engine speed threshold for anti jerk function" VALUE 0x42ed0 _REC_VAL_20_u2 8160. _CNV_A_R_LINEAR_____17_CM 0. 8160. FORMAT "%4.0" /end CHARACTERISTIC
/begin CHARACTERISTIC C_T_ACT_MAX_AJ "Maximum active time of anti jerk function after activation" VALUE 0x429b7 _REC_VAL_20_u1 25.5 _CNV_A_R_LINEAR_____14_CM 0. 25.5 FORMAT "%3.1" /end CHARACTERISTIC
/begin MEASUREMENT LV_PAS_AJ "LV anti-jerk function passive" UBYTE _CNV_S_2_RANGE______28_CM 1 100. 0. 1. ECU_ADDRESS 0x3fe78d BIT_MASK 0x1 /end MEASUREMENT
/begin MEASUREMENT LV_REQ_AJ "LV anti-jerk function requested" UBYTE _CNV_S_2_RANGE______28_CM 1 100. 0. 1. ECU_ADDRESS 0x3fe78c BIT_MASK 0x1 /end MEASUREMENT
/begin CHARACTERISTIC LC_AJ_INH_AT "Logical constant for anti jerk function to inhibit the AT influence on the activation conditions" VALUE 0x42b61 _REC_VAL_20_u1 1. _CNV_A_R_LINEAR_____10_CM 0. 1. FORMAT "%2.0" /end CHARACTERISTIC
/begin CHARACTERISTIC LC_AJ_DEACC "Logical constant for AJ trigger at deacceleration" VALUE 0x42b60 _REC_VAL_20_u1 1. _CNV_A_R_LINEAR_____12_CM 0. 1. FORMAT "%1.0" /end CHARACTERISTIC
/begin MEASUREMENT LV_INI_AJ "LV initialisation anti jerk controller requested" UBYTE _CNV_S_2_RANGE______28_CM 1 100. 0. 1. ECU_ADDRESS 0x3fd166 BIT_MASK 0x1 /end MEASUREMENT
/begin CHARACTERISTIC LC_AJ_AC "Logical constant for AJ trigger at acceleration" VALUE 0x42b5f _REC_VAL_20_u1 1. _CNV_A_R_LINEAR_____12_CM 0. 1. FORMAT "%1.0" /end CHARACTERISTIC
/begin MEASUREMENT LV_ACT_AJ "LV anti-jerk function active" UBYTE _CNV_S_2_RANGE______28_CM 1 100. 0. 1. ECU_ADDRESS 0x3fd165 BIT_MASK 0x1 /end MEASUREMENT
/begin MEASUREMENT STATE_CC_AJ "Status of allowed or not allowed AJ (CC)" UBYTE _CNV_S_2_RANGE______28_CM 1 100. 0. 1. ECU_ADDRESS 0x3fe78a BIT_MASK 0x1 /end MEASUREMENT
/begin MEASUREMENT STATE_CLU_AMT_AJ "Status of allowed or not allowed AJ (AMT)" UBYTE _CNV_S_2_RANGE______28_CM 1 100. 0. 1. ECU_ADDRESS 0x3fe78b BIT_MASK 0x1 /end MEASUREMENT
/begin CHARACTERISTIC LC_AJ_INH_DT "Logical constant for anti jerk function to inhibit theDT influence on the activation conditions" VALUE 0x42b62 _REC_VAL_20_u1 1. _CNV_A_R_LINEAR_____10_CM 0. 1. FORMAT "%2.0" /end CHARACTERISTIC
/begin CHARACTERISTIC LC_STATE_CC_OPEN "Logical constant for AJ allowed or not at CC open" VALUE 0x42bc9 _REC_VAL_20_u1 1. _CNV_A_R_LINEAR_____10_CM 0. 1. FORMAT "%2.0" /end CHARACTERISTIC
/begin CHARACTERISTIC LC_STATE_CC_CONTROLLED "Logical constant for AJ allowed or not at CC controlled" VALUE 0x42bc7 _REC_VAL_20_u1 1. _CNV_A_R_LINEAR_____10_CM 0. 1. FORMAT "%2.0" /end CHARACTERISTIC
/begin CHARACTERISTIC LC_STATE_CC_DFT "Logical constant for AJ allowed or not at CC status not defined" VALUE 0x42bc8 _REC_VAL_20_u1 1. _CNV_A_R_LINEAR_____10_CM 0. 1. FORMAT "%2.0" /end CHARACTERISTIC
/begin CHARACTERISTIC LC_STATE_CC_CLOSE "Logical constant for AJ allowed or not at CC closed" VALUE 0x42bc6 _REC_VAL_20_u1 1. _CNV_A_R_LINEAR_____10_CM 0. 1. FORMAT "%2.0" /end CHARACTERISTIC
/begin CHARACTERISTIC LC_STATE_CLU_AMT_OPEN "Logical constant for AJ allowed or not at STATE_CLU_AMT open" VALUE 0x42bce _REC_VAL_20_u1 1. _CNV_A_R_LINEAR_____10_CM 0. 1. FORMAT "%2.0" /end CHARACTERISTIC
/begin CHARACTERISTIC LC_STATE_CLU_AMT_CREEPING "Logical constant for AJ allowed or not at STATE_CLU_AMT creeping" VALUE 0x42bcb _REC_VAL_20_u1 1. _CNV_A_R_LINEAR_____10_CM 0. 1. FORMAT "%2.0" /end CHARACTERISTIC
/begin CHARACTERISTIC LC_STATE_CLU_AMT_DRIVE_OFF "Logical constant for AJ allowed or not at STATE_CLU_AMT drive off" VALUE 0x42bcd _REC_VAL_20_u1 1. _CNV_A_R_LINEAR_____10_CM 0. 1. FORMAT "%2.0" /end CHARACTERISTIC
/begin CHARACTERISTIC LC_STATE_CLU_AMT_CLOSED "Logical constant for AJ allowed or not at STATE_CLU_AMT closed" VALUE 0x42bca _REC_VAL_20_u1 1. _CNV_A_R_LINEAR_____10_CM 0. 1. FORMAT "%2.0" /end CHARACTERISTIC
/begin CHARACTERISTIC LC_STATE_CLU_AMT_DFT "Logical constant for AJ allowed or not at STATE_CLU_AMT default" VALUE 0x42bcc _REC_VAL_20_u1 1. _CNV_A_R_LINEAR_____10_CM 0. 1. FORMAT "%2.0" /end CHARACTERISTIC
/begin MEASUREMENT LV_AMT_DISABLE "logical variable for disabling AMT intervention due to EMS error" UBYTE _CNV_S_2_RANGE______11_CM 1 100. 0. 1. ECU_ADDRESS 0x3fd1fe /end MEASUREMENT
/begin MEASUREMENT LV_AMT_DISABLE_CAN "logical variable for disabling GS intervention due to CAN error" UBYTE _CNV_S_2_RANGE______11_CM 1 100. 0. 1. ECU_ADDRESS 0x3fd1ff /end MEASUREMENT
/begin MEASUREMENT LV_AMT_ENA_DEC "logical variable for decreased torque intervention due to gear shift" UBYTE _CNV_S_2_RANGE______11_CM 1 100. 0. 1. ECU_ADDRESS 0x3fd200 /end MEASUREMENT
/begin MEASUREMENT LV_AMT_ENA_INC "logical variable for increased torque intervention due to gear shift" UBYTE _CNV_S_2_RANGE______11_CM 1 100. 0. 1. ECU_ADDRESS 0x3fd201 /end MEASUREMENT
/begin MEASUREMENT LV_AMT_ENA "logical variable for gear shift intervention enabling" UBYTE _CNV_S_2_RANGE______11_CM 1 100. 0. 1. ECU_ADDRESS 0x3fe7e6 /end MEASUREMENT
/begin MEASUREMENT TQI_AMT_FAST_DEC_REQ "torque decrement for fast torque intervention during gear shift" SWORD _CNV_A_R_LINEAR_____48_CM 1 100. -1024. 1023.96875 ECU_ADDRESS 0x3fd1e6 FORMAT "%8.2" /end MEASUREMENT
/begin MEASUREMENT TQI_AMT_FAST_DEC_REQ_1 "Torque decrement for fast torque intervention during gear shift" SWORD _CNV_A_R_LINEAR_____48_CM 1 100. -1024. 1023.96875 ECU_ADDRESS 0x3fd1ee FORMAT "%8.2" /end MEASUREMENT
/begin MEASUREMENT TQI_AMT_SLOW_DEC_REQ "torque decrement for slow torque intervention during gear shift" SWORD _CNV_A_R_LINEAR_____48_CM 1 100. -1024. 1023.96875 ECU_ADDRESS 0x3fd1e8 FORMAT "%8.2" /end MEASUREMENT
/begin MEASUREMENT TQI_AMT_SLOW_DEC_REQ_1 "torque decrement for slow torque intervention during gear shift" SWORD _CNV_A_R_LINEAR_____48_CM 1 100. -1024. 1023.96875 ECU_ADDRESS 0x3fd1f0 FORMAT "%8.2" /end MEASUREMENT
/begin MEASUREMENT TQI_AMT_FAST_INC_REQ "torque increase for fast torque intervention during gear shift" SWORD _CNV_A_R_LINEAR_____48_CM 1 100. -1024. 1023.96875 ECU_ADDRESS 0x3fd1ea FORMAT "%8.2" /end MEASUREMENT
/begin MEASUREMENT TQI_AMT_FAST_INC_REQ_1 "Torque increase for fast torque intervention during gear shift" SWORD _CNV_A_R_LINEAR_____48_CM 1 100. -1024. 1023.96875 ECU_ADDRESS 0x3fd1f2 FORMAT "%8.2" /end MEASUREMENT
/begin MEASUREMENT TQI_AMT_SLOW_INC_REQ "torque increase for slow torque intervention during gear shift" SWORD _CNV_A_R_LINEAR_____48_CM 1 100. -1024. 1023.96875 ECU_ADDRESS 0x3fd1ec FORMAT "%8.2" /end MEASUREMENT
/begin MEASUREMENT TQI_AMT_SLOW_INC_REQ_1 "Torque increase for slow torque intervention during gear shift" SWORD _CNV_A_R_LINEAR_____48_CM 1 100. -1024. 1023.96875 ECU_ADDRESS 0x3fd1f4 FORMAT "%8.2" /end MEASUREMENT
/begin MEASUREMENT TQI_AMT_FAST_DEC "torque decrement for fast torque intervention during gear shift" SWORD _CNV_A_R_LINEAR_____48_CM 1 100. -1024. 1023.96875 ECU_ADDRESS 0x3fd1f6 FORMAT "%8.2" /end MEASUREMENT
/begin MEASUREMENT TQI_AMT_SLOW_DEC "torque decrement for slow torque intervention during gear shift" SWORD _CNV_A_R_LINEAR_____48_CM 1 100. -1024. 1023.96875 ECU_ADDRESS 0x3fd1f8 FORMAT "%8.2" /end MEASUREMENT
/begin MEASUREMENT LV_AMT_DEC_ACT "logical variable for torque intervention due to gear shift" UBYTE _CNV_S_2_RANGE______28_CM 1 100. 0. 1. ECU_ADDRESS 0x3fd202 /end MEASUREMENT
/begin MEASUREMENT TQI_AMT_FAST_INC "torque increase for fast torque intervention during gear shift" SWORD _CNV_A_R_LINEAR_____48_CM 1 100. -1024. 1023.96875 ECU_ADDRESS 0x3fd1fa FORMAT "%8.2" /end MEASUREMENT
/begin MEASUREMENT TQI_AMT_SLOW_INC "torque increase for slow torque intervention during gear shift" SWORD _CNV_A_R_LINEAR_____48_CM 1 100. -1024. 1023.96875 ECU_ADDRESS 0x3fd1fc FORMAT "%8.2" /end MEASUREMENT
/begin MEASUREMENT LV_AMT_DEC_LIH "logical variable for torque intervention LIH due to gear shift" UBYTE _CNV_S_2_RANGE______28_CM 1 100. 0. 1. ECU_ADDRESS 0x3fe7e7 /end MEASUREMENT
/begin MEASUREMENT LV_AMT_INC_ACT "logical variable for torque intervention due to gear shift" UBYTE _CNV_S_2_RANGE______28_CM 1 100. 0. 1. ECU_ADDRESS 0x3fd203 /end MEASUREMENT
/begin MEASUREMENT LV_AMT_INC_LIH "logical variable for torque intervention LIH due to gear shift" UBYTE _CNV_S_2_RANGE______28_CM 1 100. 0. 1. ECU_ADDRESS 0x3fd204 /end MEASUREMENT
/begin CHARACTERISTIC C_LGRD_LIH_AMT_DEC "limiting gradient for AMT emergency ramp function (default  0.6 Nm/10ms)" VALUE 0x42dee _REC_VAL_20_u2 1023.96875 _CNV_A_R_LINEAR_____201_CM 0. 1023.96875 FORMAT "%7.2" /end CHARACTERISTIC
/begin CHARACTERISTIC C_LGRD_LIH_AMT_INC "limiting gradient for AMT emergency ramp function (default  0.6 Nm/10ms)" VALUE 0x42df0 _REC_VAL_20_u2 1023.96875 _CNV_A_R_LINEAR_____201_CM 0. 1023.96875 FORMAT "%7.2" /end CHARACTERISTIC
/begin CHARACTERISTIC C_T_DLY_LIH_AMT_DEC "delay time for activation of AMT emergency ramp function (default 0s)" VALUE 0x429e4 _REC_VAL_20_u1 2.55 _CNV_A_R_LINEAR_____27_CM 0. 2.55 FORMAT "%4.2" /end CHARACTERISTIC
/begin CHARACTERISTIC C_T_DLY_LIH_AMT_INC "delay time for activation of AMT emergency ramp function (default 0s)" VALUE 0x429e5 _REC_VAL_20_u1 2.55 _CNV_A_R_LINEAR_____27_CM 0. 2.55 FORMAT "%4.2" /end CHARACTERISTIC
/begin CHARACTERISTIC C_AMT_ENA_INC_DEC "Enable switch AMT intervention" VALUE 0x427be _REC_VAL_20_u1 3. _CNV_S_4_STATE_AMT__200_CM 0. 3. /end CHARACTERISTIC
/begin MEASUREMENT LV_ARS_DISABLE "logical variable for disabling ARS intervention due to EMS error" UBYTE _CNV_S_2_RANGE______28_CM 1 100. 0. 1. ECU_ADDRESS 0x3fd1e2 /end MEASUREMENT
/begin MEASUREMENT LV_ARS_DISABLE_CAN "logical variable for disabling ARS intervention due to CAN error" UBYTE _CNV_S_2_RANGE______28_CM 1 100. 0. 1. ECU_ADDRESS 0x3fd1e3 /end MEASUREMENT
/begin MEASUREMENT LV_ARS_ENA "logical variable for ASR intervention enabling" UBYTE _CNV_S_2_RANGE______28_CM 1 100. 0. 1. ECU_ADDRESS 0x3fd1e4 /end MEASUREMENT
/begin MEASUREMENT LV_TQ_MAX_ARS "logical variable indicating maximum torque request - ARS" UBYTE _CNV_S_2_RANGE______28_CM 1 100. 0. 1. ECU_ADDRESS 0x3fd1e5 /end MEASUREMENT
/begin MEASUREMENT TQ_LOSS_ARS_SP_MAX "ARS target torque loss - maximum (considering offset)" SWORD _CNV_A_R_LINEAR_____48_CM 1 100. -1024. 1023.96875 ECU_ADDRESS 0x3fd1d4 FORMAT "%8.2" /end MEASUREMENT
/begin MEASUREMENT TQ_LOSS_ARS_SP_MAX_1 "ARS target torque loss - maximum" SWORD _CNV_A_R_LINEAR_____48_CM 1 100. -1024. 1023.96875 ECU_ADDRESS 0x3fd1d2 FORMAT "%8.2" /end MEASUREMENT
/begin MEASUREMENT TQ_LOSS_ARS_AV_MAX_1 "ARS actual value of torque loss - maximum" SWORD _CNV_A_R_LINEAR_____48_CM 1 100. -1024. 1023.96875 ECU_ADDRESS 0x3fd1d6 FORMAT "%8.2" /end MEASUREMENT
/begin MEASUREMENT T_DLY_TQ_MAX_ARS "Delay time for activation of LV_TQ_MAX_ARS" UWORD _CNV_A_R_LINEAR_____27_CM 1 100. 0. 655.35 ECU_ADDRESS 0x3fd1d0 FORMAT "%6.2" /end MEASUREMENT
/begin MEASUREMENT TQ_LOSS_ARS "torque loss ARS for torque loss calculation" SWORD _CNV_A_R_LINEAR_____48_CM 1 100. -1024. 1023.96875 ECU_ADDRESS 0x3fd1da FORMAT "%8.2" /end MEASUREMENT
/begin MEASUREMENT TQ_LOSS_ARS_AV_MAX "ARS actual value of torque loss - maximum (considering offset)" SWORD _CNV_A_R_LINEAR_____48_CM 1 100. -1024. 1023.96875 ECU_ADDRESS 0x3fd1d8 FORMAT "%8.2" /end MEASUREMENT
/begin MEASUREMENT TQ_LOSS_ARS_GRD "Torque loss gradient - ARS" SWORD _CNV_A_R_LINEAR_____48_CM 1 100. -1024. 1023.96875 ECU_ADDRESS 0x3fd1de FORMAT "%8.2" /end MEASUREMENT
/begin MEASUREMENT TQ_LOSS_ARS_DIF "Difference torque loss TQ_LOSS_ARS_SP_CAN - TQ_LOSS_ARS_AV_CAN" SWORD _CNV_A_R_LINEAR_____48_CM 1 100. -1024. 1023.96875 ECU_ADDRESS 0x3fd1e0 FORMAT "%8.2" /end MEASUREMENT
/begin CHARACTERISTIC IP_TQ_LOSS_ARS_SP_MAX "ARS target torque loss - maximum" MAP 0x4c22c _REC_MAP_20_u2_u2_u2 2047.96875 _CNV_A_R_LINEAR_____218_CM -1024. 1023.96875 FORMAT "%6.2"
 /begin AXIS_DESCR COM_AXIS AC_VEH_TRV_TCS _CNV_A_R_LINEAR_____451_CM 8 -51.175 51.175 FORMAT "%7.3" AXIS_PTS_REF ldpm_ac_veh_trv_tcs /end AXIS_DESCR
 /begin AXIS_DESCR COM_AXIS VS_FIL _CNV_A_R_LINEAR_____78_CM 8 0. 511.99218 FORMAT "%7.3" AXIS_PTS_REF ldpm_vs_fil /end AXIS_DESCR
/end CHARACTERISTIC
/begin CHARACTERISTIC IP_TQ_LOSS_ARS_AV_MAX "ARS Actual value of torque loss - maximum" MAP 0x4c12c _REC_MAP_20_u2_u2_u2 2047.96875 _CNV_A_R_LINEAR_____218_CM -1024. 1023.96875 FORMAT "%6.2"
 /begin AXIS_DESCR COM_AXIS AC_VEH_TRV_TCS _CNV_A_R_LINEAR_____451_CM 8 -51.175 51.175 FORMAT "%7.3" AXIS_PTS_REF ldpm_ac_veh_trv_tcs /end AXIS_DESCR
 /begin AXIS_DESCR COM_AXIS VS_FIL _CNV_A_R_LINEAR_____78_CM 8 0. 511.99218 FORMAT "%7.3" AXIS_PTS_REF ldpm_vs_fil /end AXIS_DESCR
/end CHARACTERISTIC
/begin CHARACTERISTIC IP_TQ_LOSS_ARS_SP_CAN_MAX "ARS torque loss depending on torque loss (SP) via CAN and engine speed" MAP 0x4c1ac _REC_MAP_20_u2_u2_u1 2047.96875 _CNV_A_R_LINEAR_____218_CM -1024. 1023.96875 FORMAT "%6.2"
 /begin AXIS_DESCR COM_AXIS TQ_LOSS_ARS_SP_CAN _CNV_A_R_LINEAR_____218_CM 8 -1024. 1023.96875 FORMAT "%6.2" AXIS_PTS_REF ldp_tq_loss_ars_sp_can_max /end AXIS_DESCR
 /begin AXIS_DESCR COM_AXIS N_32 _CNV_A_R_LINEAR_____5_CM 8 0. 8160. FORMAT "%4.0" AXIS_PTS_REF ldpm_n_32__tq_loss_ars /end AXIS_DESCR
/end CHARACTERISTIC
/begin CHARACTERISTIC IP_TQ_LOSS_ARS_AV_CAN_MAX "ARS torque loss depending on torque loss (AV) via CAN and engine speed" MAP 0x4c0ac _REC_MAP_20_u2_u2_u1 2047.96875 _CNV_A_R_LINEAR_____218_CM -1024. 1023.96875 FORMAT "%6.2"
 /begin AXIS_DESCR COM_AXIS TQ_LOSS_ARS_AV_CAN _CNV_A_R_LINEAR_____218_CM 8 -1024. 1023.96875 FORMAT "%6.2" AXIS_PTS_REF ldp_tq_loss_ars_av_can_max /end AXIS_DESCR
 /begin AXIS_DESCR COM_AXIS N_32 _CNV_A_R_LINEAR_____5_CM 8 0. 8160. FORMAT "%4.0" AXIS_PTS_REF ldpm_n_32__tq_loss_ars /end AXIS_DESCR
/end CHARACTERISTIC
/begin CHARACTERISTIC C_FAC_TQ_LOSS_ARS_GRD "ARS torque loss gradient - correction factor" VALUE 0x42d48 _REC_VAL_20_u2 0.99998474 _CNV_A_R_LINEAR_____31_CM 0. 0.99998474 FORMAT "%7.6" /end CHARACTERISTIC
/begin CHARACTERISTIC C_FAC_TQ_LOSS_ARS_DIF "ARS torque loss actual value - correction factor" VALUE 0x42d46 _REC_VAL_20_u2 0.99998474 _CNV_A_R_LINEAR_____31_CM 0. 0.99998474 FORMAT "%7.6" /end CHARACTERISTIC
/begin CHARACTERISTIC C_T_DLY_TQ_MAX_ARS "Time delay for activating LV_TQ_MAX_ARS" VALUE 0x42faa _REC_VAL_20_u2 655.35 _CNV_A_R_LINEAR_____27_CM 0. 655.35 FORMAT "%6.2" /end CHARACTERISTIC
/begin CHARACTERISTIC C_TQ_LOSS_ARS_SP_OFS "Offset for TQ_LOSS_ARS_SP" VALUE 0x43306 _REC_VAL_20_s2 2047.96875 _CNV_A_R_LINEAR_____48_CM -1024. 1023.96875 FORMAT "%8.2" /end CHARACTERISTIC
/begin CHARACTERISTIC C_TQ_LOSS_ARS_AV_OFS "Offset for TQ_LOSS_ARS_AV" VALUE 0x43304 _REC_VAL_20_s2 2047.96875 _CNV_A_R_LINEAR_____48_CM -1024. 1023.96875 FORMAT "%8.2" /end CHARACTERISTIC
/begin CHARACTERISTIC C_V_MAX_ARS_DIAG "filtered vehicle speed threshold for diagnosis" VALUE 0x43122 _REC_VAL_20_u2 511.99218 _CNV_A_R_LINEAR_____78_CM 0. 511.99218 FORMAT "%7.3" /end CHARACTERISTIC
/begin CHARACTERISTIC C_N_MAX_ARS_DIAG "engine speed threshold for diagnosis" VALUE 0x4294c _REC_VAL_20_u1 8160. _CNV_A_R_LINEAR_____5_CM 0. 8160. FORMAT "%4.0" /end CHARACTERISTIC
/begin AXIS_PTS ldpm_ac_veh_trv_tcs "" 0x44e54 AC_VEH_TRV_TCS _REC_AXS_20_u2 102.35 _CNV_A_R_LINEAR_____451_CM 8 -51.175 51.175 FORMAT "%7.3" /end AXIS_PTS
/begin AXIS_PTS ldpm_vs_fil "" 0x45668 VS_FIL _REC_AXS_20_u2 511.99218 _CNV_A_R_LINEAR_____78_CM 8 0. 511.99218 FORMAT "%7.3" /end AXIS_PTS
/begin AXIS_PTS ldpm_n_32__tq_loss_ars "" 0x43dfa N_32 _REC_AXS_20_u1 8160. _CNV_A_R_LINEAR_____5_CM 8 0. 8160. FORMAT "%4.0" /end AXIS_PTS
/begin AXIS_PTS ldp_tq_loss_ars_sp_can_max "" 0x44c24 TQ_LOSS_ARS_SP_CAN _REC_AXS_20_u2 2047.96875 _CNV_A_R_LINEAR_____218_CM 8 -1024. 1023.96875 FORMAT "%6.2" /end AXIS_PTS
/begin AXIS_PTS ldp_tq_loss_ars_av_can_max "" 0x44c12 TQ_LOSS_ARS_AV_CAN _REC_AXS_20_u2 2047.96875 _CNV_A_R_LINEAR_____218_CM 8 -1024. 1023.96875 FORMAT "%6.2" /end AXIS_PTS
/begin MEASUREMENT TQ_CLU_AMT "converter torque" SWORD _CNV_A_R_LINEAR_____48_CM 1 100. -1024. 1023.96875 ECU_ADDRESS 0x3fd170 FORMAT "%8.2" /end MEASUREMENT
/begin MEASUREMENT LV_AMT_CRAWL_ON "Active AMT clutch torque" UBYTE _CNV_S_2_RANGE______28_CM 1 100. 0. 1. ECU_ADDRESS 0x3fd175 /end MEASUREMENT
/begin CHARACTERISTIC IP_TQ_AMT "AMT torque offset" CURVE 0x4bea0 _REC_CUR_20_u2_u1 2047.96875 _CNV_A_R_LINEAR_____218_CM -1024. 1023.96875 FORMAT "%6.2"
 /begin AXIS_DESCR COM_AXIS TCO _CNV_A_R_LINEAR_____0_CM 6 -48. 142.5 FORMAT "%5.1" AXIS_PTS_REF ldp_tco__tq_clu_amt /end AXIS_DESCR
/end CHARACTERISTIC
/begin CHARACTERISTIC IP_TQ_VS_FIL_AMT "AMT torque offset by VS and N_DIF" MAP 0x4c40c _REC_MAP_20_u2_u2_u2 2047.96875 _CNV_A_R_LINEAR_____218_CM -1024. 1023.96875 FORMAT "%6.2"
 /begin AXIS_DESCR COM_AXIS VS_FIL _CNV_A_R_LINEAR_____78_CM 6 0. 511.99218 FORMAT "%7.3" AXIS_PTS_REF ldp_vs_fil__tq_clu_amt /end AXIS_DESCR
 /begin AXIS_DESCR COM_AXIS N_DIF _CNV_A_R_LINEAR_____213_CM 6 -32768. 32767. FORMAT "%6.0" AXIS_PTS_REF ldp_n_dif__tq_clu_amt /end AXIS_DESCR
/end CHARACTERISTIC
/begin MEASUREMENT TQ_ADD_AMT "Torque reserve for switching AMT Torque" SWORD _CNV_A_R_LINEAR_____48_CM 1 100. -1024. 1023.96875 ECU_ADDRESS 0x3fd172 FORMAT "%8.2" /end MEASUREMENT
/begin MEASUREMENT LV_TOUT_AMT "logical variable to start deactivation of torque reserve and condition for switch off AMT calculation" UBYTE _CNV_S_2_RANGE______28_CM 1 100. 0. 1. ECU_ADDRESS 0x3fd176 /end MEASUREMENT
/begin MEASUREMENT T_AMT "timer for duration of transient TQ_LOSS_AMT correction" UWORD _CNV_A_R_LINEAR_____27_CM 1 100. 0. 5.1 ECU_ADDRESS 0x3fe798 FORMAT "%4.2" /end MEASUREMENT
/begin CHARACTERISTIC IP_TQ_ADD_AMT "Torque reserve for switching on AMT" CURVE 0x4be00 _REC_CUR_20_u2_u1 2047.96875 _CNV_A_R_LINEAR_____218_CM -1024. 1023.96875 FORMAT "%6.2"
 /begin AXIS_DESCR COM_AXIS N_32 _CNV_A_R_LINEAR_____5_CM 6 0. 8160. FORMAT "%4.0" AXIS_PTS_REF ldp_n_32_ip_tq_add_amt /end AXIS_DESCR
/end CHARACTERISTIC
/begin CHARACTERISTIC C_TQ_THD_AMT_ISC "Threshold look  ISC" VALUE 0x43100 _REC_VAL_20_u2 1023.96875 _CNV_A_R_LINEAR_____48_CM 0. 1023.96875 FORMAT "%7.2" /end CHARACTERISTIC
/begin CHARACTERISTIC C_TQ_ADD_AMT_LGRD "Limitation gradient for TQ_ADD_AMT decrease after deactivation" VALUE 0x430ea _REC_VAL_20_u2 1023.96875 _CNV_A_R_LINEAR_____48_CM 0. 1023.96875 FORMAT "%7.2" /end CHARACTERISTIC
/begin CHARACTERISTIC C_TQ_LGRD_CRAWL_INC "????" VALUE 0x430fc _REC_VAL_20_u2 1023.96875 _CNV_A_R_LINEAR_____48_CM 0. 1023.96875 FORMAT "%7.2" /end CHARACTERISTIC
/begin CHARACTERISTIC C_TQ_LGRD_CRAWL_DEC "????" VALUE 0x430fa _REC_VAL_20_u2 1023.96875 _CNV_A_R_LINEAR_____48_CM 0. 1023.96875 FORMAT "%7.2" /end CHARACTERISTIC
/begin AXIS_PTS ldp_tco__tq_clu_amt "" 0x438dd TCO _REC_AXS_20_u1 190.5 _CNV_A_R_LINEAR_____0_CM 6 -48. 142.5 FORMAT "%5.1" /end AXIS_PTS
/begin AXIS_PTS ldp_n_dif__tq_clu_amt "" 0x44824 N_DIF _REC_AXS_20_u2 65535. _CNV_A_R_LINEAR_____213_CM 6 -32768. 32767. FORMAT "%6.0" /end AXIS_PTS
/begin AXIS_PTS ldp_n_32_ip_tq_add_amt "" 0x436bd N_32 _REC_AXS_20_u1 8160. _CNV_A_R_LINEAR_____5_CM 6 0. 8160. FORMAT "%4.0" /end AXIS_PTS
/begin AXIS_PTS ldp_vs_fil__tq_clu_amt "" 0x44e1c VS_FIL _REC_AXS_20_u2 511.99218 _CNV_A_R_LINEAR_____78_CM 6 0. 511.99218 FORMAT "%7.3" /end AXIS_PTS
/begin MEASUREMENT LV_DCC_DISABLE_CAN "logical variable for disabling DCC intervention due to CAN error" UBYTE _CNV_S_2_RANGE______28_CM 1 100. 0. 1. ECU_ADDRESS 0x3fd1cc /end MEASUREMENT
/begin MEASUREMENT TQI_DCC_FAST_INC_REQ "torque increase for fast torque intervention during DCC" SWORD _CNV_A_R_LINEAR_____48_CM 1 100. -1024. 1023.96875 ECU_ADDRESS 0x3fd1c0 FORMAT "%8.2" /end MEASUREMENT
/begin MEASUREMENT TQI_DCC_FAST_INC_REQ_1 "Torque increase for fast torque intervention during DCC" SWORD _CNV_A_R_LINEAR_____48_CM 1 100. -1024. 1023.96875 ECU_ADDRESS 0x3fd1c4 FORMAT "%8.2" /end MEASUREMENT
/begin MEASUREMENT TQI_DCC_SLOW_INC_REQ "torque increase for slow torque intervention during DCC" SWORD _CNV_A_R_LINEAR_____48_CM 1 100. -1024. 1023.96875 ECU_ADDRESS 0x3fd1c2 FORMAT "%8.2" /end MEASUREMENT
/begin MEASUREMENT TQI_DCC_SLOW_INC_REQ_1 "Torque increase for slow torque intervention during DCC" SWORD _CNV_A_R_LINEAR_____48_CM 1 100. -1024. 1023.96875 ECU_ADDRESS 0x3fd1c6 FORMAT "%8.2" /end MEASUREMENT
/begin MEASUREMENT TQI_DCC_FAST_INC "torque increase for fast torque intervention during DCC" SWORD _CNV_A_R_LINEAR_____48_CM 1 100. -1024. 1023.96875 ECU_ADDRESS 0x3fd1c8 FORMAT "%8.2" /end MEASUREMENT
/begin MEASUREMENT LV_DCC_ENA_INC "logical variable for increased torque intervention due to DCC" UBYTE _CNV_S_2_RANGE______28_CM 1 100. 0. 1. ECU_ADDRESS 0x3fd1cd /end MEASUREMENT
/begin MEASUREMENT LV_DCC_INC_ACT "logical variable for torque intervention due to DCC" UBYTE _CNV_S_2_RANGE______28_CM 1 100. 0. 1. ECU_ADDRESS 0x3fd1ce /end MEASUREMENT
/begin CHARACTERISTIC C_LGRD_LIH_DCC_INC "limiting gradient for DCC emergency ramp function (default  0.6 Nm/10ms)" VALUE 0x42df4 _REC_VAL_20_u2 1023.96875 _CNV_A_R_LINEAR_____201_CM 0. 1023.96875 FORMAT "%7.2" /end CHARACTERISTIC
/begin CHARACTERISTIC C_T_DLY_LIH_DCC_INC "delay time for activation of DCC emergency ramp function (default 0s)" VALUE 0x429e7 _REC_VAL_20_u1 2.55 _CNV_A_R_LINEAR_____27_CM 0. 2.55 FORMAT "%4.2" /end CHARACTERISTIC
/begin MEASUREMENT TQI_DCC_SLOW_INC "torque increase for slow torque intervention during DCC" SWORD _CNV_A_R_LINEAR_____48_CM 1 100. -1024. 1023.96875 ECU_ADDRESS 0x3fd1ca FORMAT "%8.2" /end MEASUREMENT
/begin MEASUREMENT LV_DCC_INC_LIH "logical variable for torque intervention LIH due to DCC" UBYTE _CNV_S_2_RANGE______28_CM 1 100. 0. 1. ECU_ADDRESS 0x3fd1cf /end MEASUREMENT
/begin MEASUREMENT T_DCC_LIH_CTR "time counter delay time" UBYTE _CNV_A_R_LINEAR_____27_CM 1 100. 0. 2.55 ECU_ADDRESS 0x3fe7e3 FORMAT "%4.2" /end MEASUREMENT
/begin MEASUREMENT LV_ASR_ENA "Logical variable for ASR intervention enabling" UBYTE _CNV_S_2_RANGE______28_CM 1 100. 0. 1. ECU_ADDRESS 0x3fd1be BIT_MASK 0x1 /end MEASUREMENT
/begin MEASUREMENT LV_MSR_ENA "Logical variable for MSR intervention enabling" UBYTE _CNV_S_2_RANGE______28_CM 1 100. 0. 1. ECU_ADDRESS 0x3fd1bf BIT_MASK 0x1 /end MEASUREMENT
/begin MEASUREMENT TQI_MSR_FAST_REQ "fast torque intervention due to MSR previous limp home check" SWORD _CNV_A_R_LINEAR_____48_CM 1 100. -1024. 1023.96875 ECU_ADDRESS 0x3fd1a4 FORMAT "%8.2" /end MEASUREMENT
/begin MEASUREMENT TQI_MSR_SLOW_REQ "slow torque intervention due to MSR previous limp home check" SWORD _CNV_A_R_LINEAR_____48_CM 1 100. -1024. 1023.96875 ECU_ADDRESS 0x3fd1a6 FORMAT "%8.2" /end MEASUREMENT
/begin MEASUREMENT SF_TQD "Status flag driving toque at clutch" UBYTE _CNV_A_R_LINEAR_____10_CM 1 100. 0. 3. ECU_ADDRESS 0x3fd1b8 FORMAT "%2.0" /end MEASUREMENT
/begin MEASUREMENT LV_TCS_DISABLE "Logical variable for disabling TCS intervention due to EMS error" UBYTE _CNV_S_2_RANGE______28_CM 1 100. 0. 1. ECU_ADDRESS 0x3fd1bc BIT_MASK 0x1 /end MEASUREMENT
/begin MEASUREMENT TQI_ASR_SLOW "torque decrement for slow torque intervention during TCS" SWORD _CNV_A_R_LINEAR_____48_CM 1 100. -1024. 1023.96875 ECU_ADDRESS 0x3fd1b2 FORMAT "%8.2" /end MEASUREMENT
/begin CHARACTERISTIC C_LGRD_LIH_ASR "Limiting gradient for ASR emergency ramp function (default 0.6 Nm/10ms)" VALUE 0x42df2 _REC_VAL_20_u2 1023.96875 _CNV_A_R_LINEAR_____201_CM 0. 1023.96875 FORMAT "%7.2" /end CHARACTERISTIC
/begin CHARACTERISTIC C_T_DLY_LIH_ASR "Delay time for activation of ASR emergency ramp function (default 0 s)" VALUE 0x429e6 _REC_VAL_20_u1 2.55 _CNV_A_R_LINEAR_____27_CM 0. 2.55 FORMAT "%4.2" /end CHARACTERISTIC
/begin MEASUREMENT TQI_ASR_FAST_REQ "fast torque intervention due to ASR" SWORD _CNV_A_R_LINEAR_____48_CM 1 100. -1024. 1023.96875 ECU_ADDRESS 0x3fd1a0 FORMAT "%8.2" /end MEASUREMENT
/begin MEASUREMENT TQI_ASR_FAST_REQ_1 "Torque decrement for fast torque intervention during TCS" SWORD _CNV_A_R_LINEAR_____48_CM 1 100. -1024. 1023.96875 ECU_ADDRESS 0x3fd1a8 FORMAT "%8.2" /end MEASUREMENT
/begin MEASUREMENT TQI_ASR_SLOW_REQ "slow torque intervention due to ASR" SWORD _CNV_A_R_LINEAR_____48_CM 1 100. -1024. 1023.96875 ECU_ADDRESS 0x3fd1a2 FORMAT "%8.2" /end MEASUREMENT
/begin MEASUREMENT TQI_MSR_FAST_REQ_1 "Torque increase for fast torque intervention during TCS" SWORD _CNV_A_R_LINEAR_____48_CM 1 100. -1024. 1023.96875 ECU_ADDRESS 0x3fd1ac FORMAT "%8.2" /end MEASUREMENT
/begin MEASUREMENT TQI_ASR_SLOW_REQ_1 "torque decrement for slow torque intervention during TCS" SWORD _CNV_A_R_LINEAR_____48_CM 1 100. -1024. 1023.96875 ECU_ADDRESS 0x3fd1aa FORMAT "%8.2" /end MEASUREMENT
/begin MEASUREMENT TQI_MSR_SLOW_REQ_1 "Torque increase for slow torque intervention during gear shift" SWORD _CNV_A_R_LINEAR_____48_CM 1 100. -1024. 1023.96875 ECU_ADDRESS 0x3fd1ae FORMAT "%8.2" /end MEASUREMENT
/begin MEASUREMENT TQI_ASR_FAST "torque decrement for fast torque intervention during TCS" SWORD _CNV_A_R_LINEAR_____48_CM 1 100. -1024. 1023.96875 ECU_ADDRESS 0x3fd1b0 FORMAT "%8.2" /end MEASUREMENT
/begin MEASUREMENT TQI_MSR_FAST "fast torque intervention due to MSR" SWORD _CNV_A_R_LINEAR_____48_CM 1 100. -1024. 1023.96875 ECU_ADDRESS 0x3fd1b4 FORMAT "%8.2" /end MEASUREMENT
/begin MEASUREMENT TQI_MSR_SLOW "slow torque intervention due to MSR" SWORD _CNV_A_R_LINEAR_____48_CM 1 100. -1024. 1023.96875 ECU_ADDRESS 0x3fd1b6 FORMAT "%8.2" /end MEASUREMENT
/begin MEASUREMENT LV_MSR_LIH "Logical variable fortorque intervention limp home due toMSR" UBYTE _CNV_S_2_RANGE______28_CM 1 100. 0. 1. ECU_ADDRESS 0x3fd1bb BIT_MASK 0x1 /end MEASUREMENT
/begin MEASUREMENT LV_MSR_ACT "Logical variable fortorque intervention due to MSR" UBYTE _CNV_S_2_RANGE______28_CM 1 100. 0. 1. ECU_ADDRESS 0x3fd1ba BIT_MASK 0x1 /end MEASUREMENT
/begin CHARACTERISTIC C_T_DLY_LIH_MSR "Delay time for activation of MSR emergency ramp function (default 0 s)" VALUE 0x429ea _REC_VAL_20_u1 2.55 _CNV_A_R_LINEAR_____27_CM 0. 2.55 FORMAT "%4.2" /end CHARACTERISTIC
/begin MEASUREMENT LV_ASR_ACT "Logical variable fortorque intervention due to ASR" UBYTE _CNV_S_2_RANGE______28_CM 1 100. 0. 1. ECU_ADDRESS 0x3fd1b9 BIT_MASK 0x1 /end MEASUREMENT
/begin CHARACTERISTIC LC_MSR_DISABLE "logical constant to disable MSR interventions" VALUE 0x42bb6 _REC_VAL_20_u1 1. _CNV_S_2_RANGE______28_CM 0. 1. /end CHARACTERISTIC
/begin MEASUREMENT LV_TCS_ENA "Logical variable for basically TCS intervention enabling" UBYTE _CNV_S_2_RANGE______28_CM 1 100. 0. 1. ECU_ADDRESS 0x3fe7e1 BIT_MASK 0x1 /end MEASUREMENT
/begin MEASUREMENT LV_TCS_DISABLE_CAN "logical variable for disabling TCS intervention due to EMS CAN error" UBYTE _CNV_S_2_RANGE______28_CM 1 100. 0. 1. ECU_ADDRESS 0x3fd1bd /end MEASUREMENT
/begin MEASUREMENT LV_ASR_LIH "logical variable for torque intervention LIH due to TCS" UBYTE _CNV_S_2_RANGE______28_CM 1 100. 0. 1. ECU_ADDRESS 0x3fe7e2 BIT_MASK 0x1 /end MEASUREMENT
/begin MEASUREMENT T_ASR_LIH_CTR "Delay time" UBYTE _CNV_A_R_LINEAR_____27_CM 1 100. 0. 2.55 ECU_ADDRESS 0x3fe7df FORMAT "%4.2" /end MEASUREMENT
/begin MEASUREMENT T_MSR_LIH_CTR "Delay time" UBYTE _CNV_A_R_LINEAR_____27_CM 1 100. 0. 2.55 ECU_ADDRESS 0x3fe7e0 FORMAT "%4.2" /end MEASUREMENT
/begin CHARACTERISTIC C_LGRD_LIH_MSR "Limiting gradient for MSR emergency ramp function (default 0.6 Nm/10ms)" VALUE 0x42dfa _REC_VAL_20_u2 1023.96875 _CNV_A_R_LINEAR_____201_CM 0. 1023.96875 FORMAT "%7.2" /end CHARACTERISTIC
/begin CHARACTERISTIC C_TQ_MAX_MSR "limiting torque for MSR" VALUE 0x430fe _REC_VAL_20_u2 2047.96875 _CNV_A_R_LINEAR_____218_CM -1024. 1023.96875 FORMAT "%6.2" /end CHARACTERISTIC
/begin MEASUREMENT TQ_LOSS_ADD "additional torque losses" SWORD _CNV_A_R_LINEAR_____48_CM 1 100. -1024. 1023.96875 ECU_ADDRESS 0x3fd0ea FORMAT "%6.2" /end MEASUREMENT
/begin MEASUREMENT NTL "NOX trap absolute loading" UWORD _CNV_A_R_LINEAR_____309_CM 1 100. 0. 10485.6 ECU_ADDRESS 0x3fd22c FORMAT "%7.1" /end MEASUREMENT
/begin MEASUREMENT TQI_MIN_PU "Indicated engine torque minimum value at trailing throttle conditons" SWORD _CNV_A_R_LINEAR_____48_CM 1 100. -1024. 1023.96875 ECU_ADDRESS 0x3fd114 FORMAT "%6.2" /end MEASUREMENT
/begin MEASUREMENT LV_TQI_BOL_SET "Logical variable it is set if  TQI_SP  falls below TQI_BOL" UBYTE _CNV_S_2_RANGE______28_CM 1 100. 0. 1. ECU_ADDRESS 0x3fd116 BIT_MASK 0x1 /end MEASUREMENT
/begin CHARACTERISTIC C_TQI_BOL_SET_HYS "Hysteresis for recognition bottom level indicated engine torque" VALUE 0x43108 _REC_VAL_20_u2 1023.96875 _CNV_A_R_LINEAR_____48_CM 0. 1023.96875 FORMAT "%7.2" /end CHARACTERISTIC
/begin CHARACTERISTIC C_DIP_MAX "Maximum allowed manifold differential pressure" VALUE 0x42cc4 _REC_VAL_20_u2 5434. _CNV_A_R_LINEAR_____43_CM 0. 5434. FORMAT "%7.2" /end CHARACTERISTIC
/begin AXIS_PTS ldpm_n_32__maf_min_pu "" 0x43dce N_32 _REC_AXS_20_u1 8160. _CNV_A_R_LINEAR_____5_CM 12 0. 8160. FORMAT "%4.0" /end AXIS_PTS
/begin AXIS_PTS ldpm_tco__maf_min_pu "" 0x43fab TCO _REC_AXS_20_u1 190.5 _CNV_A_R_LINEAR_____0_CM 4 -48. 142.5 FORMAT "%5.1" /end AXIS_PTS
/begin CHARACTERISTIC IP_MAF_MIN_PU "Indicated engine torque minimum level at trailing conditions" MAP 0x490b6 _REC_MAP_20_u2_u1_u1 694.5 _CNV_A_R_LINEAR_____336_CM 0. 694.5 FORMAT "%6.2"
 /begin AXIS_DESCR COM_AXIS N_32 _CNV_A_R_LINEAR_____5_CM 12 0. 8160. FORMAT "%4.0" AXIS_PTS_REF ldpm_n_32__maf_min_pu /end AXIS_DESCR
 /begin AXIS_DESCR COM_AXIS TCO _CNV_A_R_LINEAR_____0_CM 4 -48. 142.5 FORMAT "%5.1" AXIS_PTS_REF ldpm_tco__maf_min_pu /end AXIS_DESCR
/end CHARACTERISTIC
/begin CHARACTERISTIC IP_MAF_MIN_PU_RNG_L "Indicated engine torque minimum level at trailing conditions at low range mode" MAP 0x49116 _REC_MAP_20_u2_u1_u1 694.5 _CNV_A_R_LINEAR_____336_CM 0. 694.5 FORMAT "%6.2"
 /begin AXIS_DESCR COM_AXIS N_32 _CNV_A_R_LINEAR_____5_CM 12 0. 8160. FORMAT "%4.0" AXIS_PTS_REF ldpm_n_32__maf_min_pu /end AXIS_DESCR
 /begin AXIS_DESCR COM_AXIS TCO _CNV_A_R_LINEAR_____0_CM 4 -48. 142.5 FORMAT "%5.1" AXIS_PTS_REF ldpm_tco__maf_min_pu /end AXIS_DESCR
/end CHARACTERISTIC
/begin CHARACTERISTIC IP_MAF_ADD_PUC "Minimumloaded limitation on indicated torque level during PUC" CURVE 0x49012 _REC_CUR_20_u2_u1 1389. _CNV_A_R_LINEAR_____354_CM -694.5 694.5 FORMAT "%7.2"
 /begin AXIS_DESCR COM_AXIS N_32 _CNV_A_R_LINEAR_____5_CM 12 0. 8160. FORMAT "%4.0" AXIS_PTS_REF ldpm_n_32__maf_min_pu /end AXIS_DESCR
/end CHARACTERISTIC
/begin CHARACTERISTIC IP_MAF_ADD_PUC_RNG_L "Minimumloaded limitation on indicated torque level during PUC at low range mode" CURVE 0x4902a _REC_CUR_20_u2_u1 1389. _CNV_A_R_LINEAR_____354_CM -694.5 694.5 FORMAT "%7.2"
 /begin AXIS_DESCR COM_AXIS N_32 _CNV_A_R_LINEAR_____5_CM 12 0. 8160. FORMAT "%4.0" AXIS_PTS_REF ldpm_n_32__maf_min_pu /end AXIS_DESCR
/end CHARACTERISTIC
/begin MEASUREMENT TQI_BOL "Indicated engine torque bottom level at minimum load and maximum spark retard for engine run free of misfire " SWORD _CNV_A_R_LINEAR_____48_CM 1 100. -1024. 1023.96875 ECU_ADDRESS 0x3fe75c FORMAT "%8.2" /end MEASUREMENT
/begin MEASUREMENT MAF_MIN_PU_1 "minimum mass air flow calibrated for trailing throttle conditions" UWORD _CNV_A_R_LINEAR_____95_CM 1 100. 0. 1389. ECU_ADDRESS 0x3fe75e FORMAT "%7.2" /end MEASUREMENT
/begin MEASUREMENT MAF_MIN_PU_2 "minimum mass air flow calculated from maximum differential pressure" UWORD _CNV_A_R_LINEAR_____95_CM 1 100. 0. 1389. ECU_ADDRESS 0x3fe760 FORMAT "%7.2" /end MEASUREMENT
/begin MEASUREMENT MAF_MIN_PU "Resulting minimummass air flow" UWORD _CNV_A_R_LINEAR_____95_CM 1 100. 0. 1389. ECU_ADDRESS 0x3fe762 FORMAT "%7.2" /end MEASUREMENT
/begin MEASUREMENT MAP_MIN "minimum allowed manifold pressure" UWORD _CNV_A_R_LINEAR_____43_CM 1 100. 0. 5434. ECU_ADDRESS 0x3fe764 FORMAT "%7.2" /end MEASUREMENT
/begin MEASUREMENT LV_IVVT_IN_AND_EX "LV  IVVT inlet and exhaust cam (0 = inlet cam variable, 1 = inlet & exhaust cam variable) " UBYTE _CNV_S_2_RANGE______28_CM 1 100. 0. 1. ECU_ADDRESS 0x3fcd0f /end MEASUREMENT
/begin MEASUREMENT CAM_TYPE "CAM type" UBYTE _CNV_S_3_RANGE_CAM__468_CM 1 100. 0. 2. ECU_ADDRESS 0x3fcd08 /end MEASUREMENT
/begin MEASUREMENT LV_INJ_CONF "LV injection configuration (0 = intake manifold injection, 1 = direct injection) " UBYTE _CNV_S_2_RANGE______11_CM 1 100. 0. 1. ECU_ADDRESS 0x3fcd10 /end MEASUREMENT
/begin MEASUREMENT LV_ISA_CONF "logical variable idle speed actuator configuration (0=no idle speed actuator, 1=idle speed actuator)" UBYTE _CNV_S_2_RANGE______11_CM 1 100. 0. 1. ECU_ADDRESS 0x3fcd11 /end MEASUREMENT
/begin MEASUREMENT LV_VAR_EBOX_CFA "variant for EBOX cooling fan" UBYTE _CNV_S_2_RANGE______11_CM 1 100. 0. 1. ECU_ADDRESS 0x3fcd15 BIT_MASK 0x1 /end MEASUREMENT
/begin MEASUREMENT LV_VAR_ST "variant of starting mode" UBYTE _CNV_S_2_RANGE______11_CM 1 100. 0. 1. ECU_ADDRESS 0x3fcd14 BIT_MASK 0x1 /end MEASUREMENT
/begin CHARACTERISTIC C_VAR_ST "variant for EBOX cooling fan" VALUE 0x42b00 _REC_VAL_20_u1 1. _CNV_A_R_LINEAR_____10_CM 0. 1. FORMAT "%2.0" /end CHARACTERISTIC
/begin MEASUREMENT ENG_CONF "state of engine configuration code" UBYTE _CNV_S_4_RANGE_ENG__469_CM 1 100. 0. 3. ECU_ADDRESS 0x3fcd09 /end MEASUREMENT
/begin MEASUREMENT VIM_TYPE "VI)M configuration" UBYTE _CNV_S_2_RANGE_VIM__470_CM 1 100. 0. 1. ECU_ADDRESS 0x3fcd0a /end MEASUREMENT
/begin CHARACTERISTIC C_ENG_CONF "engine configuration code" VALUE 0x42893 _REC_VAL_20_u1 3. _CNV_S_4_RANGE_ENG__469_CM 0. 3. /end CHARACTERISTIC
/begin CHARACTERISTIC LC_VIM_CONF "VIM configuration switch (0= closed loop, 1= switched)" VALUE 0x42bf7 _REC_VAL_20_u1 1. _CNV_S_2_RANGE_VIM__470_CM 0. 1. /end CHARACTERISTIC
/begin MEASUREMENT LV_VAR_MSW "LV MSW detected" UBYTE _CNV_S_2_RANGE______11_CM 1 100. 0. 1. ECU_ADDRESS 0x3fcd13 BIT_MASK 0x1 /end MEASUREMENT
/begin MEASUREMENT LV_VAR_SOF "variant of sound-flap" UBYTE _CNV_S_2_RANGE______11_CM 1 100. 0. 1. ECU_ADDRESS 0x3fcd17 BIT_MASK 0x1 /end MEASUREMENT
/begin MEASUREMENT LV_CBK_MPL "LV  multiple cylinder banks (0 = single bank, 1 = multiple banks) " UBYTE _CNV_S_2_RANGE______11_CM 1 100. 0. 1. ECU_ADDRESS 0x3fcd0e /end MEASUREMENT
/begin CHARACTERISTIC C_CONF_SWI_EFP_OUT "configuration bit for EFP-control" VALUE 0x42814 _REC_VAL_20_u1 2. _CNV_A_R_LINEAR_____10_CM 0. 2. FORMAT "%2.0" /end CHARACTERISTIC
/begin MEASUREMENT CONF_OIL_LEVEL_SENS "configuration of EFP-control" UBYTE _CNV_A_R_LINEAR_____10_CM 1 100. 0. 2. ECU_ADDRESS 0x3fcd0c FORMAT "%2.0" /end MEASUREMENT
/begin CHARACTERISTIC C_CONF_OIL_LEVEL_SENS "configuration bit for EFP - control" VALUE 0x42813 _REC_VAL_20_u1 2. _CNV_A_R_LINEAR_____10_CM 0. 2. FORMAT "%2.0" /end CHARACTERISTIC
/begin CHARACTERISTIC C_CONF_DMTL "" VALUE 0x42811 _REC_VAL_20_u1 1. _CNV_A_R_LINEAR_____10_CM 0. 1. FORMAT "%2.0" /end CHARACTERISTIC
/begin MEASUREMENT LV_CONF_DMTL "configuration of DMTL" UBYTE _CNV_S_2_RANGE______11_CM 1 100. 0. 1. ECU_ADDRESS 0x3fcd16 BIT_MASK 0x1 /end MEASUREMENT
/begin MEASUREMENT LV_SOF_CONF "logical variable idle speed actuator" UBYTE _CNV_S_2_RANGE______11_CM 1 100. 0. 1. ECU_ADDRESS 0x3fcd12 /end MEASUREMENT
/begin MEASUREMENT CONF_SOF_SWI "Configuration of sport-switch" UBYTE _CNV_S_3_STATE_CONF_471_CM 1 100. 0. 2. ECU_ADDRESS 0x3fcd0d /end MEASUREMENT
/begin CHARACTERISTIC C_VAR_EBOX_CFA "variant for EBOX cooling fan" VALUE 0x42aff _REC_VAL_20_u1 1. _CNV_A_R_LINEAR_____10_CM 0. 1. FORMAT "%2.0" /end CHARACTERISTIC
/begin CHARACTERISTIC C_V_VAR_AMP_THD_MIN "Minimum voltage threshold for enquiry of pressure sensor detecting component configuration" VALUE 0x43154 _REC_VAL_20_u2 4.99511719 _CNV_A_R_LINEAR_____33_CM 0. 4.99511719 FORMAT "%5.3" /end CHARACTERISTIC
/begin CHARACTERISTIC C_V_VAR_AMP_THD_MAX "Maximum voltage threshold for enquiry of pressure sensor detecting component configuration" VALUE 0x43152 _REC_VAL_20_u2 4.99511719 _CNV_A_R_LINEAR_____33_CM 0. 4.99511719 FORMAT "%5.3" /end CHARACTERISTIC
/begin MEASUREMENT IF_T_SEG_MIS "Engine roughness segment time for safety level 2" UWORD _CNV_A_R_LINEAR_____490_CM 1 100. 0. 65535. ECU_ADDRESS 0x3fcd80 FORMAT "%5.0" /end MEASUREMENT
/begin MEASUREMENT CUR_SEG_COR "Current ER corrected segment time value" UWORD _CNV_A_R_LINEAR_____490_CM 1 100. 0. 65535. ECU_ADDRESS 0x3fcd82 FORMAT "%5.0" /end MEASUREMENT
/begin MEASUREMENT SEG_T_COR_0 "ER corrected segment times buffer (after adaptation)" UWORD _CNV_A_R_LINEAR_____490_CM 1 100. 0. 65535. ECU_ADDRESS 0x3fcd74 FORMAT "%5.0" /end MEASUREMENT
/begin MEASUREMENT SEG_T_COR_1 "ER corrected segment times buffer (after adaptation)" UWORD _CNV_A_R_LINEAR_____490_CM 1 100. 0. 65535. ECU_ADDRESS 0x3fcd76 FORMAT "%5.0" /end MEASUREMENT
/begin MEASUREMENT SEG_T_COR_2 "ER corrected segment times buffer (after adaptation)" UWORD _CNV_A_R_LINEAR_____490_CM 1 100. 0. 65535. ECU_ADDRESS 0x3fcd78 FORMAT "%5.0" /end MEASUREMENT
/begin MEASUREMENT SEG_T_COR_3 "ER corrected segment times buffer (after adaptation)" UWORD _CNV_A_R_LINEAR_____490_CM 1 100. 0. 65535. ECU_ADDRESS 0x3fcd7a FORMAT "%5.0" /end MEASUREMENT
/begin MEASUREMENT SEG_T_COR_4 "ER corrected segment times buffer (after adaptation)" UWORD _CNV_A_R_LINEAR_____490_CM 1 100. 0. 65535. ECU_ADDRESS 0x3fcd7c FORMAT "%5.0" /end MEASUREMENT
/begin MEASUREMENT SEG_T_COR_5 "ER corrected segment times buffer (after adaptation)" UWORD _CNV_A_R_LINEAR_____490_CM 1 100. 0. 65535. ECU_ADDRESS 0x3fcd7e FORMAT "%5.0" /end MEASUREMENT
/begin MEASUREMENT DRV0_ER "Engine roughness static component" SLONG _CNV_A_R_LINEAR_____491_CM 1 100. -2147483647. 2147483648. ECU_ADDRESS 0x3fcd58 FORMAT "%11.0" /end MEASUREMENT
/begin MEASUREMENT DRV2_MMV_ER "Averaged engine roughness curvature component" UWORD _CNV_A_R_LINEAR_____490_CM 1 100. 0. 65535. ECU_ADDRESS 0x3fe2b0 FORMAT "%5.0" /end MEASUREMENT
/begin MEASUREMENT DRV1_ER "Engine roughness dynamic component" SWORD _CNV_A_R_LINEAR_____490_CM 1 100. -32768. 32767. ECU_ADDRESS 0x3fcd86 FORMAT "%6.0" /end MEASUREMENT
/begin MEASUREMENT ER_RAW "Engine roughness without curvature component" SWORD _CNV_A_R_LINEAR_____490_CM 1 100. -32768. 32767. ECU_ADDRESS 0x3fcd88 FORMAT "%6.0" /end MEASUREMENT
/begin MEASUREMENT LV_ENA_ER "Engine roughness enable flag" UBYTE _CNV_S_2_RANGE______11_CM 1 100. 0. 1. ECU_ADDRESS 0x3fcd93 /end MEASUREMENT
/begin CHARACTERISTIC C_N_MIN_ER "Minimum engine speed for engine roughness calculation" VALUE 0x42060 _REC_VAL_20_u2 8160. _CNV_A_R_LINEAR_____17_CM 0. 8160. FORMAT "%4.0" /end CHARACTERISTIC
/begin MEASUREMENT THD_AD_ER "Engine roughness threshold correction factor during segment adaptation learning process" UWORD _CNV_A_R_LINEAR_____490_CM 1 100. 0. 65535. ECU_ADDRESS 0x3fcd8a FORMAT "%5.0" /end MEASUREMENT
/begin MEASUREMENT SEG_T_AD_MIN_ER "Calculated correlation factor for segment adaptation" UWORD _CNV_A_R_LINEAR_____10_CM 1 100. 0. 65535. ECU_ADDRESS 0x3fcd8e FORMAT "%5.0" /end MEASUREMENT
/begin CHARACTERISTIC C_CRK_DIF_MAX_ER "Limitation of adaptation range ( mechanical tolerance)" VALUE 0x42056 _REC_VAL_20_u2 7.8125 _CNV_A_R_LINEAR_____492_CM 0. 7.8125 FORMAT "%4.2" /end CHARACTERISTIC
/begin MEASUREMENT DELTA_CRK_DIF_MAX_ER "Limitation of adaptation range (mech. Tolerance)" UWORD _CNV_A_R_LINEAR_____493_CM 1 100. 0. 245.3 ECU_ADDRESS 0x3fcd90 FORMAT "%7.3" /end MEASUREMENT
/begin MEASUREMENT LV_SEG_AD_LIM "Segment adaptation values at limit" UBYTE _CNV_S_2_RANGE______11_CM 1 100. 0. 1. ECU_ADDRESS 0x3fcd94 /end MEASUREMENT
/begin MEASUREMENT CUR_SEG_MES "Current ER raw segment time measurement" UWORD _CNV_A_R_LINEAR_____490_CM 1 100. 0. 65535. ECU_ADDRESS 0x3fe2ac FORMAT "%5.0" /end MEASUREMENT
/begin MEASUREMENT SEG_T_MES_0 "ER  raw segment times buffer (before adaptation)" UWORD _CNV_A_R_LINEAR_____490_CM 1 100. 0. 65535. ECU_ADDRESS 0x3fe2a0 FORMAT "%5.0" /end MEASUREMENT
/begin MEASUREMENT SEG_T_MES_1 "ER  raw segment times buffer (before adaptation)" UWORD _CNV_A_R_LINEAR_____490_CM 1 100. 0. 65535. ECU_ADDRESS 0x3fe2a2 FORMAT "%5.0" /end MEASUREMENT
/begin MEASUREMENT SEG_T_MES_2 "ER  raw segment times buffer (before adaptation)" UWORD _CNV_A_R_LINEAR_____490_CM 1 100. 0. 65535. ECU_ADDRESS 0x3fe2a4 FORMAT "%5.0" /end MEASUREMENT
/begin MEASUREMENT SEG_T_MES_3 "ER  raw segment times buffer (before adaptation)" UWORD _CNV_A_R_LINEAR_____490_CM 1 100. 0. 65535. ECU_ADDRESS 0x3fe2a6 FORMAT "%5.0" /end MEASUREMENT
/begin MEASUREMENT SEG_T_MES_4 "ER  raw segment times buffer (before adaptation)" UWORD _CNV_A_R_LINEAR_____490_CM 1 100. 0. 65535. ECU_ADDRESS 0x3fe2a8 FORMAT "%5.0" /end MEASUREMENT
/begin MEASUREMENT SEG_T_MES_5 "ER  raw segment times buffer (before adaptation)" UWORD _CNV_A_R_LINEAR_____490_CM 1 100. 0. 65535. ECU_ADDRESS 0x3fe2aa FORMAT "%5.0" /end MEASUREMENT
/begin MEASUREMENT DRV2_ER "Engine roughness curvature component" UWORD _CNV_A_R_LINEAR_____490_CM 1 100. 0. 65535. ECU_ADDRESS 0x3fe2ae FORMAT "%5.0" /end MEASUREMENT
/begin MEASUREMENT SEG_T_AD_NR "Counter for segment adaptation" UWORD _CNV_A_R_LINEAR_____10_CM 1 100. 0. 65535. ECU_ADDRESS 0x3fcd8c FORMAT "%5.0" /end MEASUREMENT
/begin MEASUREMENT LV_SEG_AD_STATE "Segment adaptation process state : no adaptive process executed (=0) fast adaptive process executed (=1)" UBYTE _CNV_S_2_RANGE______11_CM 1 100. 0. 1. ECU_ADDRESS 0x3fcd95 /end MEASUREMENT
/begin CHARACTERISTIC C_SEG_T_AD_COR_DRV1_MAX_ER "Maximum value of DRV1_ER (dynamic part of engine roughness) for crankshaft target wheel learning" VALUE 0x42064 _REC_VAL_20_u2 32767. _CNV_A_R_LINEAR_____490_CM 0. 32767. FORMAT "%5.0" /end CHARACTERISTIC
/begin CHARACTERISTIC C_NR_SEG_AD_ACT_MIN "Minimum segments number in fuel cut-off mode before triggering ER segment adaptive learning process" VALUE 0x42084 _REC_VAL_20_u1 255. _CNV_A_R_LINEAR_____10_CM 0. 255. FORMAT "%3.0" /end CHARACTERISTIC
/begin CHARACTERISTIC C_NR_SEG_DRV1_ER_MIN "Minimum number of segments for engine roughness dynamic part" VALUE 0x42086 _REC_VAL_20_u1 255. _CNV_A_R_LINEAR_____10_CM 0. 255. FORMAT "%3.0" /end CHARACTERISTIC
/begin CHARACTERISTIC C_N_MAX_ER "Maximum engine speed for engine roughness calculation" VALUE 0x4205e _REC_VAL_20_u2 8160. _CNV_A_R_LINEAR_____17_CM 0. 8160. FORMAT "%4.0" /end CHARACTERISTIC
/begin MEASUREMENT SEG_NR_ER "ER segment counter for segment identification (0...NC_CYL_NR - 1)" UBYTE _CNV_A_R_LINEAR_____12_CM 1 100. 0. 12. ECU_ADDRESS 0x3fcd92 FORMAT "%3.0" /end MEASUREMENT
/begin CHARACTERISTIC C_N_32_MIN_SEG "Engine speed threshold to allow IF_T_SEG_MIS calculation during start phase" VALUE 0x4207d _REC_VAL_20_u1 8160. _CNV_A_R_LINEAR_____5_CM 0. 8160. FORMAT "%4.0" /end CHARACTERISTIC
/begin MEASUREMENT ER "Engine roughness " SWORD _CNV_A_R_LINEAR_____490_CM 1 100. -32768. 32767. ECU_ADDRESS 0x3fcd84 FORMAT "%6.0" /end MEASUREMENT
/begin MEASUREMENT ER_0 "Cylinder Engine roughness values" SWORD _CNV_A_R_LINEAR_____490_CM 1 100. -32768. 32767. ECU_ADDRESS 0x3fe294 FORMAT "%6.0" /end MEASUREMENT
/begin MEASUREMENT ER_1 "Cylinder Engine roughness values" SWORD _CNV_A_R_LINEAR_____490_CM 1 100. -32768. 32767. ECU_ADDRESS 0x3fe296 FORMAT "%6.0" /end MEASUREMENT
/begin MEASUREMENT ER_2 "Cylinder Engine roughness values" SWORD _CNV_A_R_LINEAR_____490_CM 1 100. -32768. 32767. ECU_ADDRESS 0x3fe298 FORMAT "%6.0" /end MEASUREMENT
/begin MEASUREMENT ER_3 "Cylinder Engine roughness values" SWORD _CNV_A_R_LINEAR_____490_CM 1 100. -32768. 32767. ECU_ADDRESS 0x3fe29a FORMAT "%6.0" /end MEASUREMENT
/begin MEASUREMENT ER_4 "Cylinder Engine roughness values" SWORD _CNV_A_R_LINEAR_____490_CM 1 100. -32768. 32767. ECU_ADDRESS 0x3fe29c FORMAT "%6.0" /end MEASUREMENT
/begin MEASUREMENT ER_5 "Cylinder Engine roughness values" SWORD _CNV_A_R_LINEAR_____490_CM 1 100. -32768. 32767. ECU_ADDRESS 0x3fe29e FORMAT "%6.0" /end MEASUREMENT
/begin MEASUREMENT SEG_AD_MMV_0 "Filtered adaptive values used for learning process (for each segment)" SWORD _CNV_A_R_LINEAR_____494_CM 1 100. -7.8125 7.8123 ECU_ADDRESS 0x3fcd5c FORMAT "%7.4" /end MEASUREMENT
/begin MEASUREMENT SEG_AD_MMV_1 "Filtered adaptive values used for learning process (for each segment)" SWORD _CNV_A_R_LINEAR_____494_CM 1 100. -7.8125 7.8123 ECU_ADDRESS 0x3fcd5e FORMAT "%7.4" /end MEASUREMENT
/begin MEASUREMENT SEG_AD_MMV_2 "Filtered adaptive values used for learning process (for each segment)" SWORD _CNV_A_R_LINEAR_____494_CM 1 100. -7.8125 7.8123 ECU_ADDRESS 0x3fcd60 FORMAT "%7.4" /end MEASUREMENT
/begin MEASUREMENT SEG_AD_MMV_3 "Filtered adaptive values used for learning process (for each segment)" SWORD _CNV_A_R_LINEAR_____494_CM 1 100. -7.8125 7.8123 ECU_ADDRESS 0x3fcd62 FORMAT "%7.4" /end MEASUREMENT
/begin MEASUREMENT SEG_AD_MMV_4 "Filtered adaptive values used for learning process (for each segment)" SWORD _CNV_A_R_LINEAR_____494_CM 1 100. -7.8125 7.8123 ECU_ADDRESS 0x3fcd64 FORMAT "%7.4" /end MEASUREMENT
/begin MEASUREMENT SEG_AD_MMV_5 "Filtered adaptive values used for learning process (for each segment)" SWORD _CNV_A_R_LINEAR_____494_CM 1 100. -7.8125 7.8123 ECU_ADDRESS 0x3fcd66 FORMAT "%7.4" /end MEASUREMENT
/begin MEASUREMENT SEG_AD_RAW_MMV_0 "Filtered adaptive values used for learning process monitoring (for each segment)" SWORD _CNV_A_R_LINEAR_____494_CM 1 100. -7.8125 7.8123 ECU_ADDRESS 0x3fcd68 FORMAT "%7.4" /end MEASUREMENT
/begin MEASUREMENT SEG_AD_RAW_MMV_1 "Filtered adaptive values used for learning process monitoring (for each segment)" SWORD _CNV_A_R_LINEAR_____494_CM 1 100. -7.8125 7.8123 ECU_ADDRESS 0x3fcd6a FORMAT "%7.4" /end MEASUREMENT
/begin MEASUREMENT SEG_AD_RAW_MMV_2 "Filtered adaptive values used for learning process monitoring (for each segment)" SWORD _CNV_A_R_LINEAR_____494_CM 1 100. -7.8125 7.8123 ECU_ADDRESS 0x3fcd6c FORMAT "%7.4" /end MEASUREMENT
/begin MEASUREMENT SEG_AD_RAW_MMV_3 "Filtered adaptive values used for learning process monitoring (for each segment)" SWORD _CNV_A_R_LINEAR_____494_CM 1 100. -7.8125 7.8123 ECU_ADDRESS 0x3fcd6e FORMAT "%7.4" /end MEASUREMENT
/begin MEASUREMENT SEG_AD_RAW_MMV_4 "Filtered adaptive values used for learning process monitoring (for each segment)" SWORD _CNV_A_R_LINEAR_____494_CM 1 100. -7.8125 7.8123 ECU_ADDRESS 0x3fcd70 FORMAT "%7.4" /end MEASUREMENT
/begin MEASUREMENT SEG_AD_RAW_MMV_5 "Filtered adaptive values used for learning process monitoring (for each segment)" SWORD _CNV_A_R_LINEAR_____494_CM 1 100. -7.8125 7.8123 ECU_ADDRESS 0x3fcd72 FORMAT "%7.4" /end MEASUREMENT
/begin MEASUREMENT LV_SEG_AD_ACT_STATE "ER segment adaptation process enable" UBYTE _CNV_S_2_RANGE______11_CM 1 100. 0. 1. ECU_ADDRESS 0x3fcd96 /end MEASUREMENT
/begin MEASUREMENT LV_SEG_AD_RAW_ACT_STATE "ER segment adaptation process monitoring enable" UBYTE _CNV_S_2_RANGE______11_CM 1 100. 0. 1. ECU_ADDRESS 0x3fcd97 /end MEASUREMENT
/begin CHARACTERISTIC C_N_SEG_T_AD_RAW_MIN_ER "Minimum engine speed threshold for crankshaft target wheel monitoring" VALUE 0x42083 _REC_VAL_20_u1 8160. _CNV_A_R_LINEAR_____5_CM 0. 8160. FORMAT "%4.0" /end CHARACTERISTIC
/begin CHARACTERISTIC C_N_SEG_T_AD_MIN_ER "Minimum engine speed threshold for crankshaft target wheel learning" VALUE 0x42080 _REC_VAL_20_u1 8160. _CNV_A_R_LINEAR_____5_CM 0. 8160. FORMAT "%4.0" /end CHARACTERISTIC
/begin CHARACTERISTIC C_N_SEG_T_AD_MAX_ER "Maximum engine speed threshold for crankshaft target wheel learning" VALUE 0x4207e _REC_VAL_20_u1 8160. _CNV_A_R_LINEAR_____5_CM 0. 8160. FORMAT "%4.0" /end CHARACTERISTIC
/begin CHARACTERISTIC C_N_SEG_T_AD_RAW_MAX_ER "Maximum engine speed threshold for crankshaft target wheel monitoring" VALUE 0x42082 _REC_VAL_20_u1 8160. _CNV_A_R_LINEAR_____5_CM 0. 8160. FORMAT "%4.0" /end CHARACTERISTIC
/begin CHARACTERISTIC C_SEG_T_AD_RAW_CRLC_ER "ER segment adaptive values filtering coefficient for monitoring process" VALUE 0x4206c _REC_VAL_20_u2 0.99998474 _CNV_A_R_LINEAR_____31_CM 0. 0.99998474 FORMAT "%7.5" /end CHARACTERISTIC
/begin CHARACTERISTIC C_TPS_GRD_DLY_ER_AD "Fade out duration when maximum throttle gradient has been detected" VALUE 0x42076 _REC_VAL_20_u2 655.34 _CNV_A_R_LINEAR_____27_CM 1.e-002 655.35 FORMAT "%5.2" /end CHARACTERISTIC
/begin CHARACTERISTIC C_SEG_T_MES_MIN "ER minimum valid segment time" VALUE 0x42072 _REC_VAL_20_u2 65535. _CNV_A_R_LINEAR_____490_CM 0. 65535. FORMAT "%5.0" /end CHARACTERISTIC
/begin CHARACTERISTIC C_SEG_T_MES_MAX "ER maximum valid segment time" VALUE 0x42070 _REC_VAL_20_u2 65535. _CNV_A_R_LINEAR_____490_CM 0. 65535. FORMAT "%5.0" /end CHARACTERISTIC
/begin CHARACTERISTIC C_SEG_T_FAST_AD_CRLC_ER "Fast ER segment adaptive values filtering coefficient (fast learning phase)" VALUE 0x4206e _REC_VAL_20_u2 0.99998474 _CNV_A_R_LINEAR_____31_CM 0. 0.99998474 FORMAT "%7.5" /end CHARACTERISTIC
/begin CHARACTERISTIC C_SEG_T_AD_CRLC_ER_EOL "EOL specific filtering coefficient for ER segment adaptive values learning process" VALUE 0x4206a _REC_VAL_20_u2 0.99998474 _CNV_A_R_LINEAR_____31_CM 0. 0.99998474 FORMAT "%7.5" /end CHARACTERISTIC
/begin CHARACTERISTIC C_SEG_T_AD_CRLC_ER "Nominal ER segment adaptive values filtering coefficient" VALUE 0x42068 _REC_VAL_20_u2 0.99998474 _CNV_A_R_LINEAR_____31_CM 0. 0.99998474 FORMAT "%7.5" /end CHARACTERISTIC
/begin CHARACTERISTIC C_SEG_T_AD_COR_DRV1_MAX_ER_EOL "Maximum value of DRV1_ER (dynamic part of engine roughness) for crankshaft target wheel learning for EOL request mode" VALUE 0x42066 _REC_VAL_20_u2 32767. _CNV_A_R_LINEAR_____490_CM 0. 32767. FORMAT "%5.0" /end CHARACTERISTIC
/begin CHARACTERISTIC C_SEG_AD_DIF_MAX_ER "Maximum range for difference between same physical segment adaptive values" VALUE 0x42062 _REC_VAL_20_u2 7.8123 _CNV_A_R_LINEAR_____495_CM 0. 7.8123 FORMAT "%6.4" /end CHARACTERISTIC
/begin CHARACTERISTIC C_NR_SEG_DRV1_ER_MIN_EOL "Minimum number of segments for engine roughness dynamic part for EOL request mode" VALUE 0x42087 _REC_VAL_20_u1 255. _CNV_A_R_LINEAR_____10_CM 0. 255. FORMAT "%3.0" /end CHARACTERISTIC
/begin CHARACTERISTIC C_NR_SEG_AD_ACT_MIN_EOL "Minimum segments number in fuel cut-off mode before triggering ER segment adaptive learning process for EOL request mode" VALUE 0x42085 _REC_VAL_20_u1 255. _CNV_A_R_LINEAR_____10_CM 0. 255. FORMAT "%3.0" /end CHARACTERISTIC
/begin CHARACTERISTIC C_N_SEG_T_AD_MIN_ER_EOL "Minimum engine speed threshold for crankshaft target wheel learning for EOL request mode" VALUE 0x42081 _REC_VAL_20_u1 8160. _CNV_A_R_LINEAR_____5_CM 0. 8160. FORMAT "%4.0" /end CHARACTERISTIC
/begin CHARACTERISTIC C_N_SEG_T_AD_MAX_ER_EOL "Maximum engine speed threshold for crankshaft target wheel learning for EOL request mode" VALUE 0x4207f _REC_VAL_20_u1 8160. _CNV_A_R_LINEAR_____5_CM 0. 8160. FORMAT "%4.0" /end CHARACTERISTIC
/begin CHARACTERISTIC C_MAF_DIF_DLY_ER_AD "Fade out duration when maximum air-mass gradient has been detected" VALUE 0x4205c _REC_VAL_20_u2 655.34 _CNV_A_R_LINEAR_____27_CM 1.e-002 655.35 FORMAT "%5.2" /end CHARACTERISTIC
/begin CHARACTERISTIC C_LOAD_MIS_DIF_DLY_ER_AD "Fade out duration when maximum actual torque gradient has been detected" VALUE 0x4205a _REC_VAL_20_u2 655.35 _CNV_A_R_LINEAR_____27_CM 0. 655.35 FORMAT "%5.2" /end CHARACTERISTIC
/begin CHARACTERISTIC C_FAC_DRV2_ZDLY_ER "Weighting factor for engine roughness curvative component calculation (correction amount) after start" VALUE 0x42058 _REC_VAL_20_u2 4. _CNV_A_R_LINEAR_____496_CM 0. 4. FORMAT "%6.5" /end CHARACTERISTIC
/begin CHARACTERISTIC C_CRLC_DRV2_ZDLY_ER "Correlation factor for engine roughness curvature component calculation after start" VALUE 0x4207c _REC_VAL_20_u1 0.9960940000000002 _CNV_A_R_LINEAR_____44_CM 0. 0.996094 FORMAT "%5.3" /end CHARACTERISTIC
/begin MEASUREMENT FAC_GAIN_ER_0 "ER multiplicative correction components" UWORD _CNV_A_R_LINEAR_____497_CM 1 100. 0. 2. ECU_ADDRESS 0x3fcd98 FORMAT "%6.5" /end MEASUREMENT
/begin MEASUREMENT FAC_GAIN_ER_1 "ER multiplicative correction components" UWORD _CNV_A_R_LINEAR_____497_CM 1 100. 0. 2. ECU_ADDRESS 0x3fcd9a FORMAT "%6.5" /end MEASUREMENT
/begin MEASUREMENT FAC_GAIN_ER_2 "ER multiplicative correction components" UWORD _CNV_A_R_LINEAR_____497_CM 1 100. 0. 2. ECU_ADDRESS 0x3fcd9c FORMAT "%6.5" /end MEASUREMENT
/begin MEASUREMENT FAC_GAIN_ER_3 "ER multiplicative correction components" UWORD _CNV_A_R_LINEAR_____497_CM 1 100. 0. 2. ECU_ADDRESS 0x3fcd9e FORMAT "%6.5" /end MEASUREMENT
/begin MEASUREMENT FAC_GAIN_ER_4 "ER multiplicative correction components" UWORD _CNV_A_R_LINEAR_____497_CM 1 100. 0. 2. ECU_ADDRESS 0x3fcda0 FORMAT "%6.5" /end MEASUREMENT
/begin MEASUREMENT FAC_GAIN_ER_5 "ER multiplicative correction components" UWORD _CNV_A_R_LINEAR_____497_CM 1 100. 0. 2. ECU_ADDRESS 0x3fcda2 FORMAT "%6.5" /end MEASUREMENT
/begin MEASUREMENT FAC_DRV2_ER "Weighting factor for engine roughness curvative component calculation (correction amount)" UWORD _CNV_A_R_LINEAR_____496_CM 1 100. 0. 4. ECU_ADDRESS 0x3fcdb4 FORMAT "%6.5" /end MEASUREMENT
/begin MEASUREMENT FAC_ADD_ER_0 "ER additive correction components" SWORD _CNV_A_R_LINEAR_____490_CM 1 100. -32768. 32767. ECU_ADDRESS 0x3fcda4 FORMAT "%6.0" /end MEASUREMENT
/begin MEASUREMENT FAC_ADD_ER_1 "ER additive correction components" SWORD _CNV_A_R_LINEAR_____490_CM 1 100. -32768. 32767. ECU_ADDRESS 0x3fcda6 FORMAT "%6.0" /end MEASUREMENT
/begin MEASUREMENT FAC_ADD_ER_2 "ER additive correction components" SWORD _CNV_A_R_LINEAR_____490_CM 1 100. -32768. 32767. ECU_ADDRESS 0x3fcda8 FORMAT "%6.0" /end MEASUREMENT
/begin MEASUREMENT FAC_ADD_ER_3 "ER additive correction components" SWORD _CNV_A_R_LINEAR_____490_CM 1 100. -32768. 32767. ECU_ADDRESS 0x3fcdaa FORMAT "%6.0" /end MEASUREMENT
/begin MEASUREMENT FAC_ADD_ER_4 "ER additive correction components" SWORD _CNV_A_R_LINEAR_____490_CM 1 100. -32768. 32767. ECU_ADDRESS 0x3fcdac FORMAT "%6.0" /end MEASUREMENT
/begin MEASUREMENT FAC_ADD_ER_5 "ER additive correction components" SWORD _CNV_A_R_LINEAR_____490_CM 1 100. -32768. 32767. ECU_ADDRESS 0x3fcdae FORMAT "%6.0" /end MEASUREMENT
/begin MEASUREMENT CRLC_DRV2_ER "Correlation factor for engine roughness curvature component calculation" UBYTE _CNV_A_R_LINEAR_____44_CM 1 100. 0. 0.996094 ECU_ADDRESS 0x3fcdb8 FORMAT "%5.3" /end MEASUREMENT
/begin CHARACTERISTIC IP_SEG_2_AD_COR "Adaptive value correction versus engine speed for segment 2 & 5" CURVE 0x42642 _REC_CUR_20_u2_u1 15.6248 _CNV_A_R_LINEAR_____498_CM -7.8125 7.8123 FORMAT "%7.4"
 /begin AXIS_DESCR COM_AXIS N_32 _CNV_A_R_LINEAR_____5_CM 6 0. 8160. FORMAT "%4.0" AXIS_PTS_REF ldpm_n_32__seg_ad_cor /end AXIS_DESCR
/end CHARACTERISTIC
/begin CHARACTERISTIC IP_SEG_1_AD_COR "Adaptive value correction versus engine speed for segment 1 & 4" CURVE 0x42636 _REC_CUR_20_u2_u1 15.6248 _CNV_A_R_LINEAR_____498_CM -7.8125 7.8123 FORMAT "%7.4"
 /begin AXIS_DESCR COM_AXIS N_32 _CNV_A_R_LINEAR_____5_CM 6 0. 8160. FORMAT "%4.0" AXIS_PTS_REF ldpm_n_32__seg_ad_cor /end AXIS_DESCR
/end CHARACTERISTIC
/begin CHARACTERISTIC IP_MAF_DIF_MAX_ER_AD__MAF "Maximum air-mass gradient per SEG for fade out condition" CURVE 0x4262a _REC_CUR_20_u2_u2 1389. _CNV_A_R_LINEAR_____95_CM 0. 1389. FORMAT "%7.2"
 /begin AXIS_DESCR COM_AXIS MAF _CNV_A_R_LINEAR_____95_CM 6 0. 1389. FORMAT "%7.2" AXIS_PTS_REF ldp_maf__maf_dif_max_er_ad /end AXIS_DESCR
/end CHARACTERISTIC
/begin CHARACTERISTIC IP_FAC_LOAD_DRV2_ER_MT "Weighting factor for DRV2 component calculation (engine load dependent correction amount) - MT vehicle" CURVE 0x42672 _REC_CUR_20_u1_u2 1.99220002 _CNV_A_R_LINEAR_____34_CM 0. 1.99220002 FORMAT "%5.3"
 /begin AXIS_DESCR COM_AXIS LOAD_MIS _CNV_A_R_LINEAR_____172_CM 12 0. 99.99694824 AXIS_PTS_REF ldp_load_ip_fac_load_drv2_er_mt /end AXIS_DESCR
/end CHARACTERISTIC
/begin CHARACTERISTIC IP_FAC_LOAD_DRV2_ER_AT "Weighting factor for DRV2 component calculation (engine load dependent correction amount)  - AT vehicle" CURVE 0x42666 _REC_CUR_20_u1_u2 1.99220002 _CNV_A_R_LINEAR_____34_CM 0. 1.99220002 FORMAT "%5.3"
 /begin AXIS_DESCR COM_AXIS LOAD_MIS _CNV_A_R_LINEAR_____172_CM 12 0. 99.99694824 AXIS_PTS_REF ldp_load_ip_fac_load_drv2_er_at /end AXIS_DESCR
/end CHARACTERISTIC
/begin CHARACTERISTIC IP_FAC_GAIN_ER_5_MT "ER cylinder 5 multiplicative segment dependent factor for torsion correction with MT" CURVE 0x42612 _REC_CUR_20_u2_u1 2. _CNV_A_R_LINEAR_____497_CM 0. 2. FORMAT "%6.5"
 /begin AXIS_DESCR COM_AXIS N_32 _CNV_A_R_LINEAR_____5_CM 6 0. 8160. FORMAT "%4.0" AXIS_PTS_REF ldpm_n_32__fac_er_5_mt /end AXIS_DESCR
/end CHARACTERISTIC
/begin CHARACTERISTIC IP_FAC_GAIN_ER_5_AT "ER cylinder 5 multiplicative segment dependent factor for torsion correction with AT" CURVE 0x42606 _REC_CUR_20_u2_u1 2. _CNV_A_R_LINEAR_____497_CM 0. 2. FORMAT "%6.5"
 /begin AXIS_DESCR COM_AXIS N_32 _CNV_A_R_LINEAR_____5_CM 6 0. 8160. FORMAT "%4.0" AXIS_PTS_REF ldpm_n_32__fac_er_5_at /end AXIS_DESCR
/end CHARACTERISTIC
/begin CHARACTERISTIC IP_FAC_GAIN_ER_4_MT "ER cylinder 4 multiplicative segment dependent factor for torsion correction with MT" CURVE 0x425fa _REC_CUR_20_u2_u1 2. _CNV_A_R_LINEAR_____497_CM 0. 2. FORMAT "%6.5"
 /begin AXIS_DESCR COM_AXIS N_32 _CNV_A_R_LINEAR_____5_CM 6 0. 8160. FORMAT "%4.0" AXIS_PTS_REF ldpm_n_32__fac_er_4_mt /end AXIS_DESCR
/end CHARACTERISTIC
/begin CHARACTERISTIC IP_FAC_GAIN_ER_4_AT "ER cylinder 4 multiplicative segment dependent factor for torsion correction with AT" CURVE 0x425ee _REC_CUR_20_u2_u1 2. _CNV_A_R_LINEAR_____497_CM 0. 2. FORMAT "%6.5"
 /begin AXIS_DESCR COM_AXIS N_32 _CNV_A_R_LINEAR_____5_CM 6 0. 8160. FORMAT "%4.0" AXIS_PTS_REF ldpm_n_32__fac_er_4_at /end AXIS_DESCR
/end CHARACTERISTIC
/begin CHARACTERISTIC IP_FAC_GAIN_ER_3_MT "ER cylinder 3 multiplicative segment dependent factor for torsion correction with MT" CURVE 0x425e2 _REC_CUR_20_u2_u1 2. _CNV_A_R_LINEAR_____497_CM 0. 2. FORMAT "%6.5"
 /begin AXIS_DESCR COM_AXIS N_32 _CNV_A_R_LINEAR_____5_CM 6 0. 8160. FORMAT "%4.0" AXIS_PTS_REF ldpm_n_32__fac_er_3_mt /end AXIS_DESCR
/end CHARACTERISTIC
/begin CHARACTERISTIC IP_FAC_GAIN_ER_3_AT "ER cylinder 3 multiplicative segment dependent factor for torsion correction with AT" CURVE 0x425d6 _REC_CUR_20_u2_u1 2. _CNV_A_R_LINEAR_____497_CM 0. 2. FORMAT "%6.5"
 /begin AXIS_DESCR COM_AXIS N_32 _CNV_A_R_LINEAR_____5_CM 6 0. 8160. FORMAT "%4.0" AXIS_PTS_REF ldpm_n_32__fac_er_3_at /end AXIS_DESCR
/end CHARACTERISTIC
/begin CHARACTERISTIC IP_FAC_GAIN_ER_2_MT "ER cylinder 2 multiplicative segment dependent factor for torsion correction with MT" CURVE 0x425ca _REC_CUR_20_u2_u1 2. _CNV_A_R_LINEAR_____497_CM 0. 2. FORMAT "%6.5"
 /begin AXIS_DESCR COM_AXIS N_32 _CNV_A_R_LINEAR_____5_CM 6 0. 8160. FORMAT "%4.0" AXIS_PTS_REF ldpm_n_32__fac_er_2_mt /end AXIS_DESCR
/end CHARACTERISTIC
/begin CHARACTERISTIC IP_FAC_GAIN_ER_2_AT "ER cylinder 2 multiplicative segment dependent factor for torsion correction with AT" CURVE 0x425be _REC_CUR_20_u2_u1 2. _CNV_A_R_LINEAR_____497_CM 0. 2. FORMAT "%6.5"
 /begin AXIS_DESCR COM_AXIS N_32 _CNV_A_R_LINEAR_____5_CM 6 0. 8160. FORMAT "%4.0" AXIS_PTS_REF ldpm_n_32__fac_er_2_at /end AXIS_DESCR
/end CHARACTERISTIC
/begin CHARACTERISTIC IP_FAC_GAIN_ER_1_MT "ER cylinder 1 multiplicative segment dependent factor for torsion correction with MT" CURVE 0x425b2 _REC_CUR_20_u2_u1 2. _CNV_A_R_LINEAR_____497_CM 0. 2. FORMAT "%6.5"
 /begin AXIS_DESCR COM_AXIS N_32 _CNV_A_R_LINEAR_____5_CM 6 0. 8160. FORMAT "%4.0" AXIS_PTS_REF ldpm_n_32__fac_er_1_mt /end AXIS_DESCR
/end CHARACTERISTIC
/begin CHARACTERISTIC IP_FAC_GAIN_ER_1_AT "ER cylinder 1 multiplicative segment dependent factor for torsion correction with AT" CURVE 0x425a6 _REC_CUR_20_u2_u1 2. _CNV_A_R_LINEAR_____497_CM 0. 2. FORMAT "%6.5"
 /begin AXIS_DESCR COM_AXIS N_32 _CNV_A_R_LINEAR_____5_CM 6 0. 8160. FORMAT "%4.0" AXIS_PTS_REF ldpm_n_32__fac_er_1_at /end AXIS_DESCR
/end CHARACTERISTIC
/begin CHARACTERISTIC IP_FAC_GAIN_ER_0_MT "ER cylinder 0 multiplicative segment dependent factor for torsion correction with MT" CURVE 0x4259a _REC_CUR_20_u2_u1 2. _CNV_A_R_LINEAR_____497_CM 0. 2. FORMAT "%6.5"
 /begin AXIS_DESCR COM_AXIS N_32 _CNV_A_R_LINEAR_____5_CM 6 0. 8160. FORMAT "%4.0" AXIS_PTS_REF ldpm_n_32__fac_er_0_mt /end AXIS_DESCR
/end CHARACTERISTIC
/begin CHARACTERISTIC IP_FAC_GAIN_ER_0_AT "ER cylinder 0 multiplicative segment dependent factor for torsion correction with AT" CURVE 0x4258e _REC_CUR_20_u2_u1 2. _CNV_A_R_LINEAR_____497_CM 0. 2. FORMAT "%6.5"
 /begin AXIS_DESCR COM_AXIS N_32 _CNV_A_R_LINEAR_____5_CM 6 0. 8160. FORMAT "%4.0" AXIS_PTS_REF ldpm_n_32__fac_er_0_at /end AXIS_DESCR
/end CHARACTERISTIC
/begin CHARACTERISTIC IP_FAC_ADD_ER_4_AT "ER cylinder 4 additive segment dependet factor for torsion correction with AT" MAP 0x4246e _REC_MAP_20_u2_u1_u2 65535. _CNV_A_R_LINEAR_____499_CM -32768. 32767. FORMAT "%6.0"
 /begin AXIS_DESCR COM_AXIS N_32 _CNV_A_R_LINEAR_____5_CM 6 0. 8160. FORMAT "%4.0" AXIS_PTS_REF ldpm_n_32__fac_er_4_at /end AXIS_DESCR
 /begin AXIS_DESCR COM_AXIS LOAD_MIS _CNV_A_R_LINEAR_____172_CM 6 0. 99.99694824 AXIS_PTS_REF ldp_load_mis__fac_add_er_4_at /end AXIS_DESCR
/end CHARACTERISTIC
/begin CHARACTERISTIC IP_FAC_ADD_ER_4_MT "ER cylinder 4 additive segment dependent factor for torsion correction with MT" MAP 0x424b6 _REC_MAP_20_u2_u1_u2 65535. _CNV_A_R_LINEAR_____499_CM -32768. 32767. FORMAT "%6.0"
 /begin AXIS_DESCR COM_AXIS N_32 _CNV_A_R_LINEAR_____5_CM 6 0. 8160. FORMAT "%4.0" AXIS_PTS_REF ldpm_n_32__fac_er_4_mt /end AXIS_DESCR
 /begin AXIS_DESCR COM_AXIS LOAD_MIS _CNV_A_R_LINEAR_____172_CM 6 0. 99.99694824 AXIS_PTS_REF ldp_load_mis__fac_add_er_4_mt /end AXIS_DESCR
/end CHARACTERISTIC
/begin CHARACTERISTIC IP_FAC_ADD_ER_3_MT "ER cylinder 3 additive segment dependent factor for torsion correction with MT" MAP 0x42426 _REC_MAP_20_u2_u1_u2 65535. _CNV_A_R_LINEAR_____499_CM -32768. 32767. FORMAT "%6.0"
 /begin AXIS_DESCR COM_AXIS N_32 _CNV_A_R_LINEAR_____5_CM 6 0. 8160. FORMAT "%4.0" AXIS_PTS_REF ldpm_n_32__fac_er_3_mt /end AXIS_DESCR
 /begin AXIS_DESCR COM_AXIS LOAD_MIS _CNV_A_R_LINEAR_____172_CM 6 0. 99.99694824 AXIS_PTS_REF ldp_load_mis__fac_add_er_3_mt /end AXIS_DESCR
/end CHARACTERISTIC
/begin CHARACTERISTIC IP_FAC_ADD_ER_3_AT "ER cylinder 3 additive segment dependent factor for torsion correction with AT" MAP 0x423de _REC_MAP_20_u2_u1_u2 65535. _CNV_A_R_LINEAR_____499_CM -32768. 32767. FORMAT "%6.0"
 /begin AXIS_DESCR COM_AXIS N_32 _CNV_A_R_LINEAR_____5_CM 6 0. 8160. FORMAT "%4.0" AXIS_PTS_REF ldpm_n_32__fac_er_3_at /end AXIS_DESCR
 /begin AXIS_DESCR COM_AXIS LOAD_MIS _CNV_A_R_LINEAR_____172_CM 6 0. 99.99694824 AXIS_PTS_REF ldp_load_mis__fac_add_er_3_at /end AXIS_DESCR
/end CHARACTERISTIC
/begin CHARACTERISTIC IP_FAC_ADD_ER_5_AT "ER cylinder 5 additive segment dependent factor for torsion correction with AT" MAP 0x424fe _REC_MAP_20_u2_u1_u2 65535. _CNV_A_R_LINEAR_____499_CM -32768. 32767. FORMAT "%6.0"
 /begin AXIS_DESCR COM_AXIS N_32 _CNV_A_R_LINEAR_____5_CM 6 0. 8160. FORMAT "%4.0" AXIS_PTS_REF ldpm_n_32__fac_er_5_at /end AXIS_DESCR
 /begin AXIS_DESCR COM_AXIS LOAD_MIS _CNV_A_R_LINEAR_____172_CM 6 0. 99.99694824 AXIS_PTS_REF ldp_load_mis__fac_add_er_5_at /end AXIS_DESCR
/end CHARACTERISTIC
/begin CHARACTERISTIC IP_FAC_ADD_ER_5_MT "ER cylinder 5 additive segment dependent factor for torsion correction with MT" MAP 0x42546 _REC_MAP_20_u2_u1_u2 65535. _CNV_A_R_LINEAR_____499_CM -32768. 32767. FORMAT "%6.0"
 /begin AXIS_DESCR COM_AXIS N_32 _CNV_A_R_LINEAR_____5_CM 6 0. 8160. FORMAT "%4.0" AXIS_PTS_REF ldpm_n_32__fac_er_5_mt /end AXIS_DESCR
 /begin AXIS_DESCR COM_AXIS LOAD_MIS _CNV_A_R_LINEAR_____172_CM 6 0. 99.99694824 AXIS_PTS_REF ldp_load_mis__fac_add_er_5_mt /end AXIS_DESCR
/end CHARACTERISTIC
/begin CHARACTERISTIC IP_FAC_ADD_ER_1_AT "ER cylinder 1 additive segment dependent factor for torsion correction with AT" MAP 0x422be _REC_MAP_20_u2_u1_u2 65535. _CNV_A_R_LINEAR_____499_CM -32768. 32767. FORMAT "%6.0"
 /begin AXIS_DESCR COM_AXIS N_32 _CNV_A_R_LINEAR_____5_CM 6 0. 8160. FORMAT "%4.0" AXIS_PTS_REF ldpm_n_32__fac_er_1_at /end AXIS_DESCR
 /begin AXIS_DESCR COM_AXIS LOAD_MIS _CNV_A_R_LINEAR_____172_CM 6 0. 99.99694824 AXIS_PTS_REF ldp_load_mis__fac_add_er_1_at /end AXIS_DESCR
/end CHARACTERISTIC
/begin CHARACTERISTIC IP_FAC_ADD_ER_2_MT "ER cylinder 2 additive segment dependent factor for torsion correction with MT" MAP 0x42396 _REC_MAP_20_u2_u1_u2 65535. _CNV_A_R_LINEAR_____499_CM -32768. 32767. FORMAT "%6.0"
 /begin AXIS_DESCR COM_AXIS N_32 _CNV_A_R_LINEAR_____5_CM 6 0. 8160. FORMAT "%4.0" AXIS_PTS_REF ldpm_n_32__fac_er_2_mt /end AXIS_DESCR
 /begin AXIS_DESCR COM_AXIS LOAD_MIS _CNV_A_R_LINEAR_____172_CM 6 0. 99.99694824 AXIS_PTS_REF ldp_load_mis__fac_add_er_2_mt /end AXIS_DESCR
/end CHARACTERISTIC
/begin CHARACTERISTIC IP_FAC_ADD_ER_2_AT "ER cylinder 2 additive segment dependent factor for torsion correction with AT" MAP 0x4234e _REC_MAP_20_u2_u1_u2 65535. _CNV_A_R_LINEAR_____499_CM -32768. 32767. FORMAT "%6.0"
 /begin AXIS_DESCR COM_AXIS N_32 _CNV_A_R_LINEAR_____5_CM 6 0. 8160. FORMAT "%4.0" AXIS_PTS_REF ldpm_n_32__fac_er_2_at /end AXIS_DESCR
 /begin AXIS_DESCR COM_AXIS LOAD_MIS _CNV_A_R_LINEAR_____172_CM 6 0. 99.99694824 AXIS_PTS_REF ldp_load_mis__fac_add_er_2_at /end AXIS_DESCR
/end CHARACTERISTIC
/begin CHARACTERISTIC IP_FAC_ADD_ER_1_MT "ER cylinder 1 additive segment dependent factor for torsion correction with MT" MAP 0x42306 _REC_MAP_20_u2_u1_u2 65535. _CNV_A_R_LINEAR_____499_CM -32768. 32767. FORMAT "%6.0"
 /begin AXIS_DESCR COM_AXIS N_32 _CNV_A_R_LINEAR_____5_CM 6 0. 8160. FORMAT "%4.0" AXIS_PTS_REF ldpm_n_32__fac_er_1_mt /end AXIS_DESCR
 /begin AXIS_DESCR COM_AXIS LOAD_MIS _CNV_A_R_LINEAR_____172_CM 6 0. 99.99694824 AXIS_PTS_REF ldp_load_mis__fac_add_er_1_mt /end AXIS_DESCR
/end CHARACTERISTIC
/begin CHARACTERISTIC IP_CRLC_DRV2_ER_AT "Correlation factor for engine roughness curvature component calculation (correction duration) - AT vehicle" CURVE 0x4264e _REC_CUR_20_u1_u1 0.9960940000000002 _CNV_A_R_LINEAR_____44_CM 0. 0.996094 FORMAT "%5.3"
 /begin AXIS_DESCR COM_AXIS N_32 _CNV_A_R_LINEAR_____5_CM 12 0. 8160. FORMAT "%4.0" AXIS_PTS_REF ldp_n_32_ip_crlc_drv2_er_at /end AXIS_DESCR
/end CHARACTERISTIC
/begin CHARACTERISTIC IP_CRLC_DRV2_ER_MT "Correlation factor for engine roughness curvature component calculation (correction duration) - MT vehicle" CURVE 0x4265a _REC_CUR_20_u1_u1 0.9960940000000002 _CNV_A_R_LINEAR_____44_CM 0. 0.996094 FORMAT "%5.3"
 /begin AXIS_DESCR COM_AXIS N_32 _CNV_A_R_LINEAR_____5_CM 12 0. 8160. FORMAT "%4.0" AXIS_PTS_REF ldp_n_32_ip_crlc_drv2_er_at /end AXIS_DESCR
/end CHARACTERISTIC
/begin CHARACTERISTIC IP_FAC_ADD_ER_0_AT "ER cylinder 0 additive segment dependent factor for torsion correction with AT" MAP 0x4222e _REC_MAP_20_u2_u1_u2 65535. _CNV_A_R_LINEAR_____499_CM -32768. 32767. FORMAT "%6.0"
 /begin AXIS_DESCR COM_AXIS N_32 _CNV_A_R_LINEAR_____5_CM 6 0. 8160. FORMAT "%4.0" AXIS_PTS_REF ldpm_n_32__fac_er_0_at /end AXIS_DESCR
 /begin AXIS_DESCR COM_AXIS LOAD_MIS _CNV_A_R_LINEAR_____172_CM 6 0. 99.99694824 AXIS_PTS_REF ldp_load_mis__fac_add_er_0_at /end AXIS_DESCR
/end CHARACTERISTIC
/begin CHARACTERISTIC IP_FAC_ADD_ER_0_MT "ER cylinder 0 additive segment dependent factor for torsion correction with MT" MAP 0x42276 _REC_MAP_20_u2_u1_u2 65535. _CNV_A_R_LINEAR_____499_CM -32768. 32767. FORMAT "%6.0"
 /begin AXIS_DESCR COM_AXIS N_32 _CNV_A_R_LINEAR_____5_CM 6 0. 8160. FORMAT "%4.0" AXIS_PTS_REF ldpm_n_32__fac_er_0_mt /end AXIS_DESCR
 /begin AXIS_DESCR COM_AXIS LOAD_MIS _CNV_A_R_LINEAR_____172_CM 6 0. 99.99694824 AXIS_PTS_REF ldp_load_mis__fac_add_er_0_mt /end AXIS_DESCR
/end CHARACTERISTIC
/begin CHARACTERISTIC C_T_DRV2_ZDLY_ER "Delay for specific curvative component calculation during after start" VALUE 0x42074 _REC_VAL_20_u2 655.35 _CNV_A_R_LINEAR_____27_CM 0. 655.35 FORMAT "%5.2" /end CHARACTERISTIC
/begin CHARACTERISTIC C_ACCOUT_DLY_ER_AD "Fade out duration when air-conditioning compressor has been switched on or off" VALUE 0x42054 _REC_VAL_20_u2 655.34 _CNV_A_R_LINEAR_____27_CM 1.e-002 655.35 FORMAT "%5.2" /end CHARACTERISTIC
/begin CHARACTERISTIC IP_TPS_GRD_MAX_ER_AD__TPS_AV "Maximum throttle gradient threshold for fade out condition" CURVE 0x42696 _REC_CUR_20_u1_u2 2987.5 _CNV_A_R_LINEAR_____264_CM 0. 2987.5 FORMAT "%6.1"
 /begin AXIS_DESCR COM_AXIS TPS_AV _CNV_A_R_LINEAR_____226_CM 6 0. 119.5 FORMAT "%7.3" AXIS_PTS_REF ldp_tps_av__tps_grd_max_er_ad /end AXIS_DESCR
/end CHARACTERISTIC
/begin CHARACTERISTIC IP_LOAD_MIS_DIF_MAX_ER_AD "Maximum actual torque gradient fade out condition" CURVE 0x4261e _REC_CUR_20_u2_u2 100. _CNV_A_R_LINEAR_____368_CM 0. 100. FORMAT "%7.3"
 /begin AXIS_DESCR COM_AXIS LOAD_MIS _CNV_A_R_LINEAR_____368_CM 6 0. 100. FORMAT "%7.3" AXIS_PTS_REF ldp_load_mis__load_mis_dif_max /end AXIS_DESCR
/end CHARACTERISTIC
/begin MEASUREMENT LV_SEG_AD_REQ_EOL "EOL specific request for ER segment adaptive learning process" UBYTE _CNV_S_2_RANGE______11_CM 1 100. 0. 1. ECU_ADDRESS 0x3fcdbd /end MEASUREMENT
/begin MEASUREMENT LV_SEG_AD_RST_EOL "EOL specific request to reset ER segment adaptive values" UBYTE _CNV_S_2_RANGE______11_CM 1 100. 0. 1. ECU_ADDRESS 0x3fcdbe /end MEASUREMENT
/begin MEASUREMENT LV_ERR_DET_CRK "Crankshaft signal detected error (before debouncing)" UBYTE _CNV_S_2_RANGE______11_CM 1 100. 0. 1. ECU_ADDRESS 0x3fcdbb /end MEASUREMENT
/begin MEASUREMENT SEG_T_MES "Engine roughness segment time (Applicative software)" UWORD _CNV_A_R_LINEAR_____490_CM 1 100. 0. 65535. ECU_ADDRESS 0x3fcdb2 FORMAT "%5.0" /end MEASUREMENT
/begin MEASUREMENT LV_ENA_SEG_T_MES "Engine roughness segment time validity flag" UBYTE _CNV_S_2_RANGE______11_CM 1 100. 0. 1. ECU_ADDRESS 0x3fcdb9 /end MEASUREMENT
/begin MEASUREMENT LV_SEG_AD_FDOUT "Boolean for segment adaptation fade out condition" UBYTE _CNV_S_2_RANGE______11_CM 1 100. 0. 1. ECU_ADDRESS 0x3fcdba /end MEASUREMENT
/begin MEASUREMENT SEG_AD_COR "Segment adaptive values correction versus engine speed (for each segment)" SWORD _CNV_A_R_LINEAR_____494_CM 1 100. -7.8125 7.8123 ECU_ADDRESS 0x3fcdb0 FORMAT "%7.4" /end MEASUREMENT
/begin MEASUREMENT SEG_AD_DIF_1 "ER adaptive values difference on same physical segment (Segment 1 & 4)" UWORD _CNV_A_R_LINEAR_____495_CM 1 100. 0. 7.8123 ECU_ADDRESS 0x3fe2ba FORMAT "%6.4" /end MEASUREMENT
/begin MEASUREMENT SEG_AD_DIF_0 "ER adaptive values difference on same physical segment (Segment 0 & 3)" UWORD _CNV_A_R_LINEAR_____495_CM 1 100. 0. 7.8123 ECU_ADDRESS 0x3fe2b8 FORMAT "%6.4" /end MEASUREMENT
/begin MEASUREMENT SEG_AD_DIF_2 "ER adaptive values difference on same physical segment (Segment 2 & 5)" UWORD _CNV_A_R_LINEAR_____495_CM 1 100. 0. 7.8123 ECU_ADDRESS 0x3fe2bc FORMAT "%6.4" /end MEASUREMENT
/begin MEASUREMENT SEG_T_AD_CRLC_ER "ER segment adaptive values filtering coefficient" UWORD _CNV_A_R_LINEAR_____31_CM 1 100. 0. 0.99998474 ECU_ADDRESS 0x3fcdb6 FORMAT "%7.6" /end MEASUREMENT
/begin CHARACTERISTIC LC_SEG_AD_RST_ENA_EOL "Specific EOL request enable flag to reset ER segment adaptive values & learning process" VALUE 0x4208a _REC_VAL_20_u1 1. _CNV_A_R_LINEAR_____10_CM 0. 1. FORMAT "%2.0" /end CHARACTERISTIC
/begin CHARACTERISTIC LC_SEG_AD_REQ_ENA_EOL "Specific EOL request enable flag for ER segment adaptive value learning process" VALUE 0x42089 _REC_VAL_20_u1 1. _CNV_A_R_LINEAR_____10_CM 0. 1. FORMAT "%2.0" /end CHARACTERISTIC
/begin CHARACTERISTIC LC_CONF_GAIN_ADD_ER "ER gain/additive correction enable flag" VALUE 0x42088 _REC_VAL_20_u1 1. _CNV_A_R_LINEAR_____10_CM 0. 1. FORMAT "%2.0" /end CHARACTERISTIC
/begin AXIS_PTS ldpm_n_32__seg_ad_cor "" 0x42113 LDPM_N_32__SEG_AD_COR _REC_AXS_20_u1 8160. _CNV_A_R_LINEAR_____5_CM 6 0. 8160. FORMAT "%4.0" /end AXIS_PTS
/begin AXIS_PTS ldp_maf__maf_dif_max_er_ad "" 0x42204 LDP_MAF__MAF_DIF_MAX_ER_AD _REC_AXS_20_u2 1389. _CNV_A_R_LINEAR_____95_CM 6 0. 1389. FORMAT "%7.2" /end AXIS_PTS
/begin AXIS_PTS ldp_tps_av__tps_grd_max_er_ad "" 0x42212 LDP_TPS_AV__TPS_GRD_MAX_ER_AD _REC_AXS_20_u2 119.5 _CNV_A_R_LINEAR_____226_CM 6 0. 119.5 FORMAT "%7.3" /end AXIS_PTS
/begin MEASUREMENT CTR_ABC_SEG_T_AD "" UBYTE _CNV_A_R_LINEAR_____10_CM 1 100. 0. 255. ECU_ADDRESS 0x3fd52a FORMAT "%3.0" /end MEASUREMENT
/begin MEASUREMENT LV_CDN_DIAG_SEG_T_AD "" UBYTE _CNV_S_2_RANGE______21_R_CM 1 100. 0. 255. ECU_ADDRESS 0x3fd528 BIT_MASK 0x10 /end MEASUREMENT
/begin MEASUREMENT LV_END_DIAG_SEG_T_AD "" UBYTE _CNV_S_2_RANGE______21_R_CM 1 100. 0. 255. ECU_ADDRESS 0x3fd528 BIT_MASK 0x20 /end MEASUREMENT
/begin MEASUREMENT LV_READY_SEG_T_AD "" UBYTE _CNV_S_2_RANGE______21_R_CM 1 100. 0. 255. ECU_ADDRESS 0x3fd528 BIT_MASK 0x40 /end MEASUREMENT
/begin MEASUREMENT ERR_SYM_SEG_T_AD "" UBYTE _CNV_S_6_RANGE_ERR__22_CM 1 100. 0. 15. ECU_ADDRESS 0x3fd528 BIT_MASK 0xF /end MEASUREMENT
/begin MEASUREMENT LV_ERR_MEM_SEG_T_AD "" UBYTE _CNV_S_2_RANGE______21_R_CM 1 100. 0. 255. ECU_ADDRESS 0x3fd528 BIT_MASK 0x80 /end MEASUREMENT
/begin MEASUREMENT CTR_ABC_END_DIAG_SEG_T_AD "" UBYTE _CNV_A_R_LINEAR_____12_CM 1 100. 0. 255. ECU_ADDRESS 0x3fd529 FORMAT "%3.0" /end MEASUREMENT
/begin MEASUREMENT CTR_ABC_SEG_T "" UBYTE _CNV_A_R_LINEAR_____10_CM 1 100. 0. 255. ECU_ADDRESS 0x3fd52e FORMAT "%3.0" /end MEASUREMENT
/begin MEASUREMENT LV_CDN_DIAG_SEG_T "" UBYTE _CNV_S_2_RANGE______21_R_CM 1 100. 0. 255. ECU_ADDRESS 0x3fd52c BIT_MASK 0x10 /end MEASUREMENT
/begin MEASUREMENT LV_END_DIAG_SEG_T "" UBYTE _CNV_S_2_RANGE______21_R_CM 1 100. 0. 255. ECU_ADDRESS 0x3fd52c BIT_MASK 0x20 /end MEASUREMENT
/begin MEASUREMENT LV_READY_SEG_T "" UBYTE _CNV_S_2_RANGE______21_R_CM 1 100. 0. 255. ECU_ADDRESS 0x3fd52c BIT_MASK 0x40 /end MEASUREMENT
/begin MEASUREMENT ERR_SYM_SEG_T "" UBYTE _CNV_S_6_RANGE_ERR__22_CM 1 100. 0. 15. ECU_ADDRESS 0x3fd52c BIT_MASK 0xF /end MEASUREMENT
/begin MEASUREMENT LV_ERR_MEM_SEG_T "" UBYTE _CNV_S_2_RANGE______21_R_CM 1 100. 0. 255. ECU_ADDRESS 0x3fd52c BIT_MASK 0x80 /end MEASUREMENT
/begin MEASUREMENT LV_INH_SEG_AD "ER segment adaptive process inhibition flag" UBYTE _CNV_S_2_RANGE______11_CM 1 100. 0. 1. ECU_ADDRESS 0x3fcdbc /end MEASUREMENT
/begin MEASUREMENT LV_ERR_SEG_T "Prsent failure for segment time adaptive values" UBYTE _CNV_S_2_RANGE______11_CM 1 100. 0. 1. ECU_ADDRESS 0x3fd52f /end MEASUREMENT
/begin MEASUREMENT LV_ERR_SEG_T_AD "Prsent failure for segment time adaptive values" UBYTE _CNV_S_2_RANGE______11_CM 1 100. 0. 1. ECU_ADDRESS 0x3fd52b /end MEASUREMENT
/begin AXIS_PTS ldp_load_mis__load_mis_dif_max "" 0x421f6 LDP_LOAD_MIS__LOAD_MIS_DIF_MAX _REC_AXS_20_u2 100. _CNV_A_R_LINEAR_____368_CM 6 0. 100. FORMAT "%7.3" /end AXIS_PTS
/begin CHARACTERISTIC IP_FAC_N_DRV2_ER_AT "Weighting factor for DRV2 component calculation (engine speed dependent correction amount) - AT vehicle" CURVE 0x4267e _REC_CUR_20_u1_u1 1.99220002 _CNV_A_R_LINEAR_____34_CM 0. 1.99220002 FORMAT "%5.3"
 /begin AXIS_DESCR COM_AXIS N_32 _CNV_A_R_LINEAR_____5_CM 12 0. 8160. FORMAT "%4.0" AXIS_PTS_REF ldp_n_32_ip_fac_n_drv2_er_at /end AXIS_DESCR
/end CHARACTERISTIC
/begin CHARACTERISTIC IP_FAC_N_DRV2_ER_MT "Weighting factor for DRV2 component calculation (engine speed dependent correction amount) - MT vehicle" CURVE 0x4268a _REC_CUR_20_u1_u1 1.99220002 _CNV_A_R_LINEAR_____34_CM 0. 1.99220002 FORMAT "%5.3"
 /begin AXIS_DESCR COM_AXIS N_32 _CNV_A_R_LINEAR_____5_CM 12 0. 8160. FORMAT "%4.0" AXIS_PTS_REF ldp_n_32_ip_fac_n_drv2_er_mt /end AXIS_DESCR
/end CHARACTERISTIC
/begin AXIS_PTS ldp_load_mis__fac_add_er_0_at "" 0x4214e LDP_LOAD_MIS__FAC_ADD_ER_0_AT _REC_AXS_20_u2 99.99694824000001 _CNV_A_R_LINEAR_____172_CM 6 0. 99.99694824 /end AXIS_PTS
/begin AXIS_PTS ldp_load_mis__fac_add_er_0_mt "" 0x4215c LDP_LOAD_MIS__FAC_ADD_ER_0_MT _REC_AXS_20_u2 99.99694824000001 _CNV_A_R_LINEAR_____172_CM 6 0. 99.99694824 /end AXIS_PTS
/begin AXIS_PTS ldp_load_mis__fac_add_er_1_at "" 0x4216a LDP_LOAD_MIS__FAC_ADD_ER_1_AT _REC_AXS_20_u2 99.99694824000001 _CNV_A_R_LINEAR_____172_CM 6 0. 99.99694824 /end AXIS_PTS
/begin AXIS_PTS ldp_load_mis__fac_add_er_1_mt "" 0x42178 LDP_LOAD_MIS__FAC_ADD_ER_1_MT _REC_AXS_20_u2 99.99694824000001 _CNV_A_R_LINEAR_____172_CM 6 0. 99.99694824 /end AXIS_PTS
/begin AXIS_PTS ldp_load_mis__fac_add_er_2_at "" 0x42186 LDP_LOAD_MIS__FAC_ADD_ER_2_AT _REC_AXS_20_u2 99.99694824000001 _CNV_A_R_LINEAR_____172_CM 6 0. 99.99694824 /end AXIS_PTS
/begin AXIS_PTS ldp_load_mis__fac_add_er_2_mt "" 0x42194 LDP_LOAD_MIS__FAC_ADD_ER_2_MT _REC_AXS_20_u2 99.99694824000001 _CNV_A_R_LINEAR_____172_CM 6 0. 99.99694824 /end AXIS_PTS
/begin AXIS_PTS ldp_load_mis__fac_add_er_3_at "" 0x421a2 LDP_LOAD_MIS__FAC_ADD_ER_3_AT _REC_AXS_20_u2 99.99694824000001 _CNV_A_R_LINEAR_____172_CM 6 0. 99.99694824 /end AXIS_PTS
/begin AXIS_PTS ldp_load_mis__fac_add_er_3_mt "" 0x421b0 LDP_LOAD_MIS__FAC_ADD_ER_3_MT _REC_AXS_20_u2 99.99694824000001 _CNV_A_R_LINEAR_____172_CM 6 0. 99.99694824 /end AXIS_PTS
/begin AXIS_PTS ldp_load_mis__fac_add_er_4_at "" 0x421be LDP_LOAD_MIS__FAC_ADD_ER_4_AT _REC_AXS_20_u2 99.99694824000001 _CNV_A_R_LINEAR_____172_CM 6 0. 99.99694824 /end AXIS_PTS
/begin AXIS_PTS ldp_load_mis__fac_add_er_4_mt "" 0x421cc LDP_LOAD_MIS__FAC_ADD_ER_4_MT _REC_AXS_20_u2 99.99694824000001 _CNV_A_R_LINEAR_____172_CM 6 0. 99.99694824 /end AXIS_PTS
/begin AXIS_PTS ldp_load_mis__fac_add_er_5_at "" 0x421da LDP_LOAD_MIS__FAC_ADD_ER_5_AT _REC_AXS_20_u2 99.99694824000001 _CNV_A_R_LINEAR_____172_CM 6 0. 99.99694824 /end AXIS_PTS
/begin AXIS_PTS ldp_load_mis__fac_add_er_5_mt "" 0x421e8 LDP_LOAD_MIS__FAC_ADD_ER_5_MT _REC_AXS_20_u2 99.99694824000001 _CNV_A_R_LINEAR_____172_CM 6 0. 99.99694824 /end AXIS_PTS
/begin AXIS_PTS ldp_load_ip_fac_load_drv2_er_at "" 0x4211a LDP_LOAD_IP_FAC_LOAD_DRV2_ER_AT _REC_AXS_20_u2 99.99694824000001 _CNV_A_R_LINEAR_____172_CM 12 0. 99.99694824 /end AXIS_PTS
/begin AXIS_PTS ldp_load_ip_fac_load_drv2_er_mt "" 0x42134 LDP_LOAD_IP_FAC_LOAD_DRV2_ER_MT _REC_AXS_20_u2 99.99694824000001 _CNV_A_R_LINEAR_____172_CM 12 0. 99.99694824 /end AXIS_PTS
/begin AXIS_PTS ldp_n_32_ip_fac_n_drv2_er_at "" 0x420a5 LDP_N_32_IP_FAC_N_DRV2_ER_AT _REC_AXS_20_u1 8160. _CNV_A_R_LINEAR_____5_CM 12 0. 8160. FORMAT "%4.0" /end AXIS_PTS
/begin AXIS_PTS ldp_n_32_ip_fac_n_drv2_er_mt "" 0x420b2 LDP_N_32_IP_FAC_N_DRV2_ER_MT _REC_AXS_20_u1 8160. _CNV_A_R_LINEAR_____5_CM 12 0. 8160. FORMAT "%4.0" /end AXIS_PTS
/begin AXIS_PTS ldp_n_32_ip_crlc_drv2_er_at "" 0x4208b LDP_N_32_IP_CRLC_DRV2_ER_AT _REC_AXS_20_u1 8160. _CNV_A_R_LINEAR_____5_CM 12 0. 8160. FORMAT "%4.0" /end AXIS_PTS
/begin AXIS_PTS ldpm_n_32__fac_er_0_at "" 0x420bf LDPM_N_32__FAC_ER_0_AT _REC_AXS_20_u1 8160. _CNV_A_R_LINEAR_____5_CM 6 0. 8160. FORMAT "%4.0" /end AXIS_PTS
/begin AXIS_PTS ldpm_n_32__fac_er_0_mt "" 0x420c6 LDPM_N_32__FAC_ER_0_MT _REC_AXS_20_u1 8160. _CNV_A_R_LINEAR_____5_CM 6 0. 8160. FORMAT "%4.0" /end AXIS_PTS
/begin AXIS_PTS ldpm_n_32__fac_er_1_at "" 0x420cd LDPM_N_32__FAC_ER_1_AT _REC_AXS_20_u1 8160. _CNV_A_R_LINEAR_____5_CM 6 0. 8160. FORMAT "%4.0" /end AXIS_PTS
/begin AXIS_PTS ldpm_n_32__fac_er_1_mt "" 0x420d4 LDPM_N_32__FAC_ER_1_MT _REC_AXS_20_u1 8160. _CNV_A_R_LINEAR_____5_CM 6 0. 8160. FORMAT "%4.0" /end AXIS_PTS
/begin AXIS_PTS ldpm_n_32__fac_er_2_at "" 0x420db LDPM_N_32__FAC_ER_2_AT _REC_AXS_20_u1 8160. _CNV_A_R_LINEAR_____5_CM 6 0. 8160. FORMAT "%4.0" /end AXIS_PTS
/begin AXIS_PTS ldpm_n_32__fac_er_2_mt "" 0x420e2 LDPM_N_32__FAC_ER_2_MT _REC_AXS_20_u1 8160. _CNV_A_R_LINEAR_____5_CM 6 0. 8160. FORMAT "%4.0" /end AXIS_PTS
/begin AXIS_PTS ldpm_n_32__fac_er_3_at "" 0x420e9 LDPM_N_32__FAC_ER_3_AT _REC_AXS_20_u1 8160. _CNV_A_R_LINEAR_____5_CM 6 0. 8160. FORMAT "%4.0" /end AXIS_PTS
/begin AXIS_PTS ldpm_n_32__fac_er_3_mt "" 0x420f0 LDPM_N_32__FAC_ER_3_MT _REC_AXS_20_u1 8160. _CNV_A_R_LINEAR_____5_CM 6 0. 8160. FORMAT "%4.0" /end AXIS_PTS
/begin AXIS_PTS ldpm_n_32__fac_er_4_at "" 0x420f7 LDPM_N_32__FAC_ER_4_AT _REC_AXS_20_u1 8160. _CNV_A_R_LINEAR_____5_CM 6 0. 8160. FORMAT "%4.0" /end AXIS_PTS
/begin AXIS_PTS ldpm_n_32__fac_er_4_mt "" 0x420fe LDPM_N_32__FAC_ER_4_MT _REC_AXS_20_u1 8160. _CNV_A_R_LINEAR_____5_CM 6 0. 8160. FORMAT "%4.0" /end AXIS_PTS
/begin AXIS_PTS ldpm_n_32__fac_er_5_at "" 0x42105 LDPM_N_32__FAC_ER_5_AT _REC_AXS_20_u1 8160. _CNV_A_R_LINEAR_____5_CM 6 0. 8160. FORMAT "%4.0" /end AXIS_PTS
/begin AXIS_PTS ldpm_n_32__fac_er_5_mt "" 0x4210c LDPM_N_32__FAC_ER_5_MT _REC_AXS_20_u1 8160. _CNV_A_R_LINEAR_____5_CM 6 0. 8160. FORMAT "%4.0" /end AXIS_PTS
/begin MEASUREMENT BATEMP_GAIN "" UWORD _CNV_R_R_igen_ub_q1_483_CM 1 100. 0. 65535. ECU_ADDRESS 0x3fb2a4 FORMAT "%8.2" /end MEASUREMENT
/begin MEASUREMENT BSDUMMY_1 "" UBYTE _CNV_R_R_igen_ub_q1_483_CM 1 100. 0. 255. ECU_ADDRESS 0x3fb2e4 FORMAT "%5.1" /end MEASUREMENT
/begin MEASUREMENT BSDUMMY_2 "" UWORD _CNV_R_R_igen_ub_q1_483_CM 1 100. 0. 65535. ECU_ADDRESS 0x3fb2a6 FORMAT "%8.2" /end MEASUREMENT
/begin MEASUREMENT BSDUMMY_3 "" UWORD _CNV_R_R_igen_ub_q1_483_CM 1 100. 0. 65535. ECU_ADDRESS 0x3fb2a8 FORMAT "%8.2" /end MEASUREMENT
/begin MEASUREMENT BSDUMMY_4 "" UBYTE _CNV_R_R_igen_ub_q1_483_CM 1 100. 0. 255. ECU_ADDRESS 0x3fb2e5 FORMAT "%5.1" /end MEASUREMENT
/begin MEASUREMENT BSDUMMY_5 "" ULONG _CNV_R_R_igen_ub_q1_483_CM 1 100. 0. 4294970000. ECU_ADDRESS 0x3fb2e0 FORMAT "%13.2" /end MEASUREMENT
/begin MEASUREMENT B_EB_BUSY "" UBYTE _CNV_S_2_B_TRUE_519_CM 1 100. 0. 1. ECU_ADDRESS 0x3fb298 BIT_MASK 0x1 /end MEASUREMENT
/begin MEASUREMENT B_EB_RXRDY "" UBYTE _CNV_S_2_B_TRUE_519_CM 1 100. 0. 1. ECU_ADDRESS 0x3fb29a BIT_MASK 0x1 /end MEASUREMENT
/begin MEASUREMENT B_EB_TXOK "" UBYTE _CNV_S_2_B_TRUE_519_CM 1 100. 0. 1. ECU_ADDRESS 0x3fb29d BIT_MASK 0x1 /end MEASUREMENT
/begin MEASUREMENT B_EB_WRITE "" UBYTE _CNV_S_2_B_TRUE_519_CM 1 100. 0. 1. ECU_ADDRESS 0x3fb29e BIT_MASK 0x1 /end MEASUREMENT
/begin MEASUREMENT B_IBFBSD "" UBYTE _CNV_S_2_B_TRUE_519_CM 1 100. 0. 1. ECU_ADDRESS 0x3fb29f BIT_MASK 0x1 /end MEASUREMENT
/begin MEASUREMENT B_IBFEBSD "" UBYTE _CNV_S_2_B_TRUE_519_CM 1 100. 0. 1. ECU_ADDRESS 0x3fb299 BIT_MASK 0x1 /end MEASUREMENT
/begin MEASUREMENT B_IBUNPLAU "" UBYTE _CNV_S_2_B_TRUE_519_CM 1 100. 0. 1. ECU_ADDRESS 0x3fb2a0 BIT_MASK 0x1 /end MEASUREMENT
/begin MEASUREMENT B_KTIB_1ST "" UBYTE _CNV_S_2_B_TRUE_519_CM 1 100. 0. 1. ECU_ADDRESS 0x3fb2a1 BIT_MASK 0x1 /end MEASUREMENT
/begin MEASUREMENT CRC16_EROM "" UWORD _CNV_R_R_igen_ub_q1_483_CM 1 100. 0. 65535. ECU_ADDRESS 0x3fb2aa FORMAT "%8.2" /end MEASUREMENT
/begin MEASUREMENT CRCPARA "" UWORD _CNV_R_R_igen_ub_q1_483_CM 1 100. 0. 65535. ECU_ADDRESS 0x3fb2ac FORMAT "%8.2" /end MEASUREMENT
/begin MEASUREMENT EBSD_ADR "" UBYTE _CNV_R_R_igen_ub_q1_483_CM 1 100. 0. 255. ECU_ADDRESS 0x3fb29b FORMAT "%5.1" /end MEASUREMENT
/begin MEASUREMENT EBSD_ARYIN "" UBYTE _CNV_R_R_igen_ub_q1_483_CM 1 100. 0. 255. ECU_ADDRESS 0x3fb2e6 FORMAT "%5.1" /end MEASUREMENT
/begin MEASUREMENT EBSD_ERRDIR "" UBYTE _CNV_S_2_B_TRUE_519_CM 1 100. 0. 1. ECU_ADDRESS 0x3fb2a2 BIT_MASK 0x1 /end MEASUREMENT
/begin MEASUREMENT EBSD_ERREP "" UBYTE _CNV_R_R_igen_ub_q1_483_CM 1 100. 0. 255. ECU_ADDRESS 0x3fb2e7 FORMAT "%5.1" /end MEASUREMENT
/begin MEASUREMENT EBSD_ERRIN "" UBYTE _CNV_R_R_igen_ub_q1_483_CM 1 100. 0. 255. ECU_ADDRESS 0x3fb2e8 FORMAT "%5.1" /end MEASUREMENT
/begin MEASUREMENT EBSD_INDEX "" UBYTE _CNV_R_R_igen_ub_q1_483_CM 1 100. 0. 255. ECU_ADDRESS 0x3fb2e9 FORMAT "%5.1" /end MEASUREMENT
/begin MEASUREMENT EBSD_NBYT "" UBYTE _CNV_R_R_igen_ub_q1_483_CM 1 100. 0. 255. ECU_ADDRESS 0x3fb29c FORMAT "%5.1" /end MEASUREMENT
/begin MEASUREMENT EBSD_VARIN "" UBYTE _CNV_R_R_igen_ub_q1_483_CM 1 100. 0. 255. ECU_ADDRESS 0x3fb2ea FORMAT "%5.1" /end MEASUREMENT
/begin MEASUREMENT ERCNTCHKSU "" UWORD _CNV_R_R_igen_ub_q1_483_CM 1 100. 0. 65535. ECU_ADDRESS 0x3fb2ae FORMAT "%8.2" /end MEASUREMENT
/begin MEASUREMENT ERCNTCKSUB "" UBYTE _CNV_R_R_igen_ub_q1_483_CM 1 100. 0. 255. ECU_ADDRESS 0x3fb2eb FORMAT "%5.1" /end MEASUREMENT
/begin MEASUREMENT ERCNTPARIB "" UBYTE _CNV_R_R_igen_ub_q1_483_CM 1 100. 0. 255. ECU_ADDRESS 0x3fb2ec FORMAT "%5.1" /end MEASUREMENT
/begin MEASUREMENT ERCNTPARIT "" UWORD _CNV_R_R_igen_ub_q1_483_CM 1 100. 0. 65535. ECU_ADDRESS 0x3fb2b0 FORMAT "%8.2" /end MEASUREMENT
/begin MEASUREMENT ERCNTUNTEB "" UBYTE _CNV_R_R_igen_ub_q1_483_CM 1 100. 0. 255. ECU_ADDRESS 0x3fb2ed FORMAT "%5.1" /end MEASUREMENT
/begin MEASUREMENT ERCNTUNTER "" UWORD _CNV_R_R_igen_ub_q1_483_CM 1 100. 0. 65535. ECU_ADDRESS 0x3fb2b2 FORMAT "%8.2" /end MEASUREMENT
/begin MEASUREMENT IBATT_10 "" UWORD _CNV_R_R_i_uw_q0p00_529_CM 1 100. 0. 40.0018 ECU_ADDRESS 0x3fb2b4 FORMAT "%8.5" /end MEASUREMENT
/begin MEASUREMENT IBATT_1000 "" UWORD _CNV_R_R_i_uw_q0p06_530_CM 1 100. 0. 4000.18 ECU_ADDRESS 0x3fb2b6 FORMAT "%8.3" /end MEASUREMENT
/begin MEASUREMENT IBATT_200 "" UWORD _CNV_R_R_i_uw_q0p02_531_CM 1 100. -200.012 1400.06 ECU_ADDRESS 0x3fb2b8 FORMAT "%8.3" /end MEASUREMENT
/begin MEASUREMENT IBATT_W "" UWORD _CNV_R_R_i_uw_q0p07_532_CM 1 100. -199.963 4600.26 ECU_ADDRESS 0x3fb2ba FORMAT "%8.3" /end MEASUREMENT
/begin MEASUREMENT IBCNTRESEB "" UBYTE _CNV_R_R_igen_ub_q1_483_CM 1 100. 0. 255. ECU_ADDRESS 0x3fb2ee FORMAT "%5.1" /end MEASUREMENT
/begin MEASUREMENT IBCNTRESET "" UWORD _CNV_R_R_igen_ub_q1_483_CM 1 100. 0. 65535. ECU_ADDRESS 0x3fb2bc FORMAT "%8.2" /end MEASUREMENT
/begin MEASUREMENT IBCNTUPDAT "" UBYTE _CNV_R_R_igen_ub_q1_483_CM 1 100. 0. 255. ECU_ADDRESS 0x3fb2ef FORMAT "%5.1" /end MEASUREMENT
/begin MEASUREMENT IBHWVERSI "" UBYTE _CNV_R_R_igen_ub_q1_483_CM 1 100. 0. 255. ECU_ADDRESS 0x3fb2f0 FORMAT "%5.1" /end MEASUREMENT
/begin MEASUREMENT IBSWBASE "" UBYTE _CNV_R_R_igen_ub_q1_483_CM 1 100. 0. 255. ECU_ADDRESS 0x3fb2f1 FORMAT "%5.1" /end MEASUREMENT
/begin MEASUREMENT IBSWCHANG "" UBYTE _CNV_R_R_igen_ub_q1_483_CM 1 100. 0. 255. ECU_ADDRESS 0x3fb2f2 FORMAT "%5.1" /end MEASUREMENT
/begin MEASUREMENT IBS_REG4 "" UBYTE _CNV_R_R_igen_ub_q1_483_CM 1 100. 0. 255. ECU_ADDRESS 0x3fb2f3 FORMAT "%5.1" /end MEASUREMENT
/begin MEASUREMENT IBS_REG5 "" UBYTE _CNV_R_R_igen_ub_q1_483_CM 1 100. 0. 255. ECU_ADDRESS 0x3fb2f4 FORMAT "%5.1" /end MEASUREMENT
/begin MEASUREMENT IB_CRC16 "" UWORD _CNV_R_R_igen_ub_q1_483_CM 1 100. 0. 65535. ECU_ADDRESS 0x3fb2be FORMAT "%8.2" /end MEASUREMENT
/begin MEASUREMENT IB_PARLEN "" UBYTE _CNV_R_R_igen_ub_q1_483_CM 1 100. 0. 255. ECU_ADDRESS 0x3fb2f5 FORMAT "%5.1" /end MEASUREMENT
/begin MEASUREMENT I_1000_GAIN "" UWORD _CNV_R_R_igen_ub_q1_483_CM 1 100. 0. 65535. ECU_ADDRESS 0x3fb2c0 FORMAT "%8.2" /end MEASUREMENT
/begin MEASUREMENT I_1000_OFFS "" UWORD _CNV_R_R_igen_ub_q1_483_CM 1 100. 0. 65535. ECU_ADDRESS 0x3fb2c2 FORMAT "%8.2" /end MEASUREMENT
/begin MEASUREMENT I_10_GAIN "" UWORD _CNV_R_R_igen_ub_q1_483_CM 1 100. 0. 65535. ECU_ADDRESS 0x3fb2c4 FORMAT "%8.2" /end MEASUREMENT
/begin MEASUREMENT I_10_OFFS "" UWORD _CNV_R_R_igen_ub_q1_483_CM 1 100. 0. 65535. ECU_ADDRESS 0x3fb2c6 FORMAT "%8.2" /end MEASUREMENT
/begin MEASUREMENT I_400_GAIN "" UWORD _CNV_R_R_igen_ub_q1_483_CM 1 100. 0. 65535. ECU_ADDRESS 0x3fb2c8 FORMAT "%8.2" /end MEASUREMENT
/begin MEASUREMENT I_400_OFFS "" UWORD _CNV_R_R_igen_ub_q1_483_CM 1 100. 0. 65535. ECU_ADDRESS 0x3fb2ca FORMAT "%8.2" /end MEASUREMENT
/begin MEASUREMENT KTIB_CRC16 "" UWORD _CNV_R_R_igen_ub_q1_483_CM 1 100. 0. 65535. ECU_ADDRESS 0x3fb2cc FORMAT "%8.2" /end MEASUREMENT
/begin MEASUREMENT KT_IBSSTATUS "" UBYTE _CNV_R_R_igen_ub_q1_483_CM 1 100. 0. 255. ECU_ADDRESS 0x3fb2f6 FORMAT "%5.1" /end MEASUREMENT
/begin MEASUREMENT KT_OLDIBSSTATUS "" UBYTE _CNV_R_R_igen_ub_q1_483_CM 1 100. 0. 255. ECU_ADDRESS 0x3fb2f7 FORMAT "%5.1" /end MEASUREMENT
/begin MEASUREMENT START_IBSSTATUS "" UBYTE _CNV_R_R_igen_ub_q1_483_CM 1 100. 0. 255. ECU_ADDRESS 0x3fb2f8 FORMAT "%5.1" /end MEASUREMENT
/begin MEASUREMENT TBATTROH "" UWORD _CNV_A_R_LINEAR_____12_CM 1 100. 0. 65535. ECU_ADDRESS 0x3fb2ce FORMAT "%8.2" /end MEASUREMENT
/begin MEASUREMENT U11_13_GAIN "" UWORD _CNV_R_R_igen_ub_q1_483_CM 1 100. 0. 65535. ECU_ADDRESS 0x3fb2d0 FORMAT "%8.2" /end MEASUREMENT
/begin MEASUREMENT U11_13_OFFS "" UWORD _CNV_R_R_igen_ub_q1_483_CM 1 100. 0. 65535. ECU_ADDRESS 0x3fb2d2 FORMAT "%8.2" /end MEASUREMENT
/begin MEASUREMENT U6_16_GAIN "" UWORD _CNV_R_R_igen_ub_q1_483_CM 1 100. 0. 65535. ECU_ADDRESS 0x3fb2d4 FORMAT "%8.2" /end MEASUREMENT
/begin MEASUREMENT U6_16_OFFS "" UWORD _CNV_R_R_igen_ub_q1_483_CM 1 100. 0. 65535. ECU_ADDRESS 0x3fb2d6 FORMAT "%8.2" /end MEASUREMENT
/begin MEASUREMENT UBATTHIROH "" UWORD _CNV_R_R_spg_uw_q0p_533_CM 1 100. 11.0007 19.001 ECU_ADDRESS 0x3fb2d8 FORMAT "%8.5" /end MEASUREMENT
/begin MEASUREMENT UBATTLOROH "" UWORD _CNV_R_R_spg_uw_q0p_534_CM 1 100. 6.00012 46.002 ECU_ADDRESS 0x3fb2da FORMAT "%8.5" /end MEASUREMENT
/begin MEASUREMENT UBATT_W "" UWORD _CNV_R_R_spg_uw_q0p_534_CM 1 100. 6.00012 46.002 ECU_ADDRESS 0x3fb2dc FORMAT "%8.5" /end MEASUREMENT
/begin CHARACTERISTIC ENABSDIBS "" VALUE 0x5a084 _REC_VAL_20_u1 255. _CNV_A_R_LINEAR_____12_CM 0. 255. FORMAT "%5.1" /end CHARACTERISTIC
/begin CHARACTERISTIC ENISOC0 "" VALUE 0x5a085 _REC_VAL_20_u1 255. _CNV_A_R_LINEAR_____12_CM 0. 255. FORMAT "%5.1" /end CHARACTERISTIC
/begin CHARACTERISTIC ENUSOC0 "" VALUE 0x5a086 _REC_VAL_20_u1 255. _CNV_A_R_LINEAR_____12_CM 0. 255. FORMAT "%5.1" /end CHARACTERISTIC
/begin CHARACTERISTIC ERREPEAT "" VALUE 0x5a087 _REC_VAL_20_u1 255. _CNV_A_R_LINEAR_____12_CM 0. 255. FORMAT "%5.1" /end CHARACTERISTIC
/begin CHARACTERISTIC IBSWBASELN "" VALUE 0x5a088 _REC_VAL_20_u1 255. _CNV_A_R_LINEAR_____12_CM 0. 255. FORMAT "%5.1" /end CHARACTERISTIC
/begin CHARACTERISTIC IBUNPLADEL "" VALUE 0x5a089 _REC_VAL_20_u1 255. _CNV_A_R_LINEAR_____12_CM 0. 255. FORMAT "%5.1" /end CHARACTERISTIC
/begin CHARACTERISTIC ISTARTTRIG "" VALUE 0x5a08a _REC_VAL_20_u1 255. _CNV_A_R_LINEAR_____12_CM 0. 255. FORMAT "%5.1" /end CHARACTERISTIC
/begin CHARACTERISTIC IWAKEUPGRZ "" VALUE 0x5a08b _REC_VAL_20_u1 255. _CNV_A_R_LINEAR_____12_CM 0. 255. FORMAT "%5.1" /end CHARACTERISTIC
/begin CHARACTERISTIC T1SOC0 "" VALUE 0x5a08c _REC_VAL_20_u1 255. _CNV_A_R_LINEAR_____12_CM 0. 255. FORMAT "%5.1" /end CHARACTERISTIC
/begin CHARACTERISTIC T2SOC0 "" VALUE 0x5a08d _REC_VAL_20_u1 255. _CNV_A_R_LINEAR_____12_CM 0. 255. FORMAT "%5.1" /end CHARACTERISTIC
/begin CHARACTERISTIC T3SOC0 "" VALUE 0x5a08e _REC_VAL_20_u1 255. _CNV_A_R_LINEAR_____12_CM 0. 255. FORMAT "%5.1" /end CHARACTERISTIC
/begin CHARACTERISTIC TNUSTART "" VALUE 0x5a08f _REC_VAL_20_u1 255. _CNV_A_R_LINEAR_____12_CM 0. 255. FORMAT "%5.1" /end CHARACTERISTIC
/begin CHARACTERISTIC TNUSTARTFL "" VALUE 0x5a090 _REC_VAL_20_u1 255. _CNV_A_R_LINEAR_____12_CM 0. 255. FORMAT "%5.1" /end CHARACTERISTIC
/begin CHARACTERISTIC USOC0GRENZ "" VALUE 0x5a091 _REC_VAL_20_u1 255. _CNV_A_R_LINEAR_____12_CM 0. 255. FORMAT "%5.1" /end CHARACTERISTIC
/begin MEASUREMENT DUMMY "" UWORD _CNV_A_R_LINEAR_____10_CM 1 100. 0. 65535. ECU_ADDRESS 0x3fe282 FORMAT "%5.0" /end MEASUREMENT
/begin MEASUREMENT FAC_FCO_KWP "correction factor for consumption" SBYTE _CNV_A_R_LINEAR_____566_CM 1 100. -0.128 0.127 ECU_ADDRESS 0x3fa120 FORMAT "%5.3" /end MEASUREMENT
/begin MEASUREMENT STATE_EOL_KWP_CPS "???" UBYTE _CNV_A_R_LINEAR_____10_CM 1 100. 0. 7. ECU_ADDRESS 0x3fa184 FORMAT "%2.0" /end MEASUREMENT
/begin MEASUREMENT STATE_EOL_KWP_DMTL "???" UBYTE _CNV_A_R_LINEAR_____10_CM 1 100. 0. 7. ECU_ADDRESS 0x3fa185 FORMAT "%2.0" /end MEASUREMENT
/begin MEASUREMENT STATE_EOL_KWP_VLS "???" UBYTE _CNV_A_R_LINEAR_____10_CM 1 100. 0. 7. ECU_ADDRESS 0x3fa186 FORMAT "%2.0" /end MEASUREMENT
/begin CHARACTERISTIC C_N_MAX_KWP "max engine speed for accepting a KWP2000(*) service" VALUE 0x42eb6 _REC_VAL_20_u2 8160. _CNV_A_R_LINEAR_____17_CM 0. 8160. FORMAT "%4.0" /end CHARACTERISTIC
/begin CHARACTERISTIC C_VS_MIN_KWP "minimum vehicle speed for accepting the service" VALUE 0x42b3a _REC_VAL_20_u1 255. _CNV_A_R_LINEAR_____13_CM 0. 255. FORMAT "%3.0" /end CHARACTERISTIC
/begin MEASUREMENT TQ_LOSS_ALTER "Torque losses due to the alternator" SWORD _CNV_A_R_LINEAR_____48_CM 1 100. -1024. 1023.96875 ECU_ADDRESS 0x3fc55c FORMAT "%6.2" /end MEASUREMENT
/begin CHARACTERISTIC IP_TQ_LOSS_ALTER "Corrected TQ_LOSS_ALTER of power management request" MAP 0x4c064 _REC_MAP_20_u2_u2_u1 2047.96875 _CNV_A_R_LINEAR_____218_CM -1024. 1023.96875 FORMAT "%6.2"
 /begin AXIS_DESCR COM_AXIS TQ_LOSS_ALTER_1 _CNV_A_R_LINEAR_____218_CM 6 -1024. 1023.96875 FORMAT "%6.2" AXIS_PTS_REF ldp_tq_loss_alter_1__tq_alter /end AXIS_DESCR
 /begin AXIS_DESCR COM_AXIS N_32 _CNV_A_R_LINEAR_____5_CM 6 0. 8160. FORMAT "%4.0" AXIS_PTS_REF ldp_n_32__tq_alter /end AXIS_DESCR
/end CHARACTERISTIC
/begin AXIS_PTS ldp_tq_loss_alter_1__tq_alter "" 0x44c04 TQ_LOSS_ALTER_1 _REC_AXS_20_u2 2047.96875 _CNV_A_R_LINEAR_____218_CM 6 -1024. 1023.96875 FORMAT "%6.2" /end AXIS_PTS
/begin AXIS_PTS ldp_n_32__tq_alter "" 0x43625 N_32 _REC_AXS_20_u1 816. _CNV_A_R_LINEAR_____5_CM 6 0. 8160. FORMAT "%4.0" /end AXIS_PTS
/begin MEASUREMENT LV_VAR_ASR "LV ASR device recognized" UBYTE _CNV_S_2_RANGE______11_CM 1 100. 0. 1. ECU_ADDRESS 0x3fc491 BIT_MASK 0x1 /end MEASUREMENT
/begin MEASUREMENT LV_VAR_TXU "TXU device recognized" UBYTE _CNV_S_2_RANGE______11_CM 1 100. 0. 1. ECU_ADDRESS 0x3fc4f5 BIT_MASK 0x1 /end MEASUREMENT
/begin MEASUREMENT LV_VAR_ICL "LV CAN-Kombi recognized" UBYTE _CNV_S_2_RANGE______11_CM 1 100. 0. 1. ECU_ADDRESS 0x3fc4bd BIT_MASK 0x1 /end MEASUREMENT
/begin MEASUREMENT LV_VAR_ACIN "LV air conditioning recognized" UBYTE _CNV_S_2_RANGE______11_CM 1 100. 0. 1. ECU_ADDRESS 0x3fc4be BIT_MASK 0x1 /end MEASUREMENT
/begin CHARACTERISTIC LC_ASR_DISABLE "logical constant to disable ASR interventions" VALUE 0x42b68 _REC_VAL_20_u1 1. _CNV_S_2_RANGE______28_CM 0. 1. /end CHARACTERISTIC
/begin CHARACTERISTIC C_VS_SP_CRU_MAX "maximum limitation of cruise control" VALUE 0x431da _REC_VAL_20_u2 511.99218 _CNV_A_R_LINEAR_____78_CM 0. 511.99218 FORMAT "%7.3" /end CHARACTERISTIC
/begin CHARACTERISTIC C_VS_MIN_CRU "lower limitation for C_VS_MIN_CRU" VALUE 0x431d0 _REC_VAL_20_u2 511.99218 _CNV_A_R_LINEAR_____78_CM 0. 511.99218 FORMAT "%7.3" /end CHARACTERISTIC
/begin CHARACTERISTIC C_VS_DIF_DLY_CRU "Max. difference from VS_SP_DRIV_CRU and C_VS_DIF_DLY_CRU" VALUE 0x431ba _REC_VAL_20_u2 255.9921875 _CNV_A_R_LINEAR_____126_CM 0. 255.9921875 FORMAT "%7.3" /end CHARACTERISTIC
/begin MEASUREMENT LV_ACT_N_SP_IS_BAS_EXT_ADJ "switch off idle speed uplift - function active = 1" UBYTE _CNV_S_2_RANGE______28_CM 1 100. 0. 1. ECU_ADDRESS 0x3fa121 /end MEASUREMENT
/begin COMPU_METHOD _CNV_A_R_LINEAR_____0_CM "" RAT_FUNC "%6.3" "°C" COEFFS 0 1.333333333333333 64. 0 0 1 /end COMPU_METHOD
/begin COMPU_METHOD _CNV_A_R_LINEAR_____4_CM "" RAT_FUNC "%6.3" "%" COEFFS 0 2.56 0. 0 0 1 /end COMPU_METHOD
/begin COMPU_METHOD _CNV_A_R_LINEAR_____5_CM "" RAT_FUNC "%6.3" "rpm" COEFFS 0 3.125e-002 0. 0 0 1 /end COMPU_METHOD
/begin COMPU_METHOD _CNV_A_R_LINEAR_____10_CM "" RAT_FUNC "%6.3" "-" COEFFS 0 1. 0. 0 0 1 /end COMPU_METHOD
/begin COMPU_METHOD _CNV_S_2_RANGE______11_CM "" TAB_VERB "%6.3" "-" COMPU_TAB_REF _CNV_S_2_RANGE______11 /end COMPU_METHOD
/begin COMPU_VTAB _CNV_S_2_RANGE______11 "" TAB_VERB 2 0 "0" 1 "1" /end COMPU_VTAB
/begin COMPU_METHOD _CNV_A_R_LINEAR_____12_CM "" RAT_FUNC "%6.3" "[-]" COEFFS 0 1. 0. 0 0 1 /end COMPU_METHOD
/begin COMPU_METHOD _CNV_A_R_LINEAR_____13_CM "" RAT_FUNC "%6.3" "km/h" COEFFS 0 1. 0. 0 0 1 /end COMPU_METHOD
/begin COMPU_METHOD _CNV_A_R_LINEAR_____14_CM "" RAT_FUNC "%6.3" "s" COEFFS 0 10. 0. 0 0 1 /end COMPU_METHOD
/begin COMPU_METHOD _CNV_A_R_LINEAR_____17_CM "" RAT_FUNC "%6.3" "rpm" COEFFS 0 1. 0. 0 0 1 /end COMPU_METHOD
/begin COMPU_METHOD _CNV_A_R_LINEAR_____20_CM "" RAT_FUNC "%6.3" "-" COEFFS 0 255.9983911655618 0. 0 0 1 /end COMPU_METHOD
/begin COMPU_METHOD _CNV_S_2_RANGE______21_R_CM "" TAB_VERB "%6.3" "[-]" COMPU_TAB_REF _CNV_S_2_RANGE______21_R /end COMPU_METHOD
/begin COMPU_VTAB_RANGE _CNV_S_2_RANGE______21_R "" 2 0 0 "0" 1 255 "1" /end COMPU_VTAB_RANGE
/begin COMPU_METHOD _CNV_S_6_RANGE_ERR__22_CM "" TAB_VERB "%6.3" "[-]" COMPU_TAB_REF _CNV_S_6_RANGE_ERR__22 /end COMPU_METHOD
/begin COMPU_VTAB _CNV_S_6_RANGE_ERR__22 "" TAB_VERB 6 0 "NO_SYM" 1 "SYM_0" 2 "SYM_1" 4 "SYM_2" 8 "SYM_3" 15 "BENCH_MODE" /end COMPU_VTAB
/begin COMPU_METHOD _CNV_A_R_LINEAR_____23_CM "" RAT_FUNC "%6.3" "ms" COEFFS 0 0.1 0. 0 0 1 /end COMPU_METHOD
/begin COMPU_METHOD _CNV_S_8_RANGE_STAT_24_CM "" TAB_VERB "%6.3" "[-]" COMPU_TAB_REF _CNV_S_8_RANGE_STAT_24 /end COMPU_METHOD
/begin COMPU_VTAB _CNV_S_8_RANGE_STAT_24 "" TAB_VERB 8 0 "None" 1 "Set-Acc-TipUp" 2 "Decelerate-TipDown" 3 "Resume" 4 "Off" 5 "-" 6 "-" 7 "Error" /end COMPU_VTAB
/begin COMPU_METHOD _CNV_S_10_RANGE_REQ__25_CM "" TAB_VERB "%6.3" "[-]" COMPU_TAB_REF _CNV_S_10_RANGE_REQ__25 /end COMPU_METHOD
/begin COMPU_VTAB _CNV_S_10_RANGE_REQ__25 "" TAB_VERB 10 0 "Hard_off" 1 "Soft_off" 2 "TIP up" 3 "TIP Down " 4 "Set / Accelerate" 5 "Resume" 6 "Decelerate" 7 "None" 8 "Mark up" 9 "Mark down" /end COMPU_VTAB
/begin COMPU_METHOD _CNV_A_R_LINEAR_____27_CM "" RAT_FUNC "%6.3" "s" COEFFS 0 100. 0. 0 0 1 /end COMPU_METHOD
/begin COMPU_METHOD _CNV_S_2_RANGE______28_CM "" TAB_VERB "%6.3" "[-]" COMPU_TAB_REF _CNV_S_2_RANGE______28 /end COMPU_METHOD
/begin COMPU_VTAB _CNV_S_2_RANGE______28 "" TAB_VERB 2 0 "0" 1 "1" /end COMPU_VTAB
/begin COMPU_METHOD _CNV_A_R_LINEAR_____31_CM "" RAT_FUNC "%6.3" "-" COEFFS 0 65536.00007936121 0. 0 0 1 /end COMPU_METHOD
/begin COMPU_METHOD _CNV_A_R_LINEAR_____33_CM "" RAT_FUNC "%6.3" "V" COEFFS 0 204.7999998974999 0. 0 0 1 /end COMPU_METHOD
/begin COMPU_METHOD _CNV_A_R_LINEAR_____34_CM "" RAT_FUNC "%6.3" "-" COEFFS 0 127.9991955827809 0. 0 0 1 /end COMPU_METHOD
/begin COMPU_METHOD _CNV_A_R_LINEAR_____43_CM "" RAT_FUNC "%6.3" "hPa" COEFFS 0 12.06017666543982 0. 0 0 1 /end COMPU_METHOD
/begin COMPU_METHOD _CNV_A_R_LINEAR_____44_CM "" RAT_FUNC "%6.3" "[-]" COEFFS 0 255.9999357490357 0. 0 0 1 /end COMPU_METHOD
/begin COMPU_METHOD _CNV_A_R_LINEAR_____45_CM "" RAT_FUNC "%6.3" "-" COEFFS 0 32768.00003968061 0. 0 0 1 /end COMPU_METHOD
/begin COMPU_METHOD _CNV_A_R_LINEAR_____47_CM "" RAT_FUNC "%6.3" "s" COEFFS 0 1. 0. 0 0 1 /end COMPU_METHOD
/begin COMPU_METHOD _CNV_A_R_LINEAR_____48_CM "" RAT_FUNC "%6.3" "Nm" COEFFS 0 32. 0. 0 0 1 /end COMPU_METHOD
/begin COMPU_METHOD _CNV_A_R_LINEAR_____61_CM "" RAT_FUNC "%6.3" "km/h" COEFFS 0 10. 0. 0 0 1 /end COMPU_METHOD
/begin COMPU_METHOD _CNV_A_R_LINEAR_____78_CM "" RAT_FUNC "%6.3" "km/h" COEFFS 0 128.0000018750286 0. 0 0 1 /end COMPU_METHOD
/begin COMPU_METHOD _CNV_A_R_LINEAR_____94_CM "" RAT_FUNC "%6.3" "%" COEFFS 0 655.3600000071681 0. 0 0 1 /end COMPU_METHOD
/begin COMPU_METHOD _CNV_A_R_LINEAR_____95_CM "" RAT_FUNC "%6.3" "mg/stk" COEFFS 0 47.18142548596112 0. 0 0 1 /end COMPU_METHOD
/begin COMPU_METHOD _CNV_A_R_LINEAR_____103_CM "" RAT_FUNC "%6.3" "-" COEFFS 0 128. 0. 0 0 1 /end COMPU_METHOD
/begin COMPU_METHOD _CNV_A_R_LINEAR_____123_CM "" RAT_FUNC "%6.3" "m/s²" COEFFS 0 2084.478388984895 2.74784179055132e-004 0 0 1 /end COMPU_METHOD
/begin COMPU_METHOD _CNV_A_R_LINEAR_____124_CM "" RAT_FUNC "%6.3" "rpm/(km/h)" COEFFS 0 0.5 0. 0 0 1 /end COMPU_METHOD
/begin COMPU_METHOD _CNV_S_8_RANGE_REQ__125_CM "" TAB_VERB "%6.3" "[-]" COMPU_TAB_REF _CNV_S_8_RANGE_REQ__125 /end COMPU_METHOD
/begin COMPU_VTAB _CNV_S_8_RANGE_REQ__125 "" TAB_VERB 8 0 "Hard_off" 1 "Soft_off" 2 "TIP up" 3 "TIP Down " 4 "Set / Accelerate" 5 "Resume" 6 "Decelerate" 7 "None" /end COMPU_VTAB
/begin COMPU_METHOD _CNV_A_R_LINEAR_____126_CM "" RAT_FUNC "%6.3" "km/h" COEFFS 0 128. 0. 0 0 1 /end COMPU_METHOD
/begin COMPU_METHOD _CNV_A_R_LINEAR_____127_CM "" RAT_FUNC "%6.3" "m/s²" COEFFS 0 2084.478406465338 0. 0 0 1 /end COMPU_METHOD
/begin COMPU_METHOD _CNV_S_8_RANGE_STAT_128_CM "" TAB_VERB "%6.3" "[-]" COMPU_TAB_REF _CNV_S_8_RANGE_STAT_128 /end COMPU_METHOD
/begin COMPU_VTAB _CNV_S_8_RANGE_STAT_128 "" TAB_VERB 8 0 "PASSIVE" 1 "CONST/TIP " 2 "-" 3 "RES" 4 "-" 5 "SET_ACC" 6 "-" 7 "DEC" /end COMPU_VTAB
/begin COMPU_METHOD _CNV_A_R_LINEAR_____129_CM "" RAT_FUNC "%6.3" "km/h" COEFFS 0 128.0039001188318 0. 0 0 1 /end COMPU_METHOD
/begin COMPU_METHOD _CNV_A_R_LINEAR_____130_CM "" RAT_FUNC "%6.3" "km/h" COEFFS 0 8. 0. 0 0 1 /end COMPU_METHOD
/begin COMPU_METHOD _CNV_A_R_LINEAR_____131_CM "" RAT_FUNC "%6.3" "m/s²" COEFFS 0 46.08002400098911 0. 0 0 1 /end COMPU_METHOD
/begin COMPU_METHOD _CNV_A_R_LINEAR_____132_CM "" RAT_FUNC "%6.3" "km/h" COEFFS 0 128. 32768. 0 0 1 /end COMPU_METHOD
/begin COMPU_METHOD _CNV_S_6_RANGE_STAT_133_CM "" TAB_VERB "%6.3" "[-]" COMPU_TAB_REF _CNV_S_6_RANGE_STAT_133 /end COMPU_METHOD
/begin COMPU_VTAB _CNV_S_6_RANGE_STAT_133 "" TAB_VERB 6 0 "PASSIVE" 1 "CONST_DRIVE" 3 "RESUME" 5 "SET_ACC" 7 "RETARD" 9 "TIP" /end COMPU_VTAB
/begin COMPU_METHOD _CNV_A_R_LINEAR_____134_CM "" RAT_FUNC "%6.3" "%/(km/h)" COEFFS 0 1310.720001587224 0. 0 0 1 /end COMPU_METHOD
/begin COMPU_METHOD _CNV_A_R_LINEAR_____135_CM "" RAT_FUNC "%6.3" "%/(m/s²)" COEFFS 0 163.8375 32767.5 0 0 1 /end COMPU_METHOD
/begin COMPU_METHOD _CNV_A_R_LINEAR_____136_CM "" RAT_FUNC "%6.3" "%" COEFFS 0 2084.478388983038 32768.00027481336 0 0 1 /end COMPU_METHOD
/begin COMPU_METHOD _CNV_A_R_LINEAR_____137_CM "" RAT_FUNC "%6.3" "km/h" COEFFS 0 4. 0. 0 0 1 /end COMPU_METHOD
/begin COMPU_METHOD _CNV_A_R_LINEAR_____138_CM "" RAT_FUNC "%6.3" "%/100ms" COEFFS 0 655.3600000071681 0. 0 0 1 /end COMPU_METHOD
/begin COMPU_METHOD _CNV_S_4_STATE_I_CR_139_CM "" TAB_VERB "%6.3" "[-]" COMPU_TAB_REF _CNV_S_4_STATE_I_CR_139 /end COMPU_METHOD
/begin COMPU_VTAB _CNV_S_4_STATE_I_CR_139 "" TAB_VERB 4 0 "NO" 1 "LIM" 2 "FREEZE" 3 "NORM" /end COMPU_VTAB
/begin COMPU_METHOD _CNV_A_R_LINEAR_____148_CM "" RAT_FUNC "%6.3" "-" COEFFS 0 1023.999999919998 0. 0 0 1 /end COMPU_METHOD
/begin COMPU_METHOD _CNV_A_R_LINEAR_____172_CM "" RAT_FUNC "%6.3" "%" COEFFS 0 327.6800000071683 0. 0 0 1 /end COMPU_METHOD
/begin COMPU_METHOD _CNV_S_4_STATE_AMT__200_CM "" TAB_VERB "%6.3" "[-]" COMPU_TAB_REF _CNV_S_4_STATE_AMT__200 /end COMPU_METHOD
/begin COMPU_VTAB _CNV_S_4_STATE_AMT__200 "" TAB_VERB 4 0 "NO" 1 "DEC" 2 "INC" 3 "DEC_INC" /end COMPU_VTAB
/begin COMPU_METHOD _CNV_A_R_LINEAR_____201_CM "" RAT_FUNC "%6.3" "Nm/10ms" COEFFS 0 32. 0. 0 0 1 /end COMPU_METHOD
/begin COMPU_METHOD _CNV_A_R_LINEAR_____213_CM "" RAT_FUNC "%6.3" "rpm" COEFFS 0 1. 32768. 0 0 1 /end COMPU_METHOD
/begin COMPU_METHOD _CNV_A_R_LINEAR_____218_CM "" RAT_FUNC "%6.3" "Nm" COEFFS 0 32. 32768. 0 0 1 /end COMPU_METHOD
/begin COMPU_METHOD _CNV_A_R_LINEAR_____226_CM "" RAT_FUNC "%6.3" "°TPS" COEFFS 0 137.0962343096234 0. 0 0 1 /end COMPU_METHOD
/begin COMPU_METHOD _CNV_A_R_LINEAR_____264_CM "" RAT_FUNC "%6.3" "°TPS/s" COEFFS 0 8.535564853556485e-002 0. 0 0 1 /end COMPU_METHOD
/begin COMPU_METHOD _CNV_A_R_LINEAR_____269_CM "" RAT_FUNC "%6.3" "°C" COEFFS 0 43.47840509520334 2086.96344456976 0 0 1 /end COMPU_METHOD
/begin COMPU_METHOD _CNV_A_R_LINEAR_____277_CM "" RAT_FUNC "%6.3" "g" COEFFS 0 36.00036915004301 0. 0 0 1 /end COMPU_METHOD
/begin COMPU_METHOD _CNV_A_R_LINEAR_____309_CM "" RAT_FUNC "%6.3" "mg" COEFFS 0 6.25 0. 0 0 1 /end COMPU_METHOD
/begin COMPU_METHOD _CNV_S_12_STATE_VLS__325_CM "" TAB_VERB "%6.3" "[-]" COMPU_TAB_REF _CNV_S_12_STATE_VLS__325 /end COMPU_METHOD
/begin COMPU_VTAB _CNV_S_12_STATE_VLS__325 "" TAB_VERB 12 0 "OFF" 1 "STEP_1" 2 "STEP_2" 16 "FINISHED" 17 "ERR_UP" 18 "ERR_DOWN" 19 "ERR_UP_DOWN" 20 "ERR_UP_1" 21 "ERR_UP_2" 22 "ERR_DOWN_1" 23 "ERR_DOWN_2" 24 "NO_RESULT" /end COMPU_VTAB
/begin COMPU_METHOD _CNV_A_R_LINEAR_____336_CM "" RAT_FUNC "%6.3" "mg/stk" COEFFS 0 47.18070554355651 0. 0 0 1 /end COMPU_METHOD
/begin COMPU_METHOD _CNV_A_R_LINEAR_____354_CM "" RAT_FUNC "%6.3" "mg/stk" COEFFS 0 47.18142548596112 32767.5 0 0 1 /end COMPU_METHOD
/begin COMPU_METHOD _CNV_A_R_LINEAR_____368_CM "" RAT_FUNC "%6.3" "%" COEFFS 0 327.67 0. 0 0 1 /end COMPU_METHOD
/begin COMPU_METHOD _CNV_A_R_LINEAR_____374_CM "" RAT_FUNC "%6.3" "rpm" COEFFS 0 0.5 0. 0 0 1 /end COMPU_METHOD
/begin COMPU_METHOD _CNV_A_R_LINEAR_____375_CM "" RAT_FUNC "%6.3" "Ah" COEFFS 0 2.007874015748032 0. 0 0 1 /end COMPU_METHOD
/begin COMPU_METHOD _CNV_S_8_RANGE_STAT_381_CM "" TAB_VERB "%6.3" "[-]" COMPU_TAB_REF _CNV_S_8_RANGE_STAT_381 /end COMPU_METHOD
/begin COMPU_VTAB _CNV_S_8_RANGE_STAT_381 "" TAB_VERB 8 0 "SAV_DIAG_NOT_ACTIVE" 1 "SAV_DIAG_DISABLED" 2 "SAV_DIAG_ABORTED" 3 "SAV_DIAG_FIN_NO_ERR_1" 4 "SAV_DIAG_FIN_NO_ERR_2" 5 "SAV_DIAG_FIN_ERR_SAV" 6 "SAV_DIAG_ACTIVE" 7 "SAV_DIAG_VERIFY" /end COMPU_VTAB
/begin COMPU_METHOD _CNV_A_R_LINEAR_____438_CM "" RAT_FUNC "%6.3" "ms" COEFFS 0 62.5 0. 0 0 1 /end COMPU_METHOD
/begin COMPU_METHOD _CNV_A_R_LINEAR_____451_CM "" RAT_FUNC "%6.3" "m/s²" COEFFS 0 640.2931118710308 32768. 0 0 1 /end COMPU_METHOD
/begin COMPU_METHOD _CNV_S_3_RANGE_CAM__468_CM "" TAB_VERB "%6.3" "[-]" COMPU_TAB_REF _CNV_S_3_RANGE_CAM__468 /end COMPU_METHOD
/begin COMPU_VTAB _CNV_S_3_RANGE_CAM__468 "" TAB_VERB 3 0 "two seg. disc" 1 "four seg. disc synchronous" 2 "four seg. disc asynchronous" /end COMPU_VTAB
/begin COMPU_METHOD _CNV_S_4_RANGE_ENG__469_CM "" TAB_VERB "%6.3" "[-]" COMPU_TAB_REF _CNV_S_4_RANGE_ENG__469 /end COMPU_METHOD
/begin COMPU_VTAB _CNV_S_4_RANGE_ENG__469 "" TAB_VERB 4 0 "NG_V6" 1 "NG6_MPI" 2 "M54/56" 3 "NG6_GDI" /end COMPU_VTAB
/begin COMPU_METHOD _CNV_S_2_RANGE_VIM__470_CM "" TAB_VERB "%6.3" "[-]" COMPU_TAB_REF _CNV_S_2_RANGE_VIM__470 /end COMPU_METHOD
/begin COMPU_VTAB _CNV_S_2_RANGE_VIM__470 "" TAB_VERB 2 0 "closed loop" 1 "switched" /end COMPU_VTAB
/begin COMPU_METHOD _CNV_S_3_STATE_CONF_471_CM "" TAB_VERB "%6.3" "-" COMPU_TAB_REF _CNV_S_3_STATE_CONF_471 /end COMPU_METHOD
/begin COMPU_VTAB _CNV_S_3_STATE_CONF_471 "" TAB_VERB 3 0 "NO_SOF_SWI" 1 "SOF_SWI" 2 "SOF_SWI_AMT" /end COMPU_VTAB
/begin COMPU_METHOD _CNV_R_R_igen_ub_q1_483_CM "" RAT_FUNC "%6.3" "[-]" COEFFS 0. 1. 0. 0. 0. 1. /end COMPU_METHOD
/begin COMPU_METHOD _CNV_A_R_LINEAR_____490_CM "" RAT_FUNC "%6.3" "µs" COEFFS 0 1. 0. 0 0 1 /end COMPU_METHOD
/begin COMPU_METHOD _CNV_A_R_LINEAR_____491_CM "" RAT_FUNC "%6.3" "µs" COEFFS 0 1. -1. 0 0 1 /end COMPU_METHOD
/begin COMPU_METHOD _CNV_A_R_LINEAR_____492_CM "" RAT_FUNC "%6.3" "%." COEFFS 0 65.408 0. 0 0 1 /end COMPU_METHOD
/begin COMPU_METHOD _CNV_A_R_LINEAR_____493_CM "" RAT_FUNC "%6.3" "%." COEFFS 0 66.66123114553608 0. 0 0 1 /end COMPU_METHOD
/begin COMPU_METHOD _CNV_A_R_LINEAR_____494_CM "" RAT_FUNC "%6.3" "%." COEFFS 0 4194.293686959193 -8.057063130399911e-002 0 0 1 /end COMPU_METHOD
/begin COMPU_METHOD _CNV_A_R_LINEAR_____495_CM "" RAT_FUNC "%6.3" "%." COEFFS 0 4194.283373654366 0. 0 0 1 /end COMPU_METHOD
/begin COMPU_METHOD _CNV_A_R_LINEAR_____496_CM "" RAT_FUNC "%6.3" "-" COEFFS 0 255. 0. 0 0 1 /end COMPU_METHOD
/begin COMPU_METHOD _CNV_A_R_LINEAR_____497_CM "" RAT_FUNC "%6.3" "-" COEFFS 0 255.5 0. 0 0 1 /end COMPU_METHOD
/begin COMPU_METHOD _CNV_A_R_LINEAR_____498_CM "" RAT_FUNC "%6.3" "%." COEFFS 0 4194.293686959193 32767.9194293687 0 0 1 /end COMPU_METHOD
/begin COMPU_METHOD _CNV_A_R_LINEAR_____499_CM "" RAT_FUNC "%6.3" "µs" COEFFS 0 1. 32768. 0 0 1 /end COMPU_METHOD
/begin COMPU_METHOD _CNV_S_2_B_TRUE_519_CM "" TAB_VERB "%6.3" "[-]" COMPU_TAB_REF _CNV_S_2_B_TRUE_519 /end COMPU_METHOD
/begin COMPU_VTAB _CNV_S_2_B_TRUE_519 "" TAB_VERB 2 0 "----" 1 "TRUE" /end COMPU_VTAB
/begin COMPU_METHOD _CNV_R_R_i_uw_q0p00_529_CM "" RAT_FUNC "%6.3" "A" COEFFS 0. 16383. 0. 0. 0. 10. /end COMPU_METHOD
/begin COMPU_METHOD _CNV_R_R_i_uw_q0p06_530_CM "" RAT_FUNC "%6.3" "A" COEFFS 0. 16383. 0. 0. 0. 1000. /end COMPU_METHOD
/begin COMPU_METHOD _CNV_R_R_i_uw_q0p02_531_CM "" RAT_FUNC "%6.3" "A" COEFFS 0. 16383. 3276800. 0. 0. 400. /end COMPU_METHOD
/begin COMPU_METHOD _CNV_R_R_i_uw_q0p07_532_CM "" RAT_FUNC "%6.3" "A" COEFFS 0. 16383. 3276000. 0. 0. 1200. /end COMPU_METHOD
/begin COMPU_METHOD _CNV_R_R_spg_uw_q0p_533_CM "" RAT_FUNC "%6.3" "V" COEFFS 0. 16383. -180224. 0. 0. 2. /end COMPU_METHOD
/begin COMPU_METHOD _CNV_R_R_spg_uw_q0p_534_CM "" RAT_FUNC "%6.3" "V" COEFFS 0. 16383. -98300. 0. 0. 10. /end COMPU_METHOD
/begin COMPU_METHOD _CNV_A_R_LINEAR_____566_CM "" RAT_FUNC "%6.3" "-" COEFFS 0 1000. 0. 0 0 1 /end COMPU_METHOD
/begin RECORD_LAYOUT _REC_VAL_20_u1 FNC_VALUES 1 UBYTE COLUMN_DIR DIRECT /end RECORD_LAYOUT
/begin RECORD_LAYOUT _REC_AXS_20_u1 NO_AXIS_PTS_X 1 UBYTE AXIS_PTS_X 2 UBYTE INDEX_INCR DIRECT /end RECORD_LAYOUT
/begin RECORD_LAYOUT _REC_CUR_20_u1_u1 FNC_VALUES 1 UBYTE COLUMN_DIR DIRECT /end RECORD_LAYOUT
/begin RECORD_LAYOUT _REC_MAP_20_u2_u2_u1 FNC_VALUES 1 UWORD COLUMN_DIR DIRECT /end RECORD_LAYOUT
/begin RECORD_LAYOUT _REC_AXS_20_u2 NO_AXIS_PTS_X 1 UWORD AXIS_PTS_X 2 UWORD INDEX_INCR DIRECT /end RECORD_LAYOUT
/begin RECORD_LAYOUT _REC_CUR_20_u2_u2 FNC_VALUES 1 UWORD COLUMN_DIR DIRECT /end RECORD_LAYOUT
/begin RECORD_LAYOUT _REC_VAL_20_u2 FNC_VALUES 1 UWORD COLUMN_DIR DIRECT /end RECORD_LAYOUT
/begin RECORD_LAYOUT _REC_CUR_20_u2_u1 FNC_VALUES 1 UWORD COLUMN_DIR DIRECT /end RECORD_LAYOUT
/begin RECORD_LAYOUT _REC_CUR_20_u1_u2 FNC_VALUES 1 UBYTE COLUMN_DIR DIRECT /end RECORD_LAYOUT
/begin RECORD_LAYOUT _REC_MAP_20_u2_u1_u1 FNC_VALUES 1 UWORD COLUMN_DIR DIRECT /end RECORD_LAYOUT
/begin RECORD_LAYOUT _REC_VAL_20_u4 FNC_VALUES 1 ULONG COLUMN_DIR DIRECT /end RECORD_LAYOUT
/begin RECORD_LAYOUT _REC_MAP_20_u2_u1_u2 FNC_VALUES 1 UWORD COLUMN_DIR DIRECT /end RECORD_LAYOUT
/begin RECORD_LAYOUT _REC_VAL_20_s2 FNC_VALUES 1 SWORD COLUMN_DIR DIRECT /end RECORD_LAYOUT
/begin RECORD_LAYOUT _REC_VAL_20_s1 FNC_VALUES 1 SBYTE COLUMN_DIR DIRECT /end RECORD_LAYOUT
/begin RECORD_LAYOUT _REC_MAP_20_u2_u2_u2 FNC_VALUES 1 UWORD COLUMN_DIR DIRECT /end RECORD_LAYOUT
/begin FUNCTION TQM_Anti_Jerk_Controller_Activat "_Anti Jerk Controller Activation Conditions"
 /begin DEF_CHARACTERISTIC C_N_DIF_AJ_AC_1 C_N_DIF_AJ_AC_2 C_N_DIF_AJ_DEACC_1 C_N_DIF_AJ_DEACC_2 C_N_THD_MAX_AJ C_N_THD_MIN_AJ C_T_ACT_MAX_AJ LC_AJ_INH_AT LC_AJ_DEACC LC_AJ_AC LC_AJ_INH_DT LC_STATE_CC_OPEN LC_STATE_CC_CONTROLLED LC_STATE_CC_DFT LC_STATE_CC_CLOSE LC_STATE_CLU_AMT_OPEN LC_STATE_CLU_AMT_CREEPING LC_STATE_CLU_AMT_DRIVE_OFF LC_STATE_CLU_AMT_CLOSED LC_STATE_CLU_AMT_DFT /end DEF_CHARACTERISTIC
 /begin OUT_MEASUREMENT LV_PAS_AJ LV_REQ_AJ LV_INI_AJ LV_ACT_AJ STATE_CC_AJ STATE_CLU_AMT_AJ /end OUT_MEASUREMENT
/end FUNCTION
/begin FUNCTION TQM_Minimum_indicated_engine_tor "_Minimum indicated engine torque at trailing throttle"
 /begin DEF_CHARACTERISTIC C_TQI_BOL_SET_HYS C_DIP_MAX IP_MAF_MIN_PU IP_MAF_MIN_PU_RNG_L IP_MAF_ADD_PUC IP_MAF_ADD_PUC_RNG_L /end DEF_CHARACTERISTIC
 /begin OUT_MEASUREMENT TQI_MIN_PU LV_TQI_BOL_SET TQI_BOL MAF_MIN_PU_1 MAF_MIN_PU_2 MAF_MIN_PU MAP_MIN /end OUT_MEASUREMENT
/end FUNCTION
/begin FUNCTION TQM_Coordination_of_additional_t "_Coordination of additional torque losses" /begin OUT_MEASUREMENT TQ_LOSS_ADD /end OUT_MEASUREMENT /end FUNCTION
/begin FUNCTION TQM_Torque_request_for_AMT_inter "_Torque request for AMT intervention"
 /begin DEF_CHARACTERISTIC C_LGRD_LIH_AMT_DEC C_LGRD_LIH_AMT_INC C_T_DLY_LIH_AMT_DEC C_T_DLY_LIH_AMT_INC C_AMT_ENA_INC_DEC /end DEF_CHARACTERISTIC
 /begin OUT_MEASUREMENT LV_AMT_DISABLE LV_AMT_DISABLE_CAN LV_AMT_ENA_DEC LV_AMT_ENA_INC LV_AMT_ENA TQI_AMT_FAST_DEC_REQ TQI_AMT_FAST_DEC_REQ_1 TQI_AMT_SLOW_DEC_REQ TQI_AMT_SLOW_DEC_REQ_1 TQI_AMT_FAST_INC_REQ TQI_AMT_FAST_INC_REQ_1 TQI_AMT_SLOW_INC_REQ TQI_AMT_SLOW_INC_REQ_1 TQI_AMT_FAST_DEC TQI_AMT_SLOW_DEC LV_AMT_DEC_ACT TQI_AMT_FAST_INC TQI_AMT_SLOW_INC LV_AMT_DEC_LIH LV_AMT_INC_ACT LV_AMT_INC_LIH /end OUT_MEASUREMENT
/end FUNCTION
/begin FUNCTION TQM_AMT_Clutch_torque "_AMT Clutch torque"
 /begin DEF_CHARACTERISTIC IP_TQ_AMT IP_TQ_VS_FIL_AMT IP_TQ_ADD_AMT C_TQ_THD_AMT_ISC C_TQ_ADD_AMT_LGRD C_TQ_LGRD_CRAWL_INC C_TQ_LGRD_CRAWL_DEC /end DEF_CHARACTERISTIC
 /begin OUT_MEASUREMENT TQ_CLU_AMT LV_AMT_CRAWL_ON TQ_ADD_AMT LV_TOUT_AMT T_AMT /end OUT_MEASUREMENT
/end FUNCTION
/begin FUNCTION TQM_Torque_request_for_distance_ "_Torque request for distance cruise control" /begin DEF_CHARACTERISTIC C_LGRD_LIH_DCC_INC C_T_DLY_LIH_DCC_INC /end DEF_CHARACTERISTIC
 /begin OUT_MEASUREMENT LV_DCC_DISABLE_CAN TQI_DCC_FAST_INC_REQ TQI_DCC_FAST_INC_REQ_1 TQI_DCC_SLOW_INC_REQ TQI_DCC_SLOW_INC_REQ_1 TQI_DCC_FAST_INC LV_DCC_ENA_INC LV_DCC_INC_ACT TQI_DCC_SLOW_INC LV_DCC_INC_LIH T_DCC_LIH_CTR /end OUT_MEASUREMENT
/end FUNCTION
/begin FUNCTION TQM_Torque_Request_for_Traction_ "_Torque Request for Traction Control TCS"
 /begin DEF_CHARACTERISTIC C_LGRD_LIH_ASR C_T_DLY_LIH_ASR C_T_DLY_LIH_MSR LC_MSR_DISABLE C_LGRD_LIH_MSR C_TQ_MAX_MSR LC_ASR_DISABLE /end DEF_CHARACTERISTIC
 /begin OUT_MEASUREMENT LV_ASR_PLAUS LV_MSR_PLAUS LV_ASR_ENA LV_MSR_ENA TQI_MSR_FAST_REQ TQI_MSR_SLOW_REQ SF_TQD LV_TCS_DISABLE TQI_ASR_SLOW TQI_ASR_FAST_REQ TQI_ASR_FAST_REQ_1 TQI_ASR_SLOW_REQ TQI_MSR_FAST_REQ_1 TQI_ASR_SLOW_REQ_1 TQI_MSR_SLOW_REQ_1 TQI_ASR_FAST TQI_MSR_FAST TQI_MSR_SLOW LV_MSR_LIH LV_MSR_ACT LV_ASR_ACT LV_TCS_ENA LV_TCS_DISABLE_CAN LV_ASR_LIH T_ASR_LIH_CTR T_MSR_LIH_CTR /end OUT_MEASUREMENT
/end FUNCTION
/begin FUNCTION TQM_Torque_Loss___Anti_Roll_Stab "_Torque Loss - Anti-Roll-Stabilisation"
 /begin DEF_CHARACTERISTIC IP_TQ_LOSS_ARS_SP_MAX IP_TQ_LOSS_ARS_AV_MAX IP_TQ_LOSS_ARS_SP_CAN_MAX IP_TQ_LOSS_ARS_AV_CAN_MAX C_FAC_TQ_LOSS_ARS_GRD C_FAC_TQ_LOSS_ARS_DIF C_T_DLY_TQ_MAX_ARS C_TQ_LOSS_ARS_SP_OFS C_TQ_LOSS_ARS_AV_OFS C_V_MAX_ARS_DIAG C_N_MAX_ARS_DIAG /end DEF_CHARACTERISTIC
 /begin OUT_MEASUREMENT LV_ARS_DISABLE LV_ARS_DISABLE_CAN LV_ARS_ENA LV_TQ_MAX_ARS TQ_LOSS_ARS_SP_MAX TQ_LOSS_ARS_SP_MAX_1 TQ_LOSS_ARS_AV_MAX_1 T_DLY_TQ_MAX_ARS TQ_LOSS_ARS TQ_LOSS_ARS_AV_MAX TQ_LOSS_ARS_GRD TQ_LOSS_ARS_DIF /end OUT_MEASUREMENT
/end FUNCTION
/begin FUNCTION TQM_Alternator_torque_losses "_Alternator torque losses" /begin DEF_CHARACTERISTIC IP_TQ_LOSS_ALTER /end DEF_CHARACTERISTIC /begin OUT_MEASUREMENT TQ_LOSS_ALTER /end OUT_MEASUREMENT /end FUNCTION
/begin FUNCTION GEN_General "GEN" /begin SUB_FUNCTION GEN_Variant_coding GEN_Initialisation_of_variables_ /end SUB_FUNCTION /end FUNCTION
/begin FUNCTION GEN_Variant_coding "_Variant coding"
 /begin DEF_CHARACTERISTIC C_VAR_ST C_ENG_CONF LC_VIM_CONF C_CONF_SWI_EFP_OUT C_CONF_OIL_LEVEL_SENS C_CONF_DMTL C_VAR_EBOX_CFA C_V_VAR_AMP_THD_MIN C_V_VAR_AMP_THD_MAX /end DEF_CHARACTERISTIC
 /begin OUT_MEASUREMENT LV_AT LV_IVVT_IN_AND_EX CAM_TYPE LV_INJ_CONF LV_ISA_CONF LV_VAR_EBOX_CFA LV_VAR_ST ENG_CONF VIM_TYPE LV_VAR_MSW LV_VAR_SOF LV_CBK_MPL CONF_OIL_LEVEL_SENS LV_CONF_DMTL LV_SOF_CONF CONF_SOF_SWI LV_VAR_ASR LV_VAR_TXU LV_VAR_ICL LV_VAR_ACIN /end OUT_MEASUREMENT
/end FUNCTION
/begin FUNCTION GEN_Initialisation_of_variables_ "_Initialisation of variables from non implemented functions"
 /begin OUT_MEASUREMENT STK_AV_EGR STATE_SAV_DIAG LV_ERR_VS LV_MTC_LIH_ACT NTL DUMMY /end OUT_MEASUREMENT
/end FUNCTION
/begin FUNCTION SEC_Serial_Communication "SEC"
 /begin SUB_FUNCTION SEC_Idle_Speed_Setpoint_offset_b SEC_Input_Output_Control SEC_Constants_for_EOBD SEC_Immobilizer SEC_Actuator_Diagnosis_Fuel_Inje /end SUB_FUNCTION
/end FUNCTION
/begin FUNCTION SEC_Idle_Speed_Setpoint_offset_b "_Idle Speed Setpoint offset by tester (KWP)"
 /begin DEF_CHARACTERISTIC C_N_OFS_ACC_DRI_MIN C_N_OFS_DRI_MAX C_N_OFS_DRI_MIN C_N_OFS_MAX C_N_OFS_MIN C_N_OFS_ACC_MAX C_N_OFS_ACC_MIN C_N_OFS_VB_MAX C_N_OFS_VB_MIN C_TCO_MIN_N_OFS_KWP LC_N_OFS_KWP_DISABLE C_CHA_CDN_BAT_KWP_MIN C_N_OFS_ACC_DRI_MAX /end DEF_CHARACTERISTIC
 /begin OUT_MEASUREMENT N_KWP_OFS_ACC N_KWP_OFS N_KWP_OFS_VB_NVMY_ N_KWP_OFS_ACC_NVMY_ N_KWP_OFS_NVMY_ N_KWP_OFS_DRI_NVMY_ N_KWP_OFS_ACC_DRI_NVMY LV_KWP_ENA N_SP_OFS_KWP N_KWP_OFS_ACC_DRI N_KWP_OFS_DRI N_KWP_OFS_VB LV_ACT_N_SP_IS_BAS_EXT_ADJ /end OUT_MEASUREMENT
/end FUNCTION
/begin FUNCTION SEC_Input_Output_Control "_Input Output Control" /begin DEF_CHARACTERISTIC C_N_MAX_KWP C_VS_MIN_KWP /end DEF_CHARACTERISTIC
 /begin OUT_MEASUREMENT FAC_FCO_KWP STATE_EOL_KWP_CPS STATE_EOL_KWP_DMTL STATE_EOL_KWP_VLS /end OUT_MEASUREMENT
/end FUNCTION
/begin FUNCTION SEC_Constants_for_EOBD "_Constants for EOBD"
 /begin DEF_CHARACTERISTIC C_PSN_LS_1 C_MOD_1_PID_2_DIAG C_MOD_1_PID_3_DIAG C_MOD_1_PID_4_DIAG C_MOD_1_PID_5_DIAG C_MOD_1_PID_6_DIAG C_MOD_1_PID_7_DIAG C_MOD_1_PID_8_DIAG C_MOD_2_PID_1_DIAG C_MOD_2_PID_2_DIAG C_MOD_2_PID_3_DIAG C_MOD_2_PID_4_DIAG C_OBD_REQ C_PSN_LS C_MOD_1_PID_1_DIAG C_MOD_6_TID_2_DIAG C_MOD_6_TID_3_DIAG C_MOD_6_TID_4_DIAG C_MOD_6_TID_1_DIAG C_MOD_9_VIT_2_DIAG C_MOD_9_VIT_3_DIAG C_MOD_9_VIT_4_DIAG C_MOD_9_VIT_1_DIAG C_MOD_8_TID_2_DIAG C_MOD_8_TID_3_DIAG C_MOD_8_TID_1_DIAG C_MOD_8_TID_4_DIAG /end DEF_CHARACTERISTIC
/end FUNCTION
/begin FUNCTION SEC_Immobilizer "_Immobilizer" /begin OUT_MEASUREMENT RLS_MPL_VALUE_PROG STATE_IMOB NR_FREE_STARTVALUES /end OUT_MEASUREMENT /end FUNCTION
/begin FUNCTION SEC_Actuator_Diagnosis_Fuel_Inje "_Actuator Diagnosis Fuel Injectors"
 /begin DEF_CHARACTERISTIC C_TI_EXT_ADJ_MIN C_TI_EXT_ADJ_MAX C_TI_PER_EXT_ADJ_MAX C_TI_PER_EXT_ADJ_MIN /end DEF_CHARACTERISTIC
 /begin OUT_MEASUREMENT TI_EXT_ADJ_1 TI_EXT_ADJ_2 TI_EXT_ADJ_3 TI_EXT_ADJ_4 TI_EXT_ADJ_5 TI_EXT_ADJ_6 TI_PER_EXT_ADJ_1 TI_PER_EXT_ADJ_2 TI_PER_EXT_ADJ_3 TI_PER_EXT_ADJ_4 TI_PER_EXT_ADJ_5 TI_PER_EXT_ADJ_6 LV_TI_EXT_ADJ_1 LV_TI_EXT_ADJ_2 LV_TI_EXT_ADJ_3 LV_TI_EXT_ADJ_4 LV_TI_EXT_ADJ_5 LV_TI_EXT_ADJ_6 /end OUT_MEASUREMENT
/end FUNCTION
/begin FUNCTION CRU_Cruise_control "CRU"
 /begin SUB_FUNCTION CRU_General__calculation_of_crui CRU_Controlled_acceleration CRU_Actuating_the_reference_inpu CRU_Intercepting_the_reference_i CRU_Interventions CRU_Ready_state_and_display CRU_Evaluation_serial_data_line_ CRU_Conditions_for_cruise_contro CRU_Additional_functions CRU_Step_cruise_control /end SUB_FUNCTION
/end FUNCTION
/begin FUNCTION CRU_General__calculation_of_crui "_General  calculation of cruise control and constant drive"
 /begin DEF_CHARACTERISTIC C_VS_DIF_MIN_IS_CRU C_VS_DIF_MAX_IS_CRU C_VS_DIF_RNG_CRU C_T_MIN_PUC_CRU IP_FAC_PROP_CRU IP_FAC_TQ_CRU_INI_ADD_AT IP_FAC_TQ_CRU_INI_ADD_MT C_FAC_VS_DIF_RNG_CRU IP_FAC_TQ_CRU_DEC__N_32 IP_FAC_VS_DIF_I_CRU IP_FAC_VS_SP_DIF_I_CRU C_FAC_TQ_CRU_LGRD C_FAC_TQ_CRU_MAX /end DEF_CHARACTERISTIC
 /begin OUT_MEASUREMENT VS_DIF_I_CRU VS_DIF_CRU FAC_TQ_CRU_INI FAC_TQ_CRU STATE_I_CRU /end OUT_MEASUREMENT
/end FUNCTION
/begin FUNCTION CRU_Controlled_acceleration "_Controlled acceleration" /begin DEF_CHARACTERISTIC C_VS_DIF_MAX_AC_CRU C_VS_DIF_MIN_AC_CRU /end DEF_CHARACTERISTIC /begin OUT_MEASUREMENT T_CTL_CRU VS_SP_CRU VS_SP_DIF_CRU /end OUT_MEASUREMENT /end FUNCTION
/begin FUNCTION CRU_Actuating_the_reference_inpu "_Actuating the reference input variable"
 /begin DEF_CHARACTERISTIC IP_FAC_CRU_REST__T_CTL_CRU IP_FAC_CRU_AC__T_CTL_CRU IP_FAC_CRU_DECE__T_CTL_CRU IP_FAC_CC_CRU_AC__T_CTL_CRU IP_FAC_CC_CRU_DECE__T_CTL_CRU /end DEF_CHARACTERISTIC
 /begin OUT_MEASUREMENT FAC_VS_CTL_CRU /end OUT_MEASUREMENT
/end FUNCTION
/begin FUNCTION CRU_Intercepting_the_reference_i "_Intercepting the reference input variable target acceleration"
 /begin DEF_CHARACTERISTIC C_VS_AC_MIN_CRU C_VS_AC_MAX_CRU IP_FAC_LGRD_CRU_REST__VS_SP_DIF IP_FAC_LGRD_CRU_TIP__VS_SP_DIF C_FAC_AC_POS_CRU C_FAC_AC_POS_CRU_RNG_L /end DEF_CHARACTERISTIC
 /begin OUT_MEASUREMENT FAC_VS_LGRD_CRU /end OUT_MEASUREMENT
/end FUNCTION
/begin FUNCTION CRU_Interventions "_Interventions"
 /begin DEF_CHARACTERISTIC C_VS_DIF_MAX_CRU C_AC_POS_CRU_TIP C_AC_NEG_CRU_TIP C_AC_NEG_CRU_DEACC C_AC_POS_CRU_DEACC C_T_MIN_CRU_CON IP_AC_NEG_CRU_AC__N__FAC_TQ_CRU C_VS_DIF_DELTA_I C_AC_POS_CRU_RESU C_AC_POS_CRU_RESU_RNG_L C_AC_POS_CRU_AC C_AC_POS_CRU_AC_RNG_L IP_AC_NEG_CRU_RESU C_VS_SP_CRU_MAX /end DEF_CHARACTERISTIC
 /begin OUT_MEASUREMENT VS_SP_INC_CRU VS_SP_DEC_CRU VS_SP_DRIV_CRU_ /end OUT_MEASUREMENT
/end FUNCTION
/begin FUNCTION CRU_Ready_state_and_display "_Ready state and display"
 /begin DEF_CHARACTERISTIC LC_CRU_REQ_SWI C_T_CRUS_ON C_T_READY_CRU C_T_CRUS C_T_CRUS_OFF /end DEF_CHARACTERISTIC
 /begin OUT_MEASUREMENT LV_CRU_MAIN_SWI_ /end OUT_MEASUREMENT
/end FUNCTION
/begin FUNCTION CRU_Evaluation_serial_data_line_ "_Evaluation serial data line from the MSW" /begin DEF_CHARACTERISTIC C_T_MIN_MSW /end DEF_CHARACTERISTIC /begin OUT_MEASUREMENT STATE_MSW_CAN REQ_MSW /end OUT_MEASUREMENT /end FUNCTION
/begin FUNCTION CRU_Conditions_for_cruise_contro "_Conditions for cruise control"
 /begin DEF_CHARACTERISTIC C_T_CRU_ESP_OFF C_T_CRU_ASR_OFF C_T_CRU_ESP_BRAKE_OFF C_VS_MIN_PLAUS_CRU C_T_DLY_VS_SP_CRU_MAX C_N_VS_MAX_CRU C_T_ERR_VS_CAN C_AC_MAX_CRU C_VS_MIN_CRU /end DEF_CHARACTERISTIC
 /begin OUT_MEASUREMENT LV_CRU_OFF_BY_ASR_ESP_CTL REQ_CRU LV_CRU_OFF_IRR LV_CRU_ACT STATE_CRU_CAN STATE_CRU_OFF_REV STATE_CRU_OFF_IRR STATE_CRU /end OUT_MEASUREMENT
/end FUNCTION
/begin FUNCTION CRU_Additional_functions "_Additional functions"
 /begin DEF_CHARACTERISTIC C_FAC_VS_FIL C_VS_MAX_DIAG C_FAC_TQ_REQ_DRIV_MMV C_FAC_AC_CRU_MMV C_DIF_VS_ICL_DISP C_T_DLY_MAX_CRU C_VS_SP_DIF_MIN_CRU C_VS_SP_DIF_MAX_CRU C_VS_DIF_DLY_CRU_NEG C_FAC_TQ_REQ_HYS_CRU C_VS_DIF_DLY_CRU_POS C_VS_DIF_MIN_CRU_OVER C_VS_DIF_DLY_CRU /end DEF_CHARACTERISTIC
 /begin OUT_MEASUREMENT AC_CRU LV_VS_DIAG_NOT_PLAUS FAC_TQ_REQ_DRIV_MMV N_VS_CRU VS_FIL VS_CRU T_DLY_CRU LV_CRU_OVER_ACT /end OUT_MEASUREMENT
/end FUNCTION
/begin FUNCTION CRU_Step_cruise_control "_Step cruise control"
 /begin DEF_CHARACTERISTIC C_VS_DIF_STEP_PROG_M C_VS_DIF_STEP_PROG_K C_VS_DIF_STEP_MIN C_VS_DIF_TIP_PROG C_VS_MIN_PROG C_MAX_STEP C_T_CRU_FLASH_LIGHT C_T_DLY_CRU_TIP C_T_MIN_PROG /end DEF_CHARACTERISTIC
 /begin OUT_MEASUREMENT NR_STEP_ON COUNT_VS_STEP VS_DIF_STEP_PROG LV_PROG_STEP_1 LV_STEP_ON VS_SP_DRIV_STEP NR_VS_CRU VS_SP_DRIV_CRU_CAN VS_STEP_CAN_1 VS_STEP_CAN_2 VS_STEP_CAN_3 /end OUT_MEASUREMENT
/end FUNCTION
/begin FUNCTION BGO_Basic_SW_General_Operation "BGO" /begin SUB_FUNCTION BGO_Non_volatile_datas /end SUB_FUNCTION /end FUNCTION
/begin FUNCTION BGO_Non_volatile_datas "_Non volatile datas"
 /begin DEF_CHARACTERISTIC LC_AD_CLR_KNK LC_AD_CLR_LAM LC_AD_CLR_EGR LC_AD_CLR_TCO LC_AD_CLR_TPS LC_AD_CLR_MIS LC_AD_CLR_IVVT LC_AD_CLR_IMM LC_AD_CLR_IDLE LC_AD_CLR_ATI LC_AD_CLR_TOIL LC_AD_CLR_ECF LC_AD_CLR_SA LC_AD_CLR_N_SP_IS LC_AD_CLR_RON LC_AD_CLR_TECU LC_AD_CLR_VAR LC_AD_CLR_DMTL LC_AD_CLR_SOF LC_AD_CLR_N_MAX LC_AD_CLR_LIF LC_AD_CLR_OZ LC_AD_CLR_TQI_LIM LC_AD_CLR_FUP LC_AD_CLR_TEG LC_AD_CLR LC_AD_CLR_CRU LC_AD_CLR_OBD2 /end DEF_CHARACTERISTIC
/end FUNCTION
/begin FUNCTION EOL_End_of_line_test ""
 /begin SUB_FUNCTION EOL_End_of_line_test_Lambda_sens EOL_Lambda_setpoint_for_external /end SUB_FUNCTION
/end FUNCTION
/begin FUNCTION EOL_End_of_line_test_Lambda_sens "_End of line test Lambda sensors confused wrong wired"
 /begin DEF_CHARACTERISTIC C_TCO_MIN_VLS_EOL C_TEG_CAT_DOWN_EOL C_MAF_INT_MIN_VLS_EOL C_LAMB_SP_VLS_EOL_AFR C_LAMB_SP_VLS_EOL_AFL C_VLS_AFR_EOL C_VLS_AFL_EOL /end DEF_CHARACTERISTIC
 /begin OUT_MEASUREMENT STATE_VLS_EOL LAMB_SP_VLS_EOL_2 LV_ACT_VLS_EOL_EXT_ADJ LAMB_SP_VLS_EOL_1 /end OUT_MEASUREMENT
/end FUNCTION
/begin FUNCTION EOL_Lambda_setpoint_for_external "_Lambda setpoint for external adjustment"
 /begin OUT_MEASUREMENT LAMB_SP_EXT_ADJ_1 LAMB_SP_EXT_ADJ_2 LV_LAMB_SP_EXT_ADJ_1 LV_LAMB_SP_EXT_ADJ_2 /end OUT_MEASUREMENT
/end FUNCTION
/begin FUNCTION C_Y_Byp_Sim "" /begin SUB_FUNCTION Bypass_Simulation /end SUB_FUNCTION /end FUNCTION
/begin FUNCTION Bypass_Simulation "Bypass_Simulation"
 /begin DEF_CHARACTERISTIC C_BYP_LIH_CNT_MAX_A C_BYP_LIH_CNT_MAX_B C_BYP_ON C_BYP_FUNC_A C_BYP_FUNC_B C_BYP_A_OFS_CH1 C_BYP_A_OFS_CH2 C_BYP_A_OFS_CH3 C_BYP_A_OFS_CH4 C_BYP_A_OFS_CH5 C_BYP_A_OFS_CH6 C_BYP_A_OFS_CH7 C_BYP_A_OFS_CH8 C_BYP_A_OFS_CH9 C_BYP_A_OFS_CH10 C_BYP_A_OFS_CH11 C_BYP_A_OFS_CH12 C_BYP_A_OFS_CH13 C_BYP_A_OFS_CH14 C_BYP_A_OFS_CH15 C_BYP_A_OFS_CH0 C_BYP_B_OFS_CH0 C_BYP_B_OFS_CH1 C_BYP_B_OFS_CH2 C_BYP_B_OFS_CH3 C_BYP_B_OFS_CH4 C_BYP_B_OFS_CH5 C_BYP_B_OFS_CH6 C_BYP_B_OFS_CH7 C_BYP_B_OFS_CH8 C_BYP_B_OFS_CH9 C_BYP_B_OFS_CH10 C_BYP_B_OFS_CH11 C_BYP_B_OFS_CH12 C_BYP_B_OFS_CH13 C_BYP_B_OFS_CH14 C_BYP_B_OFS_CH15 C_BYP_B_OFS_CH16 C_BYP_B_OFS_CH17 C_BYP_B_OFS_CH18 C_BYP_B_OFS_CH19 C_BYP_B_OFS_CH20 C_BYP_B_OFS_CH21 C_BYP_B_OFS_CH22 C_BYP_B_OFS_CH23 C_BYP_B_OFS_CH24 C_BYP_B_OFS_CH25 C_BYP_B_OFS_CH26 C_BYP_B_OFS_CH27 C_BYP_B_OFS_CH28 C_BYP_B_OFS_CH29 C_BYP_B_OFS_CH30 C_BYP_B_OFS_CH31 /end DEF_CHARACTERISTIC
 /begin OUT_MEASUREMENT LV_BYP_ON BYP_CNT_A BYP_CNT_B BYP_ERROR /end OUT_MEASUREMENT
/end FUNCTION
/begin FUNCTION ENRD "" /begin SUB_FUNCTION ENRD_Calculation ENRD_Calculation_Appli_Inci /end SUB_FUNCTION /end FUNCTION
/begin FUNCTION ENRD_Calculation ""
 /begin DEF_CHARACTERISTIC C_N_MIN_ER C_CRK_DIF_MAX_ER C_SEG_T_AD_COR_DRV1_MAX_ER C_NR_SEG_AD_ACT_MIN C_NR_SEG_DRV1_ER_MIN C_N_MAX_ER C_N_32_MIN_SEG C_N_SEG_T_AD_RAW_MIN_ER C_N_SEG_T_AD_MIN_ER C_N_SEG_T_AD_MAX_ER C_N_SEG_T_AD_RAW_MAX_ER /end DEF_CHARACTERISTIC
 /begin OUT_MEASUREMENT IF_T_SEG_MIS CUR_SEG_COR SEG_T_COR_0 SEG_T_COR_1 SEG_T_COR_2 SEG_T_COR_3 SEG_T_COR_4 SEG_T_COR_5 DRV0_ER DRV2_MMV_ER DRV1_ER ER_RAW LV_ENA_ER THD_AD_ER SEG_T_AD_MIN_ER DELTA_CRK_DIF_MAX_ER LV_SEG_AD_LIM CUR_SEG_MES SEG_T_MES_0 SEG_T_MES_1 SEG_T_MES_2 SEG_T_MES_3 SEG_T_MES_4 SEG_T_MES_5 DRV2_ER SEG_T_AD_NR LV_SEG_AD_STATE SEG_NR_ER ER ER_0 ER_1 ER_2 ER_3 ER_4 ER_5 SEG_AD_MMV_0 SEG_AD_MMV_1 SEG_AD_MMV_2 SEG_AD_MMV_3 SEG_AD_MMV_4 SEG_AD_MMV_5 SEG_AD_RAW_MMV_0 SEG_AD_RAW_MMV_1 SEG_AD_RAW_MMV_2 SEG_AD_RAW_MMV_3 SEG_AD_RAW_MMV_4 SEG_AD_RAW_MMV_5 LV_SEG_AD_ACT_STATE LV_SEG_AD_RAW_ACT_STATE /end OUT_MEASUREMENT
/end FUNCTION
/begin FUNCTION ENRD_Calculation_Appli_Inci ""
 /begin DEF_CHARACTERISTIC C_SEG_T_AD_RAW_CRLC_ER C_TPS_GRD_DLY_ER_AD C_SEG_T_MES_MIN C_SEG_T_MES_MAX C_SEG_T_FAST_AD_CRLC_ER C_SEG_T_AD_CRLC_ER_EOL C_SEG_T_AD_CRLC_ER C_SEG_T_AD_COR_DRV1_MAX_ER_EOL C_SEG_AD_DIF_MAX_ER C_NR_SEG_DRV1_ER_MIN_EOL C_NR_SEG_AD_ACT_MIN_EOL C_N_SEG_T_AD_MIN_ER_EOL C_N_SEG_T_AD_MAX_ER_EOL C_MAF_DIF_DLY_ER_AD C_LOAD_MIS_DIF_DLY_ER_AD C_FAC_DRV2_ZDLY_ER C_CRLC_DRV2_ZDLY_ER IP_SEG_2_AD_COR IP_SEG_1_AD_COR IP_MAF_DIF_MAX_ER_AD__MAF IP_FAC_LOAD_DRV2_ER_MT IP_FAC_LOAD_DRV2_ER_AT IP_FAC_GAIN_ER_5_MT IP_FAC_GAIN_ER_5_AT IP_FAC_GAIN_ER_4_MT IP_FAC_GAIN_ER_4_AT IP_FAC_GAIN_ER_3_MT IP_FAC_GAIN_ER_3_AT IP_FAC_GAIN_ER_2_MT IP_FAC_GAIN_ER_2_AT IP_FAC_GAIN_ER_1_MT IP_FAC_GAIN_ER_1_AT IP_FAC_GAIN_ER_0_MT IP_FAC_GAIN_ER_0_AT IP_FAC_ADD_ER_4_AT IP_FAC_ADD_ER_4_MT IP_FAC_ADD_ER_3_MT IP_FAC_ADD_ER_3_AT IP_FAC_ADD_ER_5_AT IP_FAC_ADD_ER_5_MT IP_FAC_ADD_ER_1_AT IP_FAC_ADD_ER_2_MT IP_FAC_ADD_ER_2_AT IP_FAC_ADD_ER_1_MT IP_CRLC_DRV2_ER_AT IP_CRLC_DRV2_ER_MT IP_FAC_ADD_ER_0_AT IP_FAC_ADD_ER_0_MT C_T_DRV2_ZDLY_ER C_ACCOUT_DLY_ER_AD IP_TPS_GRD_MAX_ER_AD__TPS_AV IP_LOAD_MIS_DIF_MAX_ER_AD LC_SEG_AD_RST_ENA_EOL LC_SEG_AD_REQ_ENA_EOL LC_CONF_GAIN_ADD_ER IP_FAC_N_DRV2_ER_AT IP_FAC_N_DRV2_ER_MT /end DEF_CHARACTERISTIC
 /begin OUT_MEASUREMENT FAC_GAIN_ER_0 FAC_GAIN_ER_1 FAC_GAIN_ER_2 FAC_GAIN_ER_3 FAC_GAIN_ER_4 FAC_GAIN_ER_5 FAC_DRV2_ER FAC_ADD_ER_0 FAC_ADD_ER_1 FAC_ADD_ER_2 FAC_ADD_ER_3 FAC_ADD_ER_4 FAC_ADD_ER_5 CRLC_DRV2_ER LV_SEG_AD_REQ_EOL LV_SEG_AD_RST_EOL LV_ERR_DET_CRK SEG_T_MES LV_ENA_SEG_T_MES LV_SEG_AD_FDOUT SEG_AD_COR SEG_AD_DIF_1 SEG_AD_DIF_0 SEG_AD_DIF_2 SEG_T_AD_CRLC_ER CTR_ABC_SEG_T_AD ERR_INFO_STAT LV_CDN_DIAG_SEG_T_AD LV_END_DIAG_SEG_T_AD LV_READY_SEG_T_AD ERR_SYM_SEG_T_AD LV_ERR_MEM_SEG_T_AD CTR_ABC_END_DIAG_SEG_T_AD CTR_ABC_SEG_T ERR_INFO_STAT LV_CDN_DIAG_SEG_T LV_END_DIAG_SEG_T LV_READY_SEG_T ERR_SYM_SEG_T LV_ERR_MEM_SEG_T CTR_ABC_END_DIAG_SEG_T_AD LV_INH_SEG_AD LV_ERR_SEG_T LV_ERR_SEG_T_AD /end OUT_MEASUREMENT
/end FUNCTION
/begin FUNCTION KT_IBS ""
 /begin DEF_CHARACTERISTIC ENABSDIBS ENISOC0 ENUSOC0 ERREPEAT IBSWBASELN IBUNPLADEL ISTARTTRIG IWAKEUPGRZ T1SOC0 T2SOC0 T3SOC0 TNUSTART TNUSTARTFL USOC0GRENZ /end DEF_CHARACTERISTIC
 /begin OUT_MEASUREMENT BATEMP_GAIN BSDUMMY_1 BSDUMMY_2 BSDUMMY_3 BSDUMMY_4 BSDUMMY_5 B_EB_BUSY B_EB_RXRDY B_EB_TXOK B_EB_WRITE B_IBFBSD B_IBFEBSD B_IBUNPLAU B_KTIB_1ST CRC16_EROM CRCPARA EBSD_ADR EBSD_ARYIN EBSD_ERRDIR EBSD_ERREP EBSD_ERRIN EBSD_INDEX EBSD_NBYT EBSD_VARIN ERCNTCHKSU ERCNTCKSUB ERCNTPARIB ERCNTPARIT ERCNTUNTEB ERCNTUNTER IBATT_10 IBATT_1000 IBATT_200 IBATT_W IBCNTRESEB IBCNTRESET IBCNTUPDAT IBHWVERSI IBSWBASE IBSWCHANG IBS_REG4 IBS_REG5 IB_CRC16 IB_PARLEN I_1000_GAIN I_1000_OFFS I_10_GAIN I_10_OFFS I_400_GAIN I_400_OFFS KTIB_CRC16 KT_IBSSTATUS KT_OLDIBSSTATUS START_IBSSTATUS TBATTROH U11_13_GAIN U11_13_OFFS U6_16_GAIN U6_16_OFFS UBATTHIROH UBATTLOROH UBATT_W /end OUT_MEASUREMENT
/end FUNCTION
/end MODULE
/end PROJECT
