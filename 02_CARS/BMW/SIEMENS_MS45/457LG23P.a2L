/* -------------------------------------------------------------------------
E T A S
Data Declaration System (DDS)
- ASAP2 export -
DDS-Version 2.3.0
Component-Version Build<000026.02> $Hotfix 4: 2002/04/08 (ident-extension #650, default raster)
CreationDate 06 Aug 2002, 13:45:06
Project MS45
Number 457
Structure G2L
Serial Nr. 00
Option Project (DataBase) D:\p\453\g2n_pis\mc1\work\dds
Option Verbose false
Option ASAP2File D:\p\453\g2n_pis\mc1\out\cal\453G2N30.a2l
Option IgnoreAddressCheck false
Option ASAP2Version 1.31
Option ExportSoftwareGrouping false
Option ExportComponentGrouping false
Option SuppressFunctionGrouping false
Option SuppressAxisFunctionGrouping false
Option ExportDisplayIdentifier <1>
Option ExportLongIdentifier <0>
Option ExportAnnotation false
Option PartialExportViaFunction
Option MemoryRegionAutoAssignment <0>
Option ExportReference2MemorySegment false
Option AddressOffset <0>
Option IfDataSetList 'CCP'
'ETK_P2'
'ETAS KWP2000'
Option IfDataOutputFormat <0>
Option CalibrationMethodList
Option SuppressEcuAddress false
Option SuppressFloat false
Option SuppressVariantCoding false
Option VariantCodingMode <0>
Option OnlineOnly false
Option ExportHiddenData false
Option Map2PointLinearConv2RatFunc true
Option NonLinearConvMode <0>
Option MapVTabRange2VTab false
Option MaxCompuTabValuePairs <255>
Option DefaultFormat4VerbalConvers...
Option WriteEscapeCharacters false
Option AllowASAP1_3IdentsAlso4NonI... false
Option IgnorePartialIdentLengthCheck false
Option A2MLIncludeMode <1>
------------------------------------------------------------------------- */
ASAP2_VERSION 1 31
/begin PROJECT MS45 "BMW Motorsteuerung R6"
/begin HEADER "_default_HeaderComment" PROJECT_NO _57 /end HEADER
/begin MODULE _default_ModuleName "_default_ModuleLongIdentifier"
/begin MOD_PAR "_default_ModParComment"
 /begin MEMORY_SEGMENT _INT_RAM "" VARIABLES RAM INTERN 0x3f9800 0x6800 -1 -1 -1 -1 -1 /begin IF_DATA ETK DP_BLOB 0x3f9800 0x6800 /end IF_DATA /end MEMORY_SEGMENT
 /begin MEMORY_SEGMENT _ROM "" DATA FLASH EXTERN 0xffe40000 0x1d000 -1 -1 -1 -1 -1 /begin IF_DATA ETK DP_BLOB 0xffe40000 0x1d000 /end IF_DATA /end MEMORY_SEGMENT
 /begin MEMORY_SEGMENT _RAM "" VARIABLES RAM EXTERN 0xffc5d000 0x3000 -1 -1 -1 -1 -1 /begin IF_DATA ETK DP_BLOB 0xffc5d000 0x3000 /end IF_DATA /end MEMORY_SEGMENT
 /begin MEMORY_SEGMENT _INT_RAM_BIT "" VARIABLES RAM INTERN 0xfd00 0x100 -1 -1 -1 -1 -1 /begin IF_DATA ETK DP_BLOB 0xfd00 0x100 /end IF_DATA /end MEMORY_SEGMENT
/end MOD_PAR
/begin MOD_COMMON "_default_ModCommonComment" DEPOSIT ABSOLUTE BYTE_ORDER MSB_FIRST ALIGNMENT_BYTE 1 ALIGNMENT_WORD 2 ALIGNMENT_LONG 4 ALIGNMENT_FLOAT32_IEEE 4 ALIGNMENT_FLOAT64_IEEE 8 /end MOD_COMMON
/begin IF_DATA ASAP1B_CCP
 /begin SOURCE "Crankshaft Synchronous Cyl.1" 0 0 DISPLAY_IDENTIFIER DAQ1 /begin QP_BLOB 1 LENGTH 10 CAN_ID_FIXED 0x7EB RASTER 1 FIRST_PID 0 /end QP_BLOB /end SOURCE
 /begin SOURCE "Crankshaft Synchronous Cyl.2" 0 0 DISPLAY_IDENTIFIER DAQ2 /begin QP_BLOB 2 LENGTH 10 CAN_ID_FIXED 0x7EB RASTER 2 FIRST_PID 16 /end QP_BLOB /end SOURCE
 /begin SOURCE "Crankshaft Synchronous Cyl.3" 0 0 DISPLAY_IDENTIFIER DAQ3 /begin QP_BLOB 3 LENGTH 10 CAN_ID_FIXED 0x7EB RASTER 3 FIRST_PID 32 /end QP_BLOB /end SOURCE
 /begin SOURCE "Crankshaft Synchronous Cyl.4" 0 0 DISPLAY_IDENTIFIER DAQ4 /begin QP_BLOB 4 LENGTH 10 CAN_ID_FIXED 0x7EB RASTER 4 FIRST_PID 48 /end QP_BLOB /end SOURCE
 /begin SOURCE "Crankshaft Synchronous Cyl.5" 0 0 DISPLAY_IDENTIFIER DAQ5 /begin QP_BLOB 5 LENGTH 10 CAN_ID_FIXED 0x7EB RASTER 5 FIRST_PID 64 /end QP_BLOB /end SOURCE
 /begin SOURCE "Crankshaft Synchronous Cyl.6" 0 0 DISPLAY_IDENTIFIER DAQ6 /begin QP_BLOB 6 LENGTH 10 CAN_ID_FIXED 0x7EB RASTER 6 FIRST_PID 80 /end QP_BLOB /end SOURCE
 /begin SOURCE "Time Synchronous 10ms" 3 10 DISPLAY_IDENTIFIER _10ms /begin QP_BLOB 30 LENGTH 10 CAN_ID_FIXED 0x7EC RASTER 30 FIRST_PID 96 /end QP_BLOB /end SOURCE
 /begin SOURCE "Display" 0 0 DISPLAY_IDENTIFIER Disp /begin QP_BLOB 31 LENGTH 60 CAN_ID_FIXED 0x7ED RASTER 31 FIRST_PID 112 /end QP_BLOB /end SOURCE
 /begin RASTER "Crankshaft Synchronous Cyl. 1" "CYL1" 1 103 1 /end RASTER
 /begin RASTER "Crankshaft Synchronous Cyl. 2" "CYL2" 2 103 1 /end RASTER
 /begin RASTER "Crankshaft Synchronous Cyl. 3" "CYL3" 3 103 1 /end RASTER
 /begin RASTER "Crankshaft Synchronous Cyl. 4" "CYL4" 4 103 1 /end RASTER
 /begin RASTER "Crankshaft Synchronous Cyl. 5" "CYL5" 5 103 1 /end RASTER
 /begin RASTER "Crankshaft Synchronous Cyl. 6" "CYL6" 6 103 1 /end RASTER
 /begin RASTER "Time Synchronous 10ms" "10ms" 30 3 10 /end RASTER
 /begin RASTER "Display 100ms" "DISP" 31 3 100 /end RASTER
 /begin EVENT_GROUP "Crankshaft Synchronous Cyl 1-6" "CRANK" RASTER 1 RASTER 2 RASTER 3 RASTER 4 RASTER 5 RASTER 6 /end EVENT_GROUP
 /begin SEED_KEY "" "" "" /end SEED_KEY
 /begin TP_BLOB 0x0201 0x0204 0x07E8 0x7EA 0x0001 2 BAUDRATE 500000 SAMPLE_POINT 66 SAMPLE_RATE 1 BTL_CYCLES 16 SJW 2 SYNC_EDGE 0 DAQ_MODE BURST RESUME_SUPPORTED CONSISTENCY DAQ ADDRESS_EXTENSION DAQ /begin CHECKSUM_PARAM 0x9001 0x80 CHECKSUM_CALCULATION ACTIVE_PAGE /end CHECKSUM_PARAM STORE_SUPPORTED
  /begin DEFINED_PAGES 1 "Working Page" 0 0xFFC40000 0x1D000 RAM RAM_INIT_BY_ECU FLASH_BACK /end DEFINED_PAGES
  /begin DEFINED_PAGES 2 "Reference Page" 0 0xFFF40000 0x1D000 FLASH DEFAULT /end DEFINED_PAGES
  OPTIONAL_CMD 0x05 OPTIONAL_CMD 0x08 OPTIONAL_CMD 0x09 OPTIONAL_CMD 0x0C OPTIONAL_CMD 0x0D OPTIONAL_CMD 0x0E OPTIONAL_CMD 0x11 OPTIONAL_CMD 0x12 OPTIONAL_CMD 0x13 OPTIONAL_CMD 0x18 OPTIONAL_CMD 0x19 OPTIONAL_CMD 0x20 OPTIONAL_CMD 0x21 OPTIONAL_CMD 0x22 /end TP_BLOB
/end IF_DATA
/begin IF_DATA ETK
 /begin SOURCE "Segment Synchronous" 103 1 QP_BLOB 1 0x3c 0xffe5c600 0xffc5e180 0xffc5e140 0 0x0 0x0 /end SOURCE
 /begin SOURCE "Time Synchronous Cylinder 10ms" 4 1 QP_BLOB 2 0x5c 0xffe5c6f8 0xffc5e1bc 0xffc5e142 10 0x0 0x0 /end SOURCE
 /begin SOURCE "Time Synchronous Cylinder 100ms" 5 1 QP_BLOB 3 0x5c 0xffe5c870 0xffc5e218 0xffc5e144 100 0x0 0x0 /end SOURCE
 /begin SOURCE "Bypass Segment Synchronous" 103 1 QP_BLOB 4 0x30 0xffe5c9e8 0xffc5e274 0xffc5e146 0 0x10 0xffe5cb78 /end SOURCE
 /begin SOURCE "Bypass Time Synchronous" 4 1 QP_BLOB 5 0x30 0xffe5cab0 0xffc5e2a4 0xffc5e148 10 0x20 0xffe5cba0 /end SOURCE
 /begin TP_BLOB 0x01000001 0x0 0x00000800
  /begin DISTAB_CFG 0xD 0x0111 0x1 0xFFC5E100 0x1010100 TRG_MOD 0x0 0xB7 0x0 0x0 0x0 /end DISTAB_CFG
  CODE_CHK 0x0 0x0 0x0 0x0 ETK_CFG 0x02 0xE2 0x4E 0xDF 0xEF 0x4E 0xDF 0xEF 0x4E 0xCF 0xFB 0xFE 0xFF 0xFF 0xFB 0xFF 0xFF 0xFF 0xFF 0xFF 0x03 0xFF 0x01 0xFF RESERVED 0xffe5c600 0x0600 EXTERN -1 -1 -1 -1 -1 /end TP_BLOB
/end IF_DATA
/begin IF_DATA ASAP1B_KWP2000
 /begin SOURCE "timeslot" 0 0 QP_BLOB 0 BLOCKMODE 0xF0 0 40 /end SOURCE
 /begin TP_BLOB 0x0101 0x12 0xF1 WuP MSB_FIRST 1 DATA_ACCESS 0x000000 0x000000 1 0 0 1 SERAM 0xFFF40000 0xFFF40000 0x5D000 0x5D000 0 0 1 0 0 1 /begin CHECKSUM 0x010201 1 0x26 RequestRoutineResults RNC_RESULT 0x23 /end CHECKSUM
  /begin FLASH_COPY TOOLFLASHBACK 0x27 RequestRoutineResults RAM_InitByECU 0x86 COPY_FRAME 1 RNC_RESULT 0x23 0xfb 0xfc COPY_PARA 1 /end FLASH_COPY
  /begin DIAG_BAUD 113636 0x86 BD_PARA 0x06 0x01 0xbb 0xe4 /end DIAG_BAUD
  /begin DIAG_BAUD 57600 0x86 BD_PARA 0x06 0x00 0xe1 0x00 /end DIAG_BAUD
  /begin DIAG_BAUD 38400 0x86 BD_PARA 0x06 0x00 0x96 0x00 /end DIAG_BAUD
  /begin DIAG_BAUD 19200 0x86 BD_PARA 0x06 0x00 0x4B 0x00 /end DIAG_BAUD
  /begin DIAG_BAUD 10400 0x86 BD_PARA 0x06 0x00 0x28 0xA0 /end DIAG_BAUD
  TIME_DEF 20 2 49 12 250 0 /begin PAGE_SWITCH ESCAPE_CODE ESCAPE_CODE_PARA 0x90 PAGE_CODE 0x00 0x01 /end PAGE_SWITCH /end TP_BLOB
/end IF_DATA
/begin CHARACTERISTIC c_tco_bol_ect "TCO setpoint for LV_REQ_TCO_L = 1" VALUE 0xffe408ed _REC_VAL_20_u1 190.5 _CNV_A_R_LINEAR_____11_CM -48. 142.5 DISPLAY_IDENTIFIER C_TCO_BOL_ECT FORMAT "%5.1" /end CHARACTERISTIC
/begin CHARACTERISTIC c_tco_ex_hys_ect "Hysteresis for end of the special case" VALUE 0xffe408fa _REC_VAL_20_u1 28.575 _CNV_A_R_LINEAR_____12_CM 0. 190.5 DISPLAY_IDENTIFIER C_TCO_EX_HYS_ECT FORMAT "%4.1" /end CHARACTERISTIC
/begin CHARACTERISTIC c_tco_ex_max_ect "TCO_EX threshold" VALUE 0xffe408fb _REC_VAL_20_u1 28.575 _CNV_A_R_LINEAR_____11_CM -48. 142.5 DISPLAY_IDENTIFIER C_TCO_EX_MAX_ECT FORMAT "%5.1" /end CHARACTERISTIC
/begin CHARACTERISTIC c_tco_min_ect "Min. TCO threshold for full energization of the thermostat" VALUE 0xffe40914 _REC_VAL_20_u1 190.5 _CNV_A_R_LINEAR_____11_CM -48. 142.5 DISPLAY_IDENTIFIER C_TCO_MIN_ECT FORMAT "%5.1" /end CHARACTERISTIC
/begin CHARACTERISTIC c_tco_sp_tco_ex_max "TCO target temperature if TCO_EX threshold exceeded" VALUE 0xffe40923 _REC_VAL_20_u1 28.575 _CNV_A_R_LINEAR_____11_CM -48. 142.5 DISPLAY_IDENTIFIER C_TCO_SP_TCO_EX_MAX FORMAT "%5.1" /end CHARACTERISTIC
/begin CHARACTERISTIC c_tco_sp_toil_min "Set value for TCO_SP" VALUE 0xffe40925 _REC_VAL_20_u1 190.5 _CNV_A_R_LINEAR_____11_CM -48. 142.5 DISPLAY_IDENTIFIER C_TCO_SP_TOIL_MIN FORMAT "%5.1" /end CHARACTERISTIC
/begin CHARACTERISTIC c_tia_hys_ect "Hysteresis for end of the special case" VALUE 0xffe4095d _REC_VAL_20_u1 28.575 _CNV_A_R_LINEAR_____12_CM 0. 190.5 DISPLAY_IDENTIFIER C_TIA_HYS_ECT FORMAT "%4.1" /end CHARACTERISTIC
/begin CHARACTERISTIC c_toil_hys_ect "TOIL hystheresis for hot operation" VALUE 0xffe40970 _REC_VAL_20_u1 255. _CNV_A_R_LINEAR_____13_CM 0. 255. DISPLAY_IDENTIFIER C_TOIL_HYS_ECT FORMAT "%3.0" /end CHARACTERISTIC
/begin CHARACTERISTIC c_toil_min_ect "Lower TOIL threshold" VALUE 0xffe40978 _REC_VAL_20_u1 200. _CNV_A_R_LINEAR_____14_CM -40. 160. DISPLAY_IDENTIFIER C_TOIL_MIN_ECT FORMAT "%3.0" /end CHARACTERISTIC
/begin MEASUREMENT tco_sp "TCO target temperature" UBYTE _CNV_A_R_LINEAR_____11_CM 1 100. -48. 142.5 DISPLAY_IDENTIFIER TCO_SP ECU_ADDRESS 0x3fe916 FORMAT "%4.1" /end MEASUREMENT
/begin MEASUREMENT lv_ect_wup "Boolean for engine warm-up state for ECT" UBYTE _CNV_A_R_LINEAR_____0_CM 1 100. 0. 1. DISPLAY_IDENTIFIER LV_ECT_WUP ECU_ADDRESS 0x3fe91f FORMAT "%2.0" /end MEASUREMENT
/begin CHARACTERISTIC id_ectpwm_add__n__tco_sp "Precontrol pulse width modulation" MAP 0xffe44055 _REC_MAP_20_u1_u1_u1 99.609375 _CNV_A_R_LINEAR_____9_CM 0. 99.609375 DISPLAY_IDENTIFIER ID_ECTPWM_ADD FORMAT "%5.2"
 /begin AXIS_DESCR COM_AXIS n_32 _CNV_A_R_LINEAR_____15_CM 8 0. 8160. FORMAT "%4.0" AXIS_PTS_REF ldp_n_32__ectpwm_add /end AXIS_DESCR
 /begin AXIS_DESCR COM_AXIS tco_sp _CNV_A_R_LINEAR_____11_CM 8 -48. 142.5 FORMAT "%5.1" AXIS_PTS_REF ldp_tco_sp__ectpwm_add /end AXIS_DESCR
/end CHARACTERISTIC
/begin CHARACTERISTIC ip_dist_min__tco_st "Distance limit" CURVE 0xffe40af7 _REC_CUR_20_u1_u1 25500. _CNV_A_R_LINEAR_____16_CM 0. 25500. DISPLAY_IDENTIFIER IP_DIST_MIN FORMAT "%6.0"
 /begin AXIS_DESCR COM_AXIS tco_st _CNV_A_R_LINEAR_____11_CM 8 -48. 142.5 FORMAT "%5.1" AXIS_PTS_REF ldp_tco_st__dist /end AXIS_DESCR
/end CHARACTERISTIC
/begin CHARACTERISTIC ip_ectpwm_i__tco_dif "Controller I component" CURVE 0xffe40aff _REC_CUR_20_u1_u1 12.45 _CNV_A_R_LINEAR_____17_CM -6.25 6.2 DISPLAY_IDENTIFIER IP_ECTPWM_I FORMAT "%5.2"
 /begin AXIS_DESCR COM_AXIS tco_dif _CNV_A_R_LINEAR_____18_CM 8 -96. 95.25 FORMAT "%6.2" AXIS_PTS_REF ldp_tco_dif__ectpwm_i /end AXIS_DESCR
/end CHARACTERISTIC
/begin CHARACTERISTIC ip_ectpwm_p__tco_dif "Controller P component" CURVE 0xffe40b07 _REC_CUR_20_u1_u1 99.60939999999999 _CNV_A_R_LINEAR_____19_CM -50. 49.6094 DISPLAY_IDENTIFIER IP_ECTPWM_P FORMAT "%5.1"
 /begin AXIS_DESCR COM_AXIS tco_dif _CNV_A_R_LINEAR_____18_CM 8 -96. 95.25 FORMAT "%6.2" AXIS_PTS_REF ldp_tco_dif__ectpwm_p /end AXIS_DESCR
/end CHARACTERISTIC
/begin MEASUREMENT ectpwm "Actuation pulse width modulation for thermostat" UBYTE _CNV_A_R_LINEAR_____9_CM 1 100. 0. 99.609375 DISPLAY_IDENTIFIER ECTPWM ECU_ADDRESS 0x3fe917 FORMAT "%5.1" /end MEASUREMENT
/begin CHARACTERISTIC c_toil_max_ect "TOIL threshold for hot operation" VALUE 0xffe40974 _REC_VAL_20_u1 200. _CNV_A_R_LINEAR_____14_CM -40. 160. DISPLAY_IDENTIFIER C_TOIL_MAX_ECT FORMAT "%3.0" /end CHARACTERISTIC
/begin CHARACTERISTIC c_tco_temp_gb_1 "TCO at cooling step 1" VALUE 0xffe40936 _REC_VAL_20_u1 28.575 _CNV_A_R_LINEAR_____11_CM -48. 142.5 DISPLAY_IDENTIFIER C_TCO_TEMP_GB_1 FORMAT "%5.1" /end CHARACTERISTIC
/begin CHARACTERISTIC c_tco_temp_gb_2 "TCO at cooling step 2" VALUE 0xffe40937 _REC_VAL_20_u1 28.575 _CNV_A_R_LINEAR_____11_CM -48. 142.5 DISPLAY_IDENTIFIER C_TCO_TEMP_GB_2 FORMAT "%5.1" /end CHARACTERISTIC
/begin CHARACTERISTIC c_ectpwm_man "Manual ECTPWM" VALUE 0xffe4071f _REC_VAL_20_u1 99.609375 _CNV_A_R_LINEAR_____9_CM 0. 99.609375 DISPLAY_IDENTIFIER C_ECTPWM_MAN FORMAT "%4.1" /end CHARACTERISTIC
/begin CHARACTERISTIC lc_ectpwm_man "Constant to switch to manual PWM activation" VALUE 0xffe40f53 _REC_VAL_20_u1 1. _CNV_A_R_LINEAR_____0_CM 0. 1. DISPLAY_IDENTIFIER LC_ECTPWM_MAN FORMAT "%2.0" /end CHARACTERISTIC
/begin AXIS_PTS ldp_n_32__ectpwm_add "" 0xffe47fe5 n_32 _REC_AXS_20_u1 8160. _CNV_A_R_LINEAR_____15_CM 8 0. 8160. DISPLAY_IDENTIFIER LDP_N_32__ECTPWM_ADD FORMAT "%4.0" /end AXIS_PTS
/begin AXIS_PTS ldp_tco_dif__ectpwm_i "" 0xffe48213 tco_dif _REC_AXS_20_u1 191.25 _CNV_A_R_LINEAR_____18_CM 8 -96. 95.25 DISPLAY_IDENTIFIER LDP_TCO_DIF__ECTPWM_I FORMAT "%6.2" /end AXIS_PTS
/begin AXIS_PTS ldp_tco_dif__ectpwm_p "" 0xffe4821c tco_dif _REC_AXS_20_u1 191.25 _CNV_A_R_LINEAR_____18_CM 8 -96. 95.25 DISPLAY_IDENTIFIER LDP_TCO_DIF__ECTPWM_P FORMAT "%6.2" /end AXIS_PTS
/begin AXIS_PTS ldp_tco_sp__ectpwm_add "" 0xffe4824b tco_sp _REC_AXS_20_u1 190.5 _CNV_A_R_LINEAR_____11_CM 8 -48. 142.5 DISPLAY_IDENTIFIER LDP_TCO_SP__ECTPWM_ADD FORMAT "%5.1" /end AXIS_PTS
/begin AXIS_PTS ldp_tco_st__dist "" 0xffe48254 tco_st _REC_AXS_20_u1 190.5 _CNV_A_R_LINEAR_____11_CM 8 -48. 142.5 DISPLAY_IDENTIFIER LDP_TCO_ST__DIST FORMAT "%5.1" /end AXIS_PTS
/begin AXIS_PTS ldpm_n_32_28 "" 0xffe48482 n_32 _REC_AXS_20_u1 8160. _CNV_A_R_LINEAR_____15_CM 12 0. 8160. DISPLAY_IDENTIFIER LDPM_N_32_28 FORMAT "%4.0" /end AXIS_PTS
/begin CHARACTERISTIC c_tia_max_ect "TIA threshold" VALUE 0xffe40960 _REC_VAL_20_u1 28.575 _CNV_A_R_LINEAR_____11_CM -48. 142.5 DISPLAY_IDENTIFIER C_TIA_MAX_ECT FORMAT "%5.1" /end CHARACTERISTIC
/begin CHARACTERISTIC c_tia_min_ect "Lower TIA threshold for engine warm-up operation" VALUE 0xffe40965 _REC_VAL_20_u1 28.575 _CNV_A_R_LINEAR_____11_CM -48. 142.5 DISPLAY_IDENTIFIER C_TIA_MIN_ECT FORMAT "%5.1" /end CHARACTERISTIC
/begin CHARACTERISTIC c_tam_hys_ect "TAM threshold for hot operation" VALUE 0xffe408d8 _REC_VAL_20_u1 28.575 _CNV_A_R_LINEAR_____12_CM 0. 190.5 DISPLAY_IDENTIFIER C_TAM_HYS_ECT FORMAT "%5.1" /end CHARACTERISTIC
/begin AXIS_PTS ldpm_fac_tq_req_ect_1 "" 0xffe5187c fac_tq_req _REC_AXS_20_u2 1.99996948 _CNV_A_R_LINEAR_____20_CM 6 0. 1.99996948 DISPLAY_IDENTIFIER LDPM_FAC_TQ_REQ_ECT_1 FORMAT "%7.5" /end AXIS_PTS
/begin CHARACTERISTIC id_tco_sp_ect "Target coolant temperature for vehicles without air conditioner" MAP 0xffe44366 _REC_MAP_20_u1_u1_u2 190.5 _CNV_A_R_LINEAR_____11_CM -48. 142.5 DISPLAY_IDENTIFIER ID_TCO_SP_ECT FORMAT "%5.1"
 /begin AXIS_DESCR COM_AXIS n_32 _CNV_A_R_LINEAR_____15_CM 12 0. 8160. FORMAT "%4.0" AXIS_PTS_REF ldpm_n_32_28 /end AXIS_DESCR
 /begin AXIS_DESCR COM_AXIS fac_tq_req _CNV_A_R_LINEAR_____20_CM 6 0. 1.99996948 FORMAT "%7.5" AXIS_PTS_REF ldpm_fac_tq_req_ect_1 /end AXIS_DESCR
/end CHARACTERISTIC
/begin CHARACTERISTIC id_tco_sp_ect_acin "Target coolant temperature for vehicles with air conditioner" MAP 0xffe443ae _REC_MAP_20_u1_u1_u2 190.5 _CNV_A_R_LINEAR_____11_CM -48. 142.5 DISPLAY_IDENTIFIER ID_TCO_SP_ECT_ACIN FORMAT "%5.1"
 /begin AXIS_DESCR COM_AXIS n_32 _CNV_A_R_LINEAR_____15_CM 12 0. 8160. FORMAT "%4.0" AXIS_PTS_REF ldpm_n_32_28 /end AXIS_DESCR
 /begin AXIS_DESCR COM_AXIS fac_tq_req _CNV_A_R_LINEAR_____20_CM 6 0. 1.99996948 FORMAT "%7.5" AXIS_PTS_REF ldpm_fac_tq_req_ect_1 /end AXIS_DESCR
/end CHARACTERISTIC
/begin CHARACTERISTIC c_tco_sp_tia_max "TCO target temperature if TIA threshold exceeded" VALUE 0xffe40924 _REC_VAL_20_u1 28.575 _CNV_A_R_LINEAR_____11_CM -48. 142.5 DISPLAY_IDENTIFIER C_TCO_SP_TIA_MAX FORMAT "%5.1" /end CHARACTERISTIC
/begin CHARACTERISTIC c_tco_sp_tam "TCO target temperature if TAM threshold exceeded" VALUE 0xffe40922 _REC_VAL_20_u1 28.575 _CNV_A_R_LINEAR_____11_CM -48. 142.5 DISPLAY_IDENTIFIER C_TCO_SP_TAM FORMAT "%5.1" /end CHARACTERISTIC
/begin CHARACTERISTIC c_tam_min_ect "Lower TAM threshold for engine warm-up operation" VALUE 0xffe408db _REC_VAL_20_u1 28.575 _CNV_A_R_LINEAR_____11_CM -48. 142.5 DISPLAY_IDENTIFIER C_TAM_MIN_ECT FORMAT "%5.1" /end CHARACTERISTIC
/begin CHARACTERISTIC c_tam_max_ect "TAM threshold" VALUE 0xffe408da _REC_VAL_20_u1 28.575 _CNV_A_R_LINEAR_____11_CM -48. 142.5 DISPLAY_IDENTIFIER C_TAM_MAX_ECT FORMAT "%5.1" /end CHARACTERISTIC
/begin MEASUREMENT lv_accout_rly_ena "LV indicating that the conditions for activating the ACC-relay are fullfilled" UBYTE _CNV_S_2_RANGE______2_CM 1 100. 0. 1. DISPLAY_IDENTIFIER LV_ACCOUT_RLY_ENA ECU_ADDRESS 0x3fe8f0 /end MEASUREMENT
/begin CHARACTERISTIC c_vs_max_accin "Speed condition for ACC suppression at high load" VALUE 0xffe409d1 _REC_VAL_20_u1 255. _CNV_A_R_LINEAR_____23_CM 0. 255. DISPLAY_IDENTIFIER C_VS_MAX_ACCIN FORMAT "%3.0" /end CHARACTERISTIC
/begin CHARACTERISTIC c_accin_dly_1 "Delay for ACC suppression in transition after full load" VALUE 0xffe414d4 _REC_VAL_20_u2 655.34 _CNV_A_R_LINEAR_____4_CM 1.e-002 655.35 DISPLAY_IDENTIFIER C_ACCIN_DLY_1 FORMAT "%6.2" /end CHARACTERISTIC
/begin CHARACTERISTIC c_accin_dly_1_lock_fl "Blocking time for renewed triggering of the ACC suppression at high load" VALUE 0xffe414d6 _REC_VAL_20_u2 655.35 _CNV_A_R_LINEAR_____4_CM 0. 655.35 DISPLAY_IDENTIFIER C_ACCIN_DLY_1_LOCK_FL FORMAT "%6.2" /end CHARACTERISTIC
/begin CHARACTERISTIC c_accin_dly_4 "Delay in transition from start" VALUE 0xffe414d8 _REC_VAL_20_u2 6553.5 _CNV_A_R_LINEAR_____24_CM 0. 6553.5 DISPLAY_IDENTIFIER C_ACCIN_DLY_4 FORMAT "%6.1" /end CHARACTERISTIC
/begin CHARACTERISTIC c_pvs_fl_accin "PV-threshold for ACC suppression" VALUE 0xffe4082e _REC_VAL_20_u1 99.609375 _CNV_A_R_LINEAR_____9_CM 0. 99.609375 DISPLAY_IDENTIFIER C_PVS_FL_ACCIN FORMAT "%4.1" /end CHARACTERISTIC
/begin CHARACTERISTIC c_accin_dly_5 "Delay before renewed reactivation of the ACC" VALUE 0xffe414da _REC_VAL_20_u2 655.35 _CNV_A_R_LINEAR_____4_CM 0. 655.35 DISPLAY_IDENTIFIER C_ACCIN_DLY_5 FORMAT "%6.2" /end CHARACTERISTIC
/begin CHARACTERISTIC c_tco_max_accin "TCC threshold for ACC suppression" VALUE 0xffe40904 _REC_VAL_20_u1 190.5 _CNV_A_R_LINEAR_____11_CM -48. 142.5 DISPLAY_IDENTIFIER C_TCO_MAX_ACCIN FORMAT "%5.1" /end CHARACTERISTIC
/begin MEASUREMENT lv_accout_rly "LV to activate the ACC-relay" UBYTE _CNV_S_2_RANGE______2_CM 1 100. 0. 1. DISPLAY_IDENTIFIER LV_ACCOUT_RLY ECU_ADDRESS 0x3fe8f1 BIT_MASK 0x1 /end MEASUREMENT
/begin CHARACTERISTIC c_tco_max_accin_hys "Hysteresis for leaving ACC suppression" VALUE 0xffe40905 _REC_VAL_20_u1 60. _CNV_A_R_LINEAR_____12_CM 0. 60. DISPLAY_IDENTIFIER C_TCO_MAX_ACCIN_HYS FORMAT "%4.1" /end CHARACTERISTIC
/begin AXIS_PTS ldpm_n_32__t_acc "" 0xffe413c6 n_32 _REC_AXS_20_u1 8160. _CNV_A_R_LINEAR_____15_CM 3 0. 8160. DISPLAY_IDENTIFIER LDPM_N_32__T_ACC FORMAT "%4.0" /end AXIS_PTS
/begin MEASUREMENT t_acc "Timer for duration of transient TQ_LOSS_ACC correction " UBYTE _CNV_A_R_LINEAR_____4_CM 1 100. 0. 2.55 DISPLAY_IDENTIFIER T_ACC ECU_ADDRESS 0x3fe8ee FORMAT "%4.2" /end MEASUREMENT
/begin MEASUREMENT t_acc_dly "delay time for start of TQ_LOSS_ACC-calculation & ACC-relay" UBYTE _CNV_A_R_LINEAR_____4_CM 1 100. 0. 2.55 DISPLAY_IDENTIFIER T_ACC_DLY ECU_ADDRESS 0x3fe8ef FORMAT "%4.2" /end MEASUREMENT
/begin CHARACTERISTIC ip_t_acc_dly_on__n_32 "Turn-On-Delay for start of T_ACC depending on N_32" CURVE 0xffe40df9 _REC_CUR_20_u1_u1 2.55 _CNV_A_R_LINEAR_____4_CM 0. 2.55 DISPLAY_IDENTIFIER IP_T_ACC_DLY_ON__N_32 FORMAT "%4.2"
 /begin AXIS_DESCR COM_AXIS n_32 _CNV_A_R_LINEAR_____15_CM 3 0. 8160. FORMAT "%4.0" AXIS_PTS_REF ldpm_n_32__t_acc /end AXIS_DESCR
/end CHARACTERISTIC
/begin CHARACTERISTIC ip_t_acc_dly_off__n_32 "Turn-Off-Delay for start of T_ACC depending on N_32" CURVE 0xffe40df6 _REC_CUR_20_u1_u1 2.55 _CNV_A_R_LINEAR_____4_CM 0. 2.55 DISPLAY_IDENTIFIER IP_T_ACC_DLY_OFF__N_32 FORMAT "%4.2"
 /begin AXIS_DESCR COM_AXIS n_32 _CNV_A_R_LINEAR_____15_CM 3 0. 8160. FORMAT "%4.0" AXIS_PTS_REF ldpm_n_32__t_acc /end AXIS_DESCR
/end CHARACTERISTIC
/begin MEASUREMENT state_cp "State of Evaporative Emission Control Function" UBYTE _CNV_S_8_RANGE_STAT_119_CM 1 100. 0. 7. DISPLAY_IDENTIFIER STATE_CP ECU_ADDRESS 0x3fe387 /end MEASUREMENT
/begin MEASUREMENT state_tra_cp "State of transitions between partial functions of the Evaporative Emission Control" UBYTE _CNV_S_12_RANGE_STAT_120_CM 1 100. 0. 11. DISPLAY_IDENTIFIER STATE_TRA_CP ECU_ADDRESS 0x3fe392 /end MEASUREMENT
/begin MEASUREMENT state_norm_deac_cp "Deactivation states of NORMAL_PURGE" UBYTE _CNV_S_3_RANGE_STAT_121_CM 1 100. 0. 2. DISPLAY_IDENTIFIER STATE_NORM_DEAC_CP ECU_ADDRESS 0x3fe393 /end MEASUREMENT
/begin MEASUREMENT rel_flow_open_cps "Setpoint value for the relative flow (FLOW_CPS/MAF_CYL) through the CPS during RAMP_PEN_FAST" UWORD _CNV_A_R_LINEAR_____37_CM 1 100. 0. 0.99998474 DISPLAY_IDENTIFIER REL_FLOW_OPEN_CPS ECU_ADDRESS 0x3fd1b8 BYTE_ORDER MSB_LAST FORMAT "%7.5" /end MEASUREMENT
/begin MEASUREMENT rel_flow_max_cps "Maximum value for the relative flow (FLOW_CPS/MAF_CYL) through the CPS" UWORD _CNV_A_R_LINEAR_____37_CM 1 100. 0. 0.99998474 DISPLAY_IDENTIFIER REL_FLOW_MAX_CPS ECU_ADDRESS 0x3fd1b4 BYTE_ORDER MSB_LAST FORMAT "%7.5" /end MEASUREMENT
/begin MEASUREMENT rel_flow_cps "Setpoint value for the relative flow (FLOW_CPS/MAF_CYL) through the CPS" UWORD _CNV_A_R_LINEAR_____37_CM 1 100. 0. 0.99998474 DISPLAY_IDENTIFIER REL_FLOW_CPS ECU_ADDRESS 0x3fd1a8 BYTE_ORDER MSB_LAST FORMAT "%7.5" /end MEASUREMENT
/begin MEASUREMENT rel_flow_cps_di "Relative flow (FLOW_CPS/MAF_CYL) through the CPS for disabled NORMAL_PURGE operation" UWORD _CNV_A_R_LINEAR_____37_CM 1 100. 0. 0.99998474 DISPLAY_IDENTIFIER REL_FLOW_CPS_DI ECU_ADDRESS 0x3fd1ba BYTE_ORDER MSB_LAST FORMAT "%7.5" /end MEASUREMENT
/begin MEASUREMENT rel_flow_cps_old "Relative flow (FLOW_CPS/MAF_CYL) for additive mass fuel correction" UWORD _CNV_A_R_LINEAR_____37_CM 1 100. 0. 0.99998474 DISPLAY_IDENTIFIER REL_FLOW_CPS_OLD ECU_ADDRESS 0x3fd1bc BYTE_ORDER MSB_LAST FORMAT "%7.5" /end MEASUREMENT
/begin MEASUREMENT rel_flow_cps_old_di "Relative flow (FLOW_CPS/MAF_CYL) for additive mass fuel correction for disabled NORMAL_PURGE operation" UWORD _CNV_A_R_LINEAR_____37_CM 1 100. 0. 0.99998474 DISPLAY_IDENTIFIER REL_FLOW_CPS_OLD_DI ECU_ADDRESS 0x3fd1be BYTE_ORDER MSB_LAST FORMAT "%7.5" /end MEASUREMENT
/begin MEASUREMENT lam_dif_cp "Lambda deviation with active canister purge" SWORD _CNV_A_R_LINEAR_____111_CM 1 100. -50. 49.99847412 DISPLAY_IDENTIFIER LAM_DIF_CP ECU_ADDRESS 0x3fd1b0 BYTE_ORDER MSB_LAST FORMAT "%7.3" /end MEASUREMENT
/begin MEASUREMENT fuel_flow_max_cp "Maximum fuel flow coming from the canister" UWORD _CNV_A_R_LINEAR_____113_CM 1 100. 0. 7.99987793 DISPLAY_IDENTIFIER FUEL_FLOW_MAX_CP ECU_ADDRESS 0x3fd1c0 BYTE_ORDER MSB_LAST FORMAT "%7.4" /end MEASUREMENT
/begin MEASUREMENT fuel_flow_cp "Fuel flow from the ACF" UWORD _CNV_A_R_LINEAR_____113_CM 1 100. 0. 7.99987793 DISPLAY_IDENTIFIER FUEL_FLOW_CP ECU_ADDRESS 0x3fd1c2 BYTE_ORDER MSB_LAST FORMAT "%7.4" /end MEASUREMENT
/begin MEASUREMENT cl "Canister load						" UWORD _CNV_A_R_LINEAR_____122_CM 1 100. 0. 1.999878 DISPLAY_IDENTIFIER CL ECU_ADDRESS 0x3fd1c6 BYTE_ORDER MSB_LAST FORMAT "%6.5" /end MEASUREMENT
/begin MEASUREMENT cl_mmv "Moving mean value of the canister load CL" UWORD _CNV_A_R_LINEAR_____122_CM 1 100. 0. 1.999878 DISPLAY_IDENTIFIER CL_MMV ECU_ADDRESS 0x3fd1aa BYTE_ORDER MSB_LAST FORMAT "%6.5" /end MEASUREMENT
/begin MEASUREMENT cl_mmv_di "Moving mean value of the canister load CL for disabled NORMAL_PURGE operation" UWORD _CNV_A_R_LINEAR_____122_CM 1 100. 0. 1.999878 DISPLAY_IDENTIFIER CL_MMV_DI ECU_ADDRESS 0x3fd1ca BYTE_ORDER MSB_LAST FORMAT "%6.5" /end MEASUREMENT
/begin MEASUREMENT cl_mmv_old "Canister load for additive mass fuel correction calculation" UWORD _CNV_A_R_LINEAR_____122_CM 1 100. 0. 1.999878 DISPLAY_IDENTIFIER CL_MMV_OLD ECU_ADDRESS 0x3fd1cc BYTE_ORDER MSB_LAST FORMAT "%6.5" /end MEASUREMENT
/begin MEASUREMENT cl_mmv_old_di "Canister load for additive mass fuel correction calculation for disabled NORMAL_PURGE operation  " UWORD _CNV_A_R_LINEAR_____123_CM 1 100. 0. 7.99987793 DISPLAY_IDENTIFIER CL_MMV_OLD_DI ECU_ADDRESS 0x3fd1ce BYTE_ORDER MSB_LAST FORMAT "%6.5" /end MEASUREMENT
/begin MEASUREMENT cl_mmv_norm_purge_end "Canister load at the end of NORMAL_PURGE_MAX_PURGE operation" UWORD _CNV_A_R_LINEAR_____122_CM 1 100. 0. 1.999878 DISPLAY_IDENTIFIER CL_MMV_NORM_PURGE_END ECU_ADDRESS 0x3fd1ae BYTE_ORDER MSB_LAST FORMAT "%6.5" /end MEASUREMENT
/begin MEASUREMENT lam_0_cp "Start value of the lambda control correction LAM_CP before the CPS is opened" SWORD _CNV_A_R_LINEAR_____111_CM 1 100. -50. 49.99847412 DISPLAY_IDENTIFIER LAM_0_CP ECU_ADDRESS 0x3fd1e0 BYTE_ORDER MSB_LAST /end MEASUREMENT
/begin MEASUREMENT lam_cp " Lambda control correction value used for canister load calculation" SWORD _CNV_A_R_LINEAR_____111_CM 1 100. -50. 49.99847412 DISPLAY_IDENTIFIER LAM_CP ECU_ADDRESS 0x3fd1ac BYTE_ORDER MSB_LAST /end MEASUREMENT
/begin MEASUREMENT lv_ramp_close_end "Logical value for end of  RAMP_CLOSE operation" UBYTE _CNV_S_2_RANGE______2_CM 1 100. 0. 1. DISPLAY_IDENTIFIER LV_RAMP_CLOSE_END ECU_ADDRESS 0x3fe395 BIT_MASK 0x1 /end MEASUREMENT
/begin MEASUREMENT lv_ramp_open_act "Logical value for active RAMP_OPEN operation" UBYTE _CNV_S_2_RANGE______2_CM 1 100. 0. 1. DISPLAY_IDENTIFIER LV_RAMP_OPEN_ACT ECU_ADDRESS 0x3fe389 BIT_MASK 0x1 /end MEASUREMENT
/begin MEASUREMENT lv_max_purge_act "Logical value for active MAX_PURGE operation" UBYTE _CNV_S_2_RANGE______2_CM 1 100. 0. 1. DISPLAY_IDENTIFIER LV_MAX_PURGE_ACT ECU_ADDRESS 0x3fe388 BIT_MASK 0x1 /end MEASUREMENT
/begin MEASUREMENT fuel_flow_add_ad_cp "Additive adaptive fuel flow from the ACF for the additive mass fuel correction" UWORD _CNV_A_R_LINEAR_____113_CM 1 100. 0. 7.99987793 DISPLAY_IDENTIFIER FUEL_FLOW_ADD_AD_CP ECU_ADDRESS 0x3fd1b2 BYTE_ORDER MSB_LAST FORMAT "%7.4" /end MEASUREMENT
/begin MEASUREMENT t_dly_max_cp "Time counter between the end of a MAX_PURGE and a new learning request" UWORD _CNV_A_R_LINEAR_____24_CM 1 100. 0. 6553.5 DISPLAY_IDENTIFIER T_DLY_MAX_CP ECU_ADDRESS 0x3fd1d4 BYTE_ORDER MSB_LAST FORMAT "%6.1" /end MEASUREMENT
/begin MEASUREMENT fuel_flow_lam_cp "Fuel flow lambda control part from the ACF" SWORD _CNV_A_R_LINEAR_____124_CM 1 100. -4. 3.99987793 DISPLAY_IDENTIFIER FUEL_FLOW_LAM_CP ECU_ADDRESS 0x3fd1de BYTE_ORDER MSB_LAST FORMAT "%6.4" /end MEASUREMENT
/begin MEASUREMENT cl_mmv_dyw_min "Minimum value of the dynamic window during RAMP_OPEN" UWORD _CNV_A_R_LINEAR_____122_CM 1 100. 0. 1.999878 DISPLAY_IDENTIFIER CL_MMV_DYW_MIN ECU_ADDRESS 0x3fd1d0 BYTE_ORDER MSB_LAST FORMAT "%6.4" /end MEASUREMENT
/begin MEASUREMENT cl_mmv_dyw_max "Maximum value of the dynamic window during RAMP_OPEN" UWORD _CNV_A_R_LINEAR_____122_CM 1 100. 0. 1.999878 DISPLAY_IDENTIFIER CL_MMV_DYW_MAX ECU_ADDRESS 0x3fd1d2 BYTE_ORDER MSB_LAST FORMAT "%6.4" /end MEASUREMENT
/begin MEASUREMENT lv_t_ramp_open_end "Time of RAMP_OPEN finished" UBYTE _CNV_S_2_RANGE______2_CM 1 100. 0. 1. DISPLAY_IDENTIFIER LV_T_RAMP_OPEN_END ECU_ADDRESS 0x3fe396 BIT_MASK 0x1 /end MEASUREMENT
/begin MEASUREMENT lv_min_purge_stab_act "MIN_PRGE active without transition" UBYTE _CNV_S_2_RANGE______2_CM 1 100. 0. 1. DISPLAY_IDENTIFIER LV_MIN_PURGE_STAB_ACT ECU_ADDRESS 0x3fe38b BIT_MASK 0x1 /end MEASUREMENT
/begin MEASUREMENT lv_t_dly_req_cp "C_T_DLY_REQ_CP time elapsed" UBYTE _CNV_S_2_RANGE______2_CM 1 100. 0. 1. DISPLAY_IDENTIFIER LV_T_DLY_REQ_CP ECU_ADDRESS 0x3fe38c BIT_MASK 0x1 /end MEASUREMENT
/begin CHARACTERISTIC c_prs_max_2_cps "" VALUE 0xffe40490 _REC_VAL_20_s2 5434. _CNV_A_R_LINEAR_____110_CM -2717.04 2716.96 DISPLAY_IDENTIFIER C_PRS_MAX_2_CPS FORMAT "%8.2" /end CHARACTERISTIC
/begin CHARACTERISTIC c_t_di_ramp_open_cp "" VALUE 0xffe418fa _REC_VAL_20_u2 6553.400000000001 _CNV_A_R_LINEAR_____24_CM 0.1 6553.5 DISPLAY_IDENTIFIER C_T_DI_RAMP_OPEN_CP FORMAT "%6.1" /end CHARACTERISTIC
/begin CHARACTERISTIC c_t_di_max_cp "" VALUE 0xffe418f8 _REC_VAL_20_u2 6553.400000000001 _CNV_A_R_LINEAR_____24_CM 0.1 6553.5 DISPLAY_IDENTIFIER C_T_DI_MAX_CP FORMAT "%6.1" /end CHARACTERISTIC
/begin CHARACTERISTIC c_t_dly_cp "" VALUE 0xffe41902 _REC_VAL_20_u2 6553.400000000001 _CNV_A_R_LINEAR_____24_CM 0.1 6553.5 DISPLAY_IDENTIFIER C_T_DLY_CP FORMAT "%6.1" /end CHARACTERISTIC
/begin CHARACTERISTIC c_t_dly_max_cp "" VALUE 0xffe41920 _REC_VAL_20_u2 6553.5 _CNV_A_R_LINEAR_____24_CM 0. 6553.5 DISPLAY_IDENTIFIER C_T_DLY_MAX_CP FORMAT "%6.1" /end CHARACTERISTIC
/begin CHARACTERISTIC c_fuel_fac_cp "" VALUE 0xffe4166a _REC_VAL_20_u2 255.996094 _CNV_A_R_LINEAR_____125_CM 0. 255.996094 DISPLAY_IDENTIFIER C_FUEL_FAC_CP FORMAT "%7.3" /end CHARACTERISTIC
/begin CHARACTERISTIC c_cl_dyw_max_cp "" VALUE 0xffe4151e _REC_VAL_20_u2 1.99996948 _CNV_A_R_LINEAR_____20_CM 0. 1.99996948 DISPLAY_IDENTIFIER C_CL_DYW_MAX_CP FORMAT "%7.5" /end CHARACTERISTIC
/begin CHARACTERISTIC c_cl_st_cp "" VALUE 0xffe41534 _REC_VAL_20_u2 1.99996948 _CNV_A_R_LINEAR_____20_CM 0. 1.99996948 DISPLAY_IDENTIFIER C_CL_ST_CP FORMAT "%7.5" /end CHARACTERISTIC
/begin CHARACTERISTIC c_lam_dif_max_cp "" VALUE 0xffe40424 _REC_VAL_20_s2 99.99847412 _CNV_A_R_LINEAR_____111_CM -50. 49.99847412 DISPLAY_IDENTIFIER C_LAM_DIF_MAX_CP FORMAT "%7.3" /end CHARACTERISTIC
/begin CHARACTERISTIC c_rel_flow_ini_cps "" VALUE 0xffe41896 _REC_VAL_20_u2 0.999755 _CNV_A_R_LINEAR_____126_CM 0. 0.999755 DISPLAY_IDENTIFIER C_REL_FLOW_INI_CPS FORMAT "%7.5" /end CHARACTERISTIC
/begin CHARACTERISTIC c_t_dly_max_ramp_open "" VALUE 0xffe41924 _REC_VAL_20_u2 655.34 _CNV_A_R_LINEAR_____4_CM 1.e-002 655.35 DISPLAY_IDENTIFIER C_T_DLY_MAX_RAMP_OPEN FORMAT "%5.2" /end CHARACTERISTIC
/begin CHARACTERISTIC c_cl_mmv_dyw "" VALUE 0xffe41526 _REC_VAL_20_u2 1.99996948 _CNV_A_R_LINEAR_____20_CM 0. 1.99996948 DISPLAY_IDENTIFIER C_CL_MMV_DYW FORMAT "%7.5" /end CHARACTERISTIC
/begin CHARACTERISTIC c_flow_min_cps "" VALUE 0xffe4165a _REC_VAL_20_u2 7.99987793 _CNV_A_R_LINEAR_____113_CM 0. 7.99987793 DISPLAY_IDENTIFIER C_FLOW_MIN_CPS FORMAT "%7.4" /end CHARACTERISTIC
/begin CHARACTERISTIC c_dif_max_ti_lam_cp "" VALUE 0xffe403f8 _REC_VAL_20_s2 99.99847412 _CNV_A_R_LINEAR_____111_CM -50. 49.99847412 DISPLAY_IDENTIFIER C_DIF_MAX_TI_LAM_CP FORMAT "%6.2" /end CHARACTERISTIC
/begin CHARACTERISTIC c_dif_min_ti_lam_cp "" VALUE 0xffe403fa _REC_VAL_20_s2 99.99847412 _CNV_A_R_LINEAR_____111_CM -50. 49.99847412 DISPLAY_IDENTIFIER C_DIF_MIN_TI_LAM_CP FORMAT "%6.2" /end CHARACTERISTIC
/begin CHARACTERISTIC c_t_dly_req_cp "" VALUE 0xffe41928 _REC_VAL_20_u2 65534. _CNV_A_R_LINEAR_____30_CM 1. 65535. DISPLAY_IDENTIFIER C_T_DLY_REQ_CP FORMAT "%5.0" /end CHARACTERISTIC
/begin CHARACTERISTIC ip_rel_flow_inc_cp__maf_cyl "Increment value for ramp increase of REL_FLOW_CPS" CURVE 0xffe4e042 _REC_CUR_20_u2_u2 0.99998474 _CNV_A_R_LINEAR_____37_CM 0. 0.99998474 DISPLAY_IDENTIFIER IP_REL_FLOW_INC_CP__MAF_CYL FORMAT "%7.5"
 /begin AXIS_DESCR COM_AXIS maf_cyl _CNV_A_R_LINEAR_____115_CM 6 0. 2047.96875 FORMAT "%6.2" AXIS_PTS_REF ldpm_maf_cyl_ip_rel_flow_inc_cp /end AXIS_DESCR
/end CHARACTERISTIC
/begin CHARACTERISTIC ip_rel_flow_fac_cp__cl "Correction factor for ramp increase of REL_FLOW_CPS" CURVE 0xffe4e02a _REC_CUR_20_u2_u2 4. _CNV_A_R_LINEAR_____127_CM 0. 4. DISPLAY_IDENTIFIER IP_REL_FLOW_FAC_CP__CL FORMAT "%6.4"
 /begin AXIS_DESCR COM_AXIS cl _CNV_A_R_LINEAR_____122_CM 6 0. 1.999878 FORMAT "%6.4" AXIS_PTS_REF ldp_cl_ip_rel_flow_fac_cp /end AXIS_DESCR
/end CHARACTERISTIC
/begin CHARACTERISTIC ip_cl_crlc_ramp_open__maf_cyl "Correlation constant for CL-filter during RAMP_OPEN" CURVE 0xffe490b4 _REC_CUR_20_u2_u2 0.99998474 _CNV_A_R_LINEAR_____37_CM 0. 0.99998474 DISPLAY_IDENTIFIER IP_CL_CRLC_RAMP_OPEN__MAF_CYL FORMAT "%7.5"
 /begin AXIS_DESCR COM_AXIS maf_cyl _CNV_A_R_LINEAR_____115_CM 6 0. 2047.96875 FORMAT "%6.2" AXIS_PTS_REF ldpm_maf_cyl_ip_rel_flow_inc_cp /end AXIS_DESCR
/end CHARACTERISTIC
/begin CHARACTERISTIC ip_cl_crlc_open_fast__maf_cyl "Correlation constant for CL-filter during RAMP_OPEN_FAST" CURVE 0xffe490a8 _REC_CUR_20_u2_u2 0.99998474 _CNV_A_R_LINEAR_____37_CM 0. 0.99998474 DISPLAY_IDENTIFIER IP_CL_CRLC_OPEN_FAST__MAF_CYL FORMAT "%7.5"
 /begin AXIS_DESCR COM_AXIS maf_cyl _CNV_A_R_LINEAR_____115_CM 6 0. 2047.96875 FORMAT "%6.2" AXIS_PTS_REF ldpm_maf_cyl_ip_rel_flow_inc_cp /end AXIS_DESCR
/end CHARACTERISTIC
/begin CHARACTERISTIC ip_cl_crlc__maf_cyl "Correlation constant for CL-filter out of RAMP_OPEN" CURVE 0xffe4909c _REC_CUR_20_u2_u2 0.99998474 _CNV_A_R_LINEAR_____37_CM 0. 0.99998474 DISPLAY_IDENTIFIER IP_CL_CRLC__MAF_CYL FORMAT "%7.5"
 /begin AXIS_DESCR COM_AXIS maf_cyl _CNV_A_R_LINEAR_____115_CM 6 0. 2047.96875 FORMAT "%6.2" AXIS_PTS_REF ldpm_maf_cyl_ip_rel_flow_inc_cp /end AXIS_DESCR
/end CHARACTERISTIC
/begin CHARACTERISTIC ip_rel_flow_dec_cp__maf_cyl "Decrement value for ramp decrease of REL_FLOW_CPS" CURVE 0xffe4e006 _REC_CUR_20_u2_u2 0.99998474 _CNV_A_R_LINEAR_____37_CM 0. 0.99998474 DISPLAY_IDENTIFIER IP_REL_FLOW_DEC_CP__MAF_CYL FORMAT "%7.5"
 /begin AXIS_DESCR COM_AXIS maf_cyl _CNV_A_R_LINEAR_____115_CM 6 0. 2047.96875 FORMAT "%6.2" AXIS_PTS_REF ldpm_maf_cyl_ip_rel_flow_inc_cp /end AXIS_DESCR
/end CHARACTERISTIC
/begin CHARACTERISTIC ip_rel_flow_max_cps__n_32__maf "Maximum limit for REL_FLOW_CPS value" MAP 0xffe4e04e _REC_MAP_20_u2_u1_u1 0.99998474 _CNV_A_R_LINEAR_____37_CM 0. 0.99998474 DISPLAY_IDENTIFIER IP_REL_FLOW_MAX_CPS__N_32__MAF FORMAT "%7.5"
 /begin AXIS_DESCR COM_AXIS n_32 _CNV_A_R_LINEAR_____15_CM 12 0. 8160. FORMAT "%4.0" AXIS_PTS_REF ldpm_n_32_ip_rel_flow_max_cps /end AXIS_DESCR
 /begin AXIS_DESCR COM_AXIS maf _CNV_A_R_LINEAR_____27_CM 12 0. 1389. FORMAT "%4.0" AXIS_PTS_REF ldpm_maf_ip_rel_flow_max_cps /end AXIS_DESCR
/end CHARACTERISTIC
/begin CHARACTERISTIC ip_rel_flow_min_cps__n_32__maf "Map for REL_FLOW_CPS  during MIN_PURGE operation" MAP 0xffe4e28e _REC_MAP_20_u2_u1_u1 0.99998474 _CNV_A_R_LINEAR_____37_CM 0. 0.99998474 DISPLAY_IDENTIFIER IP_REL_FLOW_MIN_CPS__N_32__MAF FORMAT "%7.5"
 /begin AXIS_DESCR COM_AXIS n_32 _CNV_A_R_LINEAR_____15_CM 12 0. 8160. FORMAT "%4.0" AXIS_PTS_REF ldpm_n_32_ip_rel_flow_max_cps /end AXIS_DESCR
 /begin AXIS_DESCR COM_AXIS maf _CNV_A_R_LINEAR_____27_CM 12 0. 1389. FORMAT "%4.0" AXIS_PTS_REF ldpm_maf_ip_rel_flow_max_cps /end AXIS_DESCR
/end CHARACTERISTIC
/begin CHARACTERISTIC ip_rel_flow_inc_2_cp__maf_cyl "REL_FLOW_CPS increment value in RAMP_OPEN_FAST" CURVE 0xffe4e036 _REC_CUR_20_u2_u2 0.99998474 _CNV_A_R_LINEAR_____37_CM 0. 0.99998474 DISPLAY_IDENTIFIER IP_REL_FLOW_INC_2_CP__MAF_CYL FORMAT "%7.5"
 /begin AXIS_DESCR COM_AXIS maf_cyl _CNV_A_R_LINEAR_____115_CM 6 0. 2047.96875 FORMAT "%6.2" AXIS_PTS_REF ldpm_maf_cyl_ip_rel_flow_inc_cp /end AXIS_DESCR
/end CHARACTERISTIC
/begin CHARACTERISTIC ip_rel_flow_dec_v1_cp__maf_cyl "REL_FLOW_CPS decrement value ( high speed )" CURVE 0xffe4e012 _REC_CUR_20_u2_u2 0.99998474 _CNV_A_R_LINEAR_____37_CM 0. 0.99998474 DISPLAY_IDENTIFIER IP_REL_FLOW_DEC_V1_CP__MAF_CYL FORMAT "%7.5"
 /begin AXIS_DESCR COM_AXIS maf_cyl _CNV_A_R_LINEAR_____115_CM 6 0. 2047.96875 FORMAT "%6.2" AXIS_PTS_REF ldpm_maf_cyl_ip_rel_flow_inc_cp /end AXIS_DESCR
/end CHARACTERISTIC
/begin CHARACTERISTIC ip_rel_flow_dec_v2_cp__maf_cyl "REL_FLOW_CPS decrement value ( middle speed )" CURVE 0xffe4e01e _REC_CUR_20_u2_u2 0.99998474 _CNV_A_R_LINEAR_____37_CM 0. 0.99998474 DISPLAY_IDENTIFIER IP_REL_FLOW_DEC_V2_CP__MAF_CYL FORMAT "%7.5"
 /begin AXIS_DESCR COM_AXIS maf_cyl _CNV_A_R_LINEAR_____115_CM 6 0. 2047.96875 FORMAT "%6.2" AXIS_PTS_REF ldpm_maf_cyl_ip_rel_flow_inc_cp /end AXIS_DESCR
/end CHARACTERISTIC
/begin CHARACTERISTIC ip_t_dly_cl_mmv_dyw__maf_cyl "Stabilization delay on CL_MMV vale during RAMP_OPEN" CURVE 0xffe4e852 _REC_CUR_20_u2_u2 655.34 _CNV_A_R_LINEAR_____4_CM 1.e-002 655.35 DISPLAY_IDENTIFIER IP_T_DLY_CL_MMV_DYW__MAF_CYL FORMAT "%5.2"
 /begin AXIS_DESCR COM_AXIS maf_cyl _CNV_A_R_LINEAR_____115_CM 6 0. 2047.96875 FORMAT "%6.2" AXIS_PTS_REF ldpm_maf_cyl_ip_rel_flow_inc_cp /end AXIS_DESCR
/end CHARACTERISTIC
/begin CHARACTERISTIC ip_nr_step_cl__cl_mmv "Number of step to change of correlation factor value" CURVE 0xffe41c8e _REC_CUR_20_u2_u2 0.999755 _CNV_A_R_LINEAR_____126_CM 0. 0.999755 DISPLAY_IDENTIFIER IP_NR_STEP_CL__CL_MMV FORMAT "%7.5"
 /begin AXIS_DESCR COM_AXIS maf _CNV_A_R_LINEAR_____20_CM 3 0. 1.99996948 FORMAT "%7.5" AXIS_PTS_REF ldpm_cl_mmv_ip_nr_step_cl /end AXIS_DESCR
/end CHARACTERISTIC
/begin CHARACTERISTIC ip_cl_crlc_init__cl_mmv "Initialization value for correlation factor value" CURVE 0xffe41c1e _REC_CUR_20_u2_u2 0.999755 _CNV_A_R_LINEAR_____126_CM 0. 0.999755 DISPLAY_IDENTIFIER IP_CL_CRLC_INIT__CL_MMV FORMAT "%7.5"
 /begin AXIS_DESCR COM_AXIS maf _CNV_A_R_LINEAR_____20_CM 3 0. 1.99996948 FORMAT "%7.5" AXIS_PTS_REF ldpm_cl_mmv_ip_nr_step_cl /end AXIS_DESCR
/end CHARACTERISTIC
/begin MEASUREMENT lam_adj_cp "Correction value for TI_LAM correction during RAMP_OPEN operation" SWORD _CNV_A_R_LINEAR_____111_CM 1 100. -50. 49.99847412 DISPLAY_IDENTIFIER LAM_ADJ_CP ECU_ADDRESS 0x3fd1b6 BYTE_ORDER MSB_LAST /end MEASUREMENT
/begin MEASUREMENT lv_lam_adj_cp "Logical value for TI_LAM_COR correction during RAMP_OPEN operation" UBYTE _CNV_S_2_RANGE______21_CM 1 100. 0. 1. DISPLAY_IDENTIFIER LV_LAM_ADJ_CP ECU_ADDRESS 0x3fe38d BIT_MASK 0x1 /end MEASUREMENT
/begin CHARACTERISTIC ip_rel_fuel_flow_max_cp_cor "Correction factor for FUEL_FLOW_MAX_CP" CURVE 0xffe40dd5 _REC_CUR_20_u1_u1 0.9960940000000002 _CNV_A_R_LINEAR_____128_CM 0. 0.996094 DISPLAY_IDENTIFIER IP_REL_FUEL_FLOW_MAX_CP_COR FORMAT "%5.3"
 /begin AXIS_DESCR COM_AXIS tco _CNV_A_R_LINEAR_____11_CM 5 -48. 142.5 FORMAT "%5.1" AXIS_PTS_REF ldp_tco_ip_rel_fuel_max_cp_cor /end AXIS_DESCR
/end CHARACTERISTIC
/begin AXIS_PTS ldp_cl_ip_rel_flow_fac_cp "" 0xffe50a7e cl _REC_AXS_20_u2 1.999878 _CNV_A_R_LINEAR_____122_CM 6 0. 1.999878 DISPLAY_IDENTIFIER LDP_CL_IP_REL_FLOW_FAC_CP FORMAT "%6.4" /end AXIS_PTS
/begin AXIS_PTS ldpm_maf_ip_rel_flow_max_cps "" 0xffe4842f maf _REC_AXS_20_u1 1389. _CNV_A_R_LINEAR_____27_CM 12 0. 1389. DISPLAY_IDENTIFIER LDPM_MAF_IP_REL_FLOW_MAX_CPS FORMAT "%4.0" /end AXIS_PTS
/begin AXIS_PTS ldpm_cl_mmv_ip_nr_step_cl "" 0xffe41d22 maf _REC_AXS_20_u2 1.99996948 _CNV_A_R_LINEAR_____20_CM 3 0. 1.99996948 DISPLAY_IDENTIFIER LDPM_CL_MMV_IP_NR_STEP_CL FORMAT "%7.5" /end AXIS_PTS
/begin AXIS_PTS ldp_tco_ip_rel_fuel_max_cp_cor "" 0xffe41213 tco _REC_AXS_20_u1 190.5 _CNV_A_R_LINEAR_____11_CM 5 -48. 142.5 DISPLAY_IDENTIFIER LDP_TCO_IP_REL_FUEL_MAX_CP_COR FORMAT "%5.1" /end AXIS_PTS
/begin MEASUREMENT lv_tra_lam_cp "First lambda control shift during RAMP_OPEN" UBYTE _CNV_S_2_RANGE______2_CM 1 100. 0. 1. DISPLAY_IDENTIFIER LV_TRA_LAM_CP ECU_ADDRESS 0x3fe394 BIT_MASK 0x1 /end MEASUREMENT
/begin CHARACTERISTIC c_cl_max_cp "" VALUE 0xffe41522 _REC_VAL_20_u2 1.99996948 _CNV_A_R_LINEAR_____20_CM 0. 1.99996948 DISPLAY_IDENTIFIER C_CL_MAX_CP FORMAT "%7.5" /end CHARACTERISTIC
/begin CHARACTERISTIC c_cl_cat_diag "" VALUE 0xffe4151a _REC_VAL_20_u2 1.99996948 _CNV_A_R_LINEAR_____20_CM 0. 1.99996948 DISPLAY_IDENTIFIER C_CL_CAT_DIAG FORMAT "%7.5" /end CHARACTERISTIC
/begin MEASUREMENT lv_cl_calc_avl "" UBYTE _CNV_S_2_RANGE______2_CM 1 100. 0. 1. DISPLAY_IDENTIFIER LV_CL_CALC_AVL ECU_ADDRESS 0x3fe38f BIT_MASK 0x1 /end MEASUREMENT
/begin CHARACTERISTIC lc_lam_cbk_cps "Lambda controller selection (0 -> bank 0 , 1->bank1)" VALUE 0xffe40f91 _REC_VAL_20_u1 1. _CNV_S_2_RANGE______21_CM 0. 1. DISPLAY_IDENTIFIER LC_LAM_CBK_CPS /end CHARACTERISTIC
/begin CHARACTERISTIC lc_lam_0_cp_ini_cp "init of lam_0_cp" VALUE 0xffe40f90 _REC_VAL_20_u1 1. _CNV_S_2_RANGE______21_CM 0. 1. DISPLAY_IDENTIFIER LC_LAM_0_CP_INI_CP /end CHARACTERISTIC
/begin CHARACTERISTIC lc_init_cl_crlc "Correlation factor calculation in case of  NO_PURGE ->MAX_PURGE Transition" VALUE 0xffe40f8a _REC_VAL_20_u1 1. _CNV_S_2_RANGE______21_CM 0. 1. DISPLAY_IDENTIFIER LC_INIT_CL_CRLC /end CHARACTERISTIC
/begin CHARACTERISTIC lc_mod_sel_cp_min "" VALUE 0xffe40fad _REC_VAL_20_u1 1. _CNV_S_2_RANGE______21_CM 0. 1. DISPLAY_IDENTIFIER LC_MOD_SEL_CP_MIN /end CHARACTERISTIC
/begin MEASUREMENT lv_cl_mmv "LV indicating canister load available" UBYTE _CNV_S_2_RANGE______2_CM 1 100. 0. 1. DISPLAY_IDENTIFIER LV_CL_MMV ECU_ADDRESS 0x3fe391 BIT_MASK 0x1 /end MEASUREMENT
/begin MEASUREMENT fac_cor_cp_flow "Factor MIN purge for vehicle variant without CAT" UBYTE _CNV_A_R_LINEAR_____129_CM 1 100. 0. 3.984375 DISPLAY_IDENTIFIER FAC_COR_CP_FLOW ECU_ADDRESS 0x3fe3a1 FORMAT "%4.2" /end MEASUREMENT
/begin MEASUREMENT t_dly_cp_lamb_ch "Delay time after LAMB_CH has finished to enable NO_PURGE" UBYTE _CNV_A_R_LINEAR_____24_CM 1 100. 0. 25.5 DISPLAY_IDENTIFIER T_DLY_CP_LAMB_CH ECU_ADDRESS 0x3fe3a6 FORMAT "%4.1" /end MEASUREMENT
/begin CHARACTERISTIC c_t_dly_cp_lamb_ch "Calibrateable delay time after LAMB_CH has finished to enabe NO_PURGE" VALUE 0xffe40876 _REC_VAL_20_u1 25.5 _CNV_A_R_LINEAR_____24_CM 0. 25.5 DISPLAY_IDENTIFIER C_T_DLY_CP_LAMB_CH FORMAT "%4.1" /end CHARACTERISTIC
/begin MEASUREMENT temp_mmv_sub_cat_ecf "Calculated cat. temperature substitute value" UBYTE _CNV_A_R_LINEAR_____178_CM 1 100. -33. 987. DISPLAY_IDENTIFIER TEMP_MMV_SUB_CAT_ECF ECU_ADDRESS 0x3fe8fa FORMAT "%3.0" /end MEASUREMENT
/begin MEASUREMENT temp_mmv_sub_cat_ecf_stop "Calculated cat. temperature substitute value at engine stop" UBYTE _CNV_A_R_LINEAR_____178_CM 1 100. -33. 987. DISPLAY_IDENTIFIER TEMP_MMV_SUB_CAT_ECF_STOP ECU_ADDRESS 0x3fe8fc FORMAT "%3.0" /end MEASUREMENT
/begin MEASUREMENT ecfpwm_ecf "Electric fan control pulse width modulation" UBYTE _CNV_A_R_LINEAR_____9_CM 1 100. 0. 99.609375 DISPLAY_IDENTIFIER ECFPWM_ECF ECU_ADDRESS 0x3fe8fb FORMAT "%5.1" /end MEASUREMENT
/begin MEASUREMENT n_ecf_min_hys "Hysteresis of set point Electric fan seed stage" UBYTE _CNV_A_R_LINEAR_____46_CM 1 100. 0. 15.9375 DISPLAY_IDENTIFIER N_ECF_MIN_HYS ECU_ADDRESS 0x3fe900 /end MEASUREMENT
/begin MEASUREMENT n_ecf_cor "Set point Electric fan seed stage" UBYTE _CNV_A_R_LINEAR_____46_CM 1 100. 0. 15.9375 DISPLAY_IDENTIFIER N_ECF_COR ECU_ADDRESS 0x3fe8fe /end MEASUREMENT
/begin MEASUREMENT n_perc "Percentage filtered value of set point Electric fan seed stage" UBYTE _CNV_A_R_LINEAR_____9_CM 1 100. 0. 99.609375 DISPLAY_IDENTIFIER N_PERC ECU_ADDRESS 0x3fe8ff FORMAT "%5.1" /end MEASUREMENT
/begin MEASUREMENT ecfpwm_igk_off "Electric fan pulse width modulation in the self-holding phase" UBYTE _CNV_A_R_LINEAR_____9_CM 1 100. 0. 99.609375 DISPLAY_IDENTIFIER ECFPWM_IGK_OFF ECU_ADDRESS 0x3fe902 FORMAT "%5.1" /end MEASUREMENT
/begin CHARACTERISTIC id_ecfpwm_igk_off__temp_cat "Map of Electric fan pulse width modulation in the self-holding phase" CURVE 0xffe40a29 _REC_CUR_20_u1_u1 99.609375 _CNV_A_R_LINEAR_____9_CM 0. 99.609375 DISPLAY_IDENTIFIER ID_ECFPWM_IGK_OFF__TEMP_CAT_ FORMAT "%5.1"
 /begin AXIS_DESCR COM_AXIS temp_mmv_sub_cat_ecf _CNV_A_R_LINEAR_____178_CM 6 -33. 987. FORMAT "%3.0" AXIS_PTS_REF ldpm_temp_mmv_sub_cat_ecf_1 /end AXIS_DESCR
/end CHARACTERISTIC
/begin CHARACTERISTIC ip_n_ecf_temp_cat "Electric fan minimum speed stage cat temperature" CURVE 0xffe40d44 _REC_CUR_20_u1_u1 15.9375 _CNV_A_R_LINEAR_____46_CM 0. 15.9375 DISPLAY_IDENTIFIER IP_N_ECF_TEMP_CAT_ FORMAT "%5.2"
 /begin AXIS_DESCR COM_AXIS temp_mmv_sub_cat_ecf _CNV_A_R_LINEAR_____178_CM 6 -33. 987. FORMAT "%3.0" AXIS_PTS_REF ldpm_temp_mmv_sub_cat_ecf_1 /end AXIS_DESCR
/end CHARACTERISTIC
/begin CHARACTERISTIC id_n_ecf_min_accin "Electric fan minimum speed stage CAN" CURVE 0xffe44174 _REC_CUR_20_u1_u1 15.9375 _CNV_A_R_LINEAR_____46_CM 0. 15.9375 DISPLAY_IDENTIFIER ID_N_ECF_MIN_ACCIN_ FORMAT "%5.2"
 /begin AXIS_DESCR COM_AXIS n_ecf _CNV_A_R_LINEAR_____0_CM 16 0. 15. FORMAT "%2.0" AXIS_PTS_REF ldp_n_ecf__n_ecf_min_accin /end AXIS_DESCR
/end CHARACTERISTIC
/begin CHARACTERISTIC ip_temp_sub_ecf_ini "Cat substitute temperature initialization map" MAP 0xffe47a5f _REC_MAP_20_u1_u1_u1 1020. _CNV_A_R_LINEAR_____178_CM -33. 987. DISPLAY_IDENTIFIER IP_TEMP_SUB_ECF_INI_ FORMAT "%3.0"
 /begin AXIS_DESCR COM_AXIS tam _CNV_A_R_LINEAR_____11_CM 6 -48. 142.5 FORMAT "%5.1" AXIS_PTS_REF ldp_tam__temp_sub_ecf_ini /end AXIS_DESCR
 /begin AXIS_DESCR COM_AXIS tco _CNV_A_R_LINEAR_____11_CM 6 -48. 142.5 FORMAT "%5.1" AXIS_PTS_REF ldp_tco__temp_sub_ecf_ini /end AXIS_DESCR
/end CHARACTERISTIC
/begin CHARACTERISTIC ip_n_perc_ecf "Electric fan control pulse width modulation" CURVE 0xffe40d69 _REC_CUR_20_u1_u1 99.609375 _CNV_A_R_LINEAR_____9_CM 0. 99.609375 DISPLAY_IDENTIFIER IP_N_PERC_ECF_ FORMAT "%4.1"
 /begin AXIS_DESCR COM_AXIS n_ecf_cor_fil _CNV_A_R_LINEAR_____46_CM 6 0. 15.9375 FORMAT "%5.2" AXIS_PTS_REF ldp_n_ecf_cor_fil__n_perc_ecf /end AXIS_DESCR
/end CHARACTERISTIC
/begin CHARACTERISTIC c_tco_hys_cat "TCO hysteresis" VALUE 0xffe40902 _REC_VAL_20_u1 60. _CNV_A_R_LINEAR_____12_CM 0. 60. DISPLAY_IDENTIFIER C_TCO_HYS_CAT FORMAT "%4.1" /end CHARACTERISTIC
/begin CHARACTERISTIC c_crlc_inc_cat_ecf "CRLC for substitute temperature on cat warming up" VALUE 0xffe41552 _REC_VAL_20_u2 0.99998474 _CNV_A_R_LINEAR_____37_CM 0. 0.99998474 DISPLAY_IDENTIFIER C_CRLC_INC_CAT_ECF_ FORMAT "%7.5" /end CHARACTERISTIC
/begin CHARACTERISTIC c_crlc_dec_cat_ecf "CRLC for substitute temperature on cat cooling down" VALUE 0xffe4153e _REC_VAL_20_u2 0.99998474 _CNV_A_R_LINEAR_____37_CM 0. 0.99998474 DISPLAY_IDENTIFIER C_CRLC_DEC_CAT_ECF_ FORMAT "%7.5" /end CHARACTERISTIC
/begin CHARACTERISTIC c_n_ecf_hys "Electric fan speed hysteresis" VALUE 0xffe407dd _REC_VAL_20_u1 15.9375 _CNV_A_R_LINEAR_____46_CM 0. 15.9375 DISPLAY_IDENTIFIER C_N_ECF_HYS FORMAT "%5.2" /end CHARACTERISTIC
/begin CHARACTERISTIC c_n_perc_ecf_lgrd "Limitation gradient of C_N_PERC_ECF_LGRD" VALUE 0xffe407fc _REC_VAL_20_u1 25. _CNV_A_R_LINEAR_____179_CM 0. 25. DISPLAY_IDENTIFIER C_N_PERC_ECF_LGRD FORMAT "%5.2" /end CHARACTERISTIC
/begin CHARACTERISTIC c_t_n_perc_ecf_as "Application correction" VALUE 0xffe408be _REC_VAL_20_u1 99.60939999999999 _CNV_A_R_LINEAR_____19_CM -50. 49.6094 DISPLAY_IDENTIFIER C_T_N_PERC_ECF_AS FORMAT "%5.1" /end CHARACTERISTIC
/begin CHARACTERISTIC c_t_n_perc_ecf_act "Time condition for electric fan during self diagnostic" VALUE 0xffe408bd _REC_VAL_20_u1 50.8 _CNV_A_R_LINEAR_____180_CM 0.2 51. DISPLAY_IDENTIFIER C_T_N_PERC_ECF_ACT FORMAT "%4.1" /end CHARACTERISTIC
/begin CHARACTERISTIC c_t_n_ecf_ast "Time condition after start for electric fan active" VALUE 0xffe408bc _REC_VAL_20_u1 50.8 _CNV_A_R_LINEAR_____180_CM 0.2 51. DISPLAY_IDENTIFIER C_T_N_ECF_AST FORMAT "%4.1" /end CHARACTERISTIC
/begin CHARACTERISTIC c_ecfpwm_max "Upper ECFPWM_ECF limitation" VALUE 0xffe40718 _REC_VAL_20_u1 99.609375 _CNV_A_R_LINEAR_____9_CM 0. 99.609375 DISPLAY_IDENTIFIER C_ECFPWM_MAX FORMAT "%4.1" /end CHARACTERISTIC
/begin CHARACTERISTIC c_n_perc_act_ecf "Set value for N_PERC_ECF" VALUE 0xffe407fb _REC_VAL_20_u1 99.609375 _CNV_A_R_LINEAR_____9_CM 0. 99.609375 DISPLAY_IDENTIFIER C_N_PERC_ACT_ECF FORMAT "%4.1" /end CHARACTERISTIC
/begin CHARACTERISTIC c_ecfpwm_act_ecf "Min limitation ECFPWM_ECF from speed stage C_N_PERC_ACT_ECF" VALUE 0xffe40716 _REC_VAL_20_u1 99.609375 _CNV_A_R_LINEAR_____9_CM 0. 99.609375 DISPLAY_IDENTIFIER C_ECFPWM_ACT_ECF FORMAT "%4.1" /end CHARACTERISTIC
/begin CHARACTERISTIC c_tco_ex_max_vs_hys "hysteresis of temperature threshold" VALUE 0xffe408fd _REC_VAL_20_u1 190.5 _CNV_A_R_LINEAR_____11_CM -48. 142.5 DISPLAY_IDENTIFIER C_TCO_EX_MAX_VS_HYS FORMAT "%5.1" /end CHARACTERISTIC
/begin CHARACTERISTIC c_tco_ex_max_vs "threshold for coolant temperature" VALUE 0xffe408fc _REC_VAL_20_u1 190.5 _CNV_A_R_LINEAR_____11_CM -48. 142.5 DISPLAY_IDENTIFIER C_TCO_EX_MAX_VS FORMAT "%5.1" /end CHARACTERISTIC
/begin CHARACTERISTIC ip_n_ecf "Electric fan speed stage" CURVE 0xffe40d3e _REC_CUR_20_u1_u1 15.9375 _CNV_A_R_LINEAR_____46_CM 0. 15.9375 DISPLAY_IDENTIFIER IP_N_ECF FORMAT "%5.2"
 /begin AXIS_DESCR COM_AXIS tco_ex _CNV_A_R_LINEAR_____11_CM 6 -48. 142.5 FORMAT "%5.1" AXIS_PTS_REF ldp_tco_ex__n_ecf /end AXIS_DESCR
/end CHARACTERISTIC
/begin CHARACTERISTIC c_vb_ecf_grd_max "VB gradient for VB filtering" VALUE 0xffe409b2 _REC_VAL_20_u1 26. _CNV_A_R_LINEAR_____60_CM 0. 26. DISPLAY_IDENTIFIER C_VB_ECF_GRD_MAX FORMAT "%4.1" /end CHARACTERISTIC
/begin CHARACTERISTIC c_vb_ecf "Refernce VB (1.2* nominal voltage)" VALUE 0xffe409b1 _REC_VAL_20_u1 26. _CNV_A_R_LINEAR_____60_CM 0. 26. DISPLAY_IDENTIFIER C_VB_ECF FORMAT "%4.1" /end CHARACTERISTIC
/begin CHARACTERISTIC ip_n_ecf_vs_cor "Speed correction of electric fan speed" CURVE 0xffe40d50 _REC_CUR_20_u1_u1 0.9960940000000002 _CNV_A_R_LINEAR_____50_CM 0. 0.996094 DISPLAY_IDENTIFIER IP_N_ECF_VS_COR_ FORMAT "%5.3"
 /begin AXIS_DESCR COM_AXIS vs _CNV_A_R_LINEAR_____23_CM 5 0. 255. FORMAT "%3.0" AXIS_PTS_REF ldp_vs__n_ecf_vs_cor /end AXIS_DESCR
/end CHARACTERISTIC
/begin CHARACTERISTIC ip_n_ecf_temp_gb "Electric fan speed stage depending on gear box temperature" CURVE 0xffe40d4a _REC_CUR_20_u1_u1 15.9375 _CNV_A_R_LINEAR_____46_CM 0. 15.9375 DISPLAY_IDENTIFIER IP_N_ECF_TEMP_GB FORMAT "%5.2"
 /begin AXIS_DESCR COM_AXIS temp_gb _CNV_A_R_LINEAR_____14_CM 6 -40. 215. FORMAT "%3.0" AXIS_PTS_REF ldp_temp_gb__n_ecf_temp_gb /end AXIS_DESCR
/end CHARACTERISTIC
/begin MEASUREMENT n_ecf_cor_fil "Filter value of set point Electric fan seed stage" UBYTE _CNV_A_R_LINEAR_____46_CM 1 100. 0. 15.9375 DISPLAY_IDENTIFIER N_ECF_COR_FIL ECU_ADDRESS 0x3fe901 /end MEASUREMENT
/begin MEASUREMENT n_ecf_temp_gb_max "Value of set point Electric fan seed stage in case of additional cooling request by EGS" UBYTE _CNV_A_R_LINEAR_____46_CM 1 100. 0. 15.9375 DISPLAY_IDENTIFIER N_ECF_TEMP_GB_MAX ECU_ADDRESS 0x3fe8fd /end MEASUREMENT
/begin CHARACTERISTIC c_toil_hys_cat "TOIL hysteresis" VALUE 0xffe4096f _REC_VAL_20_u1 80. _CNV_A_R_LINEAR_____13_CM 0. 80. DISPLAY_IDENTIFIER C_TOIL_HYS_CAT FORMAT "%4.1" /end CHARACTERISTIC
/begin CHARACTERISTIC c_n_ecf_temp_gb_max "Value of setpoint electric fan stage in case of additional cooling request by EGS" VALUE 0xffe407de _REC_VAL_20_u1 15.9375 _CNV_A_R_LINEAR_____46_CM 0. 15.9375 DISPLAY_IDENTIFIER C_N_ECF_TEMP_GB_MAX FORMAT "%5.2" /end CHARACTERISTIC
/begin AXIS_PTS ldp_n_ecf__n_ecf_min_accin "" 0xffe4812d n_ecf _REC_AXS_20_u1 15. _CNV_A_R_LINEAR_____0_CM 16 0. 15. DISPLAY_IDENTIFIER LDP_N_ECF__N_ECF_MIN_ACCIN FORMAT "%2.0" /end AXIS_PTS
/begin AXIS_PTS ldp_tco__temp_sub_ecf_ini "" 0xffe411f3 tco _REC_AXS_20_u1 190.5 _CNV_A_R_LINEAR_____11_CM 6 -48. 142.5 DISPLAY_IDENTIFIER LDP_TCO__TEMP_SUB_ECF_INI FORMAT "%5.1" /end AXIS_PTS
/begin AXIS_PTS ldp_n_ecf_cor_fil__n_perc_ecf "" 0xffe4112e n_ecf_cor_fil _REC_AXS_20_u1 15.9375 _CNV_A_R_LINEAR_____46_CM 6 0. 15.9375 DISPLAY_IDENTIFIER LDP_N_ECF_COR_FIL__N_PERC_ECF FORMAT "%5.2" /end AXIS_PTS
/begin AXIS_PTS ldp_tco_ex__n_ecf "" 0xffe4120c tco_ex _REC_AXS_20_u1 190.5 _CNV_A_R_LINEAR_____11_CM 6 -48. 142.5 DISPLAY_IDENTIFIER LDP_TCO_EX__N_ECF FORMAT "%5.1" /end AXIS_PTS
/begin AXIS_PTS ldp_tam__temp_sub_ecf_ini "" 0xffe411a4 tam _REC_AXS_20_u1 190.5 _CNV_A_R_LINEAR_____11_CM 6 -48. 142.5 DISPLAY_IDENTIFIER LDP_TAM__TEMP_SUB_ECF_INI FORMAT "%5.1" /end AXIS_PTS
/begin AXIS_PTS ldpm_temp_mmv_sub_cat_ecf_1 "" 0xffe4146c temp_mmv_sub_cat_ecf _REC_AXS_20_u1 1020. _CNV_A_R_LINEAR_____178_CM 6 -33. 987. DISPLAY_IDENTIFIER LDPM_TEMP_MMV_SUB_CAT_ECF_1 FORMAT "%3.0" /end AXIS_PTS
/begin AXIS_PTS ldp_vs__n_ecf_vs_cor "" 0xffe41300 vs _REC_AXS_20_u1 255. _CNV_A_R_LINEAR_____23_CM 5 0. 255. DISPLAY_IDENTIFIER LDP_VS__N_ECF_VS_COR FORMAT "%3.0" /end AXIS_PTS
/begin AXIS_PTS ldp_temp_gb__n_ecf_temp_gb "" 0xffe4125c temp_gb _REC_AXS_20_u1 255. _CNV_A_R_LINEAR_____14_CM 6 -40. 215. DISPLAY_IDENTIFIER LDP_TEMP_GB__N_ECF_TEMP_GB FORMAT "%3.0" /end AXIS_PTS
/begin CHARACTERISTIC c_ecfpwm_min "Lower ECFPWM_ECF limitation" VALUE 0xffe40719 _REC_VAL_20_u1 99.609375 _CNV_A_R_LINEAR_____9_CM 0. 99.609375 DISPLAY_IDENTIFIER C_ECFPWM_MIN FORMAT "%4.1" /end CHARACTERISTIC
/begin CHARACTERISTIC c_ecfpwm_ecf_man "Manual ECFPWM_ECF" VALUE 0xffe40717 _REC_VAL_20_u1 99.609375 _CNV_A_R_LINEAR_____9_CM 0. 99.609375 DISPLAY_IDENTIFIER C_ECFPWM_ECF_MAN FORMAT "%4.1" /end CHARACTERISTIC
/begin CHARACTERISTIC lc_ecfpwm_ecf_man "constant switch to manual ECFPWM_ECF activation" VALUE 0xffe40f50 _REC_VAL_20_u1 1. _CNV_A_R_LINEAR_____0_CM 0. 1. DISPLAY_IDENTIFIER LC_ECFPWM_ECF_MAN FORMAT "%2.0" /end CHARACTERISTIC
/begin CHARACTERISTIC lc_ecfpwm_ecf_vb_cor_di "constant to switch off VB_ECF-correction in case of \"intelligent\" ECF" VALUE 0xffe40f51 _REC_VAL_20_u1 1. _CNV_A_R_LINEAR_____0_CM 0. 1. DISPLAY_IDENTIFIER LC_ECFPWM_ECF_VB_COR_DI FORMAT "%2.0" /end CHARACTERISTIC
/begin MEASUREMENT t_dly_efp "Timer for delays in EFP" UWORD _CNV_A_R_LINEAR_____4_CM 1 100. 0. 655.35 DISPLAY_IDENTIFIER T_DLY_EFP ECU_ADDRESS 0x3fda82 BYTE_ORDER MSB_LAST FORMAT "%6.2" /end MEASUREMENT
/begin MEASUREMENT state_efp "States of electrical fuel pump function" UBYTE _CNV_S_6_RANGE_STAT_182_CM 1 100. 0. 5. DISPLAY_IDENTIFIER STATE_EFP ECU_ADDRESS 0x3fe928 /end MEASUREMENT
/begin CHARACTERISTIC c_vb_efp_ref "Reference battery voltage for EFP control" VALUE 0xffe409b3 _REC_VAL_20_u1 25.8984 _CNV_A_R_LINEAR_____34_CM 0. 25.8984 DISPLAY_IDENTIFIER C_VB_EFP_REF FORMAT "%3.1" /end CHARACTERISTIC
/begin CHARACTERISTIC c_t_efp "Time delay to shut off the electrical fuel pump relay after ignition key off" VALUE 0xffe41946 _REC_VAL_20_u2 655.35 _CNV_A_R_LINEAR_____4_CM 0. 655.35 DISPLAY_IDENTIFIER C_T_EFP FORMAT "%6.2" /end CHARACTERISTIC
/begin CHARACTERISTIC lc_level_on_efp "Switch-on level for the EFP (0 = low active, 1 = high active)" VALUE 0xffe40f98 _REC_VAL_20_u1 1. _CNV_A_R_LINEAR_____0_CM 0. 1. DISPLAY_IDENTIFIER LC_LEVEL_ON_EFP FORMAT "%2.0" /end CHARACTERISTIC
/begin MEASUREMENT efppwm "control PWM for electrial fuel pump" UBYTE _CNV_A_R_LINEAR_____183_CM 1 100. 0.392 99.568 DISPLAY_IDENTIFIER EFPPWM ECU_ADDRESS 0x3fe926 FORMAT "%4.1" /end MEASUREMENT
/begin MEASUREMENT vff_efp "Required amount of fuel" UBYTE _CNV_A_R_LINEAR_____184_CM 1 100. 0. 255. DISPLAY_IDENTIFIER VFF_EFP ECU_ADDRESS 0x3fe927 FORMAT "%4.0" /end MEASUREMENT
/begin MEASUREMENT vff_vepu_add_efp "additive VFF_EFP for venturi pump in the canister system" UBYTE _CNV_A_R_LINEAR_____184_CM 1 100. 0. 255. DISPLAY_IDENTIFIER VFF_VEPU_ADD_EFP ECU_ADDRESS 0x3fe92a FORMAT "%4.0" /end MEASUREMENT
/begin MEASUREMENT vff_vepu_fco_av "required amount of fuelin dependance of the actual fuel consumption" UBYTE _CNV_A_R_LINEAR_____184_CM 1 100. 0. 255. DISPLAY_IDENTIFIER VFF_VEPU_FCO_AV ECU_ADDRESS 0x3fe92b FORMAT "%4.0" /end MEASUREMENT
/begin CHARACTERISTIC ip_t_efp_ast_max "On-time for electrical fuel pump at the beginning of EFP_ON with EFPPWM = 99,568  %" CURVE 0xffe4e882 _REC_CUR_20_u2_u1 655.35 _CNV_A_R_LINEAR_____4_CM 0. 655.35 DISPLAY_IDENTIFIER IP_T_EFP_AST_MAX FORMAT "%6.2"
 /begin AXIS_DESCR COM_AXIS tco _CNV_A_R_LINEAR_____11_CM 6 -48. 142.5 FORMAT "%5.1" AXIS_PTS_REF ldp_tco_t_efp_ast_max /end AXIS_DESCR
/end CHARACTERISTIC
/begin CHARACTERISTIC ip_vff_efp_fl "Fuel mass setpoint" CURVE 0xffe40ecb _REC_CUR_20_u1_u1 255. _CNV_A_R_LINEAR_____184_CM 0. 255. DISPLAY_IDENTIFIER IP_VFF_EFP_FL FORMAT "%4.0"
 /begin AXIS_DESCR COM_AXIS n_32 _CNV_A_R_LINEAR_____15_CM 8 0. 8160. FORMAT "%4.0" AXIS_PTS_REF ldp_n_32_vff_efp /end AXIS_DESCR
/end CHARACTERISTIC
/begin CHARACTERISTIC ip_vff_vepu_ftl "Fuel mass setpoint in dependance of the FTL" CURVE 0xffe40ed3 _REC_CUR_20_u1_u1 255. _CNV_A_R_LINEAR_____184_CM 0. 255. DISPLAY_IDENTIFIER IP_VFF_VEPU_FTL FORMAT "%4.0"
 /begin AXIS_DESCR COM_AXIS ftl _CNV_A_R_LINEAR_____96_CM 6 0. 127. FORMAT "%3.0" AXIS_PTS_REF ldp_ftl_vff_vepu_ftl /end AXIS_DESCR
/end CHARACTERISTIC
/begin CHARACTERISTIC ip_vff_vepu_ftl_dif "Fuel mass setpoint in dependance of the FTL difference left and right canister" CURVE 0xffe40ed9 _REC_CUR_20_u1_u1 255. _CNV_A_R_LINEAR_____184_CM 0. 255. DISPLAY_IDENTIFIER IP_VFF_VEPU_FTL_DIF FORMAT "%4.0"
 /begin AXIS_DESCR COM_AXIS ftl_dif _CNV_A_R_LINEAR_____96_CM 6 0. 127. FORMAT "%3.0" AXIS_PTS_REF ldp_ftl_dif_vff_vepu_ftl_dif /end AXIS_DESCR
/end CHARACTERISTIC
/begin MEASUREMENT ftl_dif "Difference in FTL between left and right canister" UBYTE _CNV_A_R_LINEAR_____96_CM 1 100. 0. 127. DISPLAY_IDENTIFIER FTL_DIF ECU_ADDRESS 0x3fe929 FORMAT "%3.0" /end MEASUREMENT
/begin CHARACTERISTIC c_t_efp_prev "On-time for elctrical fuel pump after reset with engine stopped" VALUE 0xffe41948 _REC_VAL_20_u2 655.35 _CNV_A_R_LINEAR_____4_CM 0. 655.35 DISPLAY_IDENTIFIER C_T_EFP_PREV FORMAT "%6.2" /end CHARACTERISTIC
/begin AXIS_PTS ldp_n_32_vff_efp "" 0xffe480fd n_32 _REC_AXS_20_u1 8160. _CNV_A_R_LINEAR_____15_CM 8 0. 8160. DISPLAY_IDENTIFIER LDP_N_32_VFF_EFP FORMAT "%4.0" /end AXIS_PTS
/begin AXIS_PTS ldp_tco_t_efp_ast_max "" 0xffe4123d tco _REC_AXS_20_u1 190.5 _CNV_A_R_LINEAR_____11_CM 6 -48. 142.5 DISPLAY_IDENTIFIER LDP_TCO_T_EFP_AST_MAX FORMAT "%5.1" /end AXIS_PTS
/begin AXIS_PTS ldp_ftl_vff_vepu_ftl "" 0xffe41044 ftl _REC_AXS_20_u1 127. _CNV_A_R_LINEAR_____96_CM 6 0. 127. DISPLAY_IDENTIFIER LDP_FTL_VFF_VEPU_FTL FORMAT "%3.0" /end AXIS_PTS
/begin AXIS_PTS ldp_ftl_dif_vff_vepu_ftl_dif "" 0xffe4103d ftl_dif _REC_AXS_20_u1 127. _CNV_A_R_LINEAR_____96_CM 6 0. 127. DISPLAY_IDENTIFIER LDP_FTL_DIF_VFF_VEPU_FTL_DIF FORMAT "%3.0" /end AXIS_PTS
/begin CHARACTERISTIC c_lgrd_cam_sp_vo_inc "Limiting gradient for camshaft setpoint changes leading to increased valve overlap " VALUE 0xffe4044e _REC_VAL_20_s2 1535.9765625 _CNV_A_R_LINEAR_____226_CM -768. 767.9765625 DISPLAY_IDENTIFIER C_LGRD_CAM_SP_VO_INC FORMAT "%7.2" /end CHARACTERISTIC
/begin CHARACTERISTIC c_lgrd_cam_sp_vo_dec "Limiting gradient for camshaft setpoint changes leading to decreased valve overlap" VALUE 0xffe4044c _REC_VAL_20_s2 1535.9765625 _CNV_A_R_LINEAR_____226_CM -768. 767.9765625 DISPLAY_IDENTIFIER C_LGRD_CAM_SP_VO_DEC FORMAT "%7.2" /end CHARACTERISTIC
/begin CHARACTERISTIC ip_cam_sp_2_ex_is__n__maf_ivvt "Target spread for thermal condition 2, idle,exhaust camschaft" MAP 0xffe448e2 _REC_MAP_20_u1_u2_u2 -95.625 _CNV_A_R_LINEAR_____227_CM -40. -135.625 DISPLAY_IDENTIFIER IP_CAM_SP_2_EX_IS__N__MAF_IVVT FORMAT "%5.1"
 /begin AXIS_DESCR COM_AXIS n _CNV_A_R_LINEAR_____10_CM 6 0. 8160. FORMAT "%4.0" AXIS_PTS_REF ldpm_n_13 /end AXIS_DESCR
 /begin AXIS_DESCR COM_AXIS maf_ivvt _CNV_A_R_LINEAR_____108_CM 6 0. 1389. FORMAT "%7.2" AXIS_PTS_REF ldpm_maf_ivvt_1 /end AXIS_DESCR
/end CHARACTERISTIC
/begin MEASUREMENT lv_pvs_fl_ivvt "Logical variable for camshaft spread calculation at  high engine load demand (1 = active)" UBYTE _CNV_S_2_RANGE______21_CM 1 100. 0. 1. DISPLAY_IDENTIFIER LV_PVS_FL_IVVT ECU_ADDRESS 0x3fe4c0 /end MEASUREMENT
/begin MEASUREMENT t_cam_sp_act "Time after transition of STATE_IVVT  0 Þ 1 (passive Þ active)" UBYTE _CNV_A_R_LINEAR_____31_CM 1 100. 0. 2550. DISPLAY_IDENTIFIER T_CAM_SP_ACT ECU_ADDRESS 0x3fe4bb FORMAT "%4.0" /end MEASUREMENT
/begin CHARACTERISTIC c_cam_sp_as_ex "Additive share target spread exhaust camshaft" VALUE 0xffe403d4 _REC_VAL_20_s2 1535.9765625 _CNV_A_R_LINEAR_____228_CM -768. 767.9765625 DISPLAY_IDENTIFIER C_CAM_SP_AS_EX FORMAT "%7.2" /end CHARACTERISTIC
/begin CHARACTERISTIC c_cam_sp_as_in "Additive share target spread intake camshaft" VALUE 0xffe403d6 _REC_VAL_20_s2 1535.9765625 _CNV_A_R_LINEAR_____228_CM -768. 767.9765625 DISPLAY_IDENTIFIER C_CAM_SP_AS_IN FORMAT "%7.2" /end CHARACTERISTIC
/begin CHARACTERISTIC c_cam_sp_dif_max "CAM_Setpoint hysteresis" VALUE 0xffe403d8 _REC_VAL_20_s2 1535.9765625 _CNV_A_R_LINEAR_____228_CM -768. 767.9765625 DISPLAY_IDENTIFIER C_CAM_SP_DIF_MAX FORMAT "%7.2" /end CHARACTERISTIC
/begin CHARACTERISTIC c_lgrd_cam_sp_tra "Limiting gradient for camshaft setpoint during active IVVT transition function" VALUE 0xffe4044a _REC_VAL_20_s2 1535.9765625 _CNV_A_R_LINEAR_____226_CM -768. 767.9765625 DISPLAY_IDENTIFIER C_LGRD_CAM_SP_TRA FORMAT "%7.2" /end CHARACTERISTIC
/begin CHARACTERISTIC c_t_cam_sp_lgrd "Adjusting time for 0.375 °CRK in active transition function" VALUE 0xffe4085e _REC_VAL_20_u1 2540. _CNV_A_R_LINEAR_____31_CM 10. 2550. DISPLAY_IDENTIFIER C_T_CAM_SP_LGRD FORMAT "%4.0" /end CHARACTERISTIC
/begin CHARACTERISTIC ip_fac_cam_in_is__tco__tco_st "Weighting factor for target spread calculation, idle, intake camschaft" MAP 0xffe4511e _REC_MAP_20_u1_u1_u1 7.96875 _CNV_A_R_LINEAR_____229_CM -4. 3.96875 DISPLAY_IDENTIFIER IP_FAC_CAM_IN_IS__TCO_TCO_ST FORMAT "%5.2"
 /begin AXIS_DESCR COM_AXIS tco _CNV_A_R_LINEAR_____11_CM 8 -48. 142.5 FORMAT "%5.1" AXIS_PTS_REF ldpm_tco_17 /end AXIS_DESCR
 /begin AXIS_DESCR COM_AXIS tco_st _CNV_A_R_LINEAR_____11_CM 8 -48. 142.5 FORMAT "%5.1" AXIS_PTS_REF ldpm_tco_st_4 /end AXIS_DESCR
/end CHARACTERISTIC
/begin CHARACTERISTIC ip_cam_sp_2_ex_fl__n "Target spread for thermal condition 2, high load, exhaust camschaft" CURVE 0xffe448d2 _REC_CUR_20_u1_u2 -95.625 _CNV_A_R_LINEAR_____227_CM -40. -135.625 DISPLAY_IDENTIFIER IP_CAM_SP_2_EX_FL__N FORMAT "%5.1"
 /begin AXIS_DESCR COM_AXIS n _CNV_A_R_LINEAR_____10_CM 16 0. 8160. FORMAT "%4.0" AXIS_PTS_REF ldpm_n_5 /end AXIS_DESCR
/end CHARACTERISTIC
/begin CHARACTERISTIC ip_fac_cam_in_pl__tco__tco_st "Weighting factor for target spread calculation, part load, intake camschaft" MAP 0xffe4515e _REC_MAP_20_u1_u1_u1 7.96875 _CNV_A_R_LINEAR_____229_CM -4. 3.96875 DISPLAY_IDENTIFIER IP_FAC_CAM_IN_PL__TCO_TCO_ST FORMAT "%5.2"
 /begin AXIS_DESCR COM_AXIS tco _CNV_A_R_LINEAR_____11_CM 8 -48. 142.5 FORMAT "%5.1" AXIS_PTS_REF ldpm_tco_17 /end AXIS_DESCR
 /begin AXIS_DESCR COM_AXIS tco_st _CNV_A_R_LINEAR_____11_CM 8 -48. 142.5 FORMAT "%5.1" AXIS_PTS_REF ldpm_tco_st_4 /end AXIS_DESCR
/end CHARACTERISTIC
/begin CHARACTERISTIC ip_cam_sp_2_ex_pl__n__maf_ivvt "Target spread for thermal condition 2, part load, exhaust camschaft" MAP 0xffe4492a _REC_MAP_20_u1_u2_u2 -95.625 _CNV_A_R_LINEAR_____227_CM -40. -135.625 DISPLAY_IDENTIFIER IP_CAM_SP_2_EX_PL__N__MAF_IVVT FORMAT "%5.1"
 /begin AXIS_DESCR COM_AXIS n _CNV_A_R_LINEAR_____10_CM 16 0. 8160. FORMAT "%4.0" AXIS_PTS_REF ldpm_n_5 /end AXIS_DESCR
 /begin AXIS_DESCR COM_AXIS maf _CNV_A_R_LINEAR_____108_CM 12 0. 1389. FORMAT "%7.2" AXIS_PTS_REF ldpm_maf_ivvt_2 /end AXIS_DESCR
/end CHARACTERISTIC
/begin CHARACTERISTIC ip_cam_sp_2_in_fl__n "Target spread for thermal condition 2, high load, intake camschaft" CURVE 0xffe44ace _REC_CUR_20_u1_u2 95.625 _CNV_A_R_LINEAR_____230_CM 60. 155.625 DISPLAY_IDENTIFIER IP_CAM_SP_2_IN_FL__N FORMAT "%5.1"
 /begin AXIS_DESCR COM_AXIS n _CNV_A_R_LINEAR_____10_CM 16 0. 8160. FORMAT "%4.0" AXIS_PTS_REF ldpm_n_5 /end AXIS_DESCR
/end CHARACTERISTIC
/begin CHARACTERISTIC ip_cam_sp_1_ex_fl__n "Target spread for thermal condition 1, high load, exhaust camschaft" CURVE 0xffe444da _REC_CUR_20_u1_u2 -95.625 _CNV_A_R_LINEAR_____227_CM -40. -135.625 DISPLAY_IDENTIFIER IP_CAM_SP_1_EX_FL__N FORMAT "%5.1"
 /begin AXIS_DESCR COM_AXIS n _CNV_A_R_LINEAR_____10_CM 16 0. 8160. FORMAT "%4.0" AXIS_PTS_REF ldpm_n_5 /end AXIS_DESCR
/end CHARACTERISTIC
/begin CHARACTERISTIC ip_cam_sp_2_in_is__n__maf_ivvt "Target spread for thermal condition 1, idle, intake camschaft" MAP 0xffe44ade _REC_MAP_20_u1_u2_u2 95.625 _CNV_A_R_LINEAR_____230_CM 60. 155.625 DISPLAY_IDENTIFIER IP_CAM_SP_2_IN_IS__N__MAF_IVVT FORMAT "%5.1"
 /begin AXIS_DESCR COM_AXIS n _CNV_A_R_LINEAR_____10_CM 6 0. 8160. FORMAT "%4.0" AXIS_PTS_REF ldpm_n_13 /end AXIS_DESCR
 /begin AXIS_DESCR COM_AXIS maf_ivvt _CNV_A_R_LINEAR_____108_CM 6 0. 1389. FORMAT "%7.2" AXIS_PTS_REF ldpm_maf_ivvt_1 /end AXIS_DESCR
/end CHARACTERISTIC
/begin CHARACTERISTIC ip_cam_sp_2_in_pl__n__maf_ivvt "Target spread for thermal condition 2, part load, intake camschaft" MAP 0xffe44b26 _REC_MAP_20_u1_u2_u2 95.625 _CNV_A_R_LINEAR_____230_CM 60. 155.625 DISPLAY_IDENTIFIER IP_CAM_SP_2_IN_PL__N__MAF_IVVT FORMAT "%5.1"
 /begin AXIS_DESCR COM_AXIS n _CNV_A_R_LINEAR_____10_CM 16 0. 8160. FORMAT "%4.0" AXIS_PTS_REF ldpm_n_5 /end AXIS_DESCR
 /begin AXIS_DESCR COM_AXIS maf _CNV_A_R_LINEAR_____108_CM 12 0. 1389. FORMAT "%7.2" AXIS_PTS_REF ldpm_maf_ivvt_2 /end AXIS_DESCR
/end CHARACTERISTIC
/begin CHARACTERISTIC ip_cam_sp_1_ex_pl__n__maf_ivvt "Target spread for thermal condition 1, part load, exhaust camschaft" MAP 0xffe44532 _REC_MAP_20_u1_u2_u2 -95.625 _CNV_A_R_LINEAR_____227_CM -40. -135.625 DISPLAY_IDENTIFIER IP_CAM_SP_1_EX_PL__N__MAF_IVVT FORMAT "%5.1"
 /begin AXIS_DESCR COM_AXIS n _CNV_A_R_LINEAR_____10_CM 16 0. 8160. FORMAT "%4.0" AXIS_PTS_REF ldpm_n_5 /end AXIS_DESCR
 /begin AXIS_DESCR COM_AXIS maf _CNV_A_R_LINEAR_____108_CM 12 0. 1389. FORMAT "%7.2" AXIS_PTS_REF ldpm_maf_ivvt_2 /end AXIS_DESCR
/end CHARACTERISTIC
/begin CHARACTERISTIC ip_cam_sp_1_in_fl__n "Target spread for thermal condition 1, high load, intake camschaft" CURVE 0xffe446d6 _REC_CUR_20_u1_u2 95.625 _CNV_A_R_LINEAR_____230_CM 60. 155.625 DISPLAY_IDENTIFIER IP_CAM_SP_1_IN_FL__N FORMAT "%5.1"
 /begin AXIS_DESCR COM_AXIS n _CNV_A_R_LINEAR_____10_CM 16 0. 8160. FORMAT "%4.0" AXIS_PTS_REF ldpm_n_5 /end AXIS_DESCR
/end CHARACTERISTIC
/begin CHARACTERISTIC ip_fac_cam_ex_is__tco__tco_st "Weighting factor for target spread calculation, idle, exhaust camschaft" MAP 0xffe4509e _REC_MAP_20_u1_u1_u1 7.96875 _CNV_A_R_LINEAR_____229_CM -4. 3.96875 DISPLAY_IDENTIFIER IP_FAC_CAM_EX_IS__TCO_TCO_ST FORMAT "%5.2"
 /begin AXIS_DESCR COM_AXIS tco _CNV_A_R_LINEAR_____11_CM 8 -48. 142.5 FORMAT "%5.1" AXIS_PTS_REF ldpm_tco_17 /end AXIS_DESCR
 /begin AXIS_DESCR COM_AXIS tco_st _CNV_A_R_LINEAR_____11_CM 8 -48. 142.5 FORMAT "%5.1" AXIS_PTS_REF ldpm_tco_st_4 /end AXIS_DESCR
/end CHARACTERISTIC
/begin CHARACTERISTIC ip_fac_cam_ex_pl__tco__tco_st "Weighting factor for target spread calculation, part load, exhaust camschaft" MAP 0xffe450de _REC_MAP_20_u1_u1_u1 7.96875 _CNV_A_R_LINEAR_____229_CM -4. 3.96875 DISPLAY_IDENTIFIER IP_FAC_CAM_EX_PL__TCO_TCO_ST FORMAT "%5.2"
 /begin AXIS_DESCR COM_AXIS tco _CNV_A_R_LINEAR_____11_CM 8 -48. 142.5 FORMAT "%5.1" AXIS_PTS_REF ldpm_tco_17 /end AXIS_DESCR
 /begin AXIS_DESCR COM_AXIS tco_st _CNV_A_R_LINEAR_____11_CM 8 -48. 142.5 FORMAT "%5.1" AXIS_PTS_REF ldpm_tco_st_4 /end AXIS_DESCR
/end CHARACTERISTIC
/begin CHARACTERISTIC ip_cam_sp_1_in_pl__n__maf_ivvt "Target spread for thermal condition 1, part load, intake camschaft" MAP 0xffe4472e _REC_MAP_20_u1_u2_u2 95.625 _CNV_A_R_LINEAR_____230_CM 60. 155.625 DISPLAY_IDENTIFIER IP_CAM_SP_1_IN_PL__N__MAF_IVVT FORMAT "%5.1"
 /begin AXIS_DESCR COM_AXIS n _CNV_A_R_LINEAR_____10_CM 16 0. 8160. FORMAT "%4.0" AXIS_PTS_REF ldpm_n_5 /end AXIS_DESCR
 /begin AXIS_DESCR COM_AXIS maf _CNV_A_R_LINEAR_____108_CM 12 0. 1389. FORMAT "%7.2" AXIS_PTS_REF ldpm_maf_ivvt_2 /end AXIS_DESCR
/end CHARACTERISTIC
/begin CHARACTERISTIC ip_cam_sp_1_ex_is__n__maf_ivvt "Target spread for thermal condition 1, idle,exhaust camschaft" MAP 0xffe444ea _REC_MAP_20_u1_u2_u2 -95.625 _CNV_A_R_LINEAR_____227_CM -40. -135.625 DISPLAY_IDENTIFIER IP_CAM_SP_1_EX_IS__N__MAF_IVVT FORMAT "%5.1"
 /begin AXIS_DESCR COM_AXIS n _CNV_A_R_LINEAR_____10_CM 6 0. 8160. FORMAT "%4.0" AXIS_PTS_REF ldpm_n_13 /end AXIS_DESCR
 /begin AXIS_DESCR COM_AXIS maf_ivvt _CNV_A_R_LINEAR_____108_CM 6 0. 1389. FORMAT "%7.2" AXIS_PTS_REF ldpm_maf_ivvt_1 /end AXIS_DESCR
/end CHARACTERISTIC
/begin CHARACTERISTIC ip_cam_sp_1_in_is__n__maf_ivvt "Target spread for thermal condition 1, idle, intake camschaft" MAP 0xffe446e6 _REC_MAP_20_u1_u2_u2 95.625 _CNV_A_R_LINEAR_____230_CM 60. 155.625 DISPLAY_IDENTIFIER IP_CAM_SP_1_IN_IS__N__MAF_IVVT FORMAT "%5.1"
 /begin AXIS_DESCR COM_AXIS n _CNV_A_R_LINEAR_____10_CM 6 0. 8160. FORMAT "%4.0" AXIS_PTS_REF ldpm_n_13 /end AXIS_DESCR
 /begin AXIS_DESCR COM_AXIS maf_ivvt _CNV_A_R_LINEAR_____108_CM 6 0. 1389. FORMAT "%7.2" AXIS_PTS_REF ldpm_maf_ivvt_1 /end AXIS_DESCR
/end CHARACTERISTIC
/begin CHARACTERISTIC ip_cam_sp_ch_in " Target spread during CAT heating, LV_DRI = 0, intake camshaft" MAP 0xffe44cca _REC_MAP_20_u1_u1_u2 95.625 _CNV_A_R_LINEAR_____230_CM 60. 155.625 DISPLAY_IDENTIFIER IP_CAM_SP_CH_IN FORMAT "%5.1"
 /begin AXIS_DESCR COM_AXIS tco_st _CNV_A_R_LINEAR_____11_CM 8 -48. 142.5 FORMAT "%5.1" AXIS_PTS_REF ldpm_tco_st_1_ivvt /end AXIS_DESCR
 /begin AXIS_DESCR COM_AXIS t_ast _CNV_A_R_LINEAR_____24_CM 8 0. 6553.5 FORMAT "%6.1" AXIS_PTS_REF ldpm_t_ast_1_ivvt /end AXIS_DESCR
/end CHARACTERISTIC
/begin CHARACTERISTIC ip_cam_sp_ch_dri_in " Target spread during CAT heating, LV_DRI = 1, intake camshaft" MAP 0xffe44c4a _REC_MAP_20_u1_u1_u2 95.625 _CNV_A_R_LINEAR_____230_CM 60. 155.625 DISPLAY_IDENTIFIER IP_CAM_SP_CH_DRI_IN FORMAT "%5.1"
 /begin AXIS_DESCR COM_AXIS tco_st _CNV_A_R_LINEAR_____11_CM 8 -48. 142.5 FORMAT "%5.1" AXIS_PTS_REF ldpm_tco_st_1_ivvt /end AXIS_DESCR
 /begin AXIS_DESCR COM_AXIS t_ast _CNV_A_R_LINEAR_____24_CM 8 0. 6553.5 FORMAT "%6.1" AXIS_PTS_REF ldpm_t_ast_1_ivvt /end AXIS_DESCR
/end CHARACTERISTIC
/begin CHARACTERISTIC ip_cam_sp_ch_ex " Target spread during CAT heating, LV_DRI = 0, exhaust camshaft " MAP 0xffe44c8a _REC_MAP_20_u1_u1_u2 -95.625 _CNV_A_R_LINEAR_____227_CM -40. -135.625 DISPLAY_IDENTIFIER IP_CAM_SP_CH_EX FORMAT "%8.3"
 /begin AXIS_DESCR COM_AXIS tco_st _CNV_A_R_LINEAR_____11_CM 8 -48. 142.5 FORMAT "%5.1" AXIS_PTS_REF ldpm_tco_st_1_ivvt /end AXIS_DESCR
 /begin AXIS_DESCR COM_AXIS t_ast _CNV_A_R_LINEAR_____24_CM 8 0. 6553.5 FORMAT "%6.1" AXIS_PTS_REF ldpm_t_ast_1_ivvt /end AXIS_DESCR
/end CHARACTERISTIC
/begin CHARACTERISTIC ip_cam_sp_ch_dri_ex " Target spread during CAT heating, LV_DRI = 1, exhaust camshaft " MAP 0xffe44c0a _REC_MAP_20_u1_u1_u2 -95.625 _CNV_A_R_LINEAR_____227_CM -40. -135.625 DISPLAY_IDENTIFIER IP_CAM_SP_CH_DRI_EX FORMAT "%8.3"
 /begin AXIS_DESCR COM_AXIS tco_st _CNV_A_R_LINEAR_____11_CM 8 -48. 142.5 FORMAT "%5.1" AXIS_PTS_REF ldpm_tco_st_1_ivvt /end AXIS_DESCR
 /begin AXIS_DESCR COM_AXIS t_ast _CNV_A_R_LINEAR_____24_CM 8 0. 6553.5 FORMAT "%6.1" AXIS_PTS_REF ldpm_t_ast_1_ivvt /end AXIS_DESCR
/end CHARACTERISTIC
/begin CHARACTERISTIC ip_fac_cam_sp_ch_km "Factor vehicle mileage" CURVE 0xffe40b3b _REC_CUR_20_u1_u2 0.99610001 _CNV_A_R_LINEAR_____29_CM 0. 0.99610001 DISPLAY_IDENTIFIER IP_FAC_CAM_SP_CH_KM FORMAT "%5.3"
 /begin AXIS_DESCR COM_AXIS ctr_km_can _CNV_A_R_LINEAR_____88_CM 4 0. 655350. FORMAT "%7.0" AXIS_PTS_REF ldpm_ctr_km_can_1 /end AXIS_DESCR
/end CHARACTERISTIC
/begin CHARACTERISTIC c_t_dri_ch_ivvt "Duration of ramp LV_DRI 0«1" VALUE 0xffe41944 _REC_VAL_20_u2 655.35 _CNV_A_R_LINEAR_____4_CM 0. 655.35 DISPLAY_IDENTIFIER C_T_DRI_CH_IVVT FORMAT "%6.2" /end CHARACTERISTIC
/begin CHARACTERISTIC ip_fac_cam_sp_ch_opp "Factor operating point" MAP 0xffe4519e _REC_MAP_20_u1_u2_u2 0.99610001 _CNV_A_R_LINEAR_____29_CM 0. 0.99610001 DISPLAY_IDENTIFIER IP_FAC_CAM_SP_CH_OPP FORMAT "%5.3"
 /begin AXIS_DESCR COM_AXIS n_32 _CNV_A_R_LINEAR_____10_CM 4 0. 8160. FORMAT "%4.0" AXIS_PTS_REF ldp_n_32__fac_cam_sp_ch_opp /end AXIS_DESCR
 /begin AXIS_DESCR COM_AXIS online_dummy _CNV_A_R_LINEAR_____49_CM 4 0. 5434. FORMAT "%7.2" AXIS_PTS_REF ldp_dip__fac_cam_sp_ch_opp /end AXIS_DESCR
/end CHARACTERISTIC
/begin CHARACTERISTIC c_t_ramp_ch_ivvt "Duration of ramp LV_CH_IVVT 0«1" VALUE 0xffe419de _REC_VAL_20_u2 655.34 _CNV_A_R_LINEAR_____4_CM 1.e-002 655.35 DISPLAY_IDENTIFIER C_T_RAMP_CH_IVVT FORMAT "%5.2" /end CHARACTERISTIC
/begin MEASUREMENT fac_ch_ivvt_dri "Ramp factor when LV_DRI changes" UBYTE _CNV_A_R_LINEAR_____29_CM 1 100. 0. 0.99610001 DISPLAY_IDENTIFIER FAC_CH_IVVT_DRI ECU_ADDRESS 0x3fe4bc FORMAT "%5.3" /end MEASUREMENT
/begin MEASUREMENT fac_deac_ch_ivvt "Ramp factor when LV_CH_IVVT changes" UBYTE _CNV_A_R_LINEAR_____29_CM 1 100. 0. 0.99610001 DISPLAY_IDENTIFIER FAC_DEAC_CH_IVVT ECU_ADDRESS 0x3fe4bd FORMAT "%5.3" /end MEASUREMENT
/begin MEASUREMENT fac_ivvt_sp_ch "Interpolation factor CAM_SP catalyst heating" UBYTE _CNV_A_R_LINEAR_____29_CM 1 100. 0. 0.99610001 DISPLAY_IDENTIFIER FAC_IVVT_SP_CH ECU_ADDRESS 0x3fe4be FORMAT "%5.3" /end MEASUREMENT
/begin CHARACTERISTIC id_cmb_ivvt "Definition which setpoint is to be calculated at individual STATE_CMB CTL" CURVE 0xffe4404c _REC_CUR_20_u1_u1 2. _CNV_A_R_LINEAR_____0_CM 0. 2. DISPLAY_IDENTIFIER ID_CMB_IVVT FORMAT "%2.0"
 /begin AXIS_DESCR COM_AXIS state_cmb_ctl _CNV_A_R_LINEAR_____0_CM 9 0. 8. FORMAT "%2.0" AXIS_PTS_REF ldp_state_cmb_ctl_id_cmb_ivvt /end AXIS_DESCR
/end CHARACTERISTIC
/begin CHARACTERISTIC ip_pv_max_fl_ivvt__n "PV-threshold for control IVVT at high load" CURVE 0xffe46ecb _REC_CUR_20_u1_u2 99.609375 _CNV_A_R_LINEAR_____9_CM 0. 99.609375 DISPLAY_IDENTIFIER IP_PV_MAX_FL_IVVT__N FORMAT "%5.1"
 /begin AXIS_DESCR COM_AXIS n _CNV_A_R_LINEAR_____10_CM 16 0. 8160. FORMAT "%4.0" AXIS_PTS_REF ldpm_n_11 /end AXIS_DESCR
/end CHARACTERISTIC
/begin AXIS_PTS ldpm_tco_st_4 "" 0xffe486ad tco_st _REC_AXS_20_u1 190.5 _CNV_A_R_LINEAR_____11_CM 8 -48. 142.5 DISPLAY_IDENTIFIER LDPM_TCO_ST_4 FORMAT "%5.1" /end AXIS_PTS
/begin AXIS_PTS ldpm_n_11 "ldpm 6 points N for IGA" 0xffe51a2e n _REC_AXS_20_u2 8160. _CNV_A_R_LINEAR_____10_CM 16 0. 8160. DISPLAY_IDENTIFIER LDPM_N_11 FORMAT "%4.0" /end AXIS_PTS
/begin AXIS_PTS ldpm_maf_ivvt_1 "" 0xffe51990 maf_ivvt _REC_AXS_20_u2 1389. _CNV_A_R_LINEAR_____108_CM 6 0. 1389. DISPLAY_IDENTIFIER LDPM_MAF_IVVT_1 FORMAT "%7.2" /end AXIS_PTS
/begin AXIS_PTS ldpm_tco_17 "" 0xffe485f6 tco _REC_AXS_20_u1 190.5 _CNV_A_R_LINEAR_____11_CM 8 -48. 142.5 DISPLAY_IDENTIFIER LDPM_TCO_17 FORMAT "%5.1" /end AXIS_PTS
/begin AXIS_PTS ldpm_tco_st_1_ivvt "" 0xffe4869b tco_st _REC_AXS_20_u1 190.5 _CNV_A_R_LINEAR_____11_CM 8 -48. 142.5 DISPLAY_IDENTIFIER LDPM_TCO_ST_1_IVVT FORMAT "%5.1" /end AXIS_PTS
/begin AXIS_PTS ldpm_t_ast_1_ivvt "" 0xffe51cf2 t_ast _REC_AXS_20_u2 6553.5 _CNV_A_R_LINEAR_____24_CM 8 0. 6553.5 DISPLAY_IDENTIFIER LDPM_T_AST_1_IVVT FORMAT "%6.1" /end AXIS_PTS
/begin AXIS_PTS ldp_n_32__fac_cam_sp_ch_opp "" 0xffe50f96 n_32 _REC_AXS_20_u2 8160. _CNV_A_R_LINEAR_____10_CM 4 0. 8160. DISPLAY_IDENTIFIER LDP_N_32__FAC_CAM_SP_CH_OPP FORMAT "%4.0" /end AXIS_PTS
/begin AXIS_PTS ldp_dip__fac_cam_sp_ch_opp "" 0xffe50af8 online_dummy _REC_AXS_20_u2 5434. _CNV_A_R_LINEAR_____49_CM 4 0. 5434. DISPLAY_IDENTIFIER LDP_DIP__FAC_CAM_SP_CH_OPP FORMAT "%7.2" /end AXIS_PTS
/begin AXIS_PTS ldp_state_cmb_ctl_id_cmb_ivvt "" 0xffe48182 state_cmb_ctl _REC_AXS_20_u1 8. _CNV_A_R_LINEAR_____0_CM 9 0. 8. DISPLAY_IDENTIFIER LDP_STATE_CMB_CTL_ID_CMB_IVVT FORMAT "%2.0" /end AXIS_PTS
/begin CHARACTERISTIC c_cam_sp_hys_neut_ivvt_ex "" VALUE 0xffe4064c _REC_VAL_20_u1 60. _CNV_A_R_LINEAR_____82_CM 0. 60. DISPLAY_IDENTIFIER C_CAM_SP_HYS_NEUT_IVVT_EX FORMAT "%4.1" /end CHARACTERISTIC
/begin CHARACTERISTIC c_cam_sp_park_in " Target spread for IVVT parking function shut down, inlet camshaft" VALUE 0xffe403dc _REC_VAL_20_s2 1535.9765625 _CNV_A_R_LINEAR_____228_CM -768. 767.9765625 DISPLAY_IDENTIFIER C_CAM_SP_PARK_IN FORMAT "%7.2" /end CHARACTERISTIC
/begin CHARACTERISTIC c_cam_sp_park_ex " Target spread for IVVT parking function, exhaust camshaft" VALUE 0xffe403da _REC_VAL_20_s2 1535.9765625 _CNV_A_R_LINEAR_____228_CM -768. 767.9765625 DISPLAY_IDENTIFIER C_CAM_SP_PARK_EX FORMAT "%7.2" /end CHARACTERISTIC
/begin CHARACTERISTIC c_cam_sp_hys_neut_ivvt_in "" VALUE 0xffe4064d _REC_VAL_20_u1 60. _CNV_A_R_LINEAR_____82_CM 0. 60. DISPLAY_IDENTIFIER C_CAM_SP_HYS_NEUT_IVVT_IN FORMAT "%4.1" /end CHARACTERISTIC
/begin AXIS_PTS ldpm_ctr_km_can_1 "" 0xffe517a4 ctr_km_can _REC_AXS_20_u2 655350. _CNV_A_R_LINEAR_____88_CM 4 0. 655350. DISPLAY_IDENTIFIER LDPM_CTR_KM_CAN_1 FORMAT "%7.0" /end AXIS_PTS
/begin AXIS_PTS ldpm_n_13 "" 0xffe51a50 n _REC_AXS_20_u2 8160. _CNV_A_R_LINEAR_____10_CM 6 0. 8160. DISPLAY_IDENTIFIER LDPM_N_13 FORMAT "%4.0" /end AXIS_PTS
/begin AXIS_PTS ldpm_n_5 "" 0xffe51ad8 n _REC_AXS_20_u2 8160. _CNV_A_R_LINEAR_____10_CM 16 0. 8160. DISPLAY_IDENTIFIER LDPM_N_5 FORMAT "%4.0" /end AXIS_PTS
/begin AXIS_PTS ldpm_maf_ivvt_2 "" 0xffe5199e maf _REC_AXS_20_u2 1389. _CNV_A_R_LINEAR_____108_CM 12 0. 1389. DISPLAY_IDENTIFIER LDPM_MAF_IVVT_2 FORMAT "%7.2" /end AXIS_PTS
/begin CHARACTERISTIC c_fac_cam_sp_pl_wout_cat "Spread weakening factor for variant 'without CAT'" VALUE 0xffe40732 _REC_VAL_20_u1 0.9960940000000002 _CNV_A_R_LINEAR_____50_CM 0. 0.996094 DISPLAY_IDENTIFIER C_FAC_CAM_SP_PL_WOUT_CAT FORMAT "%5.3" /end CHARACTERISTIC
/begin MEASUREMENT ivvt_in.struct_sp_ivvt.cam_sp_ivvt "" UBYTE _CNV_A_R_LINEAR_____230_CM 1 100. 60. 155.625 DISPLAY_IDENTIFIER CAM_SP_IVVT_IN ECU_ADDRESS 0x3fc0f0 FORMAT "%5.1" /end MEASUREMENT
/begin MEASUREMENT ivvt_in.struct_sp_ivvt.cam_sp_park "Intake camshaft target spread - for IVVT parking function" UBYTE _CNV_A_R_LINEAR_____230_CM 1 100. 60. 155.625 DISPLAY_IDENTIFIER CAM_SP_PARK_IN ECU_ADDRESS 0x3fc0f1 FORMAT "%5.1" /end MEASUREMENT
/begin MEASUREMENT ivvt_in.struct_sp_ivvt.cam_sp_ivvt_lim "Intake camshaft target spread  - after limitation" SWORD _CNV_A_R_LINEAR_____228_CM 1 100. -768. 767.9765625 DISPLAY_IDENTIFIER CAM_SP_IVVT_IN_LIM ECU_ADDRESS 0x3fc0f6 BYTE_ORDER MSB_LAST FORMAT "%7.2" /end MEASUREMENT
/begin MEASUREMENT ivvt_in.struct_sp_ivvt.cam_sp_ivvt_hys "Intake camshaft target spread  - after hysteresis" SWORD _CNV_A_R_LINEAR_____228_CM 1 100. -768. 767.9765625 DISPLAY_IDENTIFIER CAM_SP_IVVT_IN_HYS ECU_ADDRESS 0x3fc0f8 BYTE_ORDER MSB_LAST FORMAT "%7.2" /end MEASUREMENT
/begin MEASUREMENT ivvt_in.struct_sp_ivvt.cam_sp_av "Intake camshaft target spread calculated from the maps" SWORD _CNV_A_R_LINEAR_____228_CM 1 100. -768. 767.9765625 DISPLAY_IDENTIFIER CAM_SP_AV_IN ECU_ADDRESS 0x3fc0fa BYTE_ORDER MSB_LAST FORMAT "%7.2" /end MEASUREMENT
/begin MEASUREMENT ivvt_in.struct_sp_ivvt.cam_sp_av_hom "Intake camshaft target spread for homogeneous stochiometric combustion" SWORD _CNV_A_R_LINEAR_____228_CM 1 100. -768. 767.9765625 DISPLAY_IDENTIFIER CAM_SP_AV_IN_HOM ECU_ADDRESS 0x3fc0fc BYTE_ORDER MSB_LAST FORMAT "%7.2" /end MEASUREMENT
/begin MEASUREMENT ivvt_in.struct_sp_ivvt.cam_sp_av_lgrd "Intake camshaft target spread with limiting gradient during transition function (Þ \"enable\")" SWORD _CNV_A_R_LINEAR_____228_CM 1 100. -768. 767.9765625 DISPLAY_IDENTIFIER CAM_SP_AV_LGRD_IN ECU_ADDRESS 0x3fc0fe BYTE_ORDER MSB_LAST FORMAT "%7.2" /end MEASUREMENT
/begin MEASUREMENT ivvt_in.struct_sp_ivvt.lv_tran_ivvt "Logical variable for active transition function inlet cam (1 = active)" UBYTE _CNV_S_2_RANGE______2_CM 1 100. 0. 1. DISPLAY_IDENTIFIER LV_TRAN_IVVT_IN ECU_ADDRESS 0x3fc102 BIT_MASK 0x1 /end MEASUREMENT
/begin MEASUREMENT ivvt_in.struct_sp_ivvt.fac_cam_is "Temperature weighting factor intake camshaft  - idle speed" SBYTE _CNV_A_R_LINEAR_____236_CM 1 100. -4. 3.96875 DISPLAY_IDENTIFIER FAC_CAM_IN_IS ECU_ADDRESS 0x3fc103 FORMAT "%5.2" /end MEASUREMENT
/begin MEASUREMENT ivvt_in.struct_sp_ivvt.fac_cam_pl "Temperature weighting factor intake camshaft  - part load " SBYTE _CNV_A_R_LINEAR_____236_CM 1 100. -4. 3.96875 DISPLAY_IDENTIFIER FAC_CAM_IN_PL ECU_ADDRESS 0x3fc104 FORMAT "%5.2" /end MEASUREMENT
/begin MEASUREMENT ivvt_in.struct_sp_ivvt.cam_sp_ref "Intake camshaft target spread at reference conditions (warm engine)" SWORD _CNV_A_R_LINEAR_____228_CM 1 100. -768. 767.9765625 DISPLAY_IDENTIFIER CAM_SP_REF_IN ECU_ADDRESS 0x3fc0f4 BYTE_ORDER MSB_LAST FORMAT "%7.2" /end MEASUREMENT
/begin MEASUREMENT ivvt_in.struct_sp_ivvt.cam_sp_1_hom "Intake camshaft target spread  - without catalyst heating influence" SWORD _CNV_A_R_LINEAR_____228_CM 1 100. -768. 767.9765625 DISPLAY_IDENTIFIER CAM_SP_1_IN_HOM ECU_ADDRESS 0x3fc0f2 BYTE_ORDER MSB_LAST FORMAT "%7.2" /end MEASUREMENT
/begin MEASUREMENT ivvt_ex.struct_sp_ivvt.cam_sp_ivvt "" UBYTE _CNV_A_R_LINEAR_____227_CM 1 100. -40. -135.625 DISPLAY_IDENTIFIER CAM_SP_IVVT_EX ECU_ADDRESS 0x3fc20c FORMAT "%5.1" /end MEASUREMENT
/begin MEASUREMENT ivvt_ex.struct_sp_ivvt.cam_sp_park "Intake camshaft target spread - for IVVT parking function" UBYTE _CNV_A_R_LINEAR_____227_CM 1 100. -40. -135.625 DISPLAY_IDENTIFIER CAM_SP_PARK_EX ECU_ADDRESS 0x3fc20d FORMAT "%5.1" /end MEASUREMENT
/begin MEASUREMENT ivvt_ex.struct_sp_ivvt.cam_sp_ivvt_lim "Exhaust camshaft target spread - after limitation" SWORD _CNV_A_R_LINEAR_____228_CM 1 100. -768. 767.9765625 DISPLAY_IDENTIFIER CAM_SP_IVVT_EX_LIM ECU_ADDRESS 0x3fc212 BYTE_ORDER MSB_LAST FORMAT "%7.2" /end MEASUREMENT
/begin MEASUREMENT ivvt_ex.struct_sp_ivvt.cam_sp_ivvt_hys "Exhaust camshaft target spread - after hysteresis" SWORD _CNV_A_R_LINEAR_____228_CM 1 100. -768. 767.9765625 DISPLAY_IDENTIFIER CAM_SP_IVVT_EX_HYS ECU_ADDRESS 0x3fc214 BYTE_ORDER MSB_LAST FORMAT "%7.2" /end MEASUREMENT
/begin MEASUREMENT ivvt_ex.struct_sp_ivvt.cam_sp_av "Exhaust camshaft target spread calculated from the maps" SWORD _CNV_A_R_LINEAR_____228_CM 1 100. -768. 767.9765625 DISPLAY_IDENTIFIER CAM_SP_AV_EX ECU_ADDRESS 0x3fc216 BYTE_ORDER MSB_LAST FORMAT "%7.2" /end MEASUREMENT
/begin MEASUREMENT ivvt_ex.struct_sp_ivvt.cam_sp_av_hom "Exhaust camshaft target spread for homogeneous stochiometric combustion" SWORD _CNV_A_R_LINEAR_____228_CM 1 100. -768. 767.9765625 DISPLAY_IDENTIFIER CAM_SP_AV_EX_HOM ECU_ADDRESS 0x3fc218 BYTE_ORDER MSB_LAST FORMAT "%7.2" /end MEASUREMENT
/begin MEASUREMENT ivvt_ex.struct_sp_ivvt.cam_sp_av_lgrd "Exhaust camshaft target spread with limiting gradient during transition function (Þ \"enable\")" SWORD _CNV_A_R_LINEAR_____228_CM 1 100. -768. 767.9765625 DISPLAY_IDENTIFIER CAM_SP_AV_LGRD_EX ECU_ADDRESS 0x3fc21a BYTE_ORDER MSB_LAST FORMAT "%7.2" /end MEASUREMENT
/begin MEASUREMENT ivvt_ex.struct_sp_ivvt.lv_tran_ivvt "Logical variable for active transition function exhaust cam (1 = active)" UBYTE _CNV_S_2_RANGE______2_CM 1 100. 0. 1. DISPLAY_IDENTIFIER LV_TRAN_IVVT_EX ECU_ADDRESS 0x3fc21e BIT_MASK 0x1 /end MEASUREMENT
/begin MEASUREMENT ivvt_ex.struct_sp_ivvt.fac_cam_is "Temperature weighting factor exhaust camshaft  - idle speed " SBYTE _CNV_A_R_LINEAR_____236_CM 1 100. -4. 3.96875 DISPLAY_IDENTIFIER FAC_CAM_EX_IS ECU_ADDRESS 0x3fc21f FORMAT "%5.2" /end MEASUREMENT
/begin MEASUREMENT ivvt_ex.struct_sp_ivvt.fac_cam_pl "Temperature weighting factor intake camshaft  - part load " SBYTE _CNV_A_R_LINEAR_____236_CM 1 100. -4. 3.96875 DISPLAY_IDENTIFIER FAC_CAM_EX_PL ECU_ADDRESS 0x3fc220 FORMAT "%5.2" /end MEASUREMENT
/begin MEASUREMENT ivvt_ex.struct_sp_ivvt.cam_sp_ref "Exhaust camshaft target spread at reference conditions (warm engine)" SWORD _CNV_A_R_LINEAR_____228_CM 1 100. -768. 767.9765625 DISPLAY_IDENTIFIER CAM_SP_REF_EX ECU_ADDRESS 0x3fc210 BYTE_ORDER MSB_LAST FORMAT "%7.2" /end MEASUREMENT
/begin MEASUREMENT ivvt_ex.struct_sp_ivvt.cam_sp_1_hom "Exhaust camshaft target spread  - without catalyst heating influence" SWORD _CNV_A_R_LINEAR_____228_CM 1 100. -768. 767.9765625 DISPLAY_IDENTIFIER CAM_SP_1_EX_HOM ECU_ADDRESS 0x3fc20e BYTE_ORDER MSB_LAST FORMAT "%7.2" /end MEASUREMENT
/begin CHARACTERISTIC c_add_n_max_fcut "Additive threshold to maximum engine speed for activation fuel cut-off all cylinders" VALUE 0xffe414e2 _REC_VAL_20_u2 8160. _CNV_A_R_LINEAR_____10_CM 0. 8160. DISPLAY_IDENTIFIER C_ADD_N_MAX_FCUT FORMAT "%4.0" /end CHARACTERISTIC
/begin CHARACTERISTIC c_n_grd_hys "Hysteresis for N_GRD Filtering" VALUE 0xffe4038f _REC_VAL_20_s1 8160. _CNV_A_R_LINEAR_____51_CM -4096. 4064. DISPLAY_IDENTIFIER C_N_GRD_HYS FORMAT "%5.0" /end CHARACTERISTIC
/begin CHARACTERISTIC c_tqi_max_pas "Passive value indicated engine torque when engine speed limitation is inactive" VALUE 0xffe41ae6 _REC_VAL_20_u2 1023.96875 _CNV_A_R_LINEAR_____55_CM 0. 1023.96875 DISPLAY_IDENTIFIER C_TQI_MAX_PAS FORMAT "%7.2" /end CHARACTERISTIC
/begin MEASUREMENT lv_n_max_req_fcut "Logical variable fuel cut-off of all cylinder requested for engine speed limitation" UBYTE _CNV_S_2_RANGE______21_CM 1 100. 0. 1. DISPLAY_IDENTIFIER LV_N_MAX_REQ_FCUT ECU_ADDRESS 0x3fe5d0 BIT_MASK 0x1 /end MEASUREMENT
/begin MEASUREMENT n_dif_max_lim "Engine speed difference as an input for PI-controller" SWORD _CNV_A_R_LINEAR_____10_CM 1 100. -8160. 8160. DISPLAY_IDENTIFIER N_DIF_MAX_LIM ECU_ADDRESS 0x3fd5f0 BYTE_ORDER MSB_LAST FORMAT "%4.0" /end MEASUREMENT
/begin MEASUREMENT n_pred_max_lim "Predicted engine speed " UWORD _CNV_A_R_LINEAR_____10_CM 1 100. 0. 8160. DISPLAY_IDENTIFIER N_PRED_MAX_LIM ECU_ADDRESS 0x3fd5ee BYTE_ORDER MSB_LAST FORMAT "%4.0" /end MEASUREMENT
/begin MEASUREMENT tq_n_max_dif "Torque output of N_MAX-PI-Controller" SWORD _CNV_A_R_LINEAR_____55_CM 1 100. -1024. 1023.96875 DISPLAY_IDENTIFIER TQ_N_MAX_DIF ECU_ADDRESS 0x3fd5f6 BYTE_ORDER MSB_LAST FORMAT "%6.2" /end MEASUREMENT
/begin MEASUREMENT tq_n_max_dif_i "Torque output of N_MAX-I-Controller" SLONG _CNV_A_R_LINEAR_____222_CM 1 100. -1024. 1023.99999952 DISPLAY_IDENTIFIER TQ_N_MAX_DIF_I ECU_ADDRESS 0x3fcbc4 BYTE_ORDER MSB_LAST FORMAT "%11.7" /end MEASUREMENT
/begin MEASUREMENT tq_n_max_dif_p "Torque output of N_MAX-P-Controller" SWORD _CNV_A_R_LINEAR_____55_CM 1 100. -1024. 1023.96875 DISPLAY_IDENTIFIER TQ_N_MAX_DIF_P ECU_ADDRESS 0x3fd5f8 BYTE_ORDER MSB_LAST FORMAT "%6.2" /end MEASUREMENT
/begin MEASUREMENT tq_n_max_inp_i "Torque input for N_MAX I-controller" SWORD _CNV_A_R_LINEAR_____213_CM 1 100. -4. 3.99987793 DISPLAY_IDENTIFIER TQ_N_MAX_INP_I ECU_ADDRESS 0x3fd5f2 BYTE_ORDER MSB_LAST FORMAT "%5.4" /end MEASUREMENT
/begin MEASUREMENT tqi_n_max "Indicated engine torque setpoint  for N_MAX-limitation" SWORD _CNV_A_R_LINEAR_____55_CM 1 100. -1024. 1023.96875 DISPLAY_IDENTIFIER TQI_N_MAX ECU_ADDRESS 0x3fd5ec BYTE_ORDER MSB_LAST FORMAT "%8.2" /end MEASUREMENT
/begin MEASUREMENT tqi_n_max_ref "Reference indicated engine  torque on which controller output is applied" SWORD _CNV_A_R_LINEAR_____55_CM 1 100. -1024. 1023.96875 DISPLAY_IDENTIFIER TQI_N_MAX_REF ECU_ADDRESS 0x3fd5f4 BYTE_ORDER MSB_LAST FORMAT "%8.2" /end MEASUREMENT
/begin MEASUREMENT n_grd_fil "Filtered engine speed gradient for predicted engine speed" SBYTE _CNV_A_R_LINEAR_____416_CM 1 100. -4096. 4064. DISPLAY_IDENTIFIER N_GRD_FIL ECU_ADDRESS 0x3fe5d1 FORMAT "%4.0" /end MEASUREMENT
/begin CHARACTERISTIC c_crlc_n_grd_fil_1 "N_GRD_FIL low pass filter constant if LV_N_MAX = 0" VALUE 0xffe41562 _REC_VAL_20_u2 0.99998474 _CNV_A_R_LINEAR_____37_CM 0. 0.99998474 DISPLAY_IDENTIFIER C_CRLC_N_GRD_FIL_1 FORMAT "%7.5" /end CHARACTERISTIC
/begin CHARACTERISTIC c_crlc_n_grd_fil_2 "N_GRD_FIL low pass filter constant if LV_N_MAX = 1" VALUE 0xffe41564 _REC_VAL_20_u2 0.99998474 _CNV_A_R_LINEAR_____37_CM 0. 0.99998474 DISPLAY_IDENTIFIER C_CRLC_N_GRD_FIL_2 FORMAT "%7.5" /end CHARACTERISTIC
/begin CHARACTERISTIC c_tqi_n_max_inc "Maximum increment for the output when limiting increasing rate" VALUE 0xffe41ae8 _REC_VAL_20_u2 1023.96875 _CNV_A_R_LINEAR_____55_CM 0. 1023.96875 DISPLAY_IDENTIFIER C_TQI_N_MAX_INC FORMAT "%7.2" /end CHARACTERISTIC
/begin CHARACTERISTIC id_fac_n_max_i_at__gear "I-control parameter for N_MAX-controller automatic transmission" CURVE 0xffe48788 _REC_CUR_20_u2_u1 7.99987793 _CNV_A_R_LINEAR_____424_CM 0. 7.99987793 DISPLAY_IDENTIFIER ID_FAC_N_MAX_I_AT__GEAR FORMAT "%6.4"
 /begin AXIS_DESCR COM_AXIS gear _CNV_A_R_LINEAR_____0_CM 9 0. 255. FORMAT "%3.0" AXIS_PTS_REF ldpm_gear /end AXIS_DESCR
/end CHARACTERISTIC
/begin CHARACTERISTIC id_fac_n_max_p_mt__gear "P-control parameter for N_MAX-controller manual transmission" CURVE 0xffe4409e _REC_CUR_20_u1_u1 7.96875 _CNV_A_R_LINEAR_____425_CM 0. 7.96875 DISPLAY_IDENTIFIER ID_FAC_N_MAX_P_MT__GEAR FORMAT "%4.2"
 /begin AXIS_DESCR COM_AXIS gear _CNV_A_R_LINEAR_____0_CM 9 0. 255. FORMAT "%3.0" AXIS_PTS_REF ldpm_gear /end AXIS_DESCR
/end CHARACTERISTIC
/begin CHARACTERISTIC id_fac_n_max_i_mt__gear "I-control parameter for N_MAX-controller manual transmission" CURVE 0xffe4879a _REC_CUR_20_u2_u1 7.99987793 _CNV_A_R_LINEAR_____424_CM 0. 7.99987793 DISPLAY_IDENTIFIER ID_FAC_N_MAX_I_MT__GEAR FORMAT "%6.4"
 /begin AXIS_DESCR COM_AXIS gear _CNV_A_R_LINEAR_____0_CM 9 0. 255. FORMAT "%3.0" AXIS_PTS_REF ldpm_gear /end AXIS_DESCR
/end CHARACTERISTIC
/begin CHARACTERISTIC id_fac_n_max_p_at__gear "P-control parameter for N_MAX-controller automatic transmission" CURVE 0xffe44095 _REC_CUR_20_u1_u1 7.96875 _CNV_A_R_LINEAR_____425_CM 0. 7.96875 DISPLAY_IDENTIFIER ID_FAC_N_MAX_P_AT__GEAR FORMAT "%4.2"
 /begin AXIS_DESCR COM_AXIS gear _CNV_A_R_LINEAR_____0_CM 9 0. 255. FORMAT "%3.0" AXIS_PTS_REF ldpm_gear /end AXIS_DESCR
/end CHARACTERISTIC
/begin CHARACTERISTIC id_t_n_max_pred_at__gear "Prediction time for predicted engine speed for automatic transmission" CURVE 0xffe44348 _REC_CUR_20_u1_u1 7.96875 _CNV_A_R_LINEAR_____218_CM 0. 7.96875 DISPLAY_IDENTIFIER ID_T_N_MAX_PRED_AT__GEAR FORMAT "%4.2"
 /begin AXIS_DESCR COM_AXIS gear _CNV_A_R_LINEAR_____0_CM 9 0. 255. FORMAT "%3.0" AXIS_PTS_REF ldpm_gear /end AXIS_DESCR
/end CHARACTERISTIC
/begin CHARACTERISTIC id_t_n_max_pred_mt__gear "Prediction time for predicted engine speed for manual transmission" CURVE 0xffe44351 _REC_CUR_20_u1_u1 7.96875 _CNV_A_R_LINEAR_____218_CM 0. 7.96875 DISPLAY_IDENTIFIER ID_T_N_MAX_PRED_MT__GEAR FORMAT "%4.2"
 /begin AXIS_DESCR COM_AXIS gear _CNV_A_R_LINEAR_____0_CM 9 0. 255. FORMAT "%3.0" AXIS_PTS_REF ldpm_gear /end AXIS_DESCR
/end CHARACTERISTIC
/begin CHARACTERISTIC ip_n_grd_thd__n_32 "Engine speed gradient threshold for filtering of basic engine speed gradient" CURVE 0xffe40d55 _REC_CUR_20_u1_u1 8160. _CNV_A_R_LINEAR_____216_CM -4096. 4064. DISPLAY_IDENTIFIER IP_N_GRD_THD__N_32 FORMAT "%5.0"
 /begin AXIS_DESCR COM_AXIS n_32 _CNV_A_R_LINEAR_____15_CM 8 0. 8160. FORMAT "%4.0" AXIS_PTS_REF ldp_n_32_n_grd_thd /end AXIS_DESCR
/end CHARACTERISTIC
/begin MEASUREMENT n_grd_fil_fil "Low pass filtered engine speed gradient for predicted engine speed" SBYTE _CNV_A_R_LINEAR_____416_CM 1 100. -4096. 4064. DISPLAY_IDENTIFIER N_GRD_FIL_FIL ECU_ADDRESS 0x3fe5d2 FORMAT "%4.0" /end MEASUREMENT
/begin MEASUREMENT tqi_n_max_1 "Intermitted indicated engine torque after considering PI-controller output" SWORD _CNV_A_R_LINEAR_____55_CM 1 100. -1024. 1023.96875 DISPLAY_IDENTIFIER TQI_N_MAX_1 ECU_ADDRESS 0x3fd5fa BYTE_ORDER MSB_LAST FORMAT "%8.2" /end MEASUREMENT
/begin MEASUREMENT tqi_n_max_2 "Intermitted indicated engine torque after considering PI-controller output" SWORD _CNV_A_R_LINEAR_____55_CM 1 100. -1024. 1023.96875 DISPLAY_IDENTIFIER TQI_N_MAX_2 ECU_ADDRESS 0x3fd5fc BYTE_ORDER MSB_LAST FORMAT "%8.2" /end MEASUREMENT
/begin MEASUREMENT lv_n_max "Logical variable engine speed limitation active" UBYTE _CNV_S_2_RANGE______21_CM 1 100. 0. 1. DISPLAY_IDENTIFIER LV_N_MAX ECU_ADDRESS 0x3fe5cf BIT_MASK 0x1 /end MEASUREMENT
/begin AXIS_PTS ldp_n_32_n_grd_thd "" 0xffe480eb n_32 _REC_AXS_20_u1 8160. _CNV_A_R_LINEAR_____15_CM 8 0. 8160. DISPLAY_IDENTIFIER LDP_N_32_N_GRD_THD FORMAT "%4.0" /end AXIS_PTS
/begin AXIS_PTS ldpm_gear "" 0xffe4836a gear _REC_AXS_20_u1 255. _CNV_A_R_LINEAR_____0_CM 9 0. 255. DISPLAY_IDENTIFIER LDPM_GEAR FORMAT "%3.0" /end AXIS_PTS
/begin MEASUREMENT n_max "highest engine speed reached" UWORD _CNV_A_R_LINEAR_____10_CM 1 100. 1. 8160. DISPLAY_IDENTIFIER N_MAX ECU_ADDRESS 0x3fd60e BYTE_ORDER MSB_LAST FORMAT "%4.0" /end MEASUREMENT
/begin MEASUREMENT trt_n_max "total running time in case of maximum engine speed reached" ULONG _CNV_A_R_LINEAR_____172_CM 1 100. 0. 119304.6471 DISPLAY_IDENTIFIER TRT_N_MAX ECU_ADDRESS 0x3fcbc8 BYTE_ORDER MSB_LAST FORMAT "%12.5" /end MEASUREMENT
/begin CHARACTERISTIC c_n_lim_min "Engine speed threshold for overrevving event" VALUE 0xffe4180c _REC_VAL_20_u2 8160. _CNV_A_R_LINEAR_____10_CM 0. 8160. DISPLAY_IDENTIFIER C_N_LIM_MIN FORMAT "%4.0" /end CHARACTERISTIC
/begin MEASUREMENT ctr_n_max "event frequency counter" UBYTE _CNV_A_R_LINEAR_____0_CM 1 100. 0. 255. DISPLAY_IDENTIFIER CTR_N_MAX ECU_ADDRESS 0x3fe5db FORMAT "%3.0" /end MEASUREMENT
/begin MEASUREMENT ctr_km_n_max "km counter at highest event" UWORD _CNV_A_R_LINEAR_____88_CM 1 100. 0. 655350. DISPLAY_IDENTIFIER CTR_KM_N_MAX ECU_ADDRESS 0x3fd610 BYTE_ORDER MSB_LAST FORMAT "%7.0" /end MEASUREMENT
/begin MEASUREMENT n_grd_n_max "engine speed gradient at highest event" SBYTE _CNV_A_R_LINEAR_____15_CM 1 100. -4096. 4064. DISPLAY_IDENTIFIER N_GRD_N_MAX ECU_ADDRESS 0x3fe5dc FORMAT "%5.0" /end MEASUREMENT
/begin MEASUREMENT vs_n_max "vehicle speed at highest event" UBYTE _CNV_A_R_LINEAR_____23_CM 1 100. 0. 255. DISPLAY_IDENTIFIER VS_N_MAX ECU_ADDRESS 0x3fe5dd FORMAT "%3.0" /end MEASUREMENT
/begin MEASUREMENT pv_av_n_max "pedal value at highest event" UBYTE _CNV_A_R_LINEAR_____9_CM 1 100. 0. 99.609375 DISPLAY_IDENTIFIER PV_AV_N_MAX ECU_ADDRESS 0x3fe5de FORMAT "%4.1" /end MEASUREMENT
/begin MEASUREMENT gear_ef_n_max "gear ratio at highest event" UBYTE _CNV_A_R_LINEAR_____0_CM 1 100. 0. 255. DISPLAY_IDENTIFIER GEAR_EF_N_MAX ECU_ADDRESS 0x3fe5df FORMAT "%3.0" /end MEASUREMENT
/begin MEASUREMENT lv_cs_n_max "clutch switch detection at highest event" UBYTE _CNV_S_2_RANGE______2_CM 1 100. 0. 1. DISPLAY_IDENTIFIER LV_CS_N_MAX ECU_ADDRESS 0x3fe5e1 /end MEASUREMENT
/begin MEASUREMENT t_sum_n_max "time sum of all events maximum engine speed reached" UWORD _CNV_A_R_LINEAR_____24_CM 1 100. 0. 6553.5 DISPLAY_IDENTIFIER T_SUM_N_MAX ECU_ADDRESS 0x3fd612 BYTE_ORDER MSB_LAST FORMAT "%6.1" /end MEASUREMENT
/begin MEASUREMENT t_n_max "time sum at highest event" UWORD _CNV_A_R_LINEAR_____24_CM 1 100. 0. 6553.5 DISPLAY_IDENTIFIER T_N_MAX ECU_ADDRESS 0x3fd614 BYTE_ORDER MSB_LAST FORMAT "%6.1" /end MEASUREMENT
/begin MEASUREMENT nr_pat_scc_n_max "selected index off fuel cut off pattern at highest event" UBYTE _CNV_A_R_LINEAR_____0_CM 1 100. 0. 255. DISPLAY_IDENTIFIER NR_PAT_SCC_N_MAX ECU_ADDRESS 0x3fe5e0 FORMAT "%3.0" /end MEASUREMENT
/begin MEASUREMENT lv_sap "Flag for secondary air pump activation" UBYTE _CNV_S_2_RANGE______21_CM 1 100. 0. 1. DISPLAY_IDENTIFIER LV_SAP ECU_ADDRESS 0x3fe623 BIT_MASK 0x1 /end MEASUREMENT
/begin MEASUREMENT lv_sa_end "secondary air function ended for this cycle" UBYTE _CNV_S_2_RANGE______21_CM 1 100. 0. 1. DISPLAY_IDENTIFIER LV_SA_END ECU_ADDRESS 0x3fe625 BIT_MASK 0x1 /end MEASUREMENT
/begin MEASUREMENT t_state_sa_act "Time counter which is incremented when SA function is active" UWORD _CNV_A_R_LINEAR_____4_CM 1 100. 0. 655.35 DISPLAY_IDENTIFIER T_STATE_SA_ACT ECU_ADDRESS 0x3fd668 BYTE_ORDER MSB_LAST FORMAT "%6.2" /end MEASUREMENT
/begin MEASUREMENT lv_sawup "secondary air injection time correction active" UBYTE _CNV_S_2_RANGE______21_CM 1 100. 0. 1. DISPLAY_IDENTIFIER LV_SAWUP ECU_ADDRESS 0x3fe626 BIT_MASK 0x1 /end MEASUREMENT
/begin CHARACTERISTIC c_n_max_sa_deac "Engine speed threshold to interupt SA function" VALUE 0xffe407eb _REC_VAL_20_u1 8160. _CNV_A_R_LINEAR_____15_CM 0. 8160. DISPLAY_IDENTIFIER C_N_MAX_SA_DEAC FORMAT "%4.0" /end CHARACTERISTIC
/begin CHARACTERISTIC c_n_max_sa_act "Engine speed threshold to reactivate SA function" VALUE 0xffe407ea _REC_VAL_20_u1 8160. _CNV_A_R_LINEAR_____15_CM 0. 8160. DISPLAY_IDENTIFIER C_N_MAX_SA_ACT FORMAT "%4.0" /end CHARACTERISTIC
/begin CHARACTERISTIC ip_maf_sa_deac__n_32 "MAF threshold to interupt SA function" CURVE 0xffe4cf2a _REC_CUR_20_u2_u1 1389. _CNV_A_R_LINEAR_____108_CM 0. 1389. DISPLAY_IDENTIFIER IP_MAF_SA_DEAC__N_32 FORMAT "%7.2"
 /begin AXIS_DESCR COM_AXIS n_32 _CNV_A_R_LINEAR_____15_CM 8 0. 8160. FORMAT "%4.0" AXIS_PTS_REF ldpm_n_32_maf_sa_deac /end AXIS_DESCR
/end CHARACTERISTIC
/begin CHARACTERISTIC ip_maf_sa_act__n_32 "MAF threshold to reactivate SA function" CURVE 0xffe4cf1a _REC_CUR_20_u2_u1 1389. _CNV_A_R_LINEAR_____108_CM 0. 1389. DISPLAY_IDENTIFIER IP_MAF_SA_ACT__N_32 FORMAT "%7.2"
 /begin AXIS_DESCR COM_AXIS n_32 _CNV_A_R_LINEAR_____15_CM 8 0. 8160. FORMAT "%4.0" AXIS_PTS_REF ldpm_n_32_maf_sa_act /end AXIS_DESCR
/end CHARACTERISTIC
/begin MEASUREMENT lv_sav "Flag for secondary air valve activation" UBYTE _CNV_S_2_RANGE______21_CM 1 100. 0. 1. DISPLAY_IDENTIFIER LV_SAV ECU_ADDRESS 0x3fe622 BIT_MASK 0x1 /end MEASUREMENT
/begin CHARACTERISTIC c_tco_dif_min_sa "TCO threshold for incrementation the SA restart counter" VALUE 0xffe408f3 _REC_VAL_20_u1 190.5 _CNV_A_R_LINEAR_____12_CM 0. 190.5 DISPLAY_IDENTIFIER C_TCO_DIF_MIN_SA FORMAT "%5.1" /end CHARACTERISTIC
/begin MEASUREMENT lv_puc_sa_inh "inhibition of PUC during SA active for the first time" UBYTE _CNV_S_2_RANGE______21_CM 1 100. 0. 1. DISPLAY_IDENTIFIER LV_PUC_SA_INH ECU_ADDRESS 0x3fe627 BIT_MASK 0x1 /end MEASUREMENT
/begin CHARACTERISTIC ip_t_sa_off_0 "Time delay to terminate SA function" CURVE 0xffe4eb72 _REC_CUR_20_u2_u1 655.35 _CNV_A_R_LINEAR_____4_CM 0. 655.35 DISPLAY_IDENTIFIER IP_T_SA_OFF_0 FORMAT "%6.2"
 /begin AXIS_DESCR COM_AXIS tco_st _CNV_A_R_LINEAR_____11_CM 8 -48. 142.5 FORMAT "%5.1" AXIS_PTS_REF ldpm_tco_st_1_sair /end AXIS_DESCR
/end CHARACTERISTIC
/begin MEASUREMENT state_sa "State of Secondary Air Function" UBYTE _CNV_S_12_RANGE_STAT_453_CM 1 100. 0. 11. DISPLAY_IDENTIFIER STATE_SA ECU_ADDRESS 0x3fe620 /end MEASUREMENT
/begin CHARACTERISTIC c_t_dly_sap_off "Time delay for closing of SAP after SAV shut down" VALUE 0xffe4192e _REC_VAL_20_u2 655.35 _CNV_A_R_LINEAR_____4_CM 0. 655.35 DISPLAY_IDENTIFIER C_T_DLY_SAP_OFF FORMAT "%6.2" /end CHARACTERISTIC
/begin CHARACTERISTIC ip_t_sa_off_1 "Time delay to terminate SA function" CURVE 0xffe4eb82 _REC_CUR_20_u2_u1 655.35 _CNV_A_R_LINEAR_____4_CM 0. 655.35 DISPLAY_IDENTIFIER IP_T_SA_OFF_1 FORMAT "%6.2"
 /begin AXIS_DESCR COM_AXIS tco_st _CNV_A_R_LINEAR_____11_CM 8 -48. 142.5 FORMAT "%5.1" AXIS_PTS_REF ldpm_tco_st_1_sair /end AXIS_DESCR
/end CHARACTERISTIC
/begin CHARACTERISTIC ip_t_sa_off_dyn_diag "Time delay to teminate SA function (in reason of not complete SA diagnosis)" CURVE 0xffe4eb92 _REC_CUR_20_u2_u1 655.35 _CNV_A_R_LINEAR_____4_CM 0. 655.35 DISPLAY_IDENTIFIER IP_T_SA_OFF_DYN_DIAG FORMAT "%6.2"
 /begin AXIS_DESCR COM_AXIS tco_st _CNV_A_R_LINEAR_____11_CM 8 -48. 142.5 FORMAT "%5.1" AXIS_PTS_REF ldpm_tco_st_1_sair /end AXIS_DESCR
/end CHARACTERISTIC
/begin MEASUREMENT lv_sa "Calculations for SA functions are currently active" UBYTE _CNV_S_2_RANGE______21_CM 1 100. 0. 1. DISPLAY_IDENTIFIER LV_SA ECU_ADDRESS 0x3fe624 BIT_MASK 0x1 /end MEASUREMENT
/begin MEASUREMENT t_dly_sa_end "Time delay after end of secondary air injection for lambda control activation" UWORD _CNV_A_R_LINEAR_____4_CM 1 100. 0. 655.35 DISPLAY_IDENTIFIER T_DLY_SA_END ECU_ADDRESS 0x3fd664 BYTE_ORDER MSB_LAST FORMAT "%6.2" /end MEASUREMENT
/begin MEASUREMENT t_dly_sav_on "Time delay for SAV activation" UWORD _CNV_A_R_LINEAR_____4_CM 1 100. 0. 655.35 DISPLAY_IDENTIFIER T_DLY_SAV_ON ECU_ADDRESS 0x3fd666 BYTE_ORDER MSB_LAST FORMAT "%6.2" /end MEASUREMENT
/begin MEASUREMENT t_dly_sap_on "Time delay for SAP activation" UWORD _CNV_A_R_LINEAR_____4_CM 1 100. 0. 655.35 DISPLAY_IDENTIFIER T_DLY_SAP_ON ECU_ADDRESS 0x3fd662 BYTE_ORDER MSB_LAST FORMAT "%6.2" /end MEASUREMENT
/begin MEASUREMENT t_dly_sap_off "Time delay for closing of SAP after SAV shut down" UWORD _CNV_A_R_LINEAR_____4_CM 1 100. 0. 655.35 DISPLAY_IDENTIFIER T_DLY_SAP_OFF ECU_ADDRESS 0x3fd672 BYTE_ORDER MSB_LAST FORMAT "%6.2" /end MEASUREMENT
/begin CHARACTERISTIC c_t_dly_sap_on "Time delay for start of SAP " VALUE 0xffe41930 _REC_VAL_20_u2 655.35 _CNV_A_R_LINEAR_____4_CM 0. 655.35 DISPLAY_IDENTIFIER C_T_DLY_SAP_ON FORMAT "%6.2" /end CHARACTERISTIC
/begin CHARACTERISTIC c_t_dly_sav_on "Time delay for start of SAV" VALUE 0xffe41932 _REC_VAL_20_u2 655.35 _CNV_A_R_LINEAR_____4_CM 0. 655.35 DISPLAY_IDENTIFIER C_T_DLY_SAV_ON FORMAT "%6.2" /end CHARACTERISTIC
/begin AXIS_PTS ldpm_tco_st_1_sair "" 0xffe486a4 tco_st _REC_AXS_20_u1 190.5 _CNV_A_R_LINEAR_____11_CM 8 -48. 142.5 DISPLAY_IDENTIFIER LDPM_TCO_ST_1_SAIR FORMAT "%5.1" /end AXIS_PTS
/begin AXIS_PTS ldpm_n_32_maf_sa_deac "" 0xffe48564 n_32 _REC_AXS_20_u1 8160. _CNV_A_R_LINEAR_____15_CM 8 0. 8160. DISPLAY_IDENTIFIER LDPM_N_32_MAF_SA_DEAC FORMAT "%4.0" /end AXIS_PTS
/begin AXIS_PTS ldpm_n_32_maf_sa_act "" 0xffe4855b n_32 _REC_AXS_20_u1 8160. _CNV_A_R_LINEAR_____15_CM 8 0. 8160. DISPLAY_IDENTIFIER LDPM_N_32_MAF_SA_ACT FORMAT "%4.0" /end AXIS_PTS
/begin MEASUREMENT ctr_rest_sa "Restart-counter for SA activation" UBYTE _CNV_A_R_LINEAR_____0_CM 1 100. 0. 255. DISPLAY_IDENTIFIER CTR_REST_SA ECU_ADDRESS 0x3fe621 FORMAT "%3.0" /end MEASUREMENT
/begin MEASUREMENT ctr_sa_intr "Restart-counter for SA function if STATE_SA= INTR was detect" UBYTE _CNV_A_R_LINEAR_____0_CM 1 100. 0. 255. DISPLAY_IDENTIFIER CTR_SA_INTR ECU_ADDRESS 0x3fe628 FORMAT "%3.0" /end MEASUREMENT
/begin MEASUREMENT t_sa_dyn_diag "Time delay for secondary air deactivation in reason of  not fulfilled SA diagnosis (LV_SA_MIN_FLOW_DIAG=1)" UWORD _CNV_A_R_LINEAR_____4_CM 1 100. 0. 655.35 DISPLAY_IDENTIFIER T_SA_DYN_DIAG ECU_ADDRESS 0x3fd660 BYTE_ORDER MSB_LAST FORMAT "%6.2" /end MEASUREMENT
/begin MEASUREMENT t_sa_intr "actual time during STATE_SA = INTR to increment the counter c_ctr_sa_intr" UWORD _CNV_A_R_LINEAR_____4_CM 1 100. 0. 655.35 DISPLAY_IDENTIFIER T_SA_INTR ECU_ADDRESS 0x3fd66a BYTE_ORDER MSB_LAST FORMAT "%6.2" /end MEASUREMENT
/begin CHARACTERISTIC c_ctr_max_rest_sa "Number of permissible restarts before aborting SA normal operation" VALUE 0xffe406d4 _REC_VAL_20_u1 255. _CNV_A_R_LINEAR_____0_CM 0. 255. DISPLAY_IDENTIFIER C_CTR_MAX_REST_SA FORMAT "%3.0" /end CHARACTERISTIC
/begin CHARACTERISTIC c_ctr_sa_intr "Number of permissible restarts of SA function if STATE_SA = INTR was detect" VALUE 0xffe406d6 _REC_VAL_20_u1 255. _CNV_A_R_LINEAR_____0_CM 0. 255. DISPLAY_IDENTIFIER C_CTR_SA_INTR FORMAT "%3.0" /end CHARACTERISTIC
/begin CHARACTERISTIC c_t_dly_sa_end "Time delay after end of secondary air injection for lambda control activation" VALUE 0xffe4192c _REC_VAL_20_u2 655.35 _CNV_A_R_LINEAR_____4_CM 0. 655.35 DISPLAY_IDENTIFIER C_T_DLY_SA_END FORMAT "%6.2" /end CHARACTERISTIC
/begin CHARACTERISTIC c_t_sa_intr "Time during the STATE_SA = INTR to increment the counter c_ctr_sa_intr" VALUE 0xffe419f0 _REC_VAL_20_u2 655.35 _CNV_A_R_LINEAR_____4_CM 0. 655.35 DISPLAY_IDENTIFIER C_T_SA_INTR FORMAT "%6.2" /end CHARACTERISTIC
/begin CHARACTERISTIC c_t_on_sawup "Time delay before injection time correction after STATE_SA = active" VALUE 0xffe419d2 _REC_VAL_20_u2 655.35 _CNV_A_R_LINEAR_____4_CM 0. 655.35 DISPLAY_IDENTIFIER C_T_ON_SAWUP FORMAT "%6.2" /end CHARACTERISTIC
/begin CHARACTERISTIC c_t_on_sawup_is "Time delay before injection time correction after STATE_SA = active in idle" VALUE 0xffe419d4 _REC_VAL_20_u2 655.35 _CNV_A_R_LINEAR_____4_CM 0. 655.35 DISPLAY_IDENTIFIER C_T_ON_SAWUP_IS FORMAT "%6.2" /end CHARACTERISTIC
/begin MEASUREMENT fac_t_sa_off "Secondary air function: actual correction factor for the sec. air activation depending on CTR_KM_CAN" UBYTE _CNV_A_R_LINEAR_____454_CM 1 100. 1. 1.99220002 DISPLAY_IDENTIFIER FAC_T_SA_OFF ECU_ADDRESS 0x3fe654 FORMAT "%5.3" /end MEASUREMENT
/begin CHARACTERISTIC ip_fac_t_sa_off "Factor to modify the SA active-time due to catalyst age" CURVE 0xffe40bf9 _REC_CUR_20_u1_u2 0.9922000200000001 _CNV_A_R_LINEAR_____454_CM 1. 1.99220002 DISPLAY_IDENTIFIER IP_FAC_T_SA_OFF FORMAT "%5.3"
 /begin AXIS_DESCR COM_AXIS ctr_km_can _CNV_A_R_LINEAR_____88_CM 8 0. 655350. FORMAT "%7.0" AXIS_PTS_REF ldp_ctr_km_can /end AXIS_DESCR
/end CHARACTERISTIC
/begin AXIS_PTS ldp_ctr_km_can "" 0xffe50ad4 ctr_km_can _REC_AXS_20_u2 655350. _CNV_A_R_LINEAR_____88_CM 8 0. 655350. DISPLAY_IDENTIFIER LDP_CTR_KM_CAN FORMAT "%7.0" /end AXIS_PTS
/begin CHARACTERISTIC lc_cdn_sa_eol "Constant to switch on the EOL conditions (=1)" VALUE 0xffe40f3e _REC_VAL_20_u1 1. _CNV_A_R_LINEAR_____0_CM 0. 1. DISPLAY_IDENTIFIER LC_CDN_SA_EOL FORMAT "%2.0" /end CHARACTERISTIC
/begin CHARACTERISTIC c_dist_min_sa_act "necessary DIST for SA activation" VALUE 0xffe415ba _REC_VAL_20_u2 6553500. _CNV_A_R_LINEAR_____455_CM 0. 6553500. DISPLAY_IDENTIFIER C_DIST_MIN_SA_ACT FORMAT "%7.0" /end CHARACTERISTIC
/begin MEASUREMENT lv_cdn_sa_eol "Activation condition EOL for SA function" UBYTE _CNV_S_2_RANGE______21_CM 1 100. 0. 1. DISPLAY_IDENTIFIER LV_CDN_SA_EOL ECU_ADDRESS 0x3fe656 BIT_MASK 0x1 /end MEASUREMENT
/begin CHARACTERISTIC c_vb_min_sa "Minimum VB after start to activate SA" VALUE 0xffe409c1 _REC_VAL_20_u1 26. _CNV_A_R_LINEAR_____60_CM 0. 26. DISPLAY_IDENTIFIER C_VB_MIN_SA FORMAT "%4.1" /end CHARACTERISTIC
/begin MEASUREMENT lv_fct_lih_sa "Secondary air function: application indices to apply a limp home for SA function" UBYTE _CNV_S_2_RANGE______21_CM 1 100. 0. 1. DISPLAY_IDENTIFIER LV_FCT_LIH_SA ECU_ADDRESS 0x3fe655 BIT_MASK 0x1 /end MEASUREMENT
/begin MEASUREMENT state_obd_sa "Secondary air function: application indices to apply a limp home for SA function" UBYTE _CNV_S_3_RANGE_STAT_456_CM 1 100. 0. 2. DISPLAY_IDENTIFIER STATE_OBD_SA ECU_ADDRESS 0x3fe657 /end MEASUREMENT
/begin MEASUREMENT t_dly_sa_act "Time after Start of secondary air function for very slow SAF-calculation" UWORD _CNV_A_R_LINEAR_____4_CM 1 100. 0. 655.35 DISPLAY_IDENTIFIER T_DLY_SA_ACT ECU_ADDRESS 0x3fd654 BYTE_ORDER MSB_LAST FORMAT "%6.2" /end MEASUREMENT
/begin CHARACTERISTIC c_t_dly_sa_act "Delaytime after start of secondary air function for very slow SAF-calculation  " VALUE 0xffe4192a _REC_VAL_20_u2 655.35 _CNV_A_R_LINEAR_____4_CM 0. 655.35 DISPLAY_IDENTIFIER C_T_DLY_SA_ACT FORMAT "%6.2" /end CHARACTERISTIC
/begin CHARACTERISTIC c_crlc_saf_st "Correlation constant of secondary air mass flow after the start of SA" VALUE 0xffe40693 _REC_VAL_20_u1 0.9960940000000002 _CNV_A_R_LINEAR_____50_CM 0. 0.996094 DISPLAY_IDENTIFIER C_CRLC_SAF_ST FORMAT "%5.3" /end CHARACTERISTIC
/begin CHARACTERISTIC ip_saf_mdl "secondary air mass flow depending of MAF_CYL" CURVE 0xffe4e4de _REC_CUR_20_u2_u2 1023.984375 _CNV_A_R_LINEAR_____47_CM 0. 1023.984375 DISPLAY_IDENTIFIER IP_SAF_MDL FORMAT "%7.2"
 /begin AXIS_DESCR COM_AXIS maf_cyl _CNV_A_R_LINEAR_____115_CM 8 0. 2047.96875 FORMAT "%7.2" AXIS_PTS_REF ldp_maf_cyl__saf_mdl /end AXIS_DESCR
/end CHARACTERISTIC
/begin CHARACTERISTIC ip_saf_cor_vb "correction of secondary air mass flow depending of VB" CURVE 0xffe4e4ce _REC_CUR_20_u2_u1 1023.984375 _CNV_A_R_LINEAR_____47_CM 0. 1023.984375 DISPLAY_IDENTIFIER IP_SAF_COR_VB FORMAT "%7.2"
 /begin AXIS_DESCR COM_AXIS vb _CNV_A_R_LINEAR_____60_CM 8 0. 26. FORMAT "%4.1" AXIS_PTS_REF ldp_vb__saf_cor_vb /end AXIS_DESCR
/end CHARACTERISTIC
/begin CHARACTERISTIC ip_saf_cor_amp "correction of secondary air mass flow depending of AMP" CURVE 0xffe40de2 _REC_CUR_20_u1_u2 0.99610001 _CNV_A_R_LINEAR_____29_CM 0. 0.99610001 DISPLAY_IDENTIFIER IP_SAF_COR_AMP FORMAT "%5.3"
 /begin AXIS_DESCR COM_AXIS amp _CNV_A_R_LINEAR_____49_CM 8 0. 5434. FORMAT "%7.2" AXIS_PTS_REF ldp_amp__saf_cor_amp /end AXIS_DESCR
/end CHARACTERISTIC
/begin CHARACTERISTIC c_crlc_saf "Correlation constant of secondary air mass flow" VALUE 0xffe40691 _REC_VAL_20_u1 0.9960940000000002 _CNV_A_R_LINEAR_____50_CM 0. 0.996094 DISPLAY_IDENTIFIER C_CRLC_SAF FORMAT "%5.3" /end CHARACTERISTIC
/begin MEASUREMENT saf_kgh_mdl "" UWORD _CNV_A_R_LINEAR_____47_CM 1 100. 0. 1023.984375 DISPLAY_IDENTIFIER SAF_KGH_MDL ECU_ADDRESS 0x3fd652 BYTE_ORDER MSB_LAST FORMAT "%7.2" /end MEASUREMENT
/begin MEASUREMENT saf_kgh_mdl_clc "secondary mass air flow" UWORD _CNV_A_R_LINEAR_____47_CM 1 100. 0. 1023.984375 DISPLAY_IDENTIFIER SAF_KGH_MDL_CLC ECU_ADDRESS 0x3fd656 BYTE_ORDER MSB_LAST FORMAT "%7.2" /end MEASUREMENT
/begin AXIS_PTS ldp_maf_cyl__saf_mdl "secondary air mass flow depending of MAF_CYL" 0xffe50d2a maf_cyl _REC_AXS_20_u2 2047.96875 _CNV_A_R_LINEAR_____115_CM 8 0. 2047.96875 DISPLAY_IDENTIFIER LDP_MAF_CYL__SAF_MDL FORMAT "%7.2" /end AXIS_PTS
/begin AXIS_PTS ldp_amp__saf_cor_amp "correction of secondary air mass flow depending of ambient pressure" 0xffe5097c amp _REC_AXS_20_u2 5434. _CNV_A_R_LINEAR_____49_CM 8 0. 5434. DISPLAY_IDENTIFIER LDP_AMP__SAF_COR_AMP FORMAT "%7.2" /end AXIS_PTS
/begin AXIS_PTS ldp_vb__saf_cor_vb "correction of secondary air mass flow depending of battery voltage" 0xffe48311 vb _REC_AXS_20_u1 26. _CNV_A_R_LINEAR_____60_CM 8 0. 26. DISPLAY_IDENTIFIER LDP_VB__SAF_COR_VB FORMAT "%4.1" /end AXIS_PTS
/begin CHARACTERISTIC ip_saf_cor_tam "correction of secondary air mass flow depending of ambient temperature" CURVE 0xffe40dea _REC_CUR_20_u1_u1 0.99610001 _CNV_A_R_LINEAR_____29_CM 0. 0.99610001 DISPLAY_IDENTIFIER IP_SAF_COR_TAM FORMAT "%5.3"
 /begin AXIS_DESCR COM_AXIS tia _CNV_A_R_LINEAR_____11_CM 8 -48. 142.5 FORMAT "%5.1" AXIS_PTS_REF ldp_tam_ip_saf_cor_tam /end AXIS_DESCR
/end CHARACTERISTIC
/begin AXIS_PTS ldp_tam_ip_saf_cor_tam "correction of secondary air mass flow depending of ambient temperature" 0xffe481a7 tia _REC_AXS_20_u1 190.5 _CNV_A_R_LINEAR_____11_CM 8 -48. 142.5 DISPLAY_IDENTIFIER LDP_TAM_IP_SAF_COR_TAM FORMAT "%5.1" /end AXIS_PTS
/begin CHARACTERISTIC c_crlc_saf_kgh "Correlation constant of measured secondary air mass flow" VALUE 0xffe40692 _REC_VAL_20_u1 0.9960940000000002 _CNV_A_R_LINEAR_____50_CM 0. 0.996094 DISPLAY_IDENTIFIER C_CRLC_SAF_KGH FORMAT "%5.3" /end CHARACTERISTIC
/begin MEASUREMENT saf_kgh_fil "actual value of SA mass flow" UWORD _CNV_A_R_LINEAR_____47_CM 1 100. 0. 1023.984375 DISPLAY_IDENTIFIER SAF_KGH_FIL ECU_ADDRESS 0x3fd658 BYTE_ORDER MSB_LAST FORMAT "%7.2" /end MEASUREMENT
/begin MEASUREMENT conf_swi_efp_out "configuration of EFP-control" UBYTE _CNV_A_R_LINEAR_____0_CM 1 100. 0. 2. DISPLAY_IDENTIFIER CONF_SWI_EFP_OUT ECU_ADDRESS 0x3fe6f0 FORMAT "%2.0" /end MEASUREMENT
/begin AXIS_PTS ldpm_maf_cyl_ip_rel_flow_inc_cp "" 0xffe51948 maf_cyl _REC_AXS_20_u2 2047.96875 _CNV_A_R_LINEAR_____115_CM 6 0. 2047.96875 DISPLAY_IDENTIFIER LDPM_MAF_CYL_IP_REL_FLOW_INC_CP FORMAT "%6.2" /end AXIS_PTS
/begin AXIS_PTS ldpm_n_32_ip_rel_flow_max_cps "" 0xffe48545 n_32 _REC_AXS_20_u1 8160. _CNV_A_R_LINEAR_____15_CM 12 0. 8160. DISPLAY_IDENTIFIER LDPM_N_32_IP_REL_FLOW_MAX_CPS FORMAT "%4.0" /end AXIS_PTS
/begin COMPU_METHOD _CNV_A_R_LINEAR_____0_CM "" RAT_FUNC "%6.3" "-" COEFFS 0 1. 0. 0 0 1 /end COMPU_METHOD
/begin COMPU_METHOD _CNV_S_2_RANGE______2_CM "" TAB_VERB "%6.3" "[-]" COMPU_TAB_REF _CNV_S_2_RANGE______2 /end COMPU_METHOD
/begin COMPU_VTAB _CNV_S_2_RANGE______2 "" TAB_VERB 2 0 "0" 1 "1" /end COMPU_VTAB
/begin COMPU_METHOD _CNV_A_R_LINEAR_____4_CM "" RAT_FUNC "%6.3" "s" COEFFS 0 100. 0. 0 0 1 /end COMPU_METHOD
/begin COMPU_METHOD _CNV_A_R_LINEAR_____9_CM "" RAT_FUNC "%6.3" "%" COEFFS 0 2.56 0. 0 0 1 /end COMPU_METHOD
/begin COMPU_METHOD _CNV_A_R_LINEAR_____10_CM "" RAT_FUNC "%6.3" "rpm" COEFFS 0 1. 0. 0 0 1 /end COMPU_METHOD
/begin COMPU_METHOD _CNV_A_R_LINEAR_____11_CM "" RAT_FUNC "%6.3" "°C" COEFFS 0 1.333333333333333 64. 0 0 1 /end COMPU_METHOD
/begin COMPU_METHOD _CNV_A_R_LINEAR_____12_CM "" RAT_FUNC "%6.3" "°C" COEFFS 0 1.333333333333333 0. 0 0 1 /end COMPU_METHOD
/begin COMPU_METHOD _CNV_A_R_LINEAR_____13_CM "" RAT_FUNC "%6.3" "°C" COEFFS 0 1. 0. 0 0 1 /end COMPU_METHOD
/begin COMPU_METHOD _CNV_A_R_LINEAR_____14_CM "" RAT_FUNC "%6.3" "°C" COEFFS 0 1. 40. 0 0 1 /end COMPU_METHOD
/begin COMPU_METHOD _CNV_A_R_LINEAR_____15_CM "" RAT_FUNC "%6.3" "rpm" COEFFS 0 3.125e-002 0. 0 0 1 /end COMPU_METHOD
/begin COMPU_METHOD _CNV_A_R_LINEAR_____16_CM "" RAT_FUNC "%6.3" "m" COEFFS 0 1.e-002 0. 0 0 1 /end COMPU_METHOD
/begin COMPU_METHOD _CNV_A_R_LINEAR_____17_CM "" RAT_FUNC "%6.3" "%" COEFFS 0 20.48192771084338 128.0120481927711 0 0 1 /end COMPU_METHOD
/begin COMPU_METHOD _CNV_A_R_LINEAR_____18_CM "" RAT_FUNC "%6.3" "-" COEFFS 0 1.333333333333333 128. 0 0 1 /end COMPU_METHOD
/begin COMPU_METHOD _CNV_A_R_LINEAR_____19_CM "" RAT_FUNC "%6.3" "%" COEFFS 0 2.559999357490358 127.9999678745179 0 0 1 /end COMPU_METHOD
/begin COMPU_METHOD _CNV_A_R_LINEAR_____20_CM "" RAT_FUNC "%6.3" "-" COEFFS 0 32768.00003968061 0. 0 0 1 /end COMPU_METHOD
/begin COMPU_METHOD _CNV_S_2_RANGE______21_CM "" TAB_VERB "%6.3" "-" COMPU_TAB_REF _CNV_S_2_RANGE______21 /end COMPU_METHOD
/begin COMPU_VTAB _CNV_S_2_RANGE______21 "" TAB_VERB 2 0 "0" 1 "1" /end COMPU_VTAB
/begin COMPU_METHOD _CNV_A_R_LINEAR_____23_CM "" RAT_FUNC "%6.3" "km/h" COEFFS 0 1. 0. 0 0 1 /end COMPU_METHOD
/begin COMPU_METHOD _CNV_A_R_LINEAR_____24_CM "" RAT_FUNC "%6.3" "s" COEFFS 0 10. 0. 0 0 1 /end COMPU_METHOD
/begin COMPU_METHOD _CNV_A_R_LINEAR_____27_CM "" RAT_FUNC "%6.3" "mg/stk" COEFFS 0 0.183585313174946 0. 0 0 1 /end COMPU_METHOD
/begin COMPU_METHOD _CNV_A_R_LINEAR_____29_CM "" RAT_FUNC "%6.3" "-" COEFFS 0 255.9983911655618 0. 0 0 1 /end COMPU_METHOD
/begin COMPU_METHOD _CNV_A_R_LINEAR_____30_CM "" RAT_FUNC "%6.3" "s" COEFFS 0 1. 0. 0 0 1 /end COMPU_METHOD
/begin COMPU_METHOD _CNV_A_R_LINEAR_____31_CM "" RAT_FUNC "%6.3" "ms" COEFFS 0 0.1 0. 0 0 1 /end COMPU_METHOD
/begin COMPU_METHOD _CNV_A_R_LINEAR_____34_CM "" RAT_FUNC "%6.3" "V" COEFFS 0 9.846168103048838 0. 0 0 1 /end COMPU_METHOD
/begin COMPU_METHOD _CNV_A_R_LINEAR_____37_CM "" RAT_FUNC "%6.3" "-" COEFFS 0 65536.00007936121 0. 0 0 1 /end COMPU_METHOD
/begin COMPU_METHOD _CNV_A_R_LINEAR_____46_CM "" RAT_FUNC "%6.3" "-" COEFFS 0 16. 0. 0 0 1 /end COMPU_METHOD
/begin COMPU_METHOD _CNV_A_R_LINEAR_____47_CM "" RAT_FUNC "%6.3" "kg/h" COEFFS 0 64. 0. 0 0 1 /end COMPU_METHOD
/begin COMPU_METHOD _CNV_A_R_LINEAR_____49_CM "" RAT_FUNC "%6.3" "hPa" COEFFS 0 12.06017666543982 0. 0 0 1 /end COMPU_METHOD
/begin COMPU_METHOD _CNV_A_R_LINEAR_____50_CM "" RAT_FUNC "%6.3" "[-]" COEFFS 0 255.9999357490357 0. 0 0 1 /end COMPU_METHOD
/begin COMPU_METHOD _CNV_A_R_LINEAR_____51_CM "" RAT_FUNC "%6.3" "rpm/s" COEFFS 0 3.125e-002 0. 0 0 1 /end COMPU_METHOD
/begin COMPU_METHOD _CNV_A_R_LINEAR_____55_CM "" RAT_FUNC "%6.3" "Nm" COEFFS 0 32. 0. 0 0 1 /end COMPU_METHOD
/begin COMPU_METHOD _CNV_A_R_LINEAR_____60_CM "" RAT_FUNC "%6.3" "V" COEFFS 0 9.807692307692308 0. 0 0 1 /end COMPU_METHOD
/begin COMPU_METHOD _CNV_A_R_LINEAR_____82_CM "" RAT_FUNC "%6.3" "°CRK" COEFFS 0 2.666666666666667 0. 0 0 1 /end COMPU_METHOD
/begin COMPU_METHOD _CNV_A_R_LINEAR_____88_CM "" RAT_FUNC "%6.3" "km" COEFFS 0 0.1 0. 0 0 1 /end COMPU_METHOD
/begin COMPU_METHOD _CNV_A_R_LINEAR_____96_CM "" RAT_FUNC "%6.3" "l" COEFFS 0 1. 0. 0 0 1 /end COMPU_METHOD
/begin COMPU_METHOD _CNV_A_R_LINEAR_____108_CM "" RAT_FUNC "%6.3" "mg/stk" COEFFS 0 47.18142548596112 0. 0 0 1 /end COMPU_METHOD
/begin COMPU_METHOD _CNV_A_R_LINEAR_____110_CM "" RAT_FUNC "%6.3" "hPa" COEFFS 0 12.06017666543982 -1.759293338545831e-002 0 0 1 /end COMPU_METHOD
/begin COMPU_METHOD _CNV_A_R_LINEAR_____111_CM "" RAT_FUNC "%6.3" "%" COEFFS 0 655.3600000071681 3.584063961170614e-007 0 0 1 /end COMPU_METHOD
/begin COMPU_METHOD _CNV_A_R_LINEAR_____113_CM "" RAT_FUNC "%6.3" "kg/h" COEFFS 0 8191.999999679995 0. 0 0 1 /end COMPU_METHOD
/begin COMPU_METHOD _CNV_A_R_LINEAR_____115_CM "" RAT_FUNC "%6.3" "kg/h" COEFFS 0 32. 0. 0 0 1 /end COMPU_METHOD
/begin COMPU_METHOD _CNV_S_8_RANGE_STAT_119_CM "" TAB_VERB "%6.3" "-" COMPU_TAB_REF _CNV_S_8_RANGE_STAT_119 /end COMPU_METHOD
/begin COMPU_VTAB _CNV_S_8_RANGE_STAT_119 "" TAB_VERB 8 0 "CP_NOT_ACT" 1 "NO_PURGE" 2 "MIN_PURGE" 3 "RAMP_OPEN" 4 "RAMP_OPEN_FAST" 5 "MAX_PURGE" 6 "RAMP_CLOSE" 7 "WAIT_RAMP_OPEN" /end COMPU_VTAB
/begin COMPU_METHOD _CNV_S_12_RANGE_STAT_120_CM "" TAB_VERB "%6.3" "-" COMPU_TAB_REF _CNV_S_12_RANGE_STAT_120 /end COMPU_METHOD
/begin COMPU_VTAB _CNV_S_12_RANGE_STAT_120 "" TAB_VERB 12 0 "CP_NO_TRA" 1 "MIN_PURGE_TO_NO_PURGE" 2 "NO_PURGE_TO_MIN_PURGE" 3 "RAMP_OPEN_TO_NO_PURGE" 4 "RAMP_OPEN_TO_MIN_PURGE" 5 "RAMP_OPEN_FAST_TO_NO_PURGE" 6 "RAMP_OPEN_FAST_TO_MIN_PURGE" 7 "MAX_PURGE_TO_NO_PURGE" 8 "MAX_PURGE_TO_MIN_PURGE" 9 "RAMP_CLOSE_TO_NO_PURGE" 10 "WAIT_RAMP_OPEN_TO_NO_PURGE" 11 "WAIT_RAMP_OPEN_TO_MIN_PURGE" /end COMPU_VTAB
/begin COMPU_METHOD _CNV_S_3_RANGE_STAT_121_CM "" TAB_VERB "%6.3" "-" COMPU_TAB_REF _CNV_S_3_RANGE_STAT_121 /end COMPU_METHOD
/begin COMPU_VTAB _CNV_S_3_RANGE_STAT_121 "" TAB_VERB 3 0 "CP_NO_DEAC" 1 "RAMP_OPEN_DEAC" 2 "MAX_PURGE_DEAC" /end COMPU_VTAB
/begin COMPU_METHOD _CNV_A_R_LINEAR_____122_CM "" RAT_FUNC "%6.3" "[-]" COEFFS 0 32769.4989394353 0. 0 0 1 /end COMPU_METHOD
/begin COMPU_METHOD _CNV_A_R_LINEAR_____123_CM "" RAT_FUNC "%6.3" "[-]" COEFFS 0 8191.999999679995 0. 0 0 1 /end COMPU_METHOD
/begin COMPU_METHOD _CNV_A_R_LINEAR_____124_CM "" RAT_FUNC "%6.3" "kg/h" COEFFS 0 8191.999999679995 -1.280019205296412e-006 0 0 1 /end COMPU_METHOD
/begin COMPU_METHOD _CNV_A_R_LINEAR_____125_CM "" RAT_FUNC "%6.3" "-" COEFFS 0 255.9999997499962 0. 0 0 1 /end COMPU_METHOD
/begin COMPU_METHOD _CNV_A_R_LINEAR_____126_CM "" RAT_FUNC "%6.3" "-" COEFFS 0 65551.06000970239 0. 0 0 1 /end COMPU_METHOD
/begin COMPU_METHOD _CNV_A_R_LINEAR_____127_CM "" RAT_FUNC "%6.3" "-" COEFFS 0 16383.75 0. 0 0 1 /end COMPU_METHOD
/begin COMPU_METHOD _CNV_A_R_LINEAR_____128_CM "" RAT_FUNC "%6.3" "s" COEFFS 0 255.9999357490357 0. 0 0 1 /end COMPU_METHOD
/begin COMPU_METHOD _CNV_A_R_LINEAR_____129_CM "" RAT_FUNC "%6.3" "[-]" COEFFS 0 64. 0. 0 0 1 /end COMPU_METHOD
/begin COMPU_METHOD _CNV_A_R_LINEAR_____172_CM "" RAT_FUNC "%6.3" "h" COEFFS 0 35999.99999497086 0. 0 0 1 /end COMPU_METHOD
/begin COMPU_METHOD _CNV_A_R_LINEAR_____178_CM "" RAT_FUNC "%6.3" "°C" COEFFS 0 0.25 8.25 0 0 1 /end COMPU_METHOD
/begin COMPU_METHOD _CNV_A_R_LINEAR_____179_CM "" RAT_FUNC "%6.3" "%/200ms" COEFFS 0 10.2 0. 0 0 1 /end COMPU_METHOD
/begin COMPU_METHOD _CNV_A_R_LINEAR_____180_CM "" RAT_FUNC "%6.3" "s" COEFFS 0 5. -1. 0 0 1 /end COMPU_METHOD
/begin COMPU_METHOD _CNV_S_6_RANGE_STAT_182_CM "" TAB_VERB "%6.3" "-" COMPU_TAB_REF _CNV_S_6_RANGE_STAT_182 /end COMPU_METHOD
/begin COMPU_VTAB _CNV_S_6_RANGE_STAT_182 "" TAB_VERB 6 0 "EFP_OFF" 1 "EFP_ON_DLY" 2 "EFP_ON" 3 "EFP_OFF_DLY" 4 "EFP_EXT_ADJ" 5 "EFP_CRASH" /end COMPU_VTAB
/begin COMPU_METHOD _CNV_A_R_LINEAR_____183_CM "" RAT_FUNC "%6.3" "%" COEFFS 0 2.551020408163265 0. 0 0 1 /end COMPU_METHOD
/begin COMPU_METHOD _CNV_A_R_LINEAR_____184_CM "" RAT_FUNC "%6.3" "l/h" COEFFS 0 1. 0. 0 0 1 /end COMPU_METHOD
/begin COMPU_METHOD _CNV_A_R_LINEAR_____213_CM "" RAT_FUNC "%6.3" "Nm" COEFFS 0 8191.999999679995 -1.280019205296412e-006 0 0 1 /end COMPU_METHOD
/begin COMPU_METHOD _CNV_A_R_LINEAR_____216_CM "" RAT_FUNC "%6.3" "rpm" COEFFS 0 3.125e-002 128. 0 0 1 /end COMPU_METHOD
/begin COMPU_METHOD _CNV_A_R_LINEAR_____218_CM "" RAT_FUNC "%6.3" "s" COEFFS 0 32. 0. 0 0 1 /end COMPU_METHOD
/begin COMPU_METHOD _CNV_A_R_LINEAR_____222_CM "" RAT_FUNC "%6.3" "Nm" COEFFS 0 2097152.000003239 3.316402435302734e-003 0 0 1 /end COMPU_METHOD
/begin COMPU_METHOD _CNV_A_R_LINEAR_____226_CM "" RAT_FUNC "%6.3" "°CRK/10ms" COEFFS 0 42.66666666666666 0. 0 0 1 /end COMPU_METHOD
/begin COMPU_METHOD _CNV_A_R_LINEAR_____227_CM "" RAT_FUNC "%6.3" "°CRK" COEFFS 0 -2.666666666666667 -106.6666666666667 0 0 1 /end COMPU_METHOD
/begin COMPU_METHOD _CNV_A_R_LINEAR_____228_CM "" RAT_FUNC "%6.3" "°CRK" COEFFS 0 42.66666666666666 0. 0 0 1 /end COMPU_METHOD
/begin COMPU_METHOD _CNV_A_R_LINEAR_____229_CM "" RAT_FUNC "%6.3" "-" COEFFS 0 32. 128. 0 0 1 /end COMPU_METHOD
/begin COMPU_METHOD _CNV_A_R_LINEAR_____230_CM "" RAT_FUNC "%6.3" "°CRK" COEFFS 0 2.666666666666667 -160. 0 0 1 /end COMPU_METHOD
/begin COMPU_METHOD _CNV_A_R_LINEAR_____236_CM "" RAT_FUNC "%6.3" "-" COEFFS 0 32. 0. 0 0 1 /end COMPU_METHOD
/begin COMPU_METHOD _CNV_A_R_LINEAR_____416_CM "" RAT_FUNC "%6.3" "1/min/s" COEFFS 0 3.125e-002 0. 0 0 1 /end COMPU_METHOD
/begin COMPU_METHOD _CNV_A_R_LINEAR_____424_CM "" RAT_FUNC "%6.3" "Nm/rpm" COEFFS 0 8191.999999679995 0. 0 0 1 /end COMPU_METHOD
/begin COMPU_METHOD _CNV_A_R_LINEAR_____425_CM "" RAT_FUNC "%6.3" "Nm/rpm" COEFFS 0 32. 0. 0 0 1 /end COMPU_METHOD
/begin COMPU_METHOD _CNV_S_12_RANGE_STAT_453_CM "" TAB_VERB "%6.3" "[-]" COMPU_TAB_REF _CNV_S_12_RANGE_STAT_453 /end COMPU_METHOD
/begin COMPU_VTAB _CNV_S_12_RANGE_STAT_453 "" TAB_VERB 12 0 "SA_INACTIVE" 1 "SA_DELAY" 2 "SA_ACTIVE" 3 "INTERRUPT" 4 "SAP_DELAY" 5 "FINISHED" 6 "CANCELLED" 7 "EXT_ADJ" 8 "EXT_ADJ_FIN" 9 "EOL_SA_ACT" 10 "EOL_SA_SAP_ACT" 11 "EOL_SA_FIN" /end COMPU_VTAB
/begin COMPU_METHOD _CNV_A_R_LINEAR_____454_CM "" RAT_FUNC "%6.3" "-" COEFFS 0 257.0046309815635 -257.0046309815635 0 0 1 /end COMPU_METHOD
/begin COMPU_METHOD _CNV_A_R_LINEAR_____455_CM "" RAT_FUNC "%6.3" "-" COEFFS 0 1.e-002 0. 0 0 1 /end COMPU_METHOD
/begin COMPU_METHOD _CNV_S_3_RANGE_STAT_456_CM "" TAB_VERB "%6.3" "-" COMPU_TAB_REF _CNV_S_3_RANGE_STAT_456 /end COMPU_METHOD
/begin COMPU_VTAB _CNV_S_3_RANGE_STAT_456 "" TAB_VERB 3 0 "Upstream of first catalytic converter" 1 "Downstream of first catalytic coverter inlet" 2 "Atmoshere / off" /end COMPU_VTAB
/begin RECORD_LAYOUT _REC_VAL_20_u1 FNC_VALUES 1 UBYTE COLUMN_DIR DIRECT /end RECORD_LAYOUT
/begin RECORD_LAYOUT _REC_VAL_20_u2 FNC_VALUES 1 UWORD COLUMN_DIR DIRECT /end RECORD_LAYOUT
/begin RECORD_LAYOUT _REC_CUR_20_u2_u1 FNC_VALUES 1 UWORD COLUMN_DIR DIRECT /end RECORD_LAYOUT
/begin RECORD_LAYOUT _REC_AXS_20_u1 NO_AXIS_PTS_X 1 UBYTE AXIS_PTS_X 2 UBYTE INDEX_INCR DIRECT /end RECORD_LAYOUT
/begin RECORD_LAYOUT _REC_MAP_20_u1_u1_u1 FNC_VALUES 1 UBYTE COLUMN_DIR DIRECT /end RECORD_LAYOUT
/begin RECORD_LAYOUT _REC_CUR_20_u1_u1 FNC_VALUES 1 UBYTE COLUMN_DIR DIRECT /end RECORD_LAYOUT
/begin RECORD_LAYOUT _REC_AXS_20_u2 NO_AXIS_PTS_X 1 UWORD AXIS_PTS_X 2 UWORD INDEX_INCR DIRECT /end RECORD_LAYOUT
/begin RECORD_LAYOUT _REC_MAP_20_u1_u1_u2 FNC_VALUES 1 UBYTE COLUMN_DIR DIRECT /end RECORD_LAYOUT
/begin RECORD_LAYOUT _REC_CUR_20_u1_u2 FNC_VALUES 1 UBYTE COLUMN_DIR DIRECT /end RECORD_LAYOUT
/begin RECORD_LAYOUT _REC_MAP_20_u2_u1_u1 FNC_VALUES 1 UWORD COLUMN_DIR DIRECT /end RECORD_LAYOUT
/begin RECORD_LAYOUT _REC_CUR_20_u2_u2 FNC_VALUES 1 UWORD COLUMN_DIR DIRECT /end RECORD_LAYOUT
/begin RECORD_LAYOUT _REC_VAL_20_s1 FNC_VALUES 1 SBYTE COLUMN_DIR DIRECT /end RECORD_LAYOUT
/begin RECORD_LAYOUT _REC_VAL_20_s2 FNC_VALUES 1 SWORD COLUMN_DIR DIRECT /end RECORD_LAYOUT
/begin RECORD_LAYOUT _REC_MAP_20_u1_u2_u2 FNC_VALUES 1 UBYTE COLUMN_DIR DIRECT /end RECORD_LAYOUT
/begin FUNCTION AUX_Auxiliary_Functions "AUX"
 /begin SUB_FUNCTION AUX_Blocking_of_the_air_conditio AUX_Engine_speed_limitation_cont AUX_Electrical_fuel_pump_control AUX_Electronically_controled_the AUX_Fuel_pressure_control AUX_Evaporative_emission_control AUX_Disa AUX_IVVT_setpoint_coordination AUX_Exhaust_gas_recirculation AUX_Control_of_electric_fan AUX_Secondary_air AUX_Determination_of_secondary_a AUX_Port_Deactivation_Setpoint_C AUX_Power_Management AUX_Calculating_the_pulse_width_ AUX_Coil_substitute_temperature AUX_Calculation_of_delay AUX_IVVT_Controller AUX_Adaptation_of_reference_and_ AUX_Infinitely_variable_valve_ti AUX_Exhaust_flap_actuation AUX_IVVT_application_Incidences AUX_Starter_Relay_Control AUX_E_box_cooling_fan AUX_Application_incidences_for_E AUX_IVVT_setpoint_for_homogeneou AUX_IVVT_setpoint_for_stratified AUX_Application_incidences_for_t AUX_Sound_Flap_Control AUX_Mastershift AUX_Coordination_of_secondary_ai AUX_Electronically_controlled_ra AUX_Flow_Calculations___Evaporat AUX_Canister_Purge_ON_OFF_Valve_ AUX_Time_Control_between_lambda_ AUX_Variable_Intake_Manifold AUX_General_Port_Flap AUX_Port_flap_position_controlle AUX_Adaptation_of_lower_and_high AUX_Overload_protection AUX_QLT_SENSOR /end SUB_FUNCTION
/end FUNCTION
/begin FUNCTION AUX_Blocking_of_the_air_conditio "_Blocking of the air conditioner compressor"
 /begin DEF_CHARACTERISTIC c_vs_max_accin c_accin_dly_1 c_accin_dly_1_lock_fl c_accin_dly_4 c_pvs_fl_accin c_accin_dly_5 c_tco_max_accin c_tco_max_accin_hys ip_t_acc_dly_on__n_32 ip_t_acc_dly_off__n_32 /end DEF_CHARACTERISTIC
 /begin OUT_MEASUREMENT lv_accout_rly_ena lv_accout_rly t_acc t_acc_dly /end OUT_MEASUREMENT
/end FUNCTION
/begin FUNCTION AUX_Engine_speed_limitation_cont "_Engine speed limitation controller"
 /begin DEF_CHARACTERISTIC c_add_n_max_fcut c_n_grd_hys c_tqi_max_pas c_crlc_n_grd_fil_1 c_crlc_n_grd_fil_2 c_tqi_n_max_inc id_fac_n_max_i_at__gear id_fac_n_max_p_mt__gear id_fac_n_max_i_mt__gear id_fac_n_max_p_at__gear id_t_n_max_pred_at__gear id_t_n_max_pred_mt__gear ip_n_grd_thd__n_32 c_n_lim_min /end DEF_CHARACTERISTIC
 /begin OUT_MEASUREMENT lv_n_max_req_fcut n_dif_max_lim n_pred_max_lim tq_n_max_dif tq_n_max_dif_i tq_n_max_dif_p tq_n_max_inp_i tqi_n_max tqi_n_max_ref n_grd_fil n_grd_fil_fil tqi_n_max_1 tqi_n_max_2 lv_n_max n_max trt_n_max ctr_n_max ctr_km_n_max n_grd_n_max vs_n_max pv_av_n_max gear_ef_n_max lv_cs_n_max t_sum_n_max t_n_max nr_pat_scc_n_max /end OUT_MEASUREMENT
/end FUNCTION
/begin FUNCTION AUX_Electrical_fuel_pump_control "_Electrical fuel pump control"
 /begin DEF_CHARACTERISTIC c_vb_efp_ref c_t_efp lc_level_on_efp ip_t_efp_ast_max ip_vff_efp_fl ip_vff_vepu_ftl ip_vff_vepu_ftl_dif c_t_efp_prev /end DEF_CHARACTERISTIC
 /begin OUT_MEASUREMENT t_dly_efp state_efp efppwm vff_efp vff_vepu_add_efp vff_vepu_fco_av ftl_dif conf_swi_efp_out /end OUT_MEASUREMENT
/end FUNCTION
/begin FUNCTION AUX_Electronically_controled_the "_Electronically controled thermostat"
 /begin DEF_CHARACTERISTIC c_tco_bol_ect c_tco_ex_hys_ect c_tco_ex_max_ect c_tco_min_ect c_tco_sp_tco_ex_max c_tco_sp_toil_min c_tia_hys_ect c_toil_hys_ect c_toil_min_ect id_ectpwm_add__n__tco_sp ip_dist_min__tco_st ip_ectpwm_i__tco_dif ip_ectpwm_p__tco_dif c_toil_max_ect c_tco_temp_gb_1 c_tco_temp_gb_2 c_ectpwm_man lc_ectpwm_man ldp_n_32__ectpwm_add ldp_tco_dif__ectpwm_i ldp_tco_dif__ectpwm_p ldp_tco_sp__ectpwm_add ldp_tco_st__dist c_tia_max_ect c_tia_min_ect c_tam_hys_ect id_tco_sp_ect id_tco_sp_ect_acin c_tco_sp_tia_max c_tco_sp_tam c_tam_min_ect c_tam_max_ect /end DEF_CHARACTERISTIC
 /begin OUT_MEASUREMENT tco_sp lv_ect_wup ectpwm /end OUT_MEASUREMENT
/end FUNCTION
/begin FUNCTION AUX_Fuel_pressure_control "_Fuel pressure control" /end FUNCTION
/begin FUNCTION AUX_Evaporative_emission_control "_Evaporative emission control"
 /begin DEF_CHARACTERISTIC c_prs_max_2_cps c_t_di_ramp_open_cp c_t_di_max_cp c_t_dly_cp c_t_dly_max_cp c_fuel_fac_cp c_cl_dyw_max_cp c_cl_st_cp c_lam_dif_max_cp c_rel_flow_ini_cps c_t_dly_max_ramp_open c_cl_mmv_dyw c_flow_min_cps c_dif_max_ti_lam_cp c_dif_min_ti_lam_cp c_t_dly_req_cp ip_rel_flow_inc_cp__maf_cyl ip_rel_flow_fac_cp__cl ip_cl_crlc_ramp_open__maf_cyl ip_cl_crlc_open_fast__maf_cyl ip_cl_crlc__maf_cyl ip_rel_flow_dec_cp__maf_cyl ip_rel_flow_max_cps__n_32__maf ip_rel_flow_min_cps__n_32__maf ip_rel_flow_inc_2_cp__maf_cyl ip_rel_flow_dec_v1_cp__maf_cyl ip_rel_flow_dec_v2_cp__maf_cyl ip_t_dly_cl_mmv_dyw__maf_cyl ip_nr_step_cl__cl_mmv ip_cl_crlc_init__cl_mmv ip_rel_fuel_flow_max_cp_cor c_cl_max_cp c_cl_cat_diag lc_lam_cbk_cps lc_lam_0_cp_ini_cp lc_init_cl_crlc lc_mod_sel_cp_min c_t_dly_cp_lamb_ch /end DEF_CHARACTERISTIC
 /begin OUT_MEASUREMENT state_cp state_tra_cp state_norm_deac_cp rel_flow_open_cps rel_flow_max_cps rel_flow_cps rel_flow_cps_di rel_flow_cps_old rel_flow_cps_old_di lam_dif_cp fuel_flow_max_cp fuel_flow_cp cl cl_mmv cl_mmv_di cl_mmv_old cl_mmv_old_di cl_mmv_norm_purge_end lam_0_cp lam_cp lv_ramp_close_end lv_ramp_open_act lv_max_purge_act fuel_flow_add_ad_cp t_dly_max_cp fuel_flow_lam_cp cl_mmv_dyw_min cl_mmv_dyw_max lv_t_ramp_open_end lv_min_purge_stab_act lv_t_dly_req_cp lam_adj_cp lv_lam_adj_cp lv_tra_lam_cp lv_cl_calc_avl lv_cl_mmv fac_cor_cp_flow t_dly_cp_lamb_ch /end OUT_MEASUREMENT
/end FUNCTION
/begin FUNCTION AUX_Disa "_Disa" /end FUNCTION
/begin FUNCTION AUX_IVVT_setpoint_coordination "_IVVT setpoint coordination"
 /begin DEF_CHARACTERISTIC c_lgrd_cam_sp_vo_inc c_lgrd_cam_sp_vo_dec ip_cam_sp_2_ex_is__n__maf_ivvt c_cam_sp_as_ex c_cam_sp_as_in c_cam_sp_dif_max c_lgrd_cam_sp_tra c_t_cam_sp_lgrd ip_fac_cam_in_is__tco__tco_st ip_cam_sp_2_ex_fl__n ip_fac_cam_in_pl__tco__tco_st ip_cam_sp_2_ex_pl__n__maf_ivvt ip_cam_sp_2_in_fl__n ip_cam_sp_1_ex_fl__n ip_cam_sp_2_in_is__n__maf_ivvt ip_cam_sp_2_in_pl__n__maf_ivvt ip_cam_sp_1_ex_pl__n__maf_ivvt ip_cam_sp_1_in_fl__n ip_fac_cam_ex_is__tco__tco_st ip_fac_cam_ex_pl__tco__tco_st ip_cam_sp_1_in_pl__n__maf_ivvt ip_cam_sp_1_ex_is__n__maf_ivvt ip_cam_sp_1_in_is__n__maf_ivvt ip_cam_sp_ch_in ip_cam_sp_ch_dri_in ip_cam_sp_ch_ex ip_cam_sp_ch_dri_ex ip_fac_cam_sp_ch_km c_t_dri_ch_ivvt ip_fac_cam_sp_ch_opp c_t_ramp_ch_ivvt id_cmb_ivvt ip_pv_max_fl_ivvt__n c_cam_sp_hys_neut_ivvt_ex c_cam_sp_park_in c_cam_sp_park_ex c_cam_sp_hys_neut_ivvt_in c_fac_cam_sp_pl_wout_cat /end DEF_CHARACTERISTIC
 /begin OUT_MEASUREMENT lv_pvs_fl_ivvt t_cam_sp_act fac_ch_ivvt_dri fac_deac_ch_ivvt fac_ivvt_sp_ch ivvt_in.struct_sp_ivvt.cam_sp_ivvt ivvt_in.struct_sp_ivvt.cam_sp_park ivvt_in.struct_sp_ivvt.cam_sp_ivvt_lim ivvt_in.struct_sp_ivvt.cam_sp_ivvt_hys ivvt_in.struct_sp_ivvt.cam_sp_av ivvt_in.struct_sp_ivvt.cam_sp_av_hom ivvt_in.struct_sp_ivvt.cam_sp_av_lgrd ivvt_in.struct_sp_ivvt.lv_tran_ivvt ivvt_in.struct_sp_ivvt.fac_cam_is ivvt_in.struct_sp_ivvt.fac_cam_pl ivvt_in.struct_sp_ivvt.cam_sp_ref ivvt_in.struct_sp_ivvt.cam_sp_1_hom ivvt_ex.struct_sp_ivvt.cam_sp_ivvt ivvt_ex.struct_sp_ivvt.cam_sp_park ivvt_ex.struct_sp_ivvt.cam_sp_ivvt_lim ivvt_ex.struct_sp_ivvt.cam_sp_ivvt_hys ivvt_ex.struct_sp_ivvt.cam_sp_av ivvt_ex.struct_sp_ivvt.cam_sp_av_hom ivvt_ex.struct_sp_ivvt.cam_sp_av_lgrd ivvt_ex.struct_sp_ivvt.lv_tran_ivvt ivvt_ex.struct_sp_ivvt.fac_cam_is ivvt_ex.struct_sp_ivvt.fac_cam_pl ivvt_ex.struct_sp_ivvt.cam_sp_ref ivvt_ex.struct_sp_ivvt.cam_sp_1_hom /end OUT_MEASUREMENT
/end FUNCTION
/begin FUNCTION AUX_Exhaust_gas_recirculation "_Exhaust gas recirculation" /end FUNCTION
/begin FUNCTION AUX_Control_of_electric_fan "_Control of electric fan"
 /begin DEF_CHARACTERISTIC id_ecfpwm_igk_off__temp_cat ip_n_ecf_temp_cat id_n_ecf_min_accin ip_temp_sub_ecf_ini ip_n_perc_ecf c_tco_hys_cat c_crlc_inc_cat_ecf c_crlc_dec_cat_ecf c_n_ecf_hys c_n_perc_ecf_lgrd c_t_n_perc_ecf_as c_t_n_perc_ecf_act c_t_n_ecf_ast c_ecfpwm_max c_n_perc_act_ecf c_ecfpwm_act_ecf c_tco_ex_max_vs_hys c_tco_ex_max_vs ip_n_ecf c_vb_ecf_grd_max c_vb_ecf ip_n_ecf_vs_cor ip_n_ecf_temp_gb c_toil_hys_cat c_n_ecf_temp_gb_max c_ecfpwm_min c_ecfpwm_ecf_man lc_ecfpwm_ecf_man lc_ecfpwm_ecf_vb_cor_di /end DEF_CHARACTERISTIC
 /begin OUT_MEASUREMENT temp_mmv_sub_cat_ecf temp_mmv_sub_cat_ecf_stop ecfpwm_ecf n_ecf_min_hys n_ecf_cor n_perc ecfpwm_igk_off n_ecf_cor_fil n_ecf_temp_gb_max /end OUT_MEASUREMENT
/end FUNCTION
/begin FUNCTION AUX_Secondary_air "_Secondary air"
 /begin DEF_CHARACTERISTIC c_n_max_sa_deac c_n_max_sa_act ip_maf_sa_deac__n_32 ip_maf_sa_act__n_32 c_tco_dif_min_sa ip_t_sa_off_0 c_t_dly_sap_off ip_t_sa_off_1 ip_t_sa_off_dyn_diag c_t_dly_sap_on c_t_dly_sav_on c_ctr_max_rest_sa c_ctr_sa_intr c_t_dly_sa_end c_t_sa_intr c_t_on_sawup c_t_on_sawup_is ip_fac_t_sa_off lc_cdn_sa_eol c_dist_min_sa_act c_vb_min_sa /end DEF_CHARACTERISTIC
 /begin OUT_MEASUREMENT lv_sap lv_sa_end t_state_sa_act lv_sawup lv_sav lv_puc_sa_inh state_sa lv_sa t_dly_sa_end t_dly_sav_on t_dly_sap_on t_dly_sap_off ctr_rest_sa ctr_sa_intr t_sa_dyn_diag t_sa_intr fac_t_sa_off lv_cdn_sa_eol lv_fct_lih_sa state_obd_sa /end OUT_MEASUREMENT
/end FUNCTION
/begin FUNCTION AUX_Determination_of_secondary_a "_Determination of secondary air mass flow"
 /begin DEF_CHARACTERISTIC c_t_dly_sa_act c_crlc_saf_st ip_saf_mdl ip_saf_cor_vb ip_saf_cor_amp c_crlc_saf ip_saf_cor_tam c_crlc_saf_kgh /end DEF_CHARACTERISTIC
 /begin OUT_MEASUREMENT t_dly_sa_act saf_kgh_mdl saf_kgh_mdl_clc saf_kgh_fil /end OUT_MEASUREMENT
/end FUNCTION
/begin FUNCTION AUX_Port_Deactivation_Setpoint_C "_Port Deactivation Setpoint Calculation" /end FUNCTION
/end MODULE
/end PROJECT
/* -------------------------------------------------------------------------
ETAS - Data Declaration System (DDS)
Quality FE<0> NCE<0> E<1031> W<676>
Quantity Maps <1779> Parameter<3588> Axes<1024> Online<7779>
------------------------------------------------------------------------- */
