ASAP2_VERSION 1 41
/begin PROJECT MSD85 "Spray Guided DI-System with Piezo Injectors for 8-Cylinder"
/begin HEADER "_default_HeaderComment" PROJECT_NO _91 /end HEADER
/begin MODULE _default_ModuleName "_default_ModuleLongIdentifier"
/begin MOD_COMMON "_default_ModCommonComment" DEPOSIT ABSOLUTE BYTE_ORDER MSB_LAST ALIGNMENT_BYTE 1 ALIGNMENT_WORD 2 ALIGNMENT_LONG 2 ALIGNMENT_FLOAT32_IEEE 2 ALIGNMENT_FLOAT64_IEEE 4 /end MOD_COMMON
/begin CHARACTERISTIC fmy_id_syn_crk_cam_ex_1.dtc "DTC table declaration for the diagnosis instance XX" MAP 0xa0804808 _REC_MAP_20_u2_u2_u2 65535. _CNV_A_R_LINEAR_____0_CM 0. 65535. DISPLAY_IDENTIFIER ID_ERR_DTC_SYN_CRK_CAM_EX_1 FORMAT "%5.0"
 /begin AXIS_DESCR COM_AXIS errm_online_dummy _CNV_S_2_ERRM_DTC_R_477_CM 1 0. 1. AXIS_PTS_REF ldp_nr_1_id_err_dtc /end AXIS_DESCR
 /begin AXIS_DESCR COM_AXIS errm_online_dummy _CNV_S_6_ERRM_DTC_R_478_CM 6 0. 5. AXIS_PTS_REF ldp_nr_2_id_err_dtc /end AXIS_DESCR
/end CHARACTERISTIC
/begin CHARACTERISTIC fmy_id_tooth_off_in_1.dtc "DTC table declaration for the diagnosis instance XX" MAP 0xa0804a9c _REC_MAP_20_u2_u2_u2 65535. _CNV_A_R_LINEAR_____0_CM 0. 65535. DISPLAY_IDENTIFIER ID_ERR_DTC_TOOTH_OFF_IN_1 FORMAT "%5.0"
 /begin AXIS_DESCR COM_AXIS errm_online_dummy _CNV_S_2_ERRM_DTC_R_477_CM 1 0. 1. AXIS_PTS_REF ldp_nr_1_id_err_dtc /end AXIS_DESCR
 /begin AXIS_DESCR COM_AXIS errm_online_dummy _CNV_S_6_ERRM_DTC_R_478_CM 6 0. 5. AXIS_PTS_REF ldp_nr_2_id_err_dtc /end AXIS_DESCR
/end CHARACTERISTIC
/begin CHARACTERISTIC fmy_id_tooth_off_ex_1.dtc "DTC table declaration for the diagnosis instance XX" MAP 0xa0804a74 _REC_MAP_20_u2_u2_u2 65535. _CNV_A_R_LINEAR_____0_CM 0. 65535. DISPLAY_IDENTIFIER ID_ERR_DTC_TOOTH_OFF_EX_1 FORMAT "%5.0"
 /begin AXIS_DESCR COM_AXIS errm_online_dummy _CNV_S_2_ERRM_DTC_R_477_CM 1 0. 1. AXIS_PTS_REF ldp_nr_1_id_err_dtc /end AXIS_DESCR
 /begin AXIS_DESCR COM_AXIS errm_online_dummy _CNV_S_6_ERRM_DTC_R_478_CM 6 0. 5. AXIS_PTS_REF ldp_nr_2_id_err_dtc /end AXIS_DESCR
/end CHARACTERISTIC
/begin CHARACTERISTIC fmy_id_plaus_cam_in_2.dtc "DTC table declaration for the diagnosis instance XX" MAP 0xa0804308 _REC_MAP_20_u2_u2_u2 65535. _CNV_A_R_LINEAR_____0_CM 0. 65535. DISPLAY_IDENTIFIER ID_ERR_DTC_PLAUS_CAM_IN_2 FORMAT "%5.0"
 /begin AXIS_DESCR COM_AXIS errm_online_dummy _CNV_S_2_ERRM_DTC_R_477_CM 1 0. 1. AXIS_PTS_REF ldp_nr_1_id_err_dtc /end AXIS_DESCR
 /begin AXIS_DESCR COM_AXIS errm_online_dummy _CNV_S_6_ERRM_DTC_R_478_CM 6 0. 5. AXIS_PTS_REF ldp_nr_2_id_err_dtc /end AXIS_DESCR
/end CHARACTERISTIC
/begin CHARACTERISTIC fmy_id_plaus_cam_ex_2.dtc "DTC table declaration for the diagnosis instance XX" MAP 0xa08042e0 _REC_MAP_20_u2_u2_u2 65535. _CNV_A_R_LINEAR_____0_CM 0. 65535. DISPLAY_IDENTIFIER ID_ERR_DTC_PLAUS_CAM_EX_2 FORMAT "%5.0"
 /begin AXIS_DESCR COM_AXIS errm_online_dummy _CNV_S_2_ERRM_DTC_R_477_CM 1 0. 1. AXIS_PTS_REF ldp_nr_1_id_err_dtc /end AXIS_DESCR
 /begin AXIS_DESCR COM_AXIS errm_online_dummy _CNV_S_6_ERRM_DTC_R_478_CM 6 0. 5. AXIS_PTS_REF ldp_nr_2_id_err_dtc /end AXIS_DESCR
/end CHARACTERISTIC
/begin CHARACTERISTIC fmy_id_syn_crk_cam_in_2.dtc "DTC table declaration for the diagnosis instance XX" MAP 0xa0804844 _REC_MAP_20_u2_u2_u2 65535. _CNV_A_R_LINEAR_____0_CM 0. 65535. DISPLAY_IDENTIFIER ID_ERR_DTC_SYN_CRK_CAM_IN_2 FORMAT "%5.0"
 /begin AXIS_DESCR COM_AXIS errm_online_dummy _CNV_S_2_ERRM_DTC_R_477_CM 1 0. 1. AXIS_PTS_REF ldp_nr_1_id_err_dtc /end AXIS_DESCR
 /begin AXIS_DESCR COM_AXIS errm_online_dummy _CNV_S_6_ERRM_DTC_R_478_CM 6 0. 5. AXIS_PTS_REF ldp_nr_2_id_err_dtc /end AXIS_DESCR
/end CHARACTERISTIC
/begin CHARACTERISTIC fmy_id_syn_crk_cam_ex_2.dtc "DTC table declaration for the diagnosis instance XX" MAP 0xa080481c _REC_MAP_20_u2_u2_u2 65535. _CNV_A_R_LINEAR_____0_CM 0. 65535. DISPLAY_IDENTIFIER ID_ERR_DTC_SYN_CRK_CAM_EX_2 FORMAT "%5.0"
 /begin AXIS_DESCR COM_AXIS errm_online_dummy _CNV_S_2_ERRM_DTC_R_477_CM 1 0. 1. AXIS_PTS_REF ldp_nr_1_id_err_dtc /end AXIS_DESCR
 /begin AXIS_DESCR COM_AXIS errm_online_dummy _CNV_S_6_ERRM_DTC_R_478_CM 6 0. 5. AXIS_PTS_REF ldp_nr_2_id_err_dtc /end AXIS_DESCR
/end CHARACTERISTIC
/begin CHARACTERISTIC fmy_id_tooth_off_in_2.dtc "DTC table declaration for the diagnosis instance XX" MAP 0xa0804ab0 _REC_MAP_20_u2_u2_u2 65535. _CNV_A_R_LINEAR_____0_CM 0. 65535. DISPLAY_IDENTIFIER ID_ERR_DTC_TOOTH_OFF_IN_2 FORMAT "%5.0"
 /begin AXIS_DESCR COM_AXIS errm_online_dummy _CNV_S_2_ERRM_DTC_R_477_CM 1 0. 1. AXIS_PTS_REF ldp_nr_1_id_err_dtc /end AXIS_DESCR
 /begin AXIS_DESCR COM_AXIS errm_online_dummy _CNV_S_6_ERRM_DTC_R_478_CM 6 0. 5. AXIS_PTS_REF ldp_nr_2_id_err_dtc /end AXIS_DESCR
/end CHARACTERISTIC
/begin CHARACTERISTIC fmy_id_tooth_off_ex_2.dtc "DTC table declaration for the diagnosis instance XX" MAP 0xa0804a88 _REC_MAP_20_u2_u2_u2 65535. _CNV_A_R_LINEAR_____0_CM 0. 65535. DISPLAY_IDENTIFIER ID_ERR_DTC_TOOTH_OFF_EX_2 FORMAT "%5.0"
 /begin AXIS_DESCR COM_AXIS errm_online_dummy _CNV_S_2_ERRM_DTC_R_477_CM 1 0. 1. AXIS_PTS_REF ldp_nr_1_id_err_dtc /end AXIS_DESCR
 /begin AXIS_DESCR COM_AXIS errm_online_dummy _CNV_S_6_ERRM_DTC_R_478_CM 6 0. 5. AXIS_PTS_REF ldp_nr_2_id_err_dtc /end AXIS_DESCR
/end CHARACTERISTIC
/begin CHARACTERISTIC fmy_id_can_boff.dtc "DTC table declaration for the diagnosis instance XX" MAP 0xa0802d3c _REC_MAP_20_u2_u2_u2 65535. _CNV_A_R_LINEAR_____0_CM 0. 65535. DISPLAY_IDENTIFIER ID_ERR_DTC_CAN_BOFF FORMAT "%5.0"
 /begin AXIS_DESCR COM_AXIS errm_online_dummy _CNV_S_2_ERRM_DTC_R_477_CM 1 0. 1. AXIS_PTS_REF ldp_nr_1_id_err_dtc /end AXIS_DESCR
 /begin AXIS_DESCR COM_AXIS errm_online_dummy _CNV_S_6_ERRM_DTC_R_478_CM 6 0. 5. AXIS_PTS_REF ldp_nr_2_id_err_dtc /end AXIS_DESCR
/end CHARACTERISTIC
/begin CHARACTERISTIC fmy_id_rly_main.dtc "DTC table declaration for the diagnosis instance XX" MAP 0xa080454c _REC_MAP_20_u2_u2_u2 65535. _CNV_A_R_LINEAR_____0_CM 0. 65535. DISPLAY_IDENTIFIER ID_ERR_DTC_RLY_MAIN FORMAT "%5.0"
 /begin AXIS_DESCR COM_AXIS errm_online_dummy _CNV_S_2_ERRM_DTC_R_477_CM 1 0. 1. AXIS_PTS_REF ldp_nr_1_id_err_dtc /end AXIS_DESCR
 /begin AXIS_DESCR COM_AXIS errm_online_dummy _CNV_S_6_ERRM_DTC_R_478_CM 6 0. 5. AXIS_PTS_REF ldp_nr_2_id_err_dtc /end AXIS_DESCR
/end CHARACTERISTIC
/begin CHARACTERISTIC fmy_id_rly_main_dly.dtc "DTC table declaration for the diagnosis instance XX" MAP 0xa0804560 _REC_MAP_20_u2_u2_u2 65535. _CNV_A_R_LINEAR_____0_CM 0. 65535. DISPLAY_IDENTIFIER ID_ERR_DTC_RLY_MAIN_DLY FORMAT "%5.0"
 /begin AXIS_DESCR COM_AXIS errm_online_dummy _CNV_S_2_ERRM_DTC_R_477_CM 1 0. 1. AXIS_PTS_REF ldp_nr_1_id_err_dtc /end AXIS_DESCR
 /begin AXIS_DESCR COM_AXIS errm_online_dummy _CNV_S_6_ERRM_DTC_R_478_CM 6 0. 5. AXIS_PTS_REF ldp_nr_2_id_err_dtc /end AXIS_DESCR
/end CHARACTERISTIC
/begin CHARACTERISTIC fmy_id_rly_accout.dtc "DTC table declaration for the diagnosis instance XX" MAP 0xa0804524 _REC_MAP_20_u2_u2_u2 65535. _CNV_A_R_LINEAR_____0_CM 0. 65535. DISPLAY_IDENTIFIER ID_ERR_DTC_RLY_ACCOUT FORMAT "%5.0"
 /begin AXIS_DESCR COM_AXIS errm_online_dummy _CNV_S_2_ERRM_DTC_R_477_CM 1 0. 1. AXIS_PTS_REF ldp_nr_1_id_err_dtc /end AXIS_DESCR
 /begin AXIS_DESCR COM_AXIS errm_online_dummy _CNV_S_6_ERRM_DTC_R_478_CM 6 0. 5. AXIS_PTS_REF ldp_nr_2_id_err_dtc /end AXIS_DESCR
/end CHARACTERISTIC
/begin CHARACTERISTIC fmy_id_isc.dtc "DTC table declaration for the diagnosis instance XX" MAP 0xa0803bb0 _REC_MAP_20_u2_u2_u2 65535. _CNV_A_R_LINEAR_____0_CM 0. 65535. DISPLAY_IDENTIFIER ID_ERR_DTC_ISC FORMAT "%5.0"
 /begin AXIS_DESCR COM_AXIS errm_online_dummy _CNV_S_2_ERRM_DTC_R_477_CM 1 0. 1. AXIS_PTS_REF ldp_nr_1_id_err_dtc /end AXIS_DESCR
 /begin AXIS_DESCR COM_AXIS errm_online_dummy _CNV_S_6_ERRM_DTC_R_478_CM 6 0. 5. AXIS_PTS_REF ldp_nr_2_id_err_dtc /end AXIS_DESCR
/end CHARACTERISTIC
/begin CHARACTERISTIC fmy_id_isc_cst.dtc "DTC table declaration for the diagnosis instance XX" MAP 0xa0803bc4 _REC_MAP_20_u2_u2_u2 65535. _CNV_A_R_LINEAR_____0_CM 0. 65535. DISPLAY_IDENTIFIER ID_ERR_DTC_ISC_CST FORMAT "%5.0"
 /begin AXIS_DESCR COM_AXIS errm_online_dummy _CNV_S_2_ERRM_DTC_R_477_CM 1 0. 1. AXIS_PTS_REF ldp_nr_1_id_err_dtc /end AXIS_DESCR
 /begin AXIS_DESCR COM_AXIS errm_online_dummy _CNV_S_6_ERRM_DTC_R_478_CM 6 0. 5. AXIS_PTS_REF ldp_nr_2_id_err_dtc /end AXIS_DESCR
/end CHARACTERISTIC
/begin CHARACTERISTIC fmy_id_im_bls_plaus.dtc "DTC table declaration for the diagnosis instance XX" MAP 0xa0803b38 _REC_MAP_20_u2_u2_u2 65535. _CNV_A_R_LINEAR_____0_CM 0. 65535. DISPLAY_IDENTIFIER ID_ERR_DTC_IM_BLS_PLAUS FORMAT "%5.0"
 /begin AXIS_DESCR COM_AXIS errm_online_dummy _CNV_S_2_ERRM_DTC_R_477_CM 1 0. 1. AXIS_PTS_REF ldp_nr_1_id_err_dtc /end AXIS_DESCR
 /begin AXIS_DESCR COM_AXIS errm_online_dummy _CNV_S_6_ERRM_DTC_R_478_CM 6 0. 5. AXIS_PTS_REF ldp_nr_2_id_err_dtc /end AXIS_DESCR
/end CHARACTERISTIC
/begin CHARACTERISTIC fmy_id_im_bts_plaus.dtc "DTC table declaration for the diagnosis instance XX" MAP 0xa0803b4c _REC_MAP_20_u2_u2_u2 65535. _CNV_A_R_LINEAR_____0_CM 0. 65535. DISPLAY_IDENTIFIER ID_ERR_DTC_IM_BTS_PLAUS FORMAT "%5.0"
 /begin AXIS_DESCR COM_AXIS errm_online_dummy _CNV_S_2_ERRM_DTC_R_477_CM 1 0. 1. AXIS_PTS_REF ldp_nr_1_id_err_dtc /end AXIS_DESCR
 /begin AXIS_DESCR COM_AXIS errm_online_dummy _CNV_S_6_ERRM_DTC_R_478_CM 6 0. 5. AXIS_PTS_REF ldp_nr_2_id_err_dtc /end AXIS_DESCR
/end CHARACTERISTIC
/begin CHARACTERISTIC fmy_id_msw_tog.dtc "DTC table declaration for the diagnosis instance XX" MAP 0xa08040b0 _REC_MAP_20_u2_u2_u2 65535. _CNV_A_R_LINEAR_____0_CM 0. 65535. DISPLAY_IDENTIFIER ID_ERR_DTC_MSW_TOG FORMAT "%5.0"
 /begin AXIS_DESCR COM_AXIS errm_online_dummy _CNV_S_2_ERRM_DTC_R_477_CM 1 0. 1. AXIS_PTS_REF ldp_nr_1_id_err_dtc /end AXIS_DESCR
 /begin AXIS_DESCR COM_AXIS errm_online_dummy _CNV_S_6_ERRM_DTC_R_478_CM 6 0. 5. AXIS_PTS_REF ldp_nr_2_id_err_dtc /end AXIS_DESCR
/end CHARACTERISTIC
/begin CHARACTERISTIC fmy_id_msw_2.dtc "DTC table declaration for the diagnosis instance XX" MAP 0xa0804088 _REC_MAP_20_u2_u2_u2 65535. _CNV_A_R_LINEAR_____0_CM 0. 65535. DISPLAY_IDENTIFIER ID_ERR_DTC_MSW_2 FORMAT "%5.0"
 /begin AXIS_DESCR COM_AXIS errm_online_dummy _CNV_S_2_ERRM_DTC_R_477_CM 1 0. 1. AXIS_PTS_REF ldp_nr_1_id_err_dtc /end AXIS_DESCR
 /begin AXIS_DESCR COM_AXIS errm_online_dummy _CNV_S_6_ERRM_DTC_R_478_CM 6 0. 5. AXIS_PTS_REF ldp_nr_2_id_err_dtc /end AXIS_DESCR
/end CHARACTERISTIC
/begin CHARACTERISTIC fmy_id_msw_3.dtc "DTC table declaration for the diagnosis instance XX" MAP 0xa080409c _REC_MAP_20_u2_u2_u2 65535. _CNV_A_R_LINEAR_____0_CM 0. 65535. DISPLAY_IDENTIFIER ID_ERR_DTC_MSW_3 FORMAT "%5.0"
 /begin AXIS_DESCR COM_AXIS errm_online_dummy _CNV_S_2_ERRM_DTC_R_477_CM 1 0. 1. AXIS_PTS_REF ldp_nr_1_id_err_dtc /end AXIS_DESCR
 /begin AXIS_DESCR COM_AXIS errm_online_dummy _CNV_S_6_ERRM_DTC_R_478_CM 6 0. 5. AXIS_PTS_REF ldp_nr_2_id_err_dtc /end AXIS_DESCR
/end CHARACTERISTIC
/begin CHARACTERISTIC fmy_id_mis_0.dtc "DTC table declaration for the diagnosis instance XX" MAP 0xa0803fac _REC_MAP_20_u2_u2_u2 65535. _CNV_A_R_LINEAR_____0_CM 0. 65535. DISPLAY_IDENTIFIER ID_ERR_DTC_MIS_0 FORMAT "%5.0"
 /begin AXIS_DESCR COM_AXIS errm_online_dummy _CNV_S_2_ERRM_DTC_R_477_CM 1 0. 1. AXIS_PTS_REF ldp_nr_1_id_err_dtc /end AXIS_DESCR
 /begin AXIS_DESCR COM_AXIS errm_online_dummy _CNV_S_6_ERRM_DTC_R_478_CM 6 0. 5. AXIS_PTS_REF ldp_nr_2_id_err_dtc /end AXIS_DESCR
/end CHARACTERISTIC
/begin CHARACTERISTIC fmy_id_mis_1.dtc "DTC table declaration for the diagnosis instance XX" MAP 0xa0803fc0 _REC_MAP_20_u2_u2_u2 65535. _CNV_A_R_LINEAR_____0_CM 0. 65535. DISPLAY_IDENTIFIER ID_ERR_DTC_MIS_1 FORMAT "%5.0"
 /begin AXIS_DESCR COM_AXIS errm_online_dummy _CNV_S_2_ERRM_DTC_R_477_CM 1 0. 1. AXIS_PTS_REF ldp_nr_1_id_err_dtc /end AXIS_DESCR
 /begin AXIS_DESCR COM_AXIS errm_online_dummy _CNV_S_6_ERRM_DTC_R_478_CM 6 0. 5. AXIS_PTS_REF ldp_nr_2_id_err_dtc /end AXIS_DESCR
/end CHARACTERISTIC
/begin CHARACTERISTIC fmy_id_mis_2.dtc "DTC table declaration for the diagnosis instance XX" MAP 0xa0803fd4 _REC_MAP_20_u2_u2_u2 65535. _CNV_A_R_LINEAR_____0_CM 0. 65535. DISPLAY_IDENTIFIER ID_ERR_DTC_MIS_2 FORMAT "%5.0"
 /begin AXIS_DESCR COM_AXIS errm_online_dummy _CNV_S_2_ERRM_DTC_R_477_CM 1 0. 1. AXIS_PTS_REF ldp_nr_1_id_err_dtc /end AXIS_DESCR
 /begin AXIS_DESCR COM_AXIS errm_online_dummy _CNV_S_6_ERRM_DTC_R_478_CM 6 0. 5. AXIS_PTS_REF ldp_nr_2_id_err_dtc /end AXIS_DESCR
/end CHARACTERISTIC
/begin CHARACTERISTIC fmy_id_mis_3.dtc "DTC table declaration for the diagnosis instance XX" MAP 0xa0803fe8 _REC_MAP_20_u2_u2_u2 65535. _CNV_A_R_LINEAR_____0_CM 0. 65535. DISPLAY_IDENTIFIER ID_ERR_DTC_MIS_3 FORMAT "%5.0"
 /begin AXIS_DESCR COM_AXIS errm_online_dummy _CNV_S_2_ERRM_DTC_R_477_CM 1 0. 1. AXIS_PTS_REF ldp_nr_1_id_err_dtc /end AXIS_DESCR
 /begin AXIS_DESCR COM_AXIS errm_online_dummy _CNV_S_6_ERRM_DTC_R_478_CM 6 0. 5. AXIS_PTS_REF ldp_nr_2_id_err_dtc /end AXIS_DESCR
/end CHARACTERISTIC
/begin CHARACTERISTIC fmy_id_mis_4.dtc "DTC table declaration for the diagnosis instance XX" MAP 0xa0803ffc _REC_MAP_20_u2_u2_u2 65535. _CNV_A_R_LINEAR_____0_CM 0. 65535. DISPLAY_IDENTIFIER ID_ERR_DTC_MIS_4 FORMAT "%5.0"
 /begin AXIS_DESCR COM_AXIS errm_online_dummy _CNV_S_2_ERRM_DTC_R_477_CM 1 0. 1. AXIS_PTS_REF ldp_nr_1_id_err_dtc /end AXIS_DESCR
 /begin AXIS_DESCR COM_AXIS errm_online_dummy _CNV_S_6_ERRM_DTC_R_478_CM 6 0. 5. AXIS_PTS_REF ldp_nr_2_id_err_dtc /end AXIS_DESCR
/end CHARACTERISTIC
/begin CHARACTERISTIC fmy_id_mis_5.dtc "DTC table declaration for the diagnosis instance XX" MAP 0xa0804010 _REC_MAP_20_u2_u2_u2 65535. _CNV_A_R_LINEAR_____0_CM 0. 65535. DISPLAY_IDENTIFIER ID_ERR_DTC_MIS_5 FORMAT "%5.0"
 /begin AXIS_DESCR COM_AXIS errm_online_dummy _CNV_S_2_ERRM_DTC_R_477_CM 1 0. 1. AXIS_PTS_REF ldp_nr_1_id_err_dtc /end AXIS_DESCR
 /begin AXIS_DESCR COM_AXIS errm_online_dummy _CNV_S_6_ERRM_DTC_R_478_CM 6 0. 5. AXIS_PTS_REF ldp_nr_2_id_err_dtc /end AXIS_DESCR
/end CHARACTERISTIC
/begin CHARACTERISTIC fmy_id_mis_6.dtc "DTC table declaration for the diagnosis instance XX" MAP 0xa0804024 _REC_MAP_20_u2_u2_u2 65535. _CNV_A_R_LINEAR_____0_CM 0. 65535. DISPLAY_IDENTIFIER ID_ERR_DTC_MIS_6 FORMAT "%5.0"
 /begin AXIS_DESCR COM_AXIS errm_online_dummy _CNV_S_2_ERRM_DTC_R_477_CM 1 0. 1. AXIS_PTS_REF ldp_nr_1_id_err_dtc /end AXIS_DESCR
 /begin AXIS_DESCR COM_AXIS errm_online_dummy _CNV_S_6_ERRM_DTC_R_478_CM 6 0. 5. AXIS_PTS_REF ldp_nr_2_id_err_dtc /end AXIS_DESCR
/end CHARACTERISTIC
/begin CHARACTERISTIC fmy_id_mis_7.dtc "DTC table declaration for the diagnosis instance XX" MAP 0xa0804038 _REC_MAP_20_u2_u2_u2 65535. _CNV_A_R_LINEAR_____0_CM 0. 65535. DISPLAY_IDENTIFIER ID_ERR_DTC_MIS_7 FORMAT "%5.0"
 /begin AXIS_DESCR COM_AXIS errm_online_dummy _CNV_S_2_ERRM_DTC_R_477_CM 1 0. 1. AXIS_PTS_REF ldp_nr_1_id_err_dtc /end AXIS_DESCR
 /begin AXIS_DESCR COM_AXIS errm_online_dummy _CNV_S_6_ERRM_DTC_R_478_CM 6 0. 5. AXIS_PTS_REF ldp_nr_2_id_err_dtc /end AXIS_DESCR
/end CHARACTERISTIC
/begin CHARACTERISTIC fmy_id_mis_mpl.dtc "DTC table declaration for the diagnosis instance XX" MAP 0xa0804060 _REC_MAP_20_u2_u2_u2 65535. _CNV_A_R_LINEAR_____0_CM 0. 65535. DISPLAY_IDENTIFIER ID_ERR_DTC_MIS_MPL FORMAT "%5.0"
 /begin AXIS_DESCR COM_AXIS errm_online_dummy _CNV_S_2_ERRM_DTC_R_477_CM 1 0. 1. AXIS_PTS_REF ldp_nr_1_id_err_dtc /end AXIS_DESCR
 /begin AXIS_DESCR COM_AXIS errm_online_dummy _CNV_S_6_ERRM_DTC_R_478_CM 6 0. 5. AXIS_PTS_REF ldp_nr_2_id_err_dtc /end AXIS_DESCR
/end CHARACTERISTIC
/begin CHARACTERISTIC fmy_id_mis_ftl_l.dtc "DTC table declaration for the diagnosis instance XX" MAP 0xa080404c _REC_MAP_20_u2_u2_u2 65535. _CNV_A_R_LINEAR_____0_CM 0. 65535. DISPLAY_IDENTIFIER ID_ERR_DTC_MIS_FTL_L FORMAT "%5.0"
 /begin AXIS_DESCR COM_AXIS errm_online_dummy _CNV_S_2_ERRM_DTC_R_477_CM 1 0. 1. AXIS_PTS_REF ldp_nr_1_id_err_dtc /end AXIS_DESCR
 /begin AXIS_DESCR COM_AXIS errm_online_dummy _CNV_S_6_ERRM_DTC_R_478_CM 6 0. 5. AXIS_PTS_REF ldp_nr_2_id_err_dtc /end AXIS_DESCR
/end CHARACTERISTIC
/begin CHARACTERISTIC fmy_id_ef.dtc "DTC table declaration for the diagnosis instance XX" MAP 0xa0803638 _REC_MAP_20_u2_u2_u2 65535. _CNV_A_R_LINEAR_____0_CM 0. 65535. DISPLAY_IDENTIFIER ID_ERR_DTC_EF FORMAT "%5.0"
 /begin AXIS_DESCR COM_AXIS errm_online_dummy _CNV_S_2_ERRM_DTC_R_477_CM 1 0. 1. AXIS_PTS_REF ldp_nr_1_id_err_dtc /end AXIS_DESCR
 /begin AXIS_DESCR COM_AXIS errm_online_dummy _CNV_S_6_ERRM_DTC_R_478_CM 6 0. 5. AXIS_PTS_REF ldp_nr_2_id_err_dtc /end AXIS_DESCR
/end CHARACTERISTIC
/begin CHARACTERISTIC fmy_id_tecu.dtc "DTC table declaration for the diagnosis instance XX" MAP 0xa0804998 _REC_MAP_20_u2_u2_u2 65535. _CNV_A_R_LINEAR_____0_CM 0. 65535. DISPLAY_IDENTIFIER ID_ERR_DTC_TECU FORMAT "%5.0"
 /begin AXIS_DESCR COM_AXIS errm_online_dummy _CNV_S_2_ERRM_DTC_R_477_CM 1 0. 1. AXIS_PTS_REF ldp_nr_1_id_err_dtc /end AXIS_DESCR
 /begin AXIS_DESCR COM_AXIS errm_online_dummy _CNV_S_6_ERRM_DTC_R_478_CM 6 0. 5. AXIS_PTS_REF ldp_nr_2_id_err_dtc /end AXIS_DESCR
/end CHARACTERISTIC
/begin CHARACTERISTIC fmy_id_ebox_cfa.dtc "DTC table declaration for the diagnosis instance XX" MAP 0xa0803534 _REC_MAP_20_u2_u2_u2 65535. _CNV_A_R_LINEAR_____0_CM 0. 65535. DISPLAY_IDENTIFIER ID_ERR_DTC_EBOX_CFA FORMAT "%5.0"
 /begin AXIS_DESCR COM_AXIS errm_online_dummy _CNV_S_2_ERRM_DTC_R_477_CM 1 0. 1. AXIS_PTS_REF ldp_nr_1_id_err_dtc /end AXIS_DESCR
 /begin AXIS_DESCR COM_AXIS errm_online_dummy _CNV_S_6_ERRM_DTC_R_478_CM 6 0. 5. AXIS_PTS_REF ldp_nr_2_id_err_dtc /end AXIS_DESCR
/end CHARACTERISTIC
/begin CHARACTERISTIC fmy_id_ecu_ram.dtc "DTC table declaration for the diagnosis instance XX" MAP 0xa0803624 _REC_MAP_20_u2_u2_u2 65535. _CNV_A_R_LINEAR_____0_CM 0. 65535. DISPLAY_IDENTIFIER ID_ERR_DTC_ECU_RAM FORMAT "%5.0"
 /begin AXIS_DESCR COM_AXIS errm_online_dummy _CNV_S_2_ERRM_DTC_R_477_CM 1 0. 1. AXIS_PTS_REF ldp_nr_1_id_err_dtc /end AXIS_DESCR
 /begin AXIS_DESCR COM_AXIS errm_online_dummy _CNV_S_6_ERRM_DTC_R_478_CM 6 0. 5. AXIS_PTS_REF ldp_nr_2_id_err_dtc /end AXIS_DESCR
/end CHARACTERISTIC
/begin CHARACTERISTIC fmy_id_tqi_lim.dtc "DTC table declaration for the diagnosis instance XX" MAP 0xa0804cb8 _REC_MAP_20_u2_u2_u2 65535. _CNV_A_R_LINEAR_____0_CM 0. 65535. DISPLAY_IDENTIFIER ID_ERR_DTC_TQI_LIM FORMAT "%5.0"
 /begin AXIS_DESCR COM_AXIS errm_online_dummy _CNV_S_2_ERRM_DTC_R_477_CM 1 0. 1. AXIS_PTS_REF ldp_nr_1_id_err_dtc /end AXIS_DESCR
 /begin AXIS_DESCR COM_AXIS errm_online_dummy _CNV_S_6_ERRM_DTC_R_478_CM 6 0. 5. AXIS_PTS_REF ldp_nr_2_id_err_dtc /end AXIS_DESCR
/end CHARACTERISTIC
/begin CHARACTERISTIC fmy_id_dmtls.dtc "DTC table declaration for the diagnosis instance XX" MAP 0xa08034bc _REC_MAP_20_u2_u2_u2 65535. _CNV_A_R_LINEAR_____0_CM 0. 65535. DISPLAY_IDENTIFIER ID_ERR_DTC_DMTLS FORMAT "%5.0"
 /begin AXIS_DESCR COM_AXIS errm_online_dummy _CNV_S_2_ERRM_DTC_R_477_CM 1 0. 1. AXIS_PTS_REF ldp_nr_1_id_err_dtc /end AXIS_DESCR
 /begin AXIS_DESCR COM_AXIS errm_online_dummy _CNV_S_6_ERRM_DTC_R_478_CM 6 0. 5. AXIS_PTS_REF ldp_nr_2_id_err_dtc /end AXIS_DESCR
/end CHARACTERISTIC
/begin CHARACTERISTIC fmy_id_dmtl_pump.dtc "DTC table declaration for the diagnosis instance XX" MAP 0xa0803480 _REC_MAP_20_u2_u2_u2 65535. _CNV_A_R_LINEAR_____0_CM 0. 65535. DISPLAY_IDENTIFIER ID_ERR_DTC_DMTL_PUMP FORMAT "%5.0"
 /begin AXIS_DESCR COM_AXIS errm_online_dummy _CNV_S_2_ERRM_DTC_R_477_CM 1 0. 1. AXIS_PTS_REF ldp_nr_1_id_err_dtc /end AXIS_DESCR
 /begin AXIS_DESCR COM_AXIS errm_online_dummy _CNV_S_6_ERRM_DTC_R_478_CM 6 0. 5. AXIS_PTS_REF ldp_nr_2_id_err_dtc /end AXIS_DESCR
/end CHARACTERISTIC
/begin CHARACTERISTIC fmy_id_dmtlm.dtc "DTC table declaration for the diagnosis instance XX" MAP 0xa08034a8 _REC_MAP_20_u2_u2_u2 65535. _CNV_A_R_LINEAR_____0_CM 0. 65535. DISPLAY_IDENTIFIER ID_ERR_DTC_DMTLM FORMAT "%5.0"
 /begin AXIS_DESCR COM_AXIS errm_online_dummy _CNV_S_2_ERRM_DTC_R_477_CM 1 0. 1. AXIS_PTS_REF ldp_nr_1_id_err_dtc /end AXIS_DESCR
 /begin AXIS_DESCR COM_AXIS errm_online_dummy _CNV_S_6_ERRM_DTC_R_478_CM 6 0. 5. AXIS_PTS_REF ldp_nr_2_id_err_dtc /end AXIS_DESCR
/end CHARACTERISTIC
/begin CHARACTERISTIC fmy_id_rough_leak.dtc "DTC table declaration for the diagnosis instance XX" MAP 0xa080459c _REC_MAP_20_u2_u2_u2 65535. _CNV_A_R_LINEAR_____0_CM 0. 65535. DISPLAY_IDENTIFIER ID_ERR_DTC_ROUGH_LEAK FORMAT "%5.0"
 /begin AXIS_DESCR COM_AXIS errm_online_dummy _CNV_S_2_ERRM_DTC_R_477_CM 1 0. 1. AXIS_PTS_REF ldp_nr_1_id_err_dtc /end AXIS_DESCR
 /begin AXIS_DESCR COM_AXIS errm_online_dummy _CNV_S_6_ERRM_DTC_R_478_CM 6 0. 5. AXIS_PTS_REF ldp_nr_2_id_err_dtc /end AXIS_DESCR
/end CHARACTERISTIC
/begin CHARACTERISTIC fmy_id_small_leak.dtc "DTC table declaration for the diagnosis instance XX" MAP 0xa0804718 _REC_MAP_20_u2_u2_u2 65535. _CNV_A_R_LINEAR_____0_CM 0. 65535. DISPLAY_IDENTIFIER ID_ERR_DTC_SMALL_LEAK FORMAT "%5.0"
 /begin AXIS_DESCR COM_AXIS errm_online_dummy _CNV_S_2_ERRM_DTC_R_477_CM 1 0. 1. AXIS_PTS_REF ldp_nr_1_id_err_dtc /end AXIS_DESCR
 /begin AXIS_DESCR COM_AXIS errm_online_dummy _CNV_S_6_ERRM_DTC_R_478_CM 6 0. 5. AXIS_PTS_REF ldp_nr_2_id_err_dtc /end AXIS_DESCR
/end CHARACTERISTIC
/begin CHARACTERISTIC fmy_id_chk_fuc.dtc "DTC table declaration for the diagnosis instance XX" MAP 0xa0802dc8 _REC_MAP_20_u2_u2_u2 65535. _CNV_A_R_LINEAR_____0_CM 0. 65535. DISPLAY_IDENTIFIER ID_ERR_DTC_CHK_FUC FORMAT "%5.0"
 /begin AXIS_DESCR COM_AXIS errm_online_dummy _CNV_S_2_ERRM_DTC_R_477_CM 1 0. 1. AXIS_PTS_REF ldp_nr_1_id_err_dtc /end AXIS_DESCR
 /begin AXIS_DESCR COM_AXIS errm_online_dummy _CNV_S_6_ERRM_DTC_R_478_CM 6 0. 5. AXIS_PTS_REF ldp_nr_2_id_err_dtc /end AXIS_DESCR
/end CHARACTERISTIC
/begin CHARACTERISTIC fmy_id_sof.dtc "DTC table declaration for the diagnosis instance XX" MAP 0xa080472c _REC_MAP_20_u2_u2_u2 65535. _CNV_A_R_LINEAR_____0_CM 0. 65535. DISPLAY_IDENTIFIER ID_ERR_DTC_SOF FORMAT "%5.0"
 /begin AXIS_DESCR COM_AXIS errm_online_dummy _CNV_S_2_ERRM_DTC_R_477_CM 1 0. 1. AXIS_PTS_REF ldp_nr_1_id_err_dtc /end AXIS_DESCR
 /begin AXIS_DESCR COM_AXIS errm_online_dummy _CNV_S_6_ERRM_DTC_R_478_CM 6 0. 5. AXIS_PTS_REF ldp_nr_2_id_err_dtc /end AXIS_DESCR
/end CHARACTERISTIC
/begin CHARACTERISTIC fmy_id_sof_req.dtc "DTC table declaration for the diagnosis instance XX" MAP 0xa0804740 _REC_MAP_20_u2_u2_u2 65535. _CNV_A_R_LINEAR_____0_CM 0. 65535. DISPLAY_IDENTIFIER ID_ERR_DTC_SOF_REQ FORMAT "%5.0"
 /begin AXIS_DESCR COM_AXIS errm_online_dummy _CNV_S_2_ERRM_DTC_R_477_CM 1 0. 1. AXIS_PTS_REF ldp_nr_1_id_err_dtc /end AXIS_DESCR
 /begin AXIS_DESCR COM_AXIS errm_online_dummy _CNV_S_6_ERRM_DTC_R_478_CM 6 0. 5. AXIS_PTS_REF ldp_nr_2_id_err_dtc /end AXIS_DESCR
/end CHARACTERISTIC
/begin CHARACTERISTIC fmy_id_rly_crcv_heat.dtc "DTC table declaration for the diagnosis instance XX" MAP 0xa0804538 _REC_MAP_20_u2_u2_u2 65535. _CNV_A_R_LINEAR_____0_CM 0. 65535. DISPLAY_IDENTIFIER ID_ERR_DTC_RLY_CRCV_HEAT FORMAT "%5.0"
 /begin AXIS_DESCR COM_AXIS errm_online_dummy _CNV_S_2_ERRM_DTC_R_477_CM 1 0. 1. AXIS_PTS_REF ldp_nr_1_id_err_dtc /end AXIS_DESCR
 /begin AXIS_DESCR COM_AXIS errm_online_dummy _CNV_S_6_ERRM_DTC_R_478_CM 6 0. 5. AXIS_PTS_REF ldp_nr_2_id_err_dtc /end AXIS_DESCR
/end CHARACTERISTIC
/begin CHARACTERISTIC fmy_id_rly_st.dtc "DTC table declaration for the diagnosis instance XX" MAP 0xa0804574 _REC_MAP_20_u2_u2_u2 65535. _CNV_A_R_LINEAR_____0_CM 0. 65535. DISPLAY_IDENTIFIER ID_ERR_DTC_RLY_ST FORMAT "%5.0"
 /begin AXIS_DESCR COM_AXIS errm_online_dummy _CNV_S_2_ERRM_DTC_R_477_CM 1 0. 1. AXIS_PTS_REF ldp_nr_1_id_err_dtc /end AXIS_DESCR
 /begin AXIS_DESCR COM_AXIS errm_online_dummy _CNV_S_6_ERRM_DTC_R_478_CM 6 0. 5. AXIS_PTS_REF ldp_nr_2_id_err_dtc /end AXIS_DESCR
/end CHARACTERISTIC
/begin CHARACTERISTIC fmy_id_bsd.dtc "DTC table declaration for the diagnosis instance XX" MAP 0xa0802d28 _REC_MAP_20_u2_u2_u2 65535. _CNV_A_R_LINEAR_____0_CM 0. 65535. DISPLAY_IDENTIFIER ID_ERR_DTC_BSD FORMAT "%5.0"
 /begin AXIS_DESCR COM_AXIS errm_online_dummy _CNV_S_2_ERRM_DTC_R_477_CM 1 0. 1. AXIS_PTS_REF ldp_nr_1_id_err_dtc /end AXIS_DESCR
 /begin AXIS_DESCR COM_AXIS errm_online_dummy _CNV_S_6_ERRM_DTC_R_478_CM 6 0. 5. AXIS_PTS_REF ldp_nr_2_id_err_dtc /end AXIS_DESCR
/end CHARACTERISTIC
/begin CHARACTERISTIC fmy_id_poil_swi.dtc "DTC table declaration for the diagnosis instance XX" MAP 0xa0804344 _REC_MAP_20_u2_u2_u2 65535. _CNV_A_R_LINEAR_____0_CM 0. 65535. DISPLAY_IDENTIFIER ID_ERR_DTC_POIL_SWI FORMAT "%5.0"
 /begin AXIS_DESCR COM_AXIS errm_online_dummy _CNV_S_2_ERRM_DTC_R_477_CM 1 0. 1. AXIS_PTS_REF ldp_nr_1_id_err_dtc /end AXIS_DESCR
 /begin AXIS_DESCR COM_AXIS errm_online_dummy _CNV_S_6_ERRM_DTC_R_478_CM 6 0. 5. AXIS_PTS_REF ldp_nr_2_id_err_dtc /end AXIS_DESCR
/end CHARACTERISTIC
/begin CHARACTERISTIC fmy_id_tout_efp_can.dtc "DTC table declaration for the diagnosis instance XX" MAP 0xa0804ac4 _REC_MAP_20_u2_u2_u2 65535. _CNV_A_R_LINEAR_____0_CM 0. 65535. DISPLAY_IDENTIFIER ID_ERR_DTC_TOUT_EFP_CAN FORMAT "%5.0"
 /begin AXIS_DESCR COM_AXIS errm_online_dummy _CNV_S_2_ERRM_DTC_R_477_CM 1 0. 1. AXIS_PTS_REF ldp_nr_1_id_err_dtc /end AXIS_DESCR
 /begin AXIS_DESCR COM_AXIS errm_online_dummy _CNV_S_6_ERRM_DTC_R_478_CM 6 0. 5. AXIS_PTS_REF ldp_nr_2_id_err_dtc /end AXIS_DESCR
/end CHARACTERISTIC
/begin CHARACTERISTIC fmy_id_diagcps.dtc "DTC table declaration for the diagnosis instance XX" MAP 0xa080346c _REC_MAP_20_u2_u2_u2 65535. _CNV_A_R_LINEAR_____0_CM 0. 65535. DISPLAY_IDENTIFIER ID_ERR_DTC_DIAGCPS FORMAT "%5.0"
 /begin AXIS_DESCR COM_AXIS errm_online_dummy _CNV_S_2_ERRM_DTC_R_477_CM 1 0. 1. AXIS_PTS_REF ldp_nr_1_id_err_dtc /end AXIS_DESCR
 /begin AXIS_DESCR COM_AXIS errm_online_dummy _CNV_S_6_ERRM_DTC_R_478_CM 6 0. 5. AXIS_PTS_REF ldp_nr_2_id_err_dtc /end AXIS_DESCR
/end CHARACTERISTIC
/begin CHARACTERISTIC fmy_id_dcc.dtc "DTC table declaration for the diagnosis instance XX" MAP 0xa0803430 _REC_MAP_20_u2_u2_u2 65535. _CNV_A_R_LINEAR_____0_CM 0. 65535. DISPLAY_IDENTIFIER ID_ERR_DTC_DCC FORMAT "%5.0"
 /begin AXIS_DESCR COM_AXIS errm_online_dummy _CNV_S_2_ERRM_DTC_R_477_CM 1 0. 1. AXIS_PTS_REF ldp_nr_1_id_err_dtc /end AXIS_DESCR
 /begin AXIS_DESCR COM_AXIS errm_online_dummy _CNV_S_6_ERRM_DTC_R_478_CM 6 0. 5. AXIS_PTS_REF ldp_nr_2_id_err_dtc /end AXIS_DESCR
/end CHARACTERISTIC
/begin CHARACTERISTIC fmy_id_ldm.dtc "DTC table declaration for the diagnosis instance XX" MAP 0xa0803d7c _REC_MAP_20_u2_u2_u2 65535. _CNV_A_R_LINEAR_____0_CM 0. 65535. DISPLAY_IDENTIFIER ID_ERR_DTC_LDM FORMAT "%5.0"
 /begin AXIS_DESCR COM_AXIS errm_online_dummy _CNV_S_2_ERRM_DTC_R_477_CM 1 0. 1. AXIS_PTS_REF ldp_nr_1_id_err_dtc /end AXIS_DESCR
 /begin AXIS_DESCR COM_AXIS errm_online_dummy _CNV_S_6_ERRM_DTC_R_478_CM 6 0. 5. AXIS_PTS_REF ldp_nr_2_id_err_dtc /end AXIS_DESCR
/end CHARACTERISTIC
/begin CHARACTERISTIC fmy_id_dmtlh.dtc "DTC table declaration for the diagnosis instance XX" MAP 0xa0803494 _REC_MAP_20_u2_u2_u2 65535. _CNV_A_R_LINEAR_____0_CM 0. 65535. DISPLAY_IDENTIFIER ID_ERR_DTC_DMTLH FORMAT "%5.0"
 /begin AXIS_DESCR COM_AXIS errm_online_dummy _CNV_S_2_ERRM_DTC_R_477_CM 1 0. 1. AXIS_PTS_REF ldp_nr_1_id_err_dtc /end AXIS_DESCR
 /begin AXIS_DESCR COM_AXIS errm_online_dummy _CNV_S_6_ERRM_DTC_R_478_CM 6 0. 5. AXIS_PTS_REF ldp_nr_2_id_err_dtc /end AXIS_DESCR
/end CHARACTERISTIC
/begin CHARACTERISTIC fmy_id_cs.dtc "DTC table declaration for the diagnosis instance XX" MAP 0xa080323c _REC_MAP_20_u2_u2_u2 65535. _CNV_A_R_LINEAR_____0_CM 0. 65535. DISPLAY_IDENTIFIER ID_ERR_DTC_CS FORMAT "%5.0"
 /begin AXIS_DESCR COM_AXIS errm_online_dummy _CNV_S_2_ERRM_DTC_R_477_CM 1 0. 1. AXIS_PTS_REF ldp_nr_1_id_err_dtc /end AXIS_DESCR
 /begin AXIS_DESCR COM_AXIS errm_online_dummy _CNV_S_6_ERRM_DTC_R_478_CM 6 0. 5. AXIS_PTS_REF ldp_nr_2_id_err_dtc /end AXIS_DESCR
/end CHARACTERISTIC
/begin CHARACTERISTIC fmy_id_spi_mps.dtc "DTC table declaration for the diagnosis instance XX" MAP 0xa0804768 _REC_MAP_20_u2_u2_u2 65535. _CNV_A_R_LINEAR_____0_CM 0. 65535. DISPLAY_IDENTIFIER ID_ERR_DTC_SPI_MPS FORMAT "%5.0"
 /begin AXIS_DESCR COM_AXIS errm_online_dummy _CNV_S_2_ERRM_DTC_R_477_CM 1 0. 1. AXIS_PTS_REF ldp_nr_1_id_err_dtc /end AXIS_DESCR
 /begin AXIS_DESCR COM_AXIS errm_online_dummy _CNV_S_6_ERRM_DTC_R_478_CM 6 0. 5. AXIS_PTS_REF ldp_nr_2_id_err_dtc /end AXIS_DESCR
/end CHARACTERISTIC
/begin CHARACTERISTIC fmy_id_spi_knk.dtc "DTC table declaration for the diagnosis instance XX" MAP 0xa0804754 _REC_MAP_20_u2_u2_u2 65535. _CNV_A_R_LINEAR_____0_CM 0. 65535. DISPLAY_IDENTIFIER ID_ERR_DTC_SPI_KNK FORMAT "%5.0"
 /begin AXIS_DESCR COM_AXIS errm_online_dummy _CNV_S_2_ERRM_DTC_R_477_CM 1 0. 1. AXIS_PTS_REF ldp_nr_1_id_err_dtc /end AXIS_DESCR
 /begin AXIS_DESCR COM_AXIS errm_online_dummy _CNV_S_6_ERRM_DTC_R_478_CM 6 0. 5. AXIS_PTS_REF ldp_nr_2_id_err_dtc /end AXIS_DESCR
/end CHARACTERISTIC
/begin CHARACTERISTIC fmy_id_sens_poil.dtc "DTC table declaration for the diagnosis instance XX" MAP 0xa080463c _REC_MAP_20_u2_u2_u2 65535. _CNV_A_R_LINEAR_____0_CM 0. 65535. DISPLAY_IDENTIFIER ID_ERR_DTC_SENS_POIL FORMAT "%5.0"
 /begin AXIS_DESCR COM_AXIS errm_online_dummy _CNV_S_2_ERRM_DTC_R_477_CM 1 0. 1. AXIS_PTS_REF ldp_nr_1_id_err_dtc /end AXIS_DESCR
 /begin AXIS_DESCR COM_AXIS errm_online_dummy _CNV_S_6_ERRM_DTC_R_478_CM 6 0. 5. AXIS_PTS_REF ldp_nr_2_id_err_dtc /end AXIS_DESCR
/end CHARACTERISTIC
/begin CHARACTERISTIC fmy_id_poil_dr.dtc "DTC table declaration for the diagnosis instance XX" MAP 0xa0804330 _REC_MAP_20_u2_u2_u2 65535. _CNV_A_R_LINEAR_____0_CM 0. 65535. DISPLAY_IDENTIFIER ID_ERR_DTC_POIL_DR FORMAT "%5.0"
 /begin AXIS_DESCR COM_AXIS errm_online_dummy _CNV_S_2_ERRM_DTC_R_477_CM 1 0. 1. AXIS_PTS_REF ldp_nr_1_id_err_dtc /end AXIS_DESCR
 /begin AXIS_DESCR COM_AXIS errm_online_dummy _CNV_S_6_ERRM_DTC_R_478_CM 6 0. 5. AXIS_PTS_REF ldp_nr_2_id_err_dtc /end AXIS_DESCR
/end CHARACTERISTIC
/begin CHARACTERISTIC fmy_id_bn_tq_dcc.dtc "DTC table declaration for the diagnosis instance XX" MAP 0xa0802c88 _REC_MAP_20_u2_u2_u2 65535. _CNV_A_R_LINEAR_____0_CM 0. 65535. DISPLAY_IDENTIFIER ID_ERR_DTC_BN_TQ_DCC FORMAT "%5.0"
 /begin AXIS_DESCR COM_AXIS errm_online_dummy _CNV_S_2_ERRM_DTC_R_477_CM 1 0. 1. AXIS_PTS_REF ldp_nr_1_id_err_dtc /end AXIS_DESCR
 /begin AXIS_DESCR COM_AXIS errm_online_dummy _CNV_S_6_ERRM_DTC_R_478_CM 6 0. 5. AXIS_PTS_REF ldp_nr_2_id_err_dtc /end AXIS_DESCR
/end CHARACTERISTIC
/begin CHARACTERISTIC fmy_id_bn_tq_pste_2.dtc "DTC table declaration for the diagnosis instance XX" MAP 0xa0802cb0 _REC_MAP_20_u2_u2_u2 65535. _CNV_A_R_LINEAR_____0_CM 0. 65535. DISPLAY_IDENTIFIER ID_ERR_DTC_BN_TQ_PSTE_2 FORMAT "%5.0"
 /begin AXIS_DESCR COM_AXIS errm_online_dummy _CNV_S_2_ERRM_DTC_R_477_CM 1 0. 1. AXIS_PTS_REF ldp_nr_1_id_err_dtc /end AXIS_DESCR
 /begin AXIS_DESCR COM_AXIS errm_online_dummy _CNV_S_6_ERRM_DTC_R_478_CM 6 0. 5. AXIS_PTS_REF ldp_nr_2_id_err_dtc /end AXIS_DESCR
/end CHARACTERISTIC
/begin CHARACTERISTIC fmy_id_bn_tq_pste_3.dtc "DTC table declaration for the diagnosis instance XX" MAP 0xa0802cc4 _REC_MAP_20_u2_u2_u2 65535. _CNV_A_R_LINEAR_____0_CM 0. 65535. DISPLAY_IDENTIFIER ID_ERR_DTC_BN_TQ_PSTE_3 FORMAT "%5.0"
 /begin AXIS_DESCR COM_AXIS errm_online_dummy _CNV_S_2_ERRM_DTC_R_477_CM 1 0. 1. AXIS_PTS_REF ldp_nr_1_id_err_dtc /end AXIS_DESCR
 /begin AXIS_DESCR COM_AXIS errm_online_dummy _CNV_S_6_ERRM_DTC_R_478_CM 6 0. 5. AXIS_PTS_REF ldp_nr_2_id_err_dtc /end AXIS_DESCR
/end CHARACTERISTIC
/begin CHARACTERISTIC fmy_id_bn_ars.dtc "DTC table declaration for the diagnosis instance XX" MAP 0xa0802aa8 _REC_MAP_20_u2_u2_u2 65535. _CNV_A_R_LINEAR_____0_CM 0. 65535. DISPLAY_IDENTIFIER ID_ERR_DTC_BN_ARS FORMAT "%5.0"
 /begin AXIS_DESCR COM_AXIS errm_online_dummy _CNV_S_2_ERRM_DTC_R_477_CM 1 0. 1. AXIS_PTS_REF ldp_nr_1_id_err_dtc /end AXIS_DESCR
 /begin AXIS_DESCR COM_AXIS errm_online_dummy _CNV_S_6_ERRM_DTC_R_478_CM 6 0. 5. AXIS_PTS_REF ldp_nr_2_id_err_dtc /end AXIS_DESCR
/end CHARACTERISTIC
/begin CHARACTERISTIC fmy_id_bn_cas.dtc "DTC table declaration for the diagnosis instance XX" MAP 0xa0802abc _REC_MAP_20_u2_u2_u2 65535. _CNV_A_R_LINEAR_____0_CM 0. 65535. DISPLAY_IDENTIFIER ID_ERR_DTC_BN_CAS FORMAT "%5.0"
 /begin AXIS_DESCR COM_AXIS errm_online_dummy _CNV_S_2_ERRM_DTC_R_477_CM 1 0. 1. AXIS_PTS_REF ldp_nr_1_id_err_dtc /end AXIS_DESCR
 /begin AXIS_DESCR COM_AXIS errm_online_dummy _CNV_S_6_ERRM_DTC_R_478_CM 6 0. 5. AXIS_PTS_REF ldp_nr_2_id_err_dtc /end AXIS_DESCR
/end CHARACTERISTIC
/begin CHARACTERISTIC fmy_id_bn_tq_tcs.dtc "DTC table declaration for the diagnosis instance XX" MAP 0xa0802cd8 _REC_MAP_20_u2_u2_u2 65535. _CNV_A_R_LINEAR_____0_CM 0. 65535. DISPLAY_IDENTIFIER ID_ERR_DTC_BN_TQ_TCS FORMAT "%5.0"
 /begin AXIS_DESCR COM_AXIS errm_online_dummy _CNV_S_2_ERRM_DTC_R_477_CM 1 0. 1. AXIS_PTS_REF ldp_nr_1_id_err_dtc /end AXIS_DESCR
 /begin AXIS_DESCR COM_AXIS errm_online_dummy _CNV_S_6_ERRM_DTC_R_478_CM 6 0. 5. AXIS_PTS_REF ldp_nr_2_id_err_dtc /end AXIS_DESCR
/end CHARACTERISTIC
/begin CHARACTERISTIC fmy_id_bn_vs_tcs.dtc "DTC table declaration for the diagnosis instance XX" MAP 0xa0802d14 _REC_MAP_20_u2_u2_u2 65535. _CNV_A_R_LINEAR_____0_CM 0. 65535. DISPLAY_IDENTIFIER ID_ERR_DTC_BN_VS_TCS FORMAT "%5.0"
 /begin AXIS_DESCR COM_AXIS errm_online_dummy _CNV_S_2_ERRM_DTC_R_477_CM 1 0. 1. AXIS_PTS_REF ldp_nr_1_id_err_dtc /end AXIS_DESCR
 /begin AXIS_DESCR COM_AXIS errm_online_dummy _CNV_S_6_ERRM_DTC_R_478_CM 6 0. 5. AXIS_PTS_REF ldp_nr_2_id_err_dtc /end AXIS_DESCR
/end CHARACTERISTIC
/begin CHARACTERISTIC fmy_id_bn_tcs.dtc "DTC table declaration for the diagnosis instance XX" MAP 0xa0802c60 _REC_MAP_20_u2_u2_u2 65535. _CNV_A_R_LINEAR_____0_CM 0. 65535. DISPLAY_IDENTIFIER ID_ERR_DTC_BN_TCS FORMAT "%5.0"
 /begin AXIS_DESCR COM_AXIS errm_online_dummy _CNV_S_2_ERRM_DTC_R_477_CM 1 0. 1. AXIS_PTS_REF ldp_nr_1_id_err_dtc /end AXIS_DESCR
 /begin AXIS_DESCR COM_AXIS errm_online_dummy _CNV_S_6_ERRM_DTC_R_478_CM 6 0. 5. AXIS_PTS_REF ldp_nr_2_id_err_dtc /end AXIS_DESCR
/end CHARACTERISTIC
/begin CHARACTERISTIC fmy_id_bn_tq_etcu.dtc "DTC table declaration for the diagnosis instance XX" MAP 0xa0802c9c _REC_MAP_20_u2_u2_u2 65535. _CNV_A_R_LINEAR_____0_CM 0. 65535. DISPLAY_IDENTIFIER ID_ERR_DTC_BN_TQ_ETCU FORMAT "%5.0"
 /begin AXIS_DESCR COM_AXIS errm_online_dummy _CNV_S_2_ERRM_DTC_R_477_CM 1 0. 1. AXIS_PTS_REF ldp_nr_1_id_err_dtc /end AXIS_DESCR
 /begin AXIS_DESCR COM_AXIS errm_online_dummy _CNV_S_6_ERRM_DTC_R_478_CM 6 0. 5. AXIS_PTS_REF ldp_nr_2_id_err_dtc /end AXIS_DESCR
/end CHARACTERISTIC
/begin CHARACTERISTIC fmy_id_bn_etcu.dtc "DTC table declaration for the diagnosis instance XX" MAP 0xa0802b0c _REC_MAP_20_u2_u2_u2 65535. _CNV_A_R_LINEAR_____0_CM 0. 65535. DISPLAY_IDENTIFIER ID_ERR_DTC_BN_ETCU FORMAT "%5.0"
 /begin AXIS_DESCR COM_AXIS errm_online_dummy _CNV_S_2_ERRM_DTC_R_477_CM 1 0. 1. AXIS_PTS_REF ldp_nr_1_id_err_dtc /end AXIS_DESCR
 /begin AXIS_DESCR COM_AXIS errm_online_dummy _CNV_S_6_ERRM_DTC_R_478_CM 6 0. 5. AXIS_PTS_REF ldp_nr_2_id_err_dtc /end AXIS_DESCR
/end CHARACTERISTIC
/begin CHARACTERISTIC fmy_id_bn_etcu_2.dtc "DTC table declaration for the diagnosis instance XX" MAP 0xa0802b20 _REC_MAP_20_u2_u2_u2 65535. _CNV_A_R_LINEAR_____0_CM 0. 65535. DISPLAY_IDENTIFIER ID_ERR_DTC_BN_ETCU_2 FORMAT "%5.0"
 /begin AXIS_DESCR COM_AXIS errm_online_dummy _CNV_S_2_ERRM_DTC_R_477_CM 1 0. 1. AXIS_PTS_REF ldp_nr_1_id_err_dtc /end AXIS_DESCR
 /begin AXIS_DESCR COM_AXIS errm_online_dummy _CNV_S_6_ERRM_DTC_R_478_CM 6 0. 5. AXIS_PTS_REF ldp_nr_2_id_err_dtc /end AXIS_DESCR
/end CHARACTERISTIC
/begin CHARACTERISTIC fmy_id_bn_etcu_3.dtc "DTC table declaration for the diagnosis instance XX" MAP 0xa0802b34 _REC_MAP_20_u2_u2_u2 65535. _CNV_A_R_LINEAR_____0_CM 0. 65535. DISPLAY_IDENTIFIER ID_ERR_DTC_BN_ETCU_3 FORMAT "%5.0"
 /begin AXIS_DESCR COM_AXIS errm_online_dummy _CNV_S_2_ERRM_DTC_R_477_CM 1 0. 1. AXIS_PTS_REF ldp_nr_1_id_err_dtc /end AXIS_DESCR
 /begin AXIS_DESCR COM_AXIS errm_online_dummy _CNV_S_6_ERRM_DTC_R_478_CM 6 0. 5. AXIS_PTS_REF ldp_nr_2_id_err_dtc /end AXIS_DESCR
/end CHARACTERISTIC
/begin CHARACTERISTIC fmy_id_bn_etcu_disp.dtc "DTC table declaration for the diagnosis instance XX" MAP 0xa0802b48 _REC_MAP_20_u2_u2_u2 65535. _CNV_A_R_LINEAR_____0_CM 0. 65535. DISPLAY_IDENTIFIER ID_ERR_DTC_BN_ETCU_DISP FORMAT "%5.0"
 /begin AXIS_DESCR COM_AXIS errm_online_dummy _CNV_S_2_ERRM_DTC_R_477_CM 1 0. 1. AXIS_PTS_REF ldp_nr_1_id_err_dtc /end AXIS_DESCR
 /begin AXIS_DESCR COM_AXIS errm_online_dummy _CNV_S_6_ERRM_DTC_R_478_CM 6 0. 5. AXIS_PTS_REF ldp_nr_2_id_err_dtc /end AXIS_DESCR
/end CHARACTERISTIC
/begin CHARACTERISTIC fmy_id_bn_tq_amt.dtc "DTC table declaration for the diagnosis instance XX" MAP 0xa0802c74 _REC_MAP_20_u2_u2_u2 65535. _CNV_A_R_LINEAR_____0_CM 0. 65535. DISPLAY_IDENTIFIER ID_ERR_DTC_BN_TQ_AMT FORMAT "%5.0"
 /begin AXIS_DESCR COM_AXIS errm_online_dummy _CNV_S_2_ERRM_DTC_R_477_CM 1 0. 1. AXIS_PTS_REF ldp_nr_1_id_err_dtc /end AXIS_DESCR
 /begin AXIS_DESCR COM_AXIS errm_online_dummy _CNV_S_6_ERRM_DTC_R_478_CM 6 0. 5. AXIS_PTS_REF ldp_nr_2_id_err_dtc /end AXIS_DESCR
/end CHARACTERISTIC
/begin CHARACTERISTIC fmy_id_bn_acc.dtc "DTC table declaration for the diagnosis instance XX" MAP 0xa0802a80 _REC_MAP_20_u2_u2_u2 65535. _CNV_A_R_LINEAR_____0_CM 0. 65535. DISPLAY_IDENTIFIER ID_ERR_DTC_BN_ACC FORMAT "%5.0"
 /begin AXIS_DESCR COM_AXIS errm_online_dummy _CNV_S_2_ERRM_DTC_R_477_CM 1 0. 1. AXIS_PTS_REF ldp_nr_1_id_err_dtc /end AXIS_DESCR
 /begin AXIS_DESCR COM_AXIS errm_online_dummy _CNV_S_6_ERRM_DTC_R_478_CM 6 0. 5. AXIS_PTS_REF ldp_nr_2_id_err_dtc /end AXIS_DESCR
/end CHARACTERISTIC
/begin CHARACTERISTIC fmy_id_bn_t_icl.dtc "DTC table declaration for the diagnosis instance XX" MAP 0xa0802c4c _REC_MAP_20_u2_u2_u2 65535. _CNV_A_R_LINEAR_____0_CM 0. 65535. DISPLAY_IDENTIFIER ID_ERR_DTC_BN_T_ICL FORMAT "%5.0"
 /begin AXIS_DESCR COM_AXIS errm_online_dummy _CNV_S_2_ERRM_DTC_R_477_CM 1 0. 1. AXIS_PTS_REF ldp_nr_1_id_err_dtc /end AXIS_DESCR
 /begin AXIS_DESCR COM_AXIS errm_online_dummy _CNV_S_6_ERRM_DTC_R_478_CM 6 0. 5. AXIS_PTS_REF ldp_nr_2_id_err_dtc /end AXIS_DESCR
/end CHARACTERISTIC
/begin CHARACTERISTIC fmy_id_bn_veh_mod.dtc "DTC table declaration for the diagnosis instance XX" MAP 0xa0802d00 _REC_MAP_20_u2_u2_u2 65535. _CNV_A_R_LINEAR_____0_CM 0. 65535. DISPLAY_IDENTIFIER ID_ERR_DTC_BN_VEH_MOD FORMAT "%5.0"
 /begin AXIS_DESCR COM_AXIS errm_online_dummy _CNV_S_2_ERRM_DTC_R_477_CM 1 0. 1. AXIS_PTS_REF ldp_nr_1_id_err_dtc /end AXIS_DESCR
 /begin AXIS_DESCR COM_AXIS errm_online_dummy _CNV_S_6_ERRM_DTC_R_478_CM 6 0. 5. AXIS_PTS_REF ldp_nr_2_id_err_dtc /end AXIS_DESCR
/end CHARACTERISTIC
/begin CHARACTERISTIC fmy_id_bn_km_icl.dtc "DTC table declaration for the diagnosis instance XX" MAP 0xa0802b98 _REC_MAP_20_u2_u2_u2 65535. _CNV_A_R_LINEAR_____0_CM 0. 65535. DISPLAY_IDENTIFIER ID_ERR_DTC_BN_KM_ICL FORMAT "%5.0"
 /begin AXIS_DESCR COM_AXIS errm_online_dummy _CNV_S_2_ERRM_DTC_R_477_CM 1 0. 1. AXIS_PTS_REF ldp_nr_1_id_err_dtc /end AXIS_DESCR
 /begin AXIS_DESCR COM_AXIS errm_online_dummy _CNV_S_6_ERRM_DTC_R_478_CM 6 0. 5. AXIS_PTS_REF ldp_nr_2_id_err_dtc /end AXIS_DESCR
/end CHARACTERISTIC
/begin CHARACTERISTIC fmy_id_bn_icl.dtc "DTC table declaration for the diagnosis instance XX" MAP 0xa0802b84 _REC_MAP_20_u2_u2_u2 65535. _CNV_A_R_LINEAR_____0_CM 0. 65535. DISPLAY_IDENTIFIER ID_ERR_DTC_BN_ICL FORMAT "%5.0"
 /begin AXIS_DESCR COM_AXIS errm_online_dummy _CNV_S_2_ERRM_DTC_R_477_CM 1 0. 1. AXIS_PTS_REF ldp_nr_1_id_err_dtc /end AXIS_DESCR
 /begin AXIS_DESCR COM_AXIS errm_online_dummy _CNV_S_6_ERRM_DTC_R_478_CM 6 0. 5. AXIS_PTS_REF ldp_nr_2_id_err_dtc /end AXIS_DESCR
/end CHARACTERISTIC
/begin CHARACTERISTIC fmy_id_bn_pow_vb.dtc "DTC table declaration for the diagnosis instance XX" MAP 0xa0802c10 _REC_MAP_20_u2_u2_u2 65535. _CNV_A_R_LINEAR_____0_CM 0. 65535. DISPLAY_IDENTIFIER ID_ERR_DTC_BN_POW_VB FORMAT "%5.0"
 /begin AXIS_DESCR COM_AXIS errm_online_dummy _CNV_S_2_ERRM_DTC_R_477_CM 1 0. 1. AXIS_PTS_REF ldp_nr_1_id_err_dtc /end AXIS_DESCR
 /begin AXIS_DESCR COM_AXIS errm_online_dummy _CNV_S_6_ERRM_DTC_R_478_CM 6 0. 5. AXIS_PTS_REF ldp_nr_2_id_err_dtc /end AXIS_DESCR
/end CHARACTERISTIC
/begin CHARACTERISTIC fmy_id_bn_pow_gen.dtc "DTC table declaration for the diagnosis instance XX" MAP 0xa0802bfc _REC_MAP_20_u2_u2_u2 65535. _CNV_A_R_LINEAR_____0_CM 0. 65535. DISPLAY_IDENTIFIER ID_ERR_DTC_BN_POW_GEN FORMAT "%5.0"
 /begin AXIS_DESCR COM_AXIS errm_online_dummy _CNV_S_2_ERRM_DTC_R_477_CM 1 0. 1. AXIS_PTS_REF ldp_nr_1_id_err_dtc /end AXIS_DESCR
 /begin AXIS_DESCR COM_AXIS errm_online_dummy _CNV_S_6_ERRM_DTC_R_478_CM 6 0. 5. AXIS_PTS_REF ldp_nr_2_id_err_dtc /end AXIS_DESCR
/end CHARACTERISTIC
/begin CHARACTERISTIC fmy_id_bn_msw.dtc "DTC table declaration for the diagnosis instance XX" MAP 0xa0802bd4 _REC_MAP_20_u2_u2_u2 65535. _CNV_A_R_LINEAR_____0_CM 0. 65535. DISPLAY_IDENTIFIER ID_ERR_DTC_BN_MSW FORMAT "%5.0"
 /begin AXIS_DESCR COM_AXIS errm_online_dummy _CNV_S_2_ERRM_DTC_R_477_CM 1 0. 1. AXIS_PTS_REF ldp_nr_1_id_err_dtc /end AXIS_DESCR
 /begin AXIS_DESCR COM_AXIS errm_online_dummy _CNV_S_6_ERRM_DTC_R_478_CM 6 0. 5. AXIS_PTS_REF ldp_nr_2_id_err_dtc /end AXIS_DESCR
/end CHARACTERISTIC
/begin CHARACTERISTIC fmy_id_bn_ang_pste.dtc "DTC table declaration for the diagnosis instance XX" MAP 0xa0802a94 _REC_MAP_20_u2_u2_u2 65535. _CNV_A_R_LINEAR_____0_CM 0. 65535. DISPLAY_IDENTIFIER ID_ERR_DTC_BN_ANG_PSTE FORMAT "%5.0"
 /begin AXIS_DESCR COM_AXIS errm_online_dummy _CNV_S_2_ERRM_DTC_R_477_CM 1 0. 1. AXIS_PTS_REF ldp_nr_1_id_err_dtc /end AXIS_DESCR
 /begin AXIS_DESCR COM_AXIS errm_online_dummy _CNV_S_6_ERRM_DTC_R_478_CM 6 0. 5. AXIS_PTS_REF ldp_nr_2_id_err_dtc /end AXIS_DESCR
/end CHARACTERISTIC
/begin CHARACTERISTIC fmy_id_bn_gear_rev.dtc "DTC table declaration for the diagnosis instance XX" MAP 0xa0802b5c _REC_MAP_20_u2_u2_u2 65535. _CNV_A_R_LINEAR_____0_CM 0. 65535. DISPLAY_IDENTIFIER ID_ERR_DTC_BN_GEAR_REV FORMAT "%5.0"
 /begin AXIS_DESCR COM_AXIS errm_online_dummy _CNV_S_2_ERRM_DTC_R_477_CM 1 0. 1. AXIS_PTS_REF ldp_nr_1_id_err_dtc /end AXIS_DESCR
 /begin AXIS_DESCR COM_AXIS errm_online_dummy _CNV_S_6_ERRM_DTC_R_478_CM 6 0. 5. AXIS_PTS_REF ldp_nr_2_id_err_dtc /end AXIS_DESCR
/end CHARACTERISTIC
/begin CHARACTERISTIC fmy_id_bn_ltg_hdlp_l.dtc "DTC table declaration for the diagnosis instance XX" MAP 0xa0802bc0 _REC_MAP_20_u2_u2_u2 65535. _CNV_A_R_LINEAR_____0_CM 0. 65535. DISPLAY_IDENTIFIER ID_ERR_DTC_BN_LTG_HDLP_L FORMAT "%5.0"
 /begin AXIS_DESCR COM_AXIS errm_online_dummy _CNV_S_2_ERRM_DTC_R_477_CM 1 0. 1. AXIS_PTS_REF ldp_nr_1_id_err_dtc /end AXIS_DESCR
 /begin AXIS_DESCR COM_AXIS errm_online_dummy _CNV_S_6_ERRM_DTC_R_478_CM 6 0. 5. AXIS_PTS_REF ldp_nr_2_id_err_dtc /end AXIS_DESCR
/end CHARACTERISTIC
/begin CHARACTERISTIC fmy_id_bn_ldm.dtc "DTC table declaration for the diagnosis instance XX" MAP 0xa0802bac _REC_MAP_20_u2_u2_u2 65535. _CNV_A_R_LINEAR_____0_CM 0. 65535. DISPLAY_IDENTIFIER ID_ERR_DTC_BN_LDM FORMAT "%5.0"
 /begin AXIS_DESCR COM_AXIS errm_online_dummy _CNV_S_2_ERRM_DTC_R_477_CM 1 0. 1. AXIS_PTS_REF ldp_nr_1_id_err_dtc /end AXIS_DESCR
 /begin AXIS_DESCR COM_AXIS errm_online_dummy _CNV_S_6_ERRM_DTC_R_478_CM 6 0. 5. AXIS_PTS_REF ldp_nr_2_id_err_dtc /end AXIS_DESCR
/end CHARACTERISTIC
/begin CHARACTERISTIC fmy_id_bn_trl.dtc "DTC table declaration for the diagnosis instance XX" MAP 0xa0802cec _REC_MAP_20_u2_u2_u2 65535. _CNV_A_R_LINEAR_____0_CM 0. 65535. DISPLAY_IDENTIFIER ID_ERR_DTC_BN_TRL FORMAT "%5.0"
 /begin AXIS_DESCR COM_AXIS errm_online_dummy _CNV_S_2_ERRM_DTC_R_477_CM 1 0. 1. AXIS_PTS_REF ldp_nr_1_id_err_dtc /end AXIS_DESCR
 /begin AXIS_DESCR COM_AXIS errm_online_dummy _CNV_S_6_ERRM_DTC_R_478_CM 6 0. 5. AXIS_PTS_REF ldp_nr_2_id_err_dtc /end AXIS_DESCR
/end CHARACTERISTIC
/begin CHARACTERISTIC fmy_id_bn_hiv.dtc "DTC table declaration for the diagnosis instance XX" MAP 0xa0802b70 _REC_MAP_20_u2_u2_u2 65535. _CNV_A_R_LINEAR_____0_CM 0. 65535. DISPLAY_IDENTIFIER ID_ERR_DTC_BN_HIV FORMAT "%5.0"
 /begin AXIS_DESCR COM_AXIS errm_online_dummy _CNV_S_2_ERRM_DTC_R_477_CM 1 0. 1. AXIS_PTS_REF ldp_nr_1_id_err_dtc /end AXIS_DESCR
 /begin AXIS_DESCR COM_AXIS errm_online_dummy _CNV_S_6_ERRM_DTC_R_478_CM 6 0. 5. AXIS_PTS_REF ldp_nr_2_id_err_dtc /end AXIS_DESCR
/end CHARACTERISTIC
/begin CHARACTERISTIC fmy_id_bn_t_clk.dtc "DTC table declaration for the diagnosis instance XX" MAP 0xa0802c38 _REC_MAP_20_u2_u2_u2 65535. _CNV_A_R_LINEAR_____0_CM 0. 65535. DISPLAY_IDENTIFIER ID_ERR_DTC_BN_T_CLK FORMAT "%5.0"
 /begin AXIS_DESCR COM_AXIS errm_online_dummy _CNV_S_2_ERRM_DTC_R_477_CM 1 0. 1. AXIS_PTS_REF ldp_nr_1_id_err_dtc /end AXIS_DESCR
 /begin AXIS_DESCR COM_AXIS errm_online_dummy _CNV_S_6_ERRM_DTC_R_478_CM 6 0. 5. AXIS_PTS_REF ldp_nr_2_id_err_dtc /end AXIS_DESCR
/end CHARACTERISTIC
/begin CHARACTERISTIC fmy_id_bn_efp_crash.dtc "DTC table declaration for the diagnosis instance XX" MAP 0xa0802af8 _REC_MAP_20_u2_u2_u2 65535. _CNV_A_R_LINEAR_____0_CM 0. 65535. DISPLAY_IDENTIFIER ID_ERR_DTC_BN_EFP_CRASH FORMAT "%5.0"
 /begin AXIS_DESCR COM_AXIS errm_online_dummy _CNV_S_2_ERRM_DTC_R_477_CM 1 0. 1. AXIS_PTS_REF ldp_nr_1_id_err_dtc /end AXIS_DESCR
 /begin AXIS_DESCR COM_AXIS errm_online_dummy _CNV_S_6_ERRM_DTC_R_478_CM 6 0. 5. AXIS_PTS_REF ldp_nr_2_id_err_dtc /end AXIS_DESCR
/end CHARACTERISTIC
/begin CHARACTERISTIC fmy_id_bn_cdn_door.dtc "DTC table declaration for the diagnosis instance XX" MAP 0xa0802ad0 _REC_MAP_20_u2_u2_u2 65535. _CNV_A_R_LINEAR_____0_CM 0. 65535. DISPLAY_IDENTIFIER ID_ERR_DTC_BN_CDN_DOOR FORMAT "%5.0"
 /begin AXIS_DESCR COM_AXIS errm_online_dummy _CNV_S_2_ERRM_DTC_R_477_CM 1 0. 1. AXIS_PTS_REF ldp_nr_1_id_err_dtc /end AXIS_DESCR
 /begin AXIS_DESCR COM_AXIS errm_online_dummy _CNV_S_6_ERRM_DTC_R_478_CM 6 0. 5. AXIS_PTS_REF ldp_nr_2_id_err_dtc /end AXIS_DESCR
/end CHARACTERISTIC
/begin CHARACTERISTIC fmy_id_bn_req_pbr.dtc "DTC table declaration for the diagnosis instance XX" MAP 0xa0802c24 _REC_MAP_20_u2_u2_u2 65535. _CNV_A_R_LINEAR_____0_CM 0. 65535. DISPLAY_IDENTIFIER ID_ERR_DTC_BN_REQ_PBR FORMAT "%5.0"
 /begin AXIS_DESCR COM_AXIS errm_online_dummy _CNV_S_2_ERRM_DTC_R_477_CM 1 0. 1. AXIS_PTS_REF ldp_nr_1_id_err_dtc /end AXIS_DESCR
 /begin AXIS_DESCR COM_AXIS errm_online_dummy _CNV_S_6_ERRM_DTC_R_478_CM 6 0. 5. AXIS_PTS_REF ldp_nr_2_id_err_dtc /end AXIS_DESCR
/end CHARACTERISTIC
/begin CHARACTERISTIC fmy_id_bn_pbr.dtc "DTC table declaration for the diagnosis instance XX" MAP 0xa0802be8 _REC_MAP_20_u2_u2_u2 65535. _CNV_A_R_LINEAR_____0_CM 0. 65535. DISPLAY_IDENTIFIER ID_ERR_DTC_BN_PBR FORMAT "%5.0"
 /begin AXIS_DESCR COM_AXIS errm_online_dummy _CNV_S_2_ERRM_DTC_R_477_CM 1 0. 1. AXIS_PTS_REF ldp_nr_1_id_err_dtc /end AXIS_DESCR
 /begin AXIS_DESCR COM_AXIS errm_online_dummy _CNV_S_6_ERRM_DTC_R_478_CM 6 0. 5. AXIS_PTS_REF ldp_nr_2_id_err_dtc /end AXIS_DESCR
/end CHARACTERISTIC
/begin CHARACTERISTIC fmy_id_bn_efp.dtc "DTC table declaration for the diagnosis instance XX" MAP 0xa0802ae4 _REC_MAP_20_u2_u2_u2 65535. _CNV_A_R_LINEAR_____0_CM 0. 65535. DISPLAY_IDENTIFIER ID_ERR_DTC_BN_EFP FORMAT "%5.0"
 /begin AXIS_DESCR COM_AXIS errm_online_dummy _CNV_S_2_ERRM_DTC_R_477_CM 1 0. 1. AXIS_PTS_REF ldp_nr_1_id_err_dtc /end AXIS_DESCR
 /begin AXIS_DESCR COM_AXIS errm_online_dummy _CNV_S_6_ERRM_DTC_R_478_CM 6 0. 5. AXIS_PTS_REF ldp_nr_2_id_err_dtc /end AXIS_DESCR
/end CHARACTERISTIC
/begin CHARACTERISTIC fmy_id_load_tps_plaus.dtc "DTC table declaration for the diagnosis instance XX" MAP 0xa0803d90 _REC_MAP_20_u2_u2_u2 65535. _CNV_A_R_LINEAR_____0_CM 0. 65535. DISPLAY_IDENTIFIER ID_ERR_DTC_LOAD_TPS_PLAUS FORMAT "%5.0"
 /begin AXIS_DESCR COM_AXIS errm_online_dummy _CNV_S_2_ERRM_DTC_R_477_CM 1 0. 1. AXIS_PTS_REF ldp_nr_1_id_err_dtc /end AXIS_DESCR
 /begin AXIS_DESCR COM_AXIS errm_online_dummy _CNV_S_6_ERRM_DTC_R_478_CM 6 0. 5. AXIS_PTS_REF ldp_nr_2_id_err_dtc /end AXIS_DESCR
/end CHARACTERISTIC
/begin CHARACTERISTIC fmy_id_egy_min.dtc "DTC table declaration for the diagnosis instance XX" MAP 0xa0803660 _REC_MAP_20_u2_u2_u2 65535. _CNV_A_R_LINEAR_____0_CM 0. 65535. DISPLAY_IDENTIFIER ID_ERR_DTC_EGY_MIN FORMAT "%5.0"
 /begin AXIS_DESCR COM_AXIS errm_online_dummy _CNV_S_2_ERRM_DTC_R_477_CM 1 0. 1. AXIS_PTS_REF ldp_nr_1_id_err_dtc /end AXIS_DESCR
 /begin AXIS_DESCR COM_AXIS errm_online_dummy _CNV_S_6_ERRM_DTC_R_478_CM 6 0. 5. AXIS_PTS_REF ldp_nr_2_id_err_dtc /end AXIS_DESCR
/end CHARACTERISTIC
/begin CHARACTERISTIC fmy_id_locan_boff.dtc "DTC table declaration for the diagnosis instance XX" MAP 0xa0803da4 _REC_MAP_20_u2_u2_u2 65535. _CNV_A_R_LINEAR_____0_CM 0. 65535. DISPLAY_IDENTIFIER ID_ERR_DTC_LOCAN_BOFF FORMAT "%5.0"
 /begin AXIS_DESCR COM_AXIS errm_online_dummy _CNV_S_2_ERRM_DTC_R_477_CM 1 0. 1. AXIS_PTS_REF ldp_nr_1_id_err_dtc /end AXIS_DESCR
 /begin AXIS_DESCR COM_AXIS errm_online_dummy _CNV_S_6_ERRM_DTC_R_478_CM 6 0. 5. AXIS_PTS_REF ldp_nr_2_id_err_dtc /end AXIS_DESCR
/end CHARACTERISTIC
/begin CHARACTERISTIC fmy_id_cwp_plaus.dtc "DTC table declaration for the diagnosis instance XX" MAP 0xa08032c8 _REC_MAP_20_u2_u2_u2 65535. _CNV_A_R_LINEAR_____0_CM 0. 65535. DISPLAY_IDENTIFIER ID_ERR_DTC_CWP_PLAUS FORMAT "%5.0"
 /begin AXIS_DESCR COM_AXIS errm_online_dummy _CNV_S_2_ERRM_DTC_R_477_CM 1 0. 1. AXIS_PTS_REF ldp_nr_1_id_err_dtc /end AXIS_DESCR
 /begin AXIS_DESCR COM_AXIS errm_online_dummy _CNV_S_6_ERRM_DTC_R_478_CM 6 0. 5. AXIS_PTS_REF ldp_nr_2_id_err_dtc /end AXIS_DESCR
/end CHARACTERISTIC
/begin CHARACTERISTIC fmy_id_cwp_int_off.dtc "DTC table declaration for the diagnosis instance XX" MAP 0xa08032b4 _REC_MAP_20_u2_u2_u2 65535. _CNV_A_R_LINEAR_____0_CM 0. 65535. DISPLAY_IDENTIFIER ID_ERR_DTC_CWP_INT_OFF FORMAT "%5.0"
 /begin AXIS_DESCR COM_AXIS errm_online_dummy _CNV_S_2_ERRM_DTC_R_477_CM 1 0. 1. AXIS_PTS_REF ldp_nr_1_id_err_dtc /end AXIS_DESCR
 /begin AXIS_DESCR COM_AXIS errm_online_dummy _CNV_S_6_ERRM_DTC_R_478_CM 6 0. 5. AXIS_PTS_REF ldp_nr_2_id_err_dtc /end AXIS_DESCR
/end CHARACTERISTIC
/begin CHARACTERISTIC fmy_id_cwp_pwr.dtc "DTC table declaration for the diagnosis instance XX" MAP 0xa08032dc _REC_MAP_20_u2_u2_u2 65535. _CNV_A_R_LINEAR_____0_CM 0. 65535. DISPLAY_IDENTIFIER ID_ERR_DTC_CWP_PWR FORMAT "%5.0"
 /begin AXIS_DESCR COM_AXIS errm_online_dummy _CNV_S_2_ERRM_DTC_R_477_CM 1 0. 1. AXIS_PTS_REF ldp_nr_1_id_err_dtc /end AXIS_DESCR
 /begin AXIS_DESCR COM_AXIS errm_online_dummy _CNV_S_6_ERRM_DTC_R_478_CM 6 0. 5. AXIS_PTS_REF ldp_nr_2_id_err_dtc /end AXIS_DESCR
/end CHARACTERISTIC
/begin CHARACTERISTIC fmy_id_cwp_com_plaus.dtc "DTC table declaration for the diagnosis instance XX" MAP 0xa08032a0 _REC_MAP_20_u2_u2_u2 65535. _CNV_A_R_LINEAR_____0_CM 0. 65535. DISPLAY_IDENTIFIER ID_ERR_DTC_CWP_COM_PLAUS FORMAT "%5.0"
 /begin AXIS_DESCR COM_AXIS errm_online_dummy _CNV_S_2_ERRM_DTC_R_477_CM 1 0. 1. AXIS_PTS_REF ldp_nr_1_id_err_dtc /end AXIS_DESCR
 /begin AXIS_DESCR COM_AXIS errm_online_dummy _CNV_S_6_ERRM_DTC_R_478_CM 6 0. 5. AXIS_PTS_REF ldp_nr_2_id_err_dtc /end AXIS_DESCR
/end CHARACTERISTIC
/begin CHARACTERISTIC fmy_id_qoil_sens.dtc "DTC table declaration for the diagnosis instance XX" MAP 0xa0804498 _REC_MAP_20_u2_u2_u2 65535. _CNV_A_R_LINEAR_____0_CM 0. 65535. DISPLAY_IDENTIFIER ID_ERR_DTC_QOIL_SENS FORMAT "%5.0"
 /begin AXIS_DESCR COM_AXIS errm_online_dummy _CNV_S_2_ERRM_DTC_R_477_CM 1 0. 1. AXIS_PTS_REF ldp_nr_1_id_err_dtc /end AXIS_DESCR
 /begin AXIS_DESCR COM_AXIS errm_online_dummy _CNV_S_6_ERRM_DTC_R_478_CM 6 0. 5. AXIS_PTS_REF ldp_nr_2_id_err_dtc /end AXIS_DESCR
/end CHARACTERISTIC
/begin CHARACTERISTIC fmy_id_bat_sens.dtc "DTC table declaration for the diagnosis instance XX" MAP 0xa0802a44 _REC_MAP_20_u2_u2_u2 65535. _CNV_A_R_LINEAR_____0_CM 0. 65535. DISPLAY_IDENTIFIER ID_ERR_DTC_BAT_SENS FORMAT "%5.0"
 /begin AXIS_DESCR COM_AXIS errm_online_dummy _CNV_S_2_ERRM_DTC_R_477_CM 1 0. 1. AXIS_PTS_REF ldp_nr_1_id_err_dtc /end AXIS_DESCR
 /begin AXIS_DESCR COM_AXIS errm_online_dummy _CNV_S_6_ERRM_DTC_R_478_CM 6 0. 5. AXIS_PTS_REF ldp_nr_2_id_err_dtc /end AXIS_DESCR
/end CHARACTERISTIC
/begin CHARACTERISTIC fmy_id_bat_sens_it.dtc "DTC table declaration for the diagnosis instance XX" MAP 0xa0802a58 _REC_MAP_20_u2_u2_u2 65535. _CNV_A_R_LINEAR_____0_CM 0. 65535. DISPLAY_IDENTIFIER ID_ERR_DTC_BAT_SENS_IT FORMAT "%5.0"
 /begin AXIS_DESCR COM_AXIS errm_online_dummy _CNV_S_2_ERRM_DTC_R_477_CM 1 0. 1. AXIS_PTS_REF ldp_nr_1_id_err_dtc /end AXIS_DESCR
 /begin AXIS_DESCR COM_AXIS errm_online_dummy _CNV_S_6_ERRM_DTC_R_478_CM 6 0. 5. AXIS_PTS_REF ldp_nr_2_id_err_dtc /end AXIS_DESCR
/end CHARACTERISTIC
/begin CHARACTERISTIC fmy_id_bat_sens_it_el.dtc "DTC table declaration for the diagnosis instance XX" MAP 0xa0802a6c _REC_MAP_20_u2_u2_u2 65535. _CNV_A_R_LINEAR_____0_CM 0. 65535. DISPLAY_IDENTIFIER ID_ERR_DTC_BAT_SENS_IT_EL FORMAT "%5.0"
 /begin AXIS_DESCR COM_AXIS errm_online_dummy _CNV_S_2_ERRM_DTC_R_477_CM 1 0. 1. AXIS_PTS_REF ldp_nr_1_id_err_dtc /end AXIS_DESCR
 /begin AXIS_DESCR COM_AXIS errm_online_dummy _CNV_S_6_ERRM_DTC_R_478_CM 6 0. 5. AXIS_PTS_REF ldp_nr_2_id_err_dtc /end AXIS_DESCR
/end CHARACTERISTIC
/begin CHARACTERISTIC fmy_id_ecu_nvmy.dtc "DTC table declaration for the diagnosis instance XX" MAP 0xa0803610 _REC_MAP_20_u2_u2_u2 65535. _CNV_A_R_LINEAR_____0_CM 0. 65535. DISPLAY_IDENTIFIER ID_ERR_DTC_ECU_NVMY FORMAT "%5.0"
 /begin AXIS_DESCR COM_AXIS errm_online_dummy _CNV_S_2_ERRM_DTC_R_477_CM 1 0. 1. AXIS_PTS_REF ldp_nr_1_id_err_dtc /end AXIS_DESCR
 /begin AXIS_DESCR COM_AXIS errm_online_dummy _CNV_S_6_ERRM_DTC_R_478_CM 6 0. 5. AXIS_PTS_REF ldp_nr_2_id_err_dtc /end AXIS_DESCR
/end CHARACTERISTIC
/begin CHARACTERISTIC fmy_id_gs.dtc "DTC table declaration for the diagnosis instance XX" MAP 0xa0803930 _REC_MAP_20_u2_u2_u2 65535. _CNV_A_R_LINEAR_____0_CM 0. 65535. DISPLAY_IDENTIFIER ID_ERR_DTC_GS FORMAT "%5.0"
 /begin AXIS_DESCR COM_AXIS errm_online_dummy _CNV_S_2_ERRM_DTC_R_477_CM 1 0. 1. AXIS_PTS_REF ldp_nr_1_id_err_dtc /end AXIS_DESCR
 /begin AXIS_DESCR COM_AXIS errm_online_dummy _CNV_S_6_ERRM_DTC_R_478_CM 6 0. 5. AXIS_PTS_REF ldp_nr_2_id_err_dtc /end AXIS_DESCR
/end CHARACTERISTIC
/begin CHARACTERISTIC fmy_id_plaus_igk_bn.dtc "DTC table declaration for the diagnosis instance XX" MAP 0xa080431c _REC_MAP_20_u2_u2_u2 65535. _CNV_A_R_LINEAR_____0_CM 0. 65535. DISPLAY_IDENTIFIER ID_ERR_DTC_PLAUS_IGK_BN FORMAT "%5.0"
 /begin AXIS_DESCR COM_AXIS errm_online_dummy _CNV_S_2_ERRM_DTC_R_477_CM 1 0. 1. AXIS_PTS_REF ldp_nr_1_id_err_dtc /end AXIS_DESCR
 /begin AXIS_DESCR COM_AXIS errm_online_dummy _CNV_S_6_ERRM_DTC_R_478_CM 6 0. 5. AXIS_PTS_REF ldp_nr_2_id_err_dtc /end AXIS_DESCR
/end CHARACTERISTIC
/begin CHARACTERISTIC fmy_id_tq_req_can.dtc "DTC table declaration for the diagnosis instance XX" MAP 0xa0804c7c _REC_MAP_20_u2_u2_u2 65535. _CNV_A_R_LINEAR_____0_CM 0. 65535. DISPLAY_IDENTIFIER ID_ERR_DTC_TQ_REQ_CAN FORMAT "%5.0"
 /begin AXIS_DESCR COM_AXIS errm_online_dummy _CNV_S_2_ERRM_DTC_R_477_CM 1 0. 1. AXIS_PTS_REF ldp_nr_1_id_err_dtc /end AXIS_DESCR
 /begin AXIS_DESCR COM_AXIS errm_online_dummy _CNV_S_6_ERRM_DTC_R_478_CM 6 0. 5. AXIS_PTS_REF ldp_nr_2_id_err_dtc /end AXIS_DESCR
/end CHARACTERISTIC
/begin CHARACTERISTIC fmy_id_map_sens_1.dtc "DTC table declaration for the diagnosis instance XX" MAP 0xa0803f0c _REC_MAP_20_u2_u2_u2 65535. _CNV_A_R_LINEAR_____0_CM 0. 65535. DISPLAY_IDENTIFIER ID_ERR_DTC_MAP_SENS_1 FORMAT "%5.0"
 /begin AXIS_DESCR COM_AXIS errm_online_dummy _CNV_S_2_ERRM_DTC_R_477_CM 1 0. 1. AXIS_PTS_REF ldp_nr_1_id_err_dtc /end AXIS_DESCR
 /begin AXIS_DESCR COM_AXIS errm_online_dummy _CNV_S_6_ERRM_DTC_R_478_CM 6 0. 5. AXIS_PTS_REF ldp_nr_2_id_err_dtc /end AXIS_DESCR
/end CHARACTERISTIC
/begin CHARACTERISTIC fmy_id_map_sens_2.dtc "DTC table declaration for the diagnosis instance XX" MAP 0xa0803f20 _REC_MAP_20_u2_u2_u2 65535. _CNV_A_R_LINEAR_____0_CM 0. 65535. DISPLAY_IDENTIFIER ID_ERR_DTC_MAP_SENS_2 FORMAT "%5.0"
 /begin AXIS_DESCR COM_AXIS errm_online_dummy _CNV_S_2_ERRM_DTC_R_477_CM 1 0. 1. AXIS_PTS_REF ldp_nr_1_id_err_dtc /end AXIS_DESCR
 /begin AXIS_DESCR COM_AXIS errm_online_dummy _CNV_S_6_ERRM_DTC_R_478_CM 6 0. 5. AXIS_PTS_REF ldp_nr_2_id_err_dtc /end AXIS_DESCR
/end CHARACTERISTIC
/begin CHARACTERISTIC fmy_id_dtc_trm.dtc "DTC table declaration for the diagnosis instance XX" MAP 0xa08034e4 _REC_MAP_20_u2_u2_u2 65535. _CNV_A_R_LINEAR_____0_CM 0. 65535. DISPLAY_IDENTIFIER ID_ERR_DTC_DTC_TRM FORMAT "%5.0"
 /begin AXIS_DESCR COM_AXIS errm_online_dummy _CNV_S_2_ERRM_DTC_R_477_CM 1 0. 1. AXIS_PTS_REF ldp_nr_1_id_err_dtc /end AXIS_DESCR
 /begin AXIS_DESCR COM_AXIS errm_online_dummy _CNV_S_6_ERRM_DTC_R_478_CM 6 0. 5. AXIS_PTS_REF ldp_nr_2_id_err_dtc /end AXIS_DESCR
/end CHARACTERISTIC
/begin CHARACTERISTIC fmy_id_mec_ivvt_in_1.dtc "DTC table declaration for the diagnosis instance XX" MAP 0xa0803f70 _REC_MAP_20_u2_u2_u2 65535. _CNV_A_R_LINEAR_____0_CM 0. 65535. DISPLAY_IDENTIFIER ID_ERR_DTC_MEC_IVVT_IN_1 FORMAT "%5.0"
 /begin AXIS_DESCR COM_AXIS errm_online_dummy _CNV_S_2_ERRM_DTC_R_477_CM 1 0. 1. AXIS_PTS_REF ldp_nr_1_id_err_dtc /end AXIS_DESCR
 /begin AXIS_DESCR COM_AXIS errm_online_dummy _CNV_S_6_ERRM_DTC_R_478_CM 6 0. 5. AXIS_PTS_REF ldp_nr_2_id_err_dtc /end AXIS_DESCR
/end CHARACTERISTIC
/begin CHARACTERISTIC fmy_id_mec_ivvt_in_2.dtc "DTC table declaration for the diagnosis instance XX" MAP 0xa0803f84 _REC_MAP_20_u2_u2_u2 65535. _CNV_A_R_LINEAR_____0_CM 0. 65535. DISPLAY_IDENTIFIER ID_ERR_DTC_MEC_IVVT_IN_2 FORMAT "%5.0"
 /begin AXIS_DESCR COM_AXIS errm_online_dummy _CNV_S_2_ERRM_DTC_R_477_CM 1 0. 1. AXIS_PTS_REF ldp_nr_1_id_err_dtc /end AXIS_DESCR
 /begin AXIS_DESCR COM_AXIS errm_online_dummy _CNV_S_6_ERRM_DTC_R_478_CM 6 0. 5. AXIS_PTS_REF ldp_nr_2_id_err_dtc /end AXIS_DESCR
/end CHARACTERISTIC
/begin CHARACTERISTIC fmy_id_mec_ivvt_ex.dtc "DTC table declaration for the diagnosis instance XX" MAP 0xa0803f5c _REC_MAP_20_u2_u2_u2 65535. _CNV_A_R_LINEAR_____0_CM 0. 65535. DISPLAY_IDENTIFIER ID_ERR_DTC_MEC_IVVT_EX FORMAT "%5.0"
 /begin AXIS_DESCR COM_AXIS errm_online_dummy _CNV_S_2_ERRM_DTC_R_477_CM 1 0. 1. AXIS_PTS_REF ldp_nr_1_id_err_dtc /end AXIS_DESCR
 /begin AXIS_DESCR COM_AXIS errm_online_dummy _CNV_S_6_ERRM_DTC_R_478_CM 6 0. 5. AXIS_PTS_REF ldp_nr_2_id_err_dtc /end AXIS_DESCR
/end CHARACTERISTIC
/begin CHARACTERISTIC fmy_id_tout_nox_sens_1.dtc "DTC table declaration for the diagnosis instance XX" MAP 0xa0804ad8 _REC_MAP_20_u2_u2_u2 65535. _CNV_A_R_LINEAR_____0_CM 0. 65535. DISPLAY_IDENTIFIER ID_ERR_DTC_TOUT_NOX_SENS_1 FORMAT "%5.0"
 /begin AXIS_DESCR COM_AXIS errm_online_dummy _CNV_S_2_ERRM_DTC_R_477_CM 1 0. 1. AXIS_PTS_REF ldp_nr_1_id_err_dtc /end AXIS_DESCR
 /begin AXIS_DESCR COM_AXIS errm_online_dummy _CNV_S_6_ERRM_DTC_R_478_CM 6 0. 5. AXIS_PTS_REF ldp_nr_2_id_err_dtc /end AXIS_DESCR
/end CHARACTERISTIC
/begin CHARACTERISTIC fmy_id_tout_nox_sens_2.dtc "DTC table declaration for the diagnosis instance XX" MAP 0xa0804aec _REC_MAP_20_u2_u2_u2 65535. _CNV_A_R_LINEAR_____0_CM 0. 65535. DISPLAY_IDENTIFIER ID_ERR_DTC_TOUT_NOX_SENS_2 FORMAT "%5.0"
 /begin AXIS_DESCR COM_AXIS errm_online_dummy _CNV_S_2_ERRM_DTC_R_477_CM 1 0. 1. AXIS_PTS_REF ldp_nr_1_id_err_dtc /end AXIS_DESCR
 /begin AXIS_DESCR COM_AXIS errm_online_dummy _CNV_S_6_ERRM_DTC_R_478_CM 6 0. 5. AXIS_PTS_REF ldp_nr_2_id_err_dtc /end AXIS_DESCR
/end CHARACTERISTIC
/begin CHARACTERISTIC fmy_id_vvl_rot.dtc "DTC table declaration for the diagnosis instance XX" MAP 0xa0804dd0 _REC_MAP_20_u2_u2_u2 65535. _CNV_A_R_LINEAR_____0_CM 0. 65535. DISPLAY_IDENTIFIER ID_ERR_DTC_VVL_ROT FORMAT "%5.0"
 /begin AXIS_DESCR COM_AXIS errm_online_dummy _CNV_S_2_ERRM_DTC_R_477_CM 1 0. 1. AXIS_PTS_REF ldp_nr_1_id_err_dtc /end AXIS_DESCR
 /begin AXIS_DESCR COM_AXIS errm_online_dummy _CNV_S_6_ERRM_DTC_R_478_CM 6 0. 5. AXIS_PTS_REF ldp_nr_2_id_err_dtc /end AXIS_DESCR
/end CHARACTERISTIC
/begin CHARACTERISTIC fmy_id_rly_vvl.dtc "DTC table declaration for the diagnosis instance XX" MAP 0xa0804588 _REC_MAP_20_u2_u2_u2 65535. _CNV_A_R_LINEAR_____0_CM 0. 65535. DISPLAY_IDENTIFIER ID_ERR_DTC_RLY_VVL FORMAT "%5.0"
 /begin AXIS_DESCR COM_AXIS errm_online_dummy _CNV_S_2_ERRM_DTC_R_477_CM 1 0. 1. AXIS_PTS_REF ldp_nr_1_id_err_dtc /end AXIS_DESCR
 /begin AXIS_DESCR COM_AXIS errm_online_dummy _CNV_S_6_ERRM_DTC_R_478_CM 6 0. 5. AXIS_PTS_REF ldp_nr_2_id_err_dtc /end AXIS_DESCR
/end CHARACTERISTIC
/begin CHARACTERISTIC fmy_id_nox_sens_1.dtc "DTC table declaration for the diagnosis instance XX" MAP 0xa0804100 _REC_MAP_20_u2_u2_u2 65535. _CNV_A_R_LINEAR_____0_CM 0. 65535. DISPLAY_IDENTIFIER ID_ERR_DTC_NOX_SENS_1 FORMAT "%5.0"
 /begin AXIS_DESCR COM_AXIS errm_online_dummy _CNV_S_2_ERRM_DTC_R_477_CM 1 0. 1. AXIS_PTS_REF ldp_nr_1_id_err_dtc /end AXIS_DESCR
 /begin AXIS_DESCR COM_AXIS errm_online_dummy _CNV_S_6_ERRM_DTC_R_478_CM 6 0. 5. AXIS_PTS_REF ldp_nr_2_id_err_dtc /end AXIS_DESCR
/end CHARACTERISTIC
/begin CHARACTERISTIC fmy_id_ns_obd_1_1.dtc "DTC table declaration for the diagnosis instance XX" MAP 0xa0804128 _REC_MAP_20_u2_u2_u2 65535. _CNV_A_R_LINEAR_____0_CM 0. 65535. DISPLAY_IDENTIFIER ID_ERR_DTC_NS_OBD_1_1 FORMAT "%5.0"
 /begin AXIS_DESCR COM_AXIS errm_online_dummy _CNV_S_2_ERRM_DTC_R_477_CM 1 0. 1. AXIS_PTS_REF ldp_nr_1_id_err_dtc /end AXIS_DESCR
 /begin AXIS_DESCR COM_AXIS errm_online_dummy _CNV_S_6_ERRM_DTC_R_478_CM 6 0. 5. AXIS_PTS_REF ldp_nr_2_id_err_dtc /end AXIS_DESCR
/end CHARACTERISTIC
/begin CHARACTERISTIC fmy_id_ns_obd_1_2.dtc "DTC table declaration for the diagnosis instance XX" MAP 0xa080413c _REC_MAP_20_u2_u2_u2 65535. _CNV_A_R_LINEAR_____0_CM 0. 65535. DISPLAY_IDENTIFIER ID_ERR_DTC_NS_OBD_1_2 FORMAT "%5.0"
 /begin AXIS_DESCR COM_AXIS errm_online_dummy _CNV_S_2_ERRM_DTC_R_477_CM 1 0. 1. AXIS_PTS_REF ldp_nr_1_id_err_dtc /end AXIS_DESCR
 /begin AXIS_DESCR COM_AXIS errm_online_dummy _CNV_S_6_ERRM_DTC_R_478_CM 6 0. 5. AXIS_PTS_REF ldp_nr_2_id_err_dtc /end AXIS_DESCR
/end CHARACTERISTIC
/begin CHARACTERISTIC fmy_id_ovl_ecu_vvl.dtc "DTC table declaration for the diagnosis instance XX" MAP 0xa0804218 _REC_MAP_20_u2_u2_u2 65535. _CNV_A_R_LINEAR_____0_CM 0. 65535. DISPLAY_IDENTIFIER ID_ERR_DTC_OVL_ECU_VVL FORMAT "%5.0"
 /begin AXIS_DESCR COM_AXIS errm_online_dummy _CNV_S_2_ERRM_DTC_R_477_CM 1 0. 1. AXIS_PTS_REF ldp_nr_1_id_err_dtc /end AXIS_DESCR
 /begin AXIS_DESCR COM_AXIS errm_online_dummy _CNV_S_6_ERRM_DTC_R_478_CM 6 0. 5. AXIS_PTS_REF ldp_nr_2_id_err_dtc /end AXIS_DESCR
/end CHARACTERISTIC
/begin CHARACTERISTIC fmy_id_dr_sc_vvl.dtc "DTC table declaration for the diagnosis instance XX" MAP 0xa08034d0 _REC_MAP_20_u2_u2_u2 65535. _CNV_A_R_LINEAR_____0_CM 0. 65535. DISPLAY_IDENTIFIER ID_ERR_DTC_DR_SC_VVL FORMAT "%5.0"
 /begin AXIS_DESCR COM_AXIS errm_online_dummy _CNV_S_2_ERRM_DTC_R_477_CM 1 0. 1. AXIS_PTS_REF ldp_nr_1_id_err_dtc /end AXIS_DESCR
 /begin AXIS_DESCR COM_AXIS errm_online_dummy _CNV_S_6_ERRM_DTC_R_478_CM 6 0. 5. AXIS_PTS_REF ldp_nr_2_id_err_dtc /end AXIS_DESCR
/end CHARACTERISTIC
/begin CHARACTERISTIC fmy_id_crit_ovl_ecu_vvl.dtc "DTC table declaration for the diagnosis instance XX" MAP 0xa08031c4 _REC_MAP_20_u2_u2_u2 65535. _CNV_A_R_LINEAR_____0_CM 0. 65535. DISPLAY_IDENTIFIER ID_ERR_DTC_CRIT_OVL_ECU_VVL FORMAT "%5.0"
 /begin AXIS_DESCR COM_AXIS errm_online_dummy _CNV_S_2_ERRM_DTC_R_477_CM 1 0. 1. AXIS_PTS_REF ldp_nr_1_id_err_dtc /end AXIS_DESCR
 /begin AXIS_DESCR COM_AXIS errm_online_dummy _CNV_S_6_ERRM_DTC_R_478_CM 6 0. 5. AXIS_PTS_REF ldp_nr_2_id_err_dtc /end AXIS_DESCR
/end CHARACTERISTIC
/begin CHARACTERISTIC fmy_id_nox_sens_2.dtc "DTC table declaration for the diagnosis instance XX" MAP 0xa0804114 _REC_MAP_20_u2_u2_u2 65535. _CNV_A_R_LINEAR_____0_CM 0. 65535. DISPLAY_IDENTIFIER ID_ERR_DTC_NOX_SENS_2 FORMAT "%5.0"
 /begin AXIS_DESCR COM_AXIS errm_online_dummy _CNV_S_2_ERRM_DTC_R_477_CM 1 0. 1. AXIS_PTS_REF ldp_nr_1_id_err_dtc /end AXIS_DESCR
 /begin AXIS_DESCR COM_AXIS errm_online_dummy _CNV_S_6_ERRM_DTC_R_478_CM 6 0. 5. AXIS_PTS_REF ldp_nr_2_id_err_dtc /end AXIS_DESCR
/end CHARACTERISTIC
/begin CHARACTERISTIC fmy_id_cur_h_vvl.dtc "DTC table declaration for the diagnosis instance XX" MAP 0xa0803278 _REC_MAP_20_u2_u2_u2 65535. _CNV_A_R_LINEAR_____0_CM 0. 65535. DISPLAY_IDENTIFIER ID_ERR_DTC_CUR_H_VVL FORMAT "%5.0"
 /begin AXIS_DESCR COM_AXIS errm_online_dummy _CNV_S_2_ERRM_DTC_R_477_CM 1 0. 1. AXIS_PTS_REF ldp_nr_1_id_err_dtc /end AXIS_DESCR
 /begin AXIS_DESCR COM_AXIS errm_online_dummy _CNV_S_6_ERRM_DTC_R_478_CM 6 0. 5. AXIS_PTS_REF ldp_nr_2_id_err_dtc /end AXIS_DESCR
/end CHARACTERISTIC
/begin CHARACTERISTIC fmy_id_teg_pcat_down.dtc "DTC table declaration for the diagnosis instance XX" MAP 0xa08049ac _REC_MAP_20_u2_u2_u2 65535. _CNV_A_R_LINEAR_____0_CM 0. 65535. DISPLAY_IDENTIFIER ID_ERR_DTC_TEG_PCAT_DOWN FORMAT "%5.0"
 /begin AXIS_DESCR COM_AXIS errm_online_dummy _CNV_S_2_ERRM_DTC_R_477_CM 1 0. 1. AXIS_PTS_REF ldp_nr_1_id_err_dtc /end AXIS_DESCR
 /begin AXIS_DESCR COM_AXIS errm_online_dummy _CNV_S_6_ERRM_DTC_R_478_CM 6 0. 5. AXIS_PTS_REF ldp_nr_2_id_err_dtc /end AXIS_DESCR
/end CHARACTERISTIC
/begin CHARACTERISTIC fmy_id_t_seg_er.dtc "DTC table declaration for the diagnosis instance XX" MAP 0xa080486c _REC_MAP_20_u2_u2_u2 65535. _CNV_A_R_LINEAR_____0_CM 0. 65535. DISPLAY_IDENTIFIER ID_ERR_DTC_T_SEG_ER FORMAT "%5.0"
 /begin AXIS_DESCR COM_AXIS errm_online_dummy _CNV_S_2_ERRM_DTC_R_477_CM 1 0. 1. AXIS_PTS_REF ldp_nr_1_id_err_dtc /end AXIS_DESCR
 /begin AXIS_DESCR COM_AXIS errm_online_dummy _CNV_S_6_ERRM_DTC_R_478_CM 6 0. 5. AXIS_PTS_REF ldp_nr_2_id_err_dtc /end AXIS_DESCR
/end CHARACTERISTIC
/begin CHARACTERISTIC fmy_id_seg_ad_er.dtc "DTC table declaration for the diagnosis instance XX" MAP 0xa0804600 _REC_MAP_20_u2_u2_u2 65535. _CNV_A_R_LINEAR_____0_CM 0. 65535. DISPLAY_IDENTIFIER ID_ERR_DTC_SEG_AD_ER FORMAT "%5.0"
 /begin AXIS_DESCR COM_AXIS errm_online_dummy _CNV_S_2_ERRM_DTC_R_477_CM 1 0. 1. AXIS_PTS_REF ldp_nr_1_id_err_dtc /end AXIS_DESCR
 /begin AXIS_DESCR COM_AXIS errm_online_dummy _CNV_S_6_ERRM_DTC_R_478_CM 6 0. 5. AXIS_PTS_REF ldp_nr_2_id_err_dtc /end AXIS_DESCR
/end CHARACTERISTIC
/begin CHARACTERISTIC fmy_id_vs_plaus.dtc "DTC table declaration for the diagnosis instance XX" MAP 0xa0804dbc _REC_MAP_20_u2_u2_u2 65535. _CNV_A_R_LINEAR_____0_CM 0. 65535. DISPLAY_IDENTIFIER ID_ERR_DTC_VS_PLAUS FORMAT "%5.0"
 /begin AXIS_DESCR COM_AXIS errm_online_dummy _CNV_S_2_ERRM_DTC_R_477_CM 1 0. 1. AXIS_PTS_REF ldp_nr_1_id_err_dtc /end AXIS_DESCR
 /begin AXIS_DESCR COM_AXIS errm_online_dummy _CNV_S_6_ERRM_DTC_R_478_CM 6 0. 5. AXIS_PTS_REF ldp_nr_2_id_err_dtc /end AXIS_DESCR
/end CHARACTERISTIC
/begin CHARACTERISTIC fmy_id_ftl_obd.dtc "DTC table declaration for the diagnosis instance XX" MAP 0xa08037f0 _REC_MAP_20_u2_u2_u2 65535. _CNV_A_R_LINEAR_____0_CM 0. 65535. DISPLAY_IDENTIFIER ID_ERR_DTC_FTL_OBD FORMAT "%5.0"
 /begin AXIS_DESCR COM_AXIS errm_online_dummy _CNV_S_2_ERRM_DTC_R_477_CM 1 0. 1. AXIS_PTS_REF ldp_nr_1_id_err_dtc /end AXIS_DESCR
 /begin AXIS_DESCR COM_AXIS errm_online_dummy _CNV_S_6_ERRM_DTC_R_478_CM 6 0. 5. AXIS_PTS_REF ldp_nr_2_id_err_dtc /end AXIS_DESCR
/end CHARACTERISTIC
/begin CHARACTERISTIC fmy_id_ftl_le_can.dtc "DTC table declaration for the diagnosis instance XX" MAP 0xa08037c8 _REC_MAP_20_u2_u2_u2 65535. _CNV_A_R_LINEAR_____0_CM 0. 65535. DISPLAY_IDENTIFIER ID_ERR_DTC_FTL_LE_CAN FORMAT "%5.0"
 /begin AXIS_DESCR COM_AXIS errm_online_dummy _CNV_S_2_ERRM_DTC_R_477_CM 1 0. 1. AXIS_PTS_REF ldp_nr_1_id_err_dtc /end AXIS_DESCR
 /begin AXIS_DESCR COM_AXIS errm_online_dummy _CNV_S_6_ERRM_DTC_R_478_CM 6 0. 5. AXIS_PTS_REF ldp_nr_2_id_err_dtc /end AXIS_DESCR
/end CHARACTERISTIC
/begin CHARACTERISTIC fmy_id_ftl_ri_can.dtc "DTC table declaration for the diagnosis instance XX" MAP 0xa0803804 _REC_MAP_20_u2_u2_u2 65535. _CNV_A_R_LINEAR_____0_CM 0. 65535. DISPLAY_IDENTIFIER ID_ERR_DTC_FTL_RI_CAN FORMAT "%5.0"
 /begin AXIS_DESCR COM_AXIS errm_online_dummy _CNV_S_2_ERRM_DTC_R_477_CM 1 0. 1. AXIS_PTS_REF ldp_nr_1_id_err_dtc /end AXIS_DESCR
 /begin AXIS_DESCR COM_AXIS errm_online_dummy _CNV_S_6_ERRM_DTC_R_478_CM 6 0. 5. AXIS_PTS_REF ldp_nr_2_id_err_dtc /end AXIS_DESCR
/end CHARACTERISTIC
/begin CHARACTERISTIC fmy_id_tia_plaus.dtc "DTC table declaration for the diagnosis instance XX" MAP 0xa0804a24 _REC_MAP_20_u2_u2_u2 65535. _CNV_A_R_LINEAR_____0_CM 0. 65535. DISPLAY_IDENTIFIER ID_ERR_DTC_TIA_PLAUS FORMAT "%5.0"
 /begin AXIS_DESCR COM_AXIS errm_online_dummy _CNV_S_2_ERRM_DTC_R_477_CM 1 0. 1. AXIS_PTS_REF ldp_nr_1_id_err_dtc /end AXIS_DESCR
 /begin AXIS_DESCR COM_AXIS errm_online_dummy _CNV_S_6_ERRM_DTC_R_478_CM 6 0. 5. AXIS_PTS_REF ldp_nr_2_id_err_dtc /end AXIS_DESCR
/end CHARACTERISTIC
/begin CHARACTERISTIC fmy_id_tam_can.dtc "DTC table declaration for the diagnosis instance XX" MAP 0xa0804880 _REC_MAP_20_u2_u2_u2 65535. _CNV_A_R_LINEAR_____0_CM 0. 65535. DISPLAY_IDENTIFIER ID_ERR_DTC_TAM_CAN FORMAT "%5.0"
 /begin AXIS_DESCR COM_AXIS errm_online_dummy _CNV_S_2_ERRM_DTC_R_477_CM 1 0. 1. AXIS_PTS_REF ldp_nr_1_id_err_dtc /end AXIS_DESCR
 /begin AXIS_DESCR COM_AXIS errm_online_dummy _CNV_S_6_ERRM_DTC_R_478_CM 6 0. 5. AXIS_PTS_REF ldp_nr_2_id_err_dtc /end AXIS_DESCR
/end CHARACTERISTIC
/begin CHARACTERISTIC fmy_id_tam_plaus.dtc "DTC table declaration for the diagnosis instance XX" MAP 0xa0804894 _REC_MAP_20_u2_u2_u2 65535. _CNV_A_R_LINEAR_____0_CM 0. 65535. DISPLAY_IDENTIFIER ID_ERR_DTC_TAM_PLAUS FORMAT "%5.0"
 /begin AXIS_DESCR COM_AXIS errm_online_dummy _CNV_S_2_ERRM_DTC_R_477_CM 1 0. 1. AXIS_PTS_REF ldp_nr_1_id_err_dtc /end AXIS_DESCR
 /begin AXIS_DESCR COM_AXIS errm_online_dummy _CNV_S_6_ERRM_DTC_R_478_CM 6 0. 5. AXIS_PTS_REF ldp_nr_2_id_err_dtc /end AXIS_DESCR
/end CHARACTERISTIC
/begin CHARACTERISTIC fmy_id_map_shift_1.dtc "DTC table declaration for the diagnosis instance XX" MAP 0xa0803f34 _REC_MAP_20_u2_u2_u2 65535. _CNV_A_R_LINEAR_____0_CM 0. 65535. DISPLAY_IDENTIFIER ID_ERR_DTC_MAP_SHIFT_1 FORMAT "%5.0"
 /begin AXIS_DESCR COM_AXIS errm_online_dummy _CNV_S_2_ERRM_DTC_R_477_CM 1 0. 1. AXIS_PTS_REF ldp_nr_1_id_err_dtc /end AXIS_DESCR
 /begin AXIS_DESCR COM_AXIS errm_online_dummy _CNV_S_6_ERRM_DTC_R_478_CM 6 0. 5. AXIS_PTS_REF ldp_nr_2_id_err_dtc /end AXIS_DESCR
/end CHARACTERISTIC
/begin CHARACTERISTIC fmy_id_map_shift_2.dtc "DTC table declaration for the diagnosis instance XX" MAP 0xa0803f48 _REC_MAP_20_u2_u2_u2 65535. _CNV_A_R_LINEAR_____0_CM 0. 65535. DISPLAY_IDENTIFIER ID_ERR_DTC_MAP_SHIFT_2 FORMAT "%5.0"
 /begin AXIS_DESCR COM_AXIS errm_online_dummy _CNV_S_2_ERRM_DTC_R_477_CM 1 0. 1. AXIS_PTS_REF ldp_nr_1_id_err_dtc /end AXIS_DESCR
 /begin AXIS_DESCR COM_AXIS errm_online_dummy _CNV_S_6_ERRM_DTC_R_478_CM 6 0. 5. AXIS_PTS_REF ldp_nr_2_id_err_dtc /end AXIS_DESCR
/end CHARACTERISTIC
/begin CHARACTERISTIC fmy_id_cat_diag_1.dtc "DTC table declaration for the diagnosis instance XX" MAP 0xa0802d50 _REC_MAP_20_u2_u2_u2 65535. _CNV_A_R_LINEAR_____0_CM 0. 65535. DISPLAY_IDENTIFIER ID_ERR_DTC_CAT_DIAG_1 FORMAT "%5.0"
 /begin AXIS_DESCR COM_AXIS errm_online_dummy _CNV_S_2_ERRM_DTC_R_477_CM 1 0. 1. AXIS_PTS_REF ldp_nr_1_id_err_dtc /end AXIS_DESCR
 /begin AXIS_DESCR COM_AXIS errm_online_dummy _CNV_S_6_ERRM_DTC_R_478_CM 6 0. 5. AXIS_PTS_REF ldp_nr_2_id_err_dtc /end AXIS_DESCR
/end CHARACTERISTIC
/begin CHARACTERISTIC fmy_id_cat_diag_2.dtc "DTC table declaration for the diagnosis instance XX" MAP 0xa0802d64 _REC_MAP_20_u2_u2_u2 65535. _CNV_A_R_LINEAR_____0_CM 0. 65535. DISPLAY_IDENTIFIER ID_ERR_DTC_CAT_DIAG_2 FORMAT "%5.0"
 /begin AXIS_DESCR COM_AXIS errm_online_dummy _CNV_S_2_ERRM_DTC_R_477_CM 1 0. 1. AXIS_PTS_REF ldp_nr_1_id_err_dtc /end AXIS_DESCR
 /begin AXIS_DESCR COM_AXIS errm_online_dummy _CNV_S_6_ERRM_DTC_R_478_CM 6 0. 5. AXIS_PTS_REF ldp_nr_2_id_err_dtc /end AXIS_DESCR
/end CHARACTERISTIC
/begin CHARACTERISTIC fmy_id_cat_diag_afl_1.dtc "DTC table declaration for the diagnosis instance XX" MAP 0xa0802d78 _REC_MAP_20_u2_u2_u2 65535. _CNV_A_R_LINEAR_____0_CM 0. 65535. DISPLAY_IDENTIFIER ID_ERR_DTC_CAT_DIAG_AFL_1 FORMAT "%5.0"
 /begin AXIS_DESCR COM_AXIS errm_online_dummy _CNV_S_2_ERRM_DTC_R_477_CM 1 0. 1. AXIS_PTS_REF ldp_nr_1_id_err_dtc /end AXIS_DESCR
 /begin AXIS_DESCR COM_AXIS errm_online_dummy _CNV_S_6_ERRM_DTC_R_478_CM 6 0. 5. AXIS_PTS_REF ldp_nr_2_id_err_dtc /end AXIS_DESCR
/end CHARACTERISTIC
/begin CHARACTERISTIC fmy_id_cat_diag_afl_2.dtc "DTC table declaration for the diagnosis instance XX" MAP 0xa0802d8c _REC_MAP_20_u2_u2_u2 65535. _CNV_A_R_LINEAR_____0_CM 0. 65535. DISPLAY_IDENTIFIER ID_ERR_DTC_CAT_DIAG_AFL_2 FORMAT "%5.0"
 /begin AXIS_DESCR COM_AXIS errm_online_dummy _CNV_S_2_ERRM_DTC_R_477_CM 1 0. 1. AXIS_PTS_REF ldp_nr_1_id_err_dtc /end AXIS_DESCR
 /begin AXIS_DESCR COM_AXIS errm_online_dummy _CNV_S_6_ERRM_DTC_R_478_CM 6 0. 5. AXIS_PTS_REF ldp_nr_2_id_err_dtc /end AXIS_DESCR
/end CHARACTERISTIC
/begin CHARACTERISTIC fmy_id_scg_ls_down_1.dtc "DTC table declaration for the diagnosis instance XX" MAP 0xa08045b0 _REC_MAP_20_u2_u2_u2 65535. _CNV_A_R_LINEAR_____0_CM 0. 65535. DISPLAY_IDENTIFIER ID_ERR_DTC_SCG_LS_DOWN_1 FORMAT "%5.0"
 /begin AXIS_DESCR COM_AXIS errm_online_dummy _CNV_S_2_ERRM_DTC_R_477_CM 1 0. 1. AXIS_PTS_REF ldp_nr_1_id_err_dtc /end AXIS_DESCR
 /begin AXIS_DESCR COM_AXIS errm_online_dummy _CNV_S_6_ERRM_DTC_R_478_CM 6 0. 5. AXIS_PTS_REF ldp_nr_2_id_err_dtc /end AXIS_DESCR
/end CHARACTERISTIC
/begin CHARACTERISTIC fmy_id_scp_ls_down_1.dtc "DTC table declaration for the diagnosis instance XX" MAP 0xa08045d8 _REC_MAP_20_u2_u2_u2 65535. _CNV_A_R_LINEAR_____0_CM 0. 65535. DISPLAY_IDENTIFIER ID_ERR_DTC_SCP_LS_DOWN_1 FORMAT "%5.0"
 /begin AXIS_DESCR COM_AXIS errm_online_dummy _CNV_S_2_ERRM_DTC_R_477_CM 1 0. 1. AXIS_PTS_REF ldp_nr_1_id_err_dtc /end AXIS_DESCR
 /begin AXIS_DESCR COM_AXIS errm_online_dummy _CNV_S_6_ERRM_DTC_R_478_CM 6 0. 5. AXIS_PTS_REF ldp_nr_2_id_err_dtc /end AXIS_DESCR
/end CHARACTERISTIC
/begin CHARACTERISTIC fmy_id_oc_ls_down_1.dtc "DTC table declaration for the diagnosis instance XX" MAP 0xa08041a0 _REC_MAP_20_u2_u2_u2 65535. _CNV_A_R_LINEAR_____0_CM 0. 65535. DISPLAY_IDENTIFIER ID_ERR_DTC_OC_LS_DOWN_1 FORMAT "%5.0"
 /begin AXIS_DESCR COM_AXIS errm_online_dummy _CNV_S_2_ERRM_DTC_R_477_CM 1 0. 1. AXIS_PTS_REF ldp_nr_1_id_err_dtc /end AXIS_DESCR
 /begin AXIS_DESCR COM_AXIS errm_online_dummy _CNV_S_6_ERRM_DTC_R_478_CM 6 0. 5. AXIS_PTS_REF ldp_nr_2_id_err_dtc /end AXIS_DESCR
/end CHARACTERISTIC
/begin CHARACTERISTIC fmy_id_puc_ls_down_1.dtc "DTC table declaration for the diagnosis instance XX" MAP 0xa0804358 _REC_MAP_20_u2_u2_u2 65535. _CNV_A_R_LINEAR_____0_CM 0. 65535. DISPLAY_IDENTIFIER ID_ERR_DTC_PUC_LS_DOWN_1 FORMAT "%5.0"
 /begin AXIS_DESCR COM_AXIS errm_online_dummy _CNV_S_2_ERRM_DTC_R_477_CM 1 0. 1. AXIS_PTS_REF ldp_nr_1_id_err_dtc /end AXIS_DESCR
 /begin AXIS_DESCR COM_AXIS errm_online_dummy _CNV_S_6_ERRM_DTC_R_478_CM 6 0. 5. AXIS_PTS_REF ldp_nr_2_id_err_dtc /end AXIS_DESCR
/end CHARACTERISTIC
/begin CHARACTERISTIC fmy_id_fl_ls_down_1.dtc "DTC table declaration for the diagnosis instance XX" MAP 0xa0803728 _REC_MAP_20_u2_u2_u2 65535. _CNV_A_R_LINEAR_____0_CM 0. 65535. DISPLAY_IDENTIFIER ID_ERR_DTC_FL_LS_DOWN_1 FORMAT "%5.0"
 /begin AXIS_DESCR COM_AXIS errm_online_dummy _CNV_S_2_ERRM_DTC_R_477_CM 1 0. 1. AXIS_PTS_REF ldp_nr_1_id_err_dtc /end AXIS_DESCR
 /begin AXIS_DESCR COM_AXIS errm_online_dummy _CNV_S_6_ERRM_DTC_R_478_CM 6 0. 5. AXIS_PTS_REF ldp_nr_2_id_err_dtc /end AXIS_DESCR
/end CHARACTERISTIC
/begin CHARACTERISTIC fmy_id_lsl_up_if_1.dtc "DTC table declaration for the diagnosis instance XX" MAP 0xa0803e30 _REC_MAP_20_u2_u2_u2 65535. _CNV_A_R_LINEAR_____0_CM 0. 65535. DISPLAY_IDENTIFIER ID_ERR_DTC_LSL_UP_IF_1 FORMAT "%5.0"
 /begin AXIS_DESCR COM_AXIS errm_online_dummy _CNV_S_2_ERRM_DTC_R_477_CM 1 0. 1. AXIS_PTS_REF ldp_nr_1_id_err_dtc /end AXIS_DESCR
 /begin AXIS_DESCR COM_AXIS errm_online_dummy _CNV_S_6_ERRM_DTC_R_478_CM 6 0. 5. AXIS_PTS_REF ldp_nr_2_id_err_dtc /end AXIS_DESCR
/end CHARACTERISTIC
/begin CHARACTERISTIC fmy_id_el_lsl_up_1.dtc "DTC table declaration for the diagnosis instance XX" MAP 0xa0803688 _REC_MAP_20_u2_u2_u2 65535. _CNV_A_R_LINEAR_____0_CM 0. 65535. DISPLAY_IDENTIFIER ID_ERR_DTC_EL_LSL_UP_1 FORMAT "%5.0"
 /begin AXIS_DESCR COM_AXIS errm_online_dummy _CNV_S_2_ERRM_DTC_R_477_CM 1 0. 1. AXIS_PTS_REF ldp_nr_1_id_err_dtc /end AXIS_DESCR
 /begin AXIS_DESCR COM_AXIS errm_online_dummy _CNV_S_6_ERRM_DTC_R_478_CM 6 0. 5. AXIS_PTS_REF ldp_nr_2_id_err_dtc /end AXIS_DESCR
/end CHARACTERISTIC
/begin CHARACTERISTIC fmy_id_lsh_up_1.dtc "DTC table declaration for the diagnosis instance XX" MAP 0xa0803e08 _REC_MAP_20_u2_u2_u2 65535. _CNV_A_R_LINEAR_____0_CM 0. 65535. DISPLAY_IDENTIFIER ID_ERR_DTC_LSH_UP_1 FORMAT "%5.0"
 /begin AXIS_DESCR COM_AXIS errm_online_dummy _CNV_S_2_ERRM_DTC_R_477_CM 1 0. 1. AXIS_PTS_REF ldp_nr_1_id_err_dtc /end AXIS_DESCR
 /begin AXIS_DESCR COM_AXIS errm_online_dummy _CNV_S_6_ERRM_DTC_R_478_CM 6 0. 5. AXIS_PTS_REF ldp_nr_2_id_err_dtc /end AXIS_DESCR
/end CHARACTERISTIC
/begin CHARACTERISTIC fmy_id_lsh_down_1.dtc "DTC table declaration for the diagnosis instance XX" MAP 0xa0803db8 _REC_MAP_20_u2_u2_u2 65535. _CNV_A_R_LINEAR_____0_CM 0. 65535. DISPLAY_IDENTIFIER ID_ERR_DTC_LSH_DOWN_1 FORMAT "%5.0"
 /begin AXIS_DESCR COM_AXIS errm_online_dummy _CNV_S_2_ERRM_DTC_R_477_CM 1 0. 1. AXIS_PTS_REF ldp_nr_1_id_err_dtc /end AXIS_DESCR
 /begin AXIS_DESCR COM_AXIS errm_online_dummy _CNV_S_6_ERRM_DTC_R_478_CM 6 0. 5. AXIS_PTS_REF ldp_nr_2_id_err_dtc /end AXIS_DESCR
/end CHARACTERISTIC
/begin CHARACTERISTIC fmy_id_vls_down_dif_1.dtc "DTC table declaration for the diagnosis instance XX" MAP 0xa0804d80 _REC_MAP_20_u2_u2_u2 65535. _CNV_A_R_LINEAR_____0_CM 0. 65535. DISPLAY_IDENTIFIER ID_ERR_DTC_VLS_DOWN_DIF_1 FORMAT "%5.0"
 /begin AXIS_DESCR COM_AXIS errm_online_dummy _CNV_S_2_ERRM_DTC_R_477_CM 1 0. 1. AXIS_PTS_REF ldp_nr_1_id_err_dtc /end AXIS_DESCR
 /begin AXIS_DESCR COM_AXIS errm_online_dummy _CNV_S_6_ERRM_DTC_R_478_CM 6 0. 5. AXIS_PTS_REF ldp_nr_2_id_err_dtc /end AXIS_DESCR
/end CHARACTERISTIC
/begin CHARACTERISTIC fmy_id_lsh_lsl_up_1.dtc "DTC table declaration for the diagnosis instance XX" MAP 0xa0803de0 _REC_MAP_20_u2_u2_u2 65535. _CNV_A_R_LINEAR_____0_CM 0. 65535. DISPLAY_IDENTIFIER ID_ERR_DTC_LSH_LSL_UP_1 FORMAT "%5.0"
 /begin AXIS_DESCR COM_AXIS errm_online_dummy _CNV_S_2_ERRM_DTC_R_477_CM 1 0. 1. AXIS_PTS_REF ldp_nr_1_id_err_dtc /end AXIS_DESCR
 /begin AXIS_DESCR COM_AXIS errm_online_dummy _CNV_S_6_ERRM_DTC_R_478_CM 6 0. 5. AXIS_PTS_REF ldp_nr_2_id_err_dtc /end AXIS_DESCR
/end CHARACTERISTIC
/begin CHARACTERISTIC fmy_id_air_lsl_up_1.dtc "DTC table declaration for the diagnosis instance XX" MAP 0xa0802990 _REC_MAP_20_u2_u2_u2 65535. _CNV_A_R_LINEAR_____0_CM 0. 65535. DISPLAY_IDENTIFIER ID_ERR_DTC_AIR_LSL_UP_1 FORMAT "%5.0"
 /begin AXIS_DESCR COM_AXIS errm_online_dummy _CNV_S_2_ERRM_DTC_R_477_CM 1 0. 1. AXIS_PTS_REF ldp_nr_1_id_err_dtc /end AXIS_DESCR
 /begin AXIS_DESCR COM_AXIS errm_online_dummy _CNV_S_6_ERRM_DTC_R_478_CM 6 0. 5. AXIS_PTS_REF ldp_nr_2_id_err_dtc /end AXIS_DESCR
/end CHARACTERISTIC
/begin CHARACTERISTIC fmy_id_pue_ls_down_1.dtc "DTC table declaration for the diagnosis instance XX" MAP 0xa08043a8 _REC_MAP_20_u2_u2_u2 65535. _CNV_A_R_LINEAR_____0_CM 0. 65535. DISPLAY_IDENTIFIER ID_ERR_DTC_PUE_LS_DOWN_1 FORMAT "%5.0"
 /begin AXIS_DESCR COM_AXIS errm_online_dummy _CNV_S_2_ERRM_DTC_R_477_CM 1 0. 1. AXIS_PTS_REF ldp_nr_1_id_err_dtc /end AXIS_DESCR
 /begin AXIS_DESCR COM_AXIS errm_online_dummy _CNV_S_6_ERRM_DTC_R_478_CM 6 0. 5. AXIS_PTS_REF ldp_nr_2_id_err_dtc /end AXIS_DESCR
/end CHARACTERISTIC
/begin CHARACTERISTIC fmy_id_swt_ls_down_1.dtc "DTC table declaration for the diagnosis instance XX" MAP 0xa0804790 _REC_MAP_20_u2_u2_u2 65535. _CNV_A_R_LINEAR_____0_CM 0. 65535. DISPLAY_IDENTIFIER ID_ERR_DTC_SWT_LS_DOWN_1 FORMAT "%5.0"
 /begin AXIS_DESCR COM_AXIS errm_online_dummy _CNV_S_2_ERRM_DTC_R_477_CM 1 0. 1. AXIS_PTS_REF ldp_nr_1_id_err_dtc /end AXIS_DESCR
 /begin AXIS_DESCR COM_AXIS errm_online_dummy _CNV_S_6_ERRM_DTC_R_478_CM 6 0. 5. AXIS_PTS_REF ldp_nr_2_id_err_dtc /end AXIS_DESCR
/end CHARACTERISTIC
/begin CHARACTERISTIC fmy_id_obd_lsh_down_1.dtc "DTC table declaration for the diagnosis instance XX" MAP 0xa0804150 _REC_MAP_20_u2_u2_u2 65535. _CNV_A_R_LINEAR_____0_CM 0. 65535. DISPLAY_IDENTIFIER ID_ERR_DTC_OBD_LSH_DOWN_1 FORMAT "%5.0"
 /begin AXIS_DESCR COM_AXIS errm_online_dummy _CNV_S_2_ERRM_DTC_R_477_CM 1 0. 1. AXIS_PTS_REF ldp_nr_1_id_err_dtc /end AXIS_DESCR
 /begin AXIS_DESCR COM_AXIS errm_online_dummy _CNV_S_6_ERRM_DTC_R_478_CM 6 0. 5. AXIS_PTS_REF ldp_nr_2_id_err_dtc /end AXIS_DESCR
/end CHARACTERISTIC
/begin CHARACTERISTIC fmy_id_dyn_vld_ls_up_1.dtc "DTC table declaration for the diagnosis instance XX" MAP 0xa080350c _REC_MAP_20_u2_u2_u2 65535. _CNV_A_R_LINEAR_____0_CM 0. 65535. DISPLAY_IDENTIFIER ID_ERR_DTC_DYN_VLD_LS_UP_1 FORMAT "%5.0"
 /begin AXIS_DESCR COM_AXIS errm_online_dummy _CNV_S_2_ERRM_DTC_R_477_CM 1 0. 1. AXIS_PTS_REF ldp_nr_1_id_err_dtc /end AXIS_DESCR
 /begin AXIS_DESCR COM_AXIS errm_online_dummy _CNV_S_6_ERRM_DTC_R_478_CM 6 0. 5. AXIS_PTS_REF ldp_nr_2_id_err_dtc /end AXIS_DESCR
/end CHARACTERISTIC
/begin CHARACTERISTIC fmy_id_puc_vld_ls_up_1.dtc "DTC table declaration for the diagnosis instance XX" MAP 0xa0804380 _REC_MAP_20_u2_u2_u2 65535. _CNV_A_R_LINEAR_____0_CM 0. 65535. DISPLAY_IDENTIFIER ID_ERR_DTC_PUC_VLD_LS_UP_1 FORMAT "%5.0"
 /begin AXIS_DESCR COM_AXIS errm_online_dummy _CNV_S_2_ERRM_DTC_R_477_CM 1 0. 1. AXIS_PTS_REF ldp_nr_1_id_err_dtc /end AXIS_DESCR
 /begin AXIS_DESCR COM_AXIS errm_online_dummy _CNV_S_6_ERRM_DTC_R_478_CM 6 0. 5. AXIS_PTS_REF ldp_nr_2_id_err_dtc /end AXIS_DESCR
/end CHARACTERISTIC
/begin CHARACTERISTIC fmy_id_obd_vld_lsh_up_1.dtc "DTC table declaration for the diagnosis instance XX" MAP 0xa0804178 _REC_MAP_20_u2_u2_u2 65535. _CNV_A_R_LINEAR_____0_CM 0. 65535. DISPLAY_IDENTIFIER ID_ERR_DTC_OBD_VLD_LSH_UP_1 FORMAT "%5.0"
 /begin AXIS_DESCR COM_AXIS errm_online_dummy _CNV_S_2_ERRM_DTC_R_477_CM 1 0. 1. AXIS_PTS_REF ldp_nr_1_id_err_dtc /end AXIS_DESCR
 /begin AXIS_DESCR COM_AXIS errm_online_dummy _CNV_S_6_ERRM_DTC_R_478_CM 6 0. 5. AXIS_PTS_REF ldp_nr_2_id_err_dtc /end AXIS_DESCR
/end CHARACTERISTIC
/begin CHARACTERISTIC fmy_id_chk_ls_down_1.dtc "DTC table declaration for the diagnosis instance XX" MAP 0xa0802ddc _REC_MAP_20_u2_u2_u2 65535. _CNV_A_R_LINEAR_____0_CM 0. 65535. DISPLAY_IDENTIFIER ID_ERR_DTC_CHK_LS_DOWN_1 FORMAT "%5.0"
 /begin AXIS_DESCR COM_AXIS errm_online_dummy _CNV_S_2_ERRM_DTC_R_477_CM 1 0. 1. AXIS_PTS_REF ldp_nr_1_id_err_dtc /end AXIS_DESCR
 /begin AXIS_DESCR COM_AXIS errm_online_dummy _CNV_S_6_ERRM_DTC_R_478_CM 6 0. 5. AXIS_PTS_REF ldp_nr_2_id_err_dtc /end AXIS_DESCR
/end CHARACTERISTIC
/begin CHARACTERISTIC fmy_id_shift_afl_lsl_up_1.dtc "DTC table declaration for the diagnosis instance XX" MAP 0xa0804650 _REC_MAP_20_u2_u2_u2 65535. _CNV_A_R_LINEAR_____0_CM 0. 65535. DISPLAY_IDENTIFIER ID_ERR_DTC_SHIFT_AFL_LSL_UP_1 FORMAT "%5.0"
 /begin AXIS_DESCR COM_AXIS errm_online_dummy _CNV_S_2_ERRM_DTC_R_477_CM 1 0. 1. AXIS_PTS_REF ldp_nr_1_id_err_dtc /end AXIS_DESCR
 /begin AXIS_DESCR COM_AXIS errm_online_dummy _CNV_S_6_ERRM_DTC_R_478_CM 6 0. 5. AXIS_PTS_REF ldp_nr_2_id_err_dtc /end AXIS_DESCR
/end CHARACTERISTIC
/begin CHARACTERISTIC fmy_id_shift_afr_lsl_up_1.dtc "DTC table declaration for the diagnosis instance XX" MAP 0xa0804678 _REC_MAP_20_u2_u2_u2 65535. _CNV_A_R_LINEAR_____0_CM 0. 65535. DISPLAY_IDENTIFIER ID_ERR_DTC_SHIFT_AFR_LSL_UP_1 FORMAT "%5.0"
 /begin AXIS_DESCR COM_AXIS errm_online_dummy _CNV_S_2_ERRM_DTC_R_477_CM 1 0. 1. AXIS_PTS_REF ldp_nr_1_id_err_dtc /end AXIS_DESCR
 /begin AXIS_DESCR COM_AXIS errm_online_dummy _CNV_S_6_ERRM_DTC_R_478_CM 6 0. 5. AXIS_PTS_REF ldp_nr_2_id_err_dtc /end AXIS_DESCR
/end CHARACTERISTIC
/begin CHARACTERISTIC fmy_id_oc_lsl_up_1.dtc "DTC table declaration for the diagnosis instance XX" MAP 0xa08041c8 _REC_MAP_20_u2_u2_u2 65535. _CNV_A_R_LINEAR_____0_CM 0. 65535. DISPLAY_IDENTIFIER ID_ERR_DTC_OC_LSL_UP_1 FORMAT "%5.0"
 /begin AXIS_DESCR COM_AXIS errm_online_dummy _CNV_S_2_ERRM_DTC_R_477_CM 1 0. 1. AXIS_PTS_REF ldp_nr_1_id_err_dtc /end AXIS_DESCR
 /begin AXIS_DESCR COM_AXIS errm_online_dummy _CNV_S_6_ERRM_DTC_R_478_CM 6 0. 5. AXIS_PTS_REF ldp_nr_2_id_err_dtc /end AXIS_DESCR
/end CHARACTERISTIC
/begin CHARACTERISTIC fmy_id_delta_i_lam_1.dtc "DTC table declaration for the diagnosis instance XX" MAP 0xa0803444 _REC_MAP_20_u2_u2_u2 65535. _CNV_A_R_LINEAR_____0_CM 0. 65535. DISPLAY_IDENTIFIER ID_ERR_DTC_DELTA_I_LAM_1 FORMAT "%5.0"
 /begin AXIS_DESCR COM_AXIS errm_online_dummy _CNV_S_2_ERRM_DTC_R_477_CM 1 0. 1. AXIS_PTS_REF ldp_nr_1_id_err_dtc /end AXIS_DESCR
 /begin AXIS_DESCR COM_AXIS errm_online_dummy _CNV_S_6_ERRM_DTC_R_478_CM 6 0. 5. AXIS_PTS_REF ldp_nr_2_id_err_dtc /end AXIS_DESCR
/end CHARACTERISTIC
/begin CHARACTERISTIC fmy_id_ofs_lsl_up_1.dtc "DTC table declaration for the diagnosis instance XX" MAP 0xa08041f0 _REC_MAP_20_u2_u2_u2 65535. _CNV_A_R_LINEAR_____0_CM 0. 65535. DISPLAY_IDENTIFIER ID_ERR_DTC_OFS_LSL_UP_1 FORMAT "%5.0"
 /begin AXIS_DESCR COM_AXIS errm_online_dummy _CNV_S_2_ERRM_DTC_R_477_CM 1 0. 1. AXIS_PTS_REF ldp_nr_1_id_err_dtc /end AXIS_DESCR
 /begin AXIS_DESCR COM_AXIS errm_online_dummy _CNV_S_6_ERRM_DTC_R_478_CM 6 0. 5. AXIS_PTS_REF ldp_nr_2_id_err_dtc /end AXIS_DESCR
/end CHARACTERISTIC
/begin CHARACTERISTIC fmy_id_ttip_mes_lsh_up_1.dtc "DTC table declaration for the diagnosis instance XX" MAP 0xa0804ce0 _REC_MAP_20_u2_u2_u2 65535. _CNV_A_R_LINEAR_____0_CM 0. 65535. DISPLAY_IDENTIFIER ID_ERR_DTC_TTIP_MES_LSH_UP_1 FORMAT "%5.0"
 /begin AXIS_DESCR COM_AXIS errm_online_dummy _CNV_S_2_ERRM_DTC_R_477_CM 1 0. 1. AXIS_PTS_REF ldp_nr_1_id_err_dtc /end AXIS_DESCR
 /begin AXIS_DESCR COM_AXIS errm_online_dummy _CNV_S_6_ERRM_DTC_R_478_CM 6 0. 5. AXIS_PTS_REF ldp_nr_2_id_err_dtc /end AXIS_DESCR
/end CHARACTERISTIC
/begin CHARACTERISTIC fmy_id_ctl_lsl_up_1.dtc "DTC table declaration for the diagnosis instance XX" MAP 0xa0803250 _REC_MAP_20_u2_u2_u2 65535. _CNV_A_R_LINEAR_____0_CM 0. 65535. DISPLAY_IDENTIFIER ID_ERR_DTC_CTL_LSL_UP_1 FORMAT "%5.0"
 /begin AXIS_DESCR COM_AXIS errm_online_dummy _CNV_S_2_ERRM_DTC_R_477_CM 1 0. 1. AXIS_PTS_REF ldp_nr_1_id_err_dtc /end AXIS_DESCR
 /begin AXIS_DESCR COM_AXIS errm_online_dummy _CNV_S_6_ERRM_DTC_R_478_CM 6 0. 5. AXIS_PTS_REF ldp_nr_2_id_err_dtc /end AXIS_DESCR
/end CHARACTERISTIC
/begin CHARACTERISTIC fmy_id_chg_ls_down.dtc "DTC table declaration for the diagnosis instance XX" MAP 0xa0802da0 _REC_MAP_20_u2_u2_u2 65535. _CNV_A_R_LINEAR_____0_CM 0. 65535. DISPLAY_IDENTIFIER ID_ERR_DTC_CHG_LS_DOWN FORMAT "%5.0"
 /begin AXIS_DESCR COM_AXIS errm_online_dummy _CNV_S_2_ERRM_DTC_R_477_CM 1 0. 1. AXIS_PTS_REF ldp_nr_1_id_err_dtc /end AXIS_DESCR
 /begin AXIS_DESCR COM_AXIS errm_online_dummy _CNV_S_6_ERRM_DTC_R_478_CM 6 0. 5. AXIS_PTS_REF ldp_nr_2_id_err_dtc /end AXIS_DESCR
/end CHARACTERISTIC
/begin CHARACTERISTIC fmy_id_scg_ls_down_2.dtc "DTC table declaration for the diagnosis instance XX" MAP 0xa08045c4 _REC_MAP_20_u2_u2_u2 65535. _CNV_A_R_LINEAR_____0_CM 0. 65535. DISPLAY_IDENTIFIER ID_ERR_DTC_SCG_LS_DOWN_2 FORMAT "%5.0"
 /begin AXIS_DESCR COM_AXIS errm_online_dummy _CNV_S_2_ERRM_DTC_R_477_CM 1 0. 1. AXIS_PTS_REF ldp_nr_1_id_err_dtc /end AXIS_DESCR
 /begin AXIS_DESCR COM_AXIS errm_online_dummy _CNV_S_6_ERRM_DTC_R_478_CM 6 0. 5. AXIS_PTS_REF ldp_nr_2_id_err_dtc /end AXIS_DESCR
/end CHARACTERISTIC
/begin CHARACTERISTIC fmy_id_scp_ls_down_2.dtc "DTC table declaration for the diagnosis instance XX" MAP 0xa08045ec _REC_MAP_20_u2_u2_u2 65535. _CNV_A_R_LINEAR_____0_CM 0. 65535. DISPLAY_IDENTIFIER ID_ERR_DTC_SCP_LS_DOWN_2 FORMAT "%5.0"
 /begin AXIS_DESCR COM_AXIS errm_online_dummy _CNV_S_2_ERRM_DTC_R_477_CM 1 0. 1. AXIS_PTS_REF ldp_nr_1_id_err_dtc /end AXIS_DESCR
 /begin AXIS_DESCR COM_AXIS errm_online_dummy _CNV_S_6_ERRM_DTC_R_478_CM 6 0. 5. AXIS_PTS_REF ldp_nr_2_id_err_dtc /end AXIS_DESCR
/end CHARACTERISTIC
/begin CHARACTERISTIC fmy_id_oc_ls_down_2.dtc "DTC table declaration for the diagnosis instance XX" MAP 0xa08041b4 _REC_MAP_20_u2_u2_u2 65535. _CNV_A_R_LINEAR_____0_CM 0. 65535. DISPLAY_IDENTIFIER ID_ERR_DTC_OC_LS_DOWN_2 FORMAT "%5.0"
 /begin AXIS_DESCR COM_AXIS errm_online_dummy _CNV_S_2_ERRM_DTC_R_477_CM 1 0. 1. AXIS_PTS_REF ldp_nr_1_id_err_dtc /end AXIS_DESCR
 /begin AXIS_DESCR COM_AXIS errm_online_dummy _CNV_S_6_ERRM_DTC_R_478_CM 6 0. 5. AXIS_PTS_REF ldp_nr_2_id_err_dtc /end AXIS_DESCR
/end CHARACTERISTIC
/begin CHARACTERISTIC fmy_id_puc_ls_down_2.dtc "DTC table declaration for the diagnosis instance XX" MAP 0xa080436c _REC_MAP_20_u2_u2_u2 65535. _CNV_A_R_LINEAR_____0_CM 0. 65535. DISPLAY_IDENTIFIER ID_ERR_DTC_PUC_LS_DOWN_2 FORMAT "%5.0"
 /begin AXIS_DESCR COM_AXIS errm_online_dummy _CNV_S_2_ERRM_DTC_R_477_CM 1 0. 1. AXIS_PTS_REF ldp_nr_1_id_err_dtc /end AXIS_DESCR
 /begin AXIS_DESCR COM_AXIS errm_online_dummy _CNV_S_6_ERRM_DTC_R_478_CM 6 0. 5. AXIS_PTS_REF ldp_nr_2_id_err_dtc /end AXIS_DESCR
/end CHARACTERISTIC
/begin CHARACTERISTIC fmy_id_fl_ls_down_2.dtc "DTC table declaration for the diagnosis instance XX" MAP 0xa080373c _REC_MAP_20_u2_u2_u2 65535. _CNV_A_R_LINEAR_____0_CM 0. 65535. DISPLAY_IDENTIFIER ID_ERR_DTC_FL_LS_DOWN_2 FORMAT "%5.0"
 /begin AXIS_DESCR COM_AXIS errm_online_dummy _CNV_S_2_ERRM_DTC_R_477_CM 1 0. 1. AXIS_PTS_REF ldp_nr_1_id_err_dtc /end AXIS_DESCR
 /begin AXIS_DESCR COM_AXIS errm_online_dummy _CNV_S_6_ERRM_DTC_R_478_CM 6 0. 5. AXIS_PTS_REF ldp_nr_2_id_err_dtc /end AXIS_DESCR
/end CHARACTERISTIC
/begin CHARACTERISTIC fmy_id_lsl_up_if_2.dtc "DTC table declaration for the diagnosis instance XX" MAP 0xa0803e44 _REC_MAP_20_u2_u2_u2 65535. _CNV_A_R_LINEAR_____0_CM 0. 65535. DISPLAY_IDENTIFIER ID_ERR_DTC_LSL_UP_IF_2 FORMAT "%5.0"
 /begin AXIS_DESCR COM_AXIS errm_online_dummy _CNV_S_2_ERRM_DTC_R_477_CM 1 0. 1. AXIS_PTS_REF ldp_nr_1_id_err_dtc /end AXIS_DESCR
 /begin AXIS_DESCR COM_AXIS errm_online_dummy _CNV_S_6_ERRM_DTC_R_478_CM 6 0. 5. AXIS_PTS_REF ldp_nr_2_id_err_dtc /end AXIS_DESCR
/end CHARACTERISTIC
/begin CHARACTERISTIC fmy_id_el_lsl_up_2.dtc "DTC table declaration for the diagnosis instance XX" MAP 0xa080369c _REC_MAP_20_u2_u2_u2 65535. _CNV_A_R_LINEAR_____0_CM 0. 65535. DISPLAY_IDENTIFIER ID_ERR_DTC_EL_LSL_UP_2 FORMAT "%5.0"
 /begin AXIS_DESCR COM_AXIS errm_online_dummy _CNV_S_2_ERRM_DTC_R_477_CM 1 0. 1. AXIS_PTS_REF ldp_nr_1_id_err_dtc /end AXIS_DESCR
 /begin AXIS_DESCR COM_AXIS errm_online_dummy _CNV_S_6_ERRM_DTC_R_478_CM 6 0. 5. AXIS_PTS_REF ldp_nr_2_id_err_dtc /end AXIS_DESCR
/end CHARACTERISTIC
/begin CHARACTERISTIC fmy_id_lsh_up_2.dtc "DTC table declaration for the diagnosis instance XX" MAP 0xa0803e1c _REC_MAP_20_u2_u2_u2 65535. _CNV_A_R_LINEAR_____0_CM 0. 65535. DISPLAY_IDENTIFIER ID_ERR_DTC_LSH_UP_2 FORMAT "%5.0"
 /begin AXIS_DESCR COM_AXIS errm_online_dummy _CNV_S_2_ERRM_DTC_R_477_CM 1 0. 1. AXIS_PTS_REF ldp_nr_1_id_err_dtc /end AXIS_DESCR
 /begin AXIS_DESCR COM_AXIS errm_online_dummy _CNV_S_6_ERRM_DTC_R_478_CM 6 0. 5. AXIS_PTS_REF ldp_nr_2_id_err_dtc /end AXIS_DESCR
/end CHARACTERISTIC
/begin CHARACTERISTIC fmy_id_lsh_down_2.dtc "DTC table declaration for the diagnosis instance XX" MAP 0xa0803dcc _REC_MAP_20_u2_u2_u2 65535. _CNV_A_R_LINEAR_____0_CM 0. 65535. DISPLAY_IDENTIFIER ID_ERR_DTC_LSH_DOWN_2 FORMAT "%5.0"
 /begin AXIS_DESCR COM_AXIS errm_online_dummy _CNV_S_2_ERRM_DTC_R_477_CM 1 0. 1. AXIS_PTS_REF ldp_nr_1_id_err_dtc /end AXIS_DESCR
 /begin AXIS_DESCR COM_AXIS errm_online_dummy _CNV_S_6_ERRM_DTC_R_478_CM 6 0. 5. AXIS_PTS_REF ldp_nr_2_id_err_dtc /end AXIS_DESCR
/end CHARACTERISTIC
/begin CHARACTERISTIC fmy_id_vls_down_dif_2.dtc "DTC table declaration for the diagnosis instance XX" MAP 0xa0804d94 _REC_MAP_20_u2_u2_u2 65535. _CNV_A_R_LINEAR_____0_CM 0. 65535. DISPLAY_IDENTIFIER ID_ERR_DTC_VLS_DOWN_DIF_2 FORMAT "%5.0"
 /begin AXIS_DESCR COM_AXIS errm_online_dummy _CNV_S_2_ERRM_DTC_R_477_CM 1 0. 1. AXIS_PTS_REF ldp_nr_1_id_err_dtc /end AXIS_DESCR
 /begin AXIS_DESCR COM_AXIS errm_online_dummy _CNV_S_6_ERRM_DTC_R_478_CM 6 0. 5. AXIS_PTS_REF ldp_nr_2_id_err_dtc /end AXIS_DESCR
/end CHARACTERISTIC
/begin CHARACTERISTIC fmy_id_lsh_lsl_up_2.dtc "DTC table declaration for the diagnosis instance XX" MAP 0xa0803df4 _REC_MAP_20_u2_u2_u2 65535. _CNV_A_R_LINEAR_____0_CM 0. 65535. DISPLAY_IDENTIFIER ID_ERR_DTC_LSH_LSL_UP_2 FORMAT "%5.0"
 /begin AXIS_DESCR COM_AXIS errm_online_dummy _CNV_S_2_ERRM_DTC_R_477_CM 1 0. 1. AXIS_PTS_REF ldp_nr_1_id_err_dtc /end AXIS_DESCR
 /begin AXIS_DESCR COM_AXIS errm_online_dummy _CNV_S_6_ERRM_DTC_R_478_CM 6 0. 5. AXIS_PTS_REF ldp_nr_2_id_err_dtc /end AXIS_DESCR
/end CHARACTERISTIC
/begin CHARACTERISTIC fmy_id_air_lsl_up_2.dtc "DTC table declaration for the diagnosis instance XX" MAP 0xa08029a4 _REC_MAP_20_u2_u2_u2 65535. _CNV_A_R_LINEAR_____0_CM 0. 65535. DISPLAY_IDENTIFIER ID_ERR_DTC_AIR_LSL_UP_2 FORMAT "%5.0"
 /begin AXIS_DESCR COM_AXIS errm_online_dummy _CNV_S_2_ERRM_DTC_R_477_CM 1 0. 1. AXIS_PTS_REF ldp_nr_1_id_err_dtc /end AXIS_DESCR
 /begin AXIS_DESCR COM_AXIS errm_online_dummy _CNV_S_6_ERRM_DTC_R_478_CM 6 0. 5. AXIS_PTS_REF ldp_nr_2_id_err_dtc /end AXIS_DESCR
/end CHARACTERISTIC
/begin CHARACTERISTIC fmy_id_pue_ls_down_2.dtc "DTC table declaration for the diagnosis instance XX" MAP 0xa08043bc _REC_MAP_20_u2_u2_u2 65535. _CNV_A_R_LINEAR_____0_CM 0. 65535. DISPLAY_IDENTIFIER ID_ERR_DTC_PUE_LS_DOWN_2 FORMAT "%5.0"
 /begin AXIS_DESCR COM_AXIS errm_online_dummy _CNV_S_2_ERRM_DTC_R_477_CM 1 0. 1. AXIS_PTS_REF ldp_nr_1_id_err_dtc /end AXIS_DESCR
 /begin AXIS_DESCR COM_AXIS errm_online_dummy _CNV_S_6_ERRM_DTC_R_478_CM 6 0. 5. AXIS_PTS_REF ldp_nr_2_id_err_dtc /end AXIS_DESCR
/end CHARACTERISTIC
/begin CHARACTERISTIC fmy_id_swt_ls_down_2.dtc "DTC table declaration for the diagnosis instance XX" MAP 0xa08047a4 _REC_MAP_20_u2_u2_u2 65535. _CNV_A_R_LINEAR_____0_CM 0. 65535. DISPLAY_IDENTIFIER ID_ERR_DTC_SWT_LS_DOWN_2 FORMAT "%5.0"
 /begin AXIS_DESCR COM_AXIS errm_online_dummy _CNV_S_2_ERRM_DTC_R_477_CM 1 0. 1. AXIS_PTS_REF ldp_nr_1_id_err_dtc /end AXIS_DESCR
 /begin AXIS_DESCR COM_AXIS errm_online_dummy _CNV_S_6_ERRM_DTC_R_478_CM 6 0. 5. AXIS_PTS_REF ldp_nr_2_id_err_dtc /end AXIS_DESCR
/end CHARACTERISTIC
/begin CHARACTERISTIC fmy_id_obd_lsh_down_2.dtc "DTC table declaration for the diagnosis instance XX" MAP 0xa0804164 _REC_MAP_20_u2_u2_u2 65535. _CNV_A_R_LINEAR_____0_CM 0. 65535. DISPLAY_IDENTIFIER ID_ERR_DTC_OBD_LSH_DOWN_2 FORMAT "%5.0"
 /begin AXIS_DESCR COM_AXIS errm_online_dummy _CNV_S_2_ERRM_DTC_R_477_CM 1 0. 1. AXIS_PTS_REF ldp_nr_1_id_err_dtc /end AXIS_DESCR
 /begin AXIS_DESCR COM_AXIS errm_online_dummy _CNV_S_6_ERRM_DTC_R_478_CM 6 0. 5. AXIS_PTS_REF ldp_nr_2_id_err_dtc /end AXIS_DESCR
/end CHARACTERISTIC
/begin CHARACTERISTIC fmy_id_dyn_vld_ls_up_2.dtc "DTC table declaration for the diagnosis instance XX" MAP 0xa0803520 _REC_MAP_20_u2_u2_u2 65535. _CNV_A_R_LINEAR_____0_CM 0. 65535. DISPLAY_IDENTIFIER ID_ERR_DTC_DYN_VLD_LS_UP_2 FORMAT "%5.0"
 /begin AXIS_DESCR COM_AXIS errm_online_dummy _CNV_S_2_ERRM_DTC_R_477_CM 1 0. 1. AXIS_PTS_REF ldp_nr_1_id_err_dtc /end AXIS_DESCR
 /begin AXIS_DESCR COM_AXIS errm_online_dummy _CNV_S_6_ERRM_DTC_R_478_CM 6 0. 5. AXIS_PTS_REF ldp_nr_2_id_err_dtc /end AXIS_DESCR
/end CHARACTERISTIC
/begin CHARACTERISTIC fmy_id_puc_vld_ls_up_2.dtc "DTC table declaration for the diagnosis instance XX" MAP 0xa0804394 _REC_MAP_20_u2_u2_u2 65535. _CNV_A_R_LINEAR_____0_CM 0. 65535. DISPLAY_IDENTIFIER ID_ERR_DTC_PUC_VLD_LS_UP_2 FORMAT "%5.0"
 /begin AXIS_DESCR COM_AXIS errm_online_dummy _CNV_S_2_ERRM_DTC_R_477_CM 1 0. 1. AXIS_PTS_REF ldp_nr_1_id_err_dtc /end AXIS_DESCR
 /begin AXIS_DESCR COM_AXIS errm_online_dummy _CNV_S_6_ERRM_DTC_R_478_CM 6 0. 5. AXIS_PTS_REF ldp_nr_2_id_err_dtc /end AXIS_DESCR
/end CHARACTERISTIC
/begin CHARACTERISTIC fmy_id_obd_vld_lsh_up_2.dtc "DTC table declaration for the diagnosis instance XX" MAP 0xa080418c _REC_MAP_20_u2_u2_u2 65535. _CNV_A_R_LINEAR_____0_CM 0. 65535. DISPLAY_IDENTIFIER ID_ERR_DTC_OBD_VLD_LSH_UP_2 FORMAT "%5.0"
 /begin AXIS_DESCR COM_AXIS errm_online_dummy _CNV_S_2_ERRM_DTC_R_477_CM 1 0. 1. AXIS_PTS_REF ldp_nr_1_id_err_dtc /end AXIS_DESCR
 /begin AXIS_DESCR COM_AXIS errm_online_dummy _CNV_S_6_ERRM_DTC_R_478_CM 6 0. 5. AXIS_PTS_REF ldp_nr_2_id_err_dtc /end AXIS_DESCR
/end CHARACTERISTIC
/begin CHARACTERISTIC fmy_id_chk_ls_down_2.dtc "DTC table declaration for the diagnosis instance XX" MAP 0xa0802df0 _REC_MAP_20_u2_u2_u2 65535. _CNV_A_R_LINEAR_____0_CM 0. 65535. DISPLAY_IDENTIFIER ID_ERR_DTC_CHK_LS_DOWN_2 FORMAT "%5.0"
 /begin AXIS_DESCR COM_AXIS errm_online_dummy _CNV_S_2_ERRM_DTC_R_477_CM 1 0. 1. AXIS_PTS_REF ldp_nr_1_id_err_dtc /end AXIS_DESCR
 /begin AXIS_DESCR COM_AXIS errm_online_dummy _CNV_S_6_ERRM_DTC_R_478_CM 6 0. 5. AXIS_PTS_REF ldp_nr_2_id_err_dtc /end AXIS_DESCR
/end CHARACTERISTIC
/begin CHARACTERISTIC fmy_id_shift_afl_lsl_up_2.dtc "DTC table declaration for the diagnosis instance XX" MAP 0xa0804664 _REC_MAP_20_u2_u2_u2 65535. _CNV_A_R_LINEAR_____0_CM 0. 65535. DISPLAY_IDENTIFIER ID_ERR_DTC_SHIFT_AFL_LSL_UP_2 FORMAT "%5.0"
 /begin AXIS_DESCR COM_AXIS errm_online_dummy _CNV_S_2_ERRM_DTC_R_477_CM 1 0. 1. AXIS_PTS_REF ldp_nr_1_id_err_dtc /end AXIS_DESCR
 /begin AXIS_DESCR COM_AXIS errm_online_dummy _CNV_S_6_ERRM_DTC_R_478_CM 6 0. 5. AXIS_PTS_REF ldp_nr_2_id_err_dtc /end AXIS_DESCR
/end CHARACTERISTIC
/begin CHARACTERISTIC fmy_id_shift_afr_lsl_up_2.dtc "DTC table declaration for the diagnosis instance XX" MAP 0xa080468c _REC_MAP_20_u2_u2_u2 65535. _CNV_A_R_LINEAR_____0_CM 0. 65535. DISPLAY_IDENTIFIER ID_ERR_DTC_SHIFT_AFR_LSL_UP_2 FORMAT "%5.0"
 /begin AXIS_DESCR COM_AXIS errm_online_dummy _CNV_S_2_ERRM_DTC_R_477_CM 1 0. 1. AXIS_PTS_REF ldp_nr_1_id_err_dtc /end AXIS_DESCR
 /begin AXIS_DESCR COM_AXIS errm_online_dummy _CNV_S_6_ERRM_DTC_R_478_CM 6 0. 5. AXIS_PTS_REF ldp_nr_2_id_err_dtc /end AXIS_DESCR
/end CHARACTERISTIC
/begin CHARACTERISTIC fmy_id_oc_lsl_up_2.dtc "DTC table declaration for the diagnosis instance XX" MAP 0xa08041dc _REC_MAP_20_u2_u2_u2 65535. _CNV_A_R_LINEAR_____0_CM 0. 65535. DISPLAY_IDENTIFIER ID_ERR_DTC_OC_LSL_UP_2 FORMAT "%5.0"
 /begin AXIS_DESCR COM_AXIS errm_online_dummy _CNV_S_2_ERRM_DTC_R_477_CM 1 0. 1. AXIS_PTS_REF ldp_nr_1_id_err_dtc /end AXIS_DESCR
 /begin AXIS_DESCR COM_AXIS errm_online_dummy _CNV_S_6_ERRM_DTC_R_478_CM 6 0. 5. AXIS_PTS_REF ldp_nr_2_id_err_dtc /end AXIS_DESCR
/end CHARACTERISTIC
/begin CHARACTERISTIC fmy_id_delta_i_lam_2.dtc "DTC table declaration for the diagnosis instance XX" MAP 0xa0803458 _REC_MAP_20_u2_u2_u2 65535. _CNV_A_R_LINEAR_____0_CM 0. 65535. DISPLAY_IDENTIFIER ID_ERR_DTC_DELTA_I_LAM_2 FORMAT "%5.0"
 /begin AXIS_DESCR COM_AXIS errm_online_dummy _CNV_S_2_ERRM_DTC_R_477_CM 1 0. 1. AXIS_PTS_REF ldp_nr_1_id_err_dtc /end AXIS_DESCR
 /begin AXIS_DESCR COM_AXIS errm_online_dummy _CNV_S_6_ERRM_DTC_R_478_CM 6 0. 5. AXIS_PTS_REF ldp_nr_2_id_err_dtc /end AXIS_DESCR
/end CHARACTERISTIC
/begin CHARACTERISTIC fmy_id_ofs_lsl_up_2.dtc "DTC table declaration for the diagnosis instance XX" MAP 0xa0804204 _REC_MAP_20_u2_u2_u2 65535. _CNV_A_R_LINEAR_____0_CM 0. 65535. DISPLAY_IDENTIFIER ID_ERR_DTC_OFS_LSL_UP_2 FORMAT "%5.0"
 /begin AXIS_DESCR COM_AXIS errm_online_dummy _CNV_S_2_ERRM_DTC_R_477_CM 1 0. 1. AXIS_PTS_REF ldp_nr_1_id_err_dtc /end AXIS_DESCR
 /begin AXIS_DESCR COM_AXIS errm_online_dummy _CNV_S_6_ERRM_DTC_R_478_CM 6 0. 5. AXIS_PTS_REF ldp_nr_2_id_err_dtc /end AXIS_DESCR
/end CHARACTERISTIC
/begin CHARACTERISTIC fmy_id_ttip_mes_lsh_up_2.dtc "DTC table declaration for the diagnosis instance XX" MAP 0xa0804cf4 _REC_MAP_20_u2_u2_u2 65535. _CNV_A_R_LINEAR_____0_CM 0. 65535. DISPLAY_IDENTIFIER ID_ERR_DTC_TTIP_MES_LSH_UP_2 FORMAT "%5.0"
 /begin AXIS_DESCR COM_AXIS errm_online_dummy _CNV_S_2_ERRM_DTC_R_477_CM 1 0. 1. AXIS_PTS_REF ldp_nr_1_id_err_dtc /end AXIS_DESCR
 /begin AXIS_DESCR COM_AXIS errm_online_dummy _CNV_S_6_ERRM_DTC_R_478_CM 6 0. 5. AXIS_PTS_REF ldp_nr_2_id_err_dtc /end AXIS_DESCR
/end CHARACTERISTIC
/begin CHARACTERISTIC fmy_id_ctl_lsl_up_2.dtc "DTC table declaration for the diagnosis instance XX" MAP 0xa0803264 _REC_MAP_20_u2_u2_u2 65535. _CNV_A_R_LINEAR_____0_CM 0. 65535. DISPLAY_IDENTIFIER ID_ERR_DTC_CTL_LSL_UP_2 FORMAT "%5.0"
 /begin AXIS_DESCR COM_AXIS errm_online_dummy _CNV_S_2_ERRM_DTC_R_477_CM 1 0. 1. AXIS_PTS_REF ldp_nr_1_id_err_dtc /end AXIS_DESCR
 /begin AXIS_DESCR COM_AXIS errm_online_dummy _CNV_S_6_ERRM_DTC_R_478_CM 6 0. 5. AXIS_PTS_REF ldp_nr_2_id_err_dtc /end AXIS_DESCR
/end CHARACTERISTIC
/begin CHARACTERISTIC fmy_id_chg_ls_up.dtc "DTC table declaration for the diagnosis instance XX" MAP 0xa0802db4 _REC_MAP_20_u2_u2_u2 65535. _CNV_A_R_LINEAR_____0_CM 0. 65535. DISPLAY_IDENTIFIER ID_ERR_DTC_CHG_LS_UP FORMAT "%5.0"
 /begin AXIS_DESCR COM_AXIS errm_online_dummy _CNV_S_2_ERRM_DTC_R_477_CM 1 0. 1. AXIS_PTS_REF ldp_nr_1_id_err_dtc /end AXIS_DESCR
 /begin AXIS_DESCR COM_AXIS errm_online_dummy _CNV_S_6_ERRM_DTC_R_478_CM 6 0. 5. AXIS_PTS_REF ldp_nr_2_id_err_dtc /end AXIS_DESCR
/end CHARACTERISTIC
/begin CHARACTERISTIC fmy_id_alter_com.dtc "DTC table declaration for the diagnosis instance XX" MAP 0xa08029f4 _REC_MAP_20_u2_u2_u2 65535. _CNV_A_R_LINEAR_____0_CM 0. 65535. DISPLAY_IDENTIFIER ID_ERR_DTC_ALTER_COM FORMAT "%5.0"
 /begin AXIS_DESCR COM_AXIS errm_online_dummy _CNV_S_2_ERRM_DTC_R_477_CM 1 0. 1. AXIS_PTS_REF ldp_nr_1_id_err_dtc /end AXIS_DESCR
 /begin AXIS_DESCR COM_AXIS errm_online_dummy _CNV_S_6_ERRM_DTC_R_478_CM 6 0. 5. AXIS_PTS_REF ldp_nr_2_id_err_dtc /end AXIS_DESCR
/end CHARACTERISTIC
/begin CHARACTERISTIC fmy_id_cwp_com.dtc "DTC table declaration for the diagnosis instance XX" MAP 0xa080328c _REC_MAP_20_u2_u2_u2 65535. _CNV_A_R_LINEAR_____0_CM 0. 65535. DISPLAY_IDENTIFIER ID_ERR_DTC_CWP_COM FORMAT "%5.0"
 /begin AXIS_DESCR COM_AXIS errm_online_dummy _CNV_S_2_ERRM_DTC_R_477_CM 1 0. 1. AXIS_PTS_REF ldp_nr_1_id_err_dtc /end AXIS_DESCR
 /begin AXIS_DESCR COM_AXIS errm_online_dummy _CNV_S_6_ERRM_DTC_R_478_CM 6 0. 5. AXIS_PTS_REF ldp_nr_2_id_err_dtc /end AXIS_DESCR
/end CHARACTERISTIC
/begin CHARACTERISTIC fmy_id_qoil_com.dtc "DTC table declaration for the diagnosis instance XX" MAP 0xa0804484 _REC_MAP_20_u2_u2_u2 65535. _CNV_A_R_LINEAR_____0_CM 0. 65535. DISPLAY_IDENTIFIER ID_ERR_DTC_QOIL_COM FORMAT "%5.0"
 /begin AXIS_DESCR COM_AXIS errm_online_dummy _CNV_S_2_ERRM_DTC_R_477_CM 1 0. 1. AXIS_PTS_REF ldp_nr_1_id_err_dtc /end AXIS_DESCR
 /begin AXIS_DESCR COM_AXIS errm_online_dummy _CNV_S_6_ERRM_DTC_R_478_CM 6 0. 5. AXIS_PTS_REF ldp_nr_2_id_err_dtc /end AXIS_DESCR
/end CHARACTERISTIC
/begin CHARACTERISTIC fmy_id_sens_bat_smt_com.dtc "DTC table declaration for the diagnosis instance XX" MAP 0xa0804628 _REC_MAP_20_u2_u2_u2 65535. _CNV_A_R_LINEAR_____0_CM 0. 65535. DISPLAY_IDENTIFIER ID_ERR_DTC_SENS_BAT_SMT_COM FORMAT "%5.0"
 /begin AXIS_DESCR COM_AXIS errm_online_dummy _CNV_S_2_ERRM_DTC_R_477_CM 1 0. 1. AXIS_PTS_REF ldp_nr_1_id_err_dtc /end AXIS_DESCR
 /begin AXIS_DESCR COM_AXIS errm_online_dummy _CNV_S_6_ERRM_DTC_R_478_CM 6 0. 5. AXIS_PTS_REF ldp_nr_2_id_err_dtc /end AXIS_DESCR
/end CHARACTERISTIC
/begin CHARACTERISTIC fmy_id_ecraspwm_fb.dtc "DTC table declaration for the diagnosis instance XX" MAP 0xa08035d4 _REC_MAP_20_u2_u2_u2 65535. _CNV_A_R_LINEAR_____0_CM 0. 65535. DISPLAY_IDENTIFIER ID_ERR_DTC_ECRASPWM_FB FORMAT "%5.0"
 /begin AXIS_DESCR COM_AXIS errm_online_dummy _CNV_S_2_ERRM_DTC_R_477_CM 1 0. 1. AXIS_PTS_REF ldp_nr_1_id_err_dtc /end AXIS_DESCR
 /begin AXIS_DESCR COM_AXIS errm_online_dummy _CNV_S_6_ERRM_DTC_R_478_CM 6 0. 5. AXIS_PTS_REF ldp_nr_2_id_err_dtc /end AXIS_DESCR
/end CHARACTERISTIC
/begin CHARACTERISTIC fmy_id_ecras_el.dtc "DTC table declaration for the diagnosis instance XX" MAP 0xa08035ac _REC_MAP_20_u2_u2_u2 65535. _CNV_A_R_LINEAR_____0_CM 0. 65535. DISPLAY_IDENTIFIER ID_ERR_DTC_ECRAS_EL FORMAT "%5.0"
 /begin AXIS_DESCR COM_AXIS errm_online_dummy _CNV_S_2_ERRM_DTC_R_477_CM 1 0. 1. AXIS_PTS_REF ldp_nr_1_id_err_dtc /end AXIS_DESCR
 /begin AXIS_DESCR COM_AXIS errm_online_dummy _CNV_S_6_ERRM_DTC_R_478_CM 6 0. 5. AXIS_PTS_REF ldp_nr_2_id_err_dtc /end AXIS_DESCR
/end CHARACTERISTIC
/begin CHARACTERISTIC fmy_id_ecras_up_fb.dtc "DTC table declaration for the diagnosis instance XX" MAP 0xa08035c0 _REC_MAP_20_u2_u2_u2 65535. _CNV_A_R_LINEAR_____0_CM 0. 65535. DISPLAY_IDENTIFIER ID_ERR_DTC_ECRAS_UP_FB FORMAT "%5.0"
 /begin AXIS_DESCR COM_AXIS errm_online_dummy _CNV_S_2_ERRM_DTC_R_477_CM 1 0. 1. AXIS_PTS_REF ldp_nr_1_id_err_dtc /end AXIS_DESCR
 /begin AXIS_DESCR COM_AXIS errm_online_dummy _CNV_S_6_ERRM_DTC_R_478_CM 6 0. 5. AXIS_PTS_REF ldp_nr_2_id_err_dtc /end AXIS_DESCR
/end CHARACTERISTIC
/begin CHARACTERISTIC fmy_id_ecras_down_fb.dtc "DTC table declaration for the diagnosis instance XX" MAP 0xa0803598 _REC_MAP_20_u2_u2_u2 65535. _CNV_A_R_LINEAR_____0_CM 0. 65535. DISPLAY_IDENTIFIER ID_ERR_DTC_ECRAS_DOWN_FB FORMAT "%5.0"
 /begin AXIS_DESCR COM_AXIS errm_online_dummy _CNV_S_2_ERRM_DTC_R_477_CM 1 0. 1. AXIS_PTS_REF ldp_nr_1_id_err_dtc /end AXIS_DESCR
 /begin AXIS_DESCR COM_AXIS errm_online_dummy _CNV_S_6_ERRM_DTC_R_478_CM 6 0. 5. AXIS_PTS_REF ldp_nr_2_id_err_dtc /end AXIS_DESCR
/end CHARACTERISTIC
/begin CHARACTERISTIC fmy_id_warm_rst.dtc "DTC table declaration for the diagnosis instance XX" MAP 0xa0804de4 _REC_MAP_20_u2_u2_u2 65535. _CNV_A_R_LINEAR_____0_CM 0. 65535. DISPLAY_IDENTIFIER ID_ERR_DTC_WARM_RST FORMAT "%5.0"
 /begin AXIS_DESCR COM_AXIS errm_online_dummy _CNV_S_2_ERRM_DTC_R_477_CM 1 0. 1. AXIS_PTS_REF ldp_nr_1_id_err_dtc /end AXIS_DESCR
 /begin AXIS_DESCR COM_AXIS errm_online_dummy _CNV_S_6_ERRM_DTC_R_478_CM 6 0. 5. AXIS_PTS_REF ldp_nr_2_id_err_dtc /end AXIS_DESCR
/end CHARACTERISTIC
/begin CHARACTERISTIC fmy_id_acr_ad.dtc "DTC table declaration for the diagnosis instance XX" MAP 0xa0802954 _REC_MAP_20_u2_u2_u2 65535. _CNV_A_R_LINEAR_____0_CM 0. 65535. DISPLAY_IDENTIFIER ID_ERR_DTC_ACR_AD FORMAT "%5.0"
 /begin AXIS_DESCR COM_AXIS errm_online_dummy _CNV_S_2_ERRM_DTC_R_477_CM 1 0. 1. AXIS_PTS_REF ldp_nr_1_id_err_dtc /end AXIS_DESCR
 /begin AXIS_DESCR COM_AXIS errm_online_dummy _CNV_S_6_ERRM_DTC_R_478_CM 6 0. 5. AXIS_PTS_REF ldp_nr_2_id_err_dtc /end AXIS_DESCR
/end CHARACTERISTIC
/begin CHARACTERISTIC fmy_id_sens_acr.dtc "DTC table declaration for the diagnosis instance XX" MAP 0xa0804614 _REC_MAP_20_u2_u2_u2 65535. _CNV_A_R_LINEAR_____0_CM 0. 65535. DISPLAY_IDENTIFIER ID_ERR_DTC_SENS_ACR FORMAT "%5.0"
 /begin AXIS_DESCR COM_AXIS errm_online_dummy _CNV_S_2_ERRM_DTC_R_477_CM 1 0. 1. AXIS_PTS_REF ldp_nr_1_id_err_dtc /end AXIS_DESCR
 /begin AXIS_DESCR COM_AXIS errm_online_dummy _CNV_S_6_ERRM_DTC_R_478_CM 6 0. 5. AXIS_PTS_REF ldp_nr_2_id_err_dtc /end AXIS_DESCR
/end CHARACTERISTIC
/begin CHARACTERISTIC fmy_id_acr_ctl.dtc "DTC table declaration for the diagnosis instance XX" MAP 0xa0802968 _REC_MAP_20_u2_u2_u2 65535. _CNV_A_R_LINEAR_____0_CM 0. 65535. DISPLAY_IDENTIFIER ID_ERR_DTC_ACR_CTL FORMAT "%5.0"
 /begin AXIS_DESCR COM_AXIS errm_online_dummy _CNV_S_2_ERRM_DTC_R_477_CM 1 0. 1. AXIS_PTS_REF ldp_nr_1_id_err_dtc /end AXIS_DESCR
 /begin AXIS_DESCR COM_AXIS errm_online_dummy _CNV_S_6_ERRM_DTC_R_478_CM 6 0. 5. AXIS_PTS_REF ldp_nr_2_id_err_dtc /end AXIS_DESCR
/end CHARACTERISTIC
/begin CHARACTERISTIC fmy_id_acr_dr.dtc "DTC table declaration for the diagnosis instance XX" MAP 0xa080297c _REC_MAP_20_u2_u2_u2 65535. _CNV_A_R_LINEAR_____0_CM 0. 65535. DISPLAY_IDENTIFIER ID_ERR_DTC_ACR_DR FORMAT "%5.0"
 /begin AXIS_DESCR COM_AXIS errm_online_dummy _CNV_S_2_ERRM_DTC_R_477_CM 1 0. 1. AXIS_PTS_REF ldp_nr_1_id_err_dtc /end AXIS_DESCR
 /begin AXIS_DESCR COM_AXIS errm_online_dummy _CNV_S_6_ERRM_DTC_R_478_CM 6 0. 5. AXIS_PTS_REF ldp_nr_2_id_err_dtc /end AXIS_DESCR
/end CHARACTERISTIC
/begin CHARACTERISTIC fmy_id_var_cod.dtc "DTC table declaration for the diagnosis instance XX" MAP 0xa0804d30 _REC_MAP_20_u2_u2_u2 65535. _CNV_A_R_LINEAR_____0_CM 0. 65535. DISPLAY_IDENTIFIER ID_ERR_DTC_VAR_COD FORMAT "%5.0"
 /begin AXIS_DESCR COM_AXIS errm_online_dummy _CNV_S_2_ERRM_DTC_R_477_CM 1 0. 1. AXIS_PTS_REF ldp_nr_1_id_err_dtc /end AXIS_DESCR
 /begin AXIS_DESCR COM_AXIS errm_online_dummy _CNV_S_6_ERRM_DTC_R_478_CM 6 0. 5. AXIS_PTS_REF ldp_nr_2_id_err_dtc /end AXIS_DESCR
/end CHARACTERISTIC
/begin CHARACTERISTIC fmy_id_veh_pow_var.dtc "DTC table declaration for the diagnosis instance XX" MAP 0xa0804d6c _REC_MAP_20_u2_u2_u2 65535. _CNV_A_R_LINEAR_____0_CM 0. 65535. DISPLAY_IDENTIFIER ID_ERR_DTC_VEH_POW_VAR FORMAT "%5.0"
 /begin AXIS_DESCR COM_AXIS errm_online_dummy _CNV_S_2_ERRM_DTC_R_477_CM 1 0. 1. AXIS_PTS_REF ldp_nr_1_id_err_dtc /end AXIS_DESCR
 /begin AXIS_DESCR COM_AXIS errm_online_dummy _CNV_S_6_ERRM_DTC_R_478_CM 6 0. 5. AXIS_PTS_REF ldp_nr_2_id_err_dtc /end AXIS_DESCR
/end CHARACTERISTIC
/begin CHARACTERISTIC fmy_id_fup_mfp_plaus.dtc "DTC table declaration for the diagnosis instance XX" MAP 0xa0803854 _REC_MAP_20_u2_u2_u2 65535. _CNV_A_R_LINEAR_____0_CM 0. 65535. DISPLAY_IDENTIFIER ID_ERR_DTC_FUP_MFP_PLAUS FORMAT "%5.0"
 /begin AXIS_DESCR COM_AXIS errm_online_dummy _CNV_S_2_ERRM_DTC_R_477_CM 1 0. 1. AXIS_PTS_REF ldp_nr_1_id_err_dtc /end AXIS_DESCR
 /begin AXIS_DESCR COM_AXIS errm_online_dummy _CNV_S_6_ERRM_DTC_R_478_CM 6 0. 5. AXIS_PTS_REF ldp_nr_2_id_err_dtc /end AXIS_DESCR
/end CHARACTERISTIC
/begin CHARACTERISTIC fmy_id_h_prs_sys.dtc "DTC table declaration for the diagnosis instance XX" MAP 0xa0803944 _REC_MAP_20_u2_u2_u2 65535. _CNV_A_R_LINEAR_____0_CM 0. 65535. DISPLAY_IDENTIFIER ID_ERR_DTC_H_PRS_SYS FORMAT "%5.0"
 /begin AXIS_DESCR COM_AXIS errm_online_dummy _CNV_S_2_ERRM_DTC_R_477_CM 1 0. 1. AXIS_PTS_REF ldp_nr_1_id_err_dtc /end AXIS_DESCR
 /begin AXIS_DESCR COM_AXIS errm_online_dummy _CNV_S_6_ERRM_DTC_R_478_CM 6 0. 5. AXIS_PTS_REF ldp_nr_2_id_err_dtc /end AXIS_DESCR
/end CHARACTERISTIC
/begin CHARACTERISTIC fmy_id_fup_0.dtc "DTC table declaration for the diagnosis instance XX" MAP 0xa0803818 _REC_MAP_20_u2_u2_u2 65535. _CNV_A_R_LINEAR_____0_CM 0. 65535. DISPLAY_IDENTIFIER ID_ERR_DTC_FUP_0 FORMAT "%5.0"
 /begin AXIS_DESCR COM_AXIS errm_online_dummy _CNV_S_2_ERRM_DTC_R_477_CM 1 0. 1. AXIS_PTS_REF ldp_nr_1_id_err_dtc /end AXIS_DESCR
 /begin AXIS_DESCR COM_AXIS errm_online_dummy _CNV_S_6_ERRM_DTC_R_478_CM 6 0. 5. AXIS_PTS_REF ldp_nr_2_id_err_dtc /end AXIS_DESCR
/end CHARACTERISTIC
/begin CHARACTERISTIC fmy_id_fup_1.dtc "DTC table declaration for the diagnosis instance XX" MAP 0xa080382c _REC_MAP_20_u2_u2_u2 65535. _CNV_A_R_LINEAR_____0_CM 0. 65535. DISPLAY_IDENTIFIER ID_ERR_DTC_FUP_1 FORMAT "%5.0"
 /begin AXIS_DESCR COM_AXIS errm_online_dummy _CNV_S_2_ERRM_DTC_R_477_CM 1 0. 1. AXIS_PTS_REF ldp_nr_1_id_err_dtc /end AXIS_DESCR
 /begin AXIS_DESCR COM_AXIS errm_online_dummy _CNV_S_6_ERRM_DTC_R_478_CM 6 0. 5. AXIS_PTS_REF ldp_nr_2_id_err_dtc /end AXIS_DESCR
/end CHARACTERISTIC
/begin CHARACTERISTIC fmy_id_vcv_fpc_0.dtc "DTC table declaration for the diagnosis instance XX" MAP 0xa0804d44 _REC_MAP_20_u2_u2_u2 65535. _CNV_A_R_LINEAR_____0_CM 0. 65535. DISPLAY_IDENTIFIER ID_ERR_DTC_VCV_FPC_0 FORMAT "%5.0"
 /begin AXIS_DESCR COM_AXIS errm_online_dummy _CNV_S_2_ERRM_DTC_R_477_CM 1 0. 1. AXIS_PTS_REF ldp_nr_1_id_err_dtc /end AXIS_DESCR
 /begin AXIS_DESCR COM_AXIS errm_online_dummy _CNV_S_6_ERRM_DTC_R_478_CM 6 0. 5. AXIS_PTS_REF ldp_nr_2_id_err_dtc /end AXIS_DESCR
/end CHARACTERISTIC
/begin CHARACTERISTIC fmy_id_fup_efp.dtc "DTC table declaration for the diagnosis instance XX" MAP 0xa0803840 _REC_MAP_20_u2_u2_u2 65535. _CNV_A_R_LINEAR_____0_CM 0. 65535. DISPLAY_IDENTIFIER ID_ERR_DTC_FUP_EFP FORMAT "%5.0"
 /begin AXIS_DESCR COM_AXIS errm_online_dummy _CNV_S_2_ERRM_DTC_R_477_CM 1 0. 1. AXIS_PTS_REF ldp_nr_1_id_err_dtc /end AXIS_DESCR
 /begin AXIS_DESCR COM_AXIS errm_online_dummy _CNV_S_6_ERRM_DTC_R_478_CM 6 0. 5. AXIS_PTS_REF ldp_nr_2_id_err_dtc /end AXIS_DESCR
/end CHARACTERISTIC
/begin CHARACTERISTIC fmy_id_efppwm_plaus.dtc "DTC table declaration for the diagnosis instance XX" MAP 0xa080364c _REC_MAP_20_u2_u2_u2 65535. _CNV_A_R_LINEAR_____0_CM 0. 65535. DISPLAY_IDENTIFIER ID_ERR_DTC_EFPPWM_PLAUS FORMAT "%5.0"
 /begin AXIS_DESCR COM_AXIS errm_online_dummy _CNV_S_2_ERRM_DTC_R_477_CM 1 0. 1. AXIS_PTS_REF ldp_nr_1_id_err_dtc /end AXIS_DESCR
 /begin AXIS_DESCR COM_AXIS errm_online_dummy _CNV_S_6_ERRM_DTC_R_478_CM 6 0. 5. AXIS_PTS_REF ldp_nr_2_id_err_dtc /end AXIS_DESCR
/end CHARACTERISTIC
/begin CHARACTERISTIC fmy_id_l_prs_sys.dtc "DTC table declaration for the diagnosis instance XX" MAP 0xa0803d68 _REC_MAP_20_u2_u2_u2 65535. _CNV_A_R_LINEAR_____0_CM 0. 65535. DISPLAY_IDENTIFIER ID_ERR_DTC_L_PRS_SYS FORMAT "%5.0"
 /begin AXIS_DESCR COM_AXIS errm_online_dummy _CNV_S_2_ERRM_DTC_R_477_CM 1 0. 1. AXIS_PTS_REF ldp_nr_1_id_err_dtc /end AXIS_DESCR
 /begin AXIS_DESCR COM_AXIS errm_online_dummy _CNV_S_6_ERRM_DTC_R_478_CM 6 0. 5. AXIS_PTS_REF ldp_nr_2_id_err_dtc /end AXIS_DESCR
/end CHARACTERISTIC
/begin CHARACTERISTIC fmy_id_vcv_fpc_1.dtc "DTC table declaration for the diagnosis instance XX" MAP 0xa0804d58 _REC_MAP_20_u2_u2_u2 65535. _CNV_A_R_LINEAR_____0_CM 0. 65535. DISPLAY_IDENTIFIER ID_ERR_DTC_VCV_FPC_1 FORMAT "%5.0"
 /begin AXIS_DESCR COM_AXIS errm_online_dummy _CNV_S_2_ERRM_DTC_R_477_CM 1 0. 1. AXIS_PTS_REF ldp_nr_1_id_err_dtc /end AXIS_DESCR
 /begin AXIS_DESCR COM_AXIS errm_online_dummy _CNV_S_6_ERRM_DTC_R_478_CM 6 0. 5. AXIS_PTS_REF ldp_nr_2_id_err_dtc /end AXIS_DESCR
/end CHARACTERISTIC
/begin CHARACTERISTIC fmy_id_fsd_1.dtc "DTC table declaration for the diagnosis instance XX" MAP 0xa0803750 _REC_MAP_20_u2_u2_u2 65535. _CNV_A_R_LINEAR_____0_CM 0. 65535. DISPLAY_IDENTIFIER ID_ERR_DTC_FSD_1 FORMAT "%5.0"
 /begin AXIS_DESCR COM_AXIS errm_online_dummy _CNV_S_2_ERRM_DTC_R_477_CM 1 0. 1. AXIS_PTS_REF ldp_nr_1_id_err_dtc /end AXIS_DESCR
 /begin AXIS_DESCR COM_AXIS errm_online_dummy _CNV_S_6_ERRM_DTC_R_478_CM 6 0. 5. AXIS_PTS_REF ldp_nr_2_id_err_dtc /end AXIS_DESCR
/end CHARACTERISTIC
/begin CHARACTERISTIC fmy_id_fsd_2.dtc "DTC table declaration for the diagnosis instance XX" MAP 0xa0803764 _REC_MAP_20_u2_u2_u2 65535. _CNV_A_R_LINEAR_____0_CM 0. 65535. DISPLAY_IDENTIFIER ID_ERR_DTC_FSD_2 FORMAT "%5.0"
 /begin AXIS_DESCR COM_AXIS errm_online_dummy _CNV_S_2_ERRM_DTC_R_477_CM 1 0. 1. AXIS_PTS_REF ldp_nr_1_id_err_dtc /end AXIS_DESCR
 /begin AXIS_DESCR COM_AXIS errm_online_dummy _CNV_S_6_ERRM_DTC_R_478_CM 6 0. 5. AXIS_PTS_REF ldp_nr_2_id_err_dtc /end AXIS_DESCR
/end CHARACTERISTIC
/begin CHARACTERISTIC fmy_id_fsd_lam_lim_1.dtc "DTC table declaration for the diagnosis instance XX" MAP 0xa08037a0 _REC_MAP_20_u2_u2_u2 65535. _CNV_A_R_LINEAR_____0_CM 0. 65535. DISPLAY_IDENTIFIER ID_ERR_DTC_FSD_LAM_LIM_1 FORMAT "%5.0"
 /begin AXIS_DESCR COM_AXIS errm_online_dummy _CNV_S_2_ERRM_DTC_R_477_CM 1 0. 1. AXIS_PTS_REF ldp_nr_1_id_err_dtc /end AXIS_DESCR
 /begin AXIS_DESCR COM_AXIS errm_online_dummy _CNV_S_6_ERRM_DTC_R_478_CM 6 0. 5. AXIS_PTS_REF ldp_nr_2_id_err_dtc /end AXIS_DESCR
/end CHARACTERISTIC
/begin CHARACTERISTIC fmy_id_fsd_lam_lim_2.dtc "DTC table declaration for the diagnosis instance XX" MAP 0xa08037b4 _REC_MAP_20_u2_u2_u2 65535. _CNV_A_R_LINEAR_____0_CM 0. 65535. DISPLAY_IDENTIFIER ID_ERR_DTC_FSD_LAM_LIM_2 FORMAT "%5.0"
 /begin AXIS_DESCR COM_AXIS errm_online_dummy _CNV_S_2_ERRM_DTC_R_477_CM 1 0. 1. AXIS_PTS_REF ldp_nr_1_id_err_dtc /end AXIS_DESCR
 /begin AXIS_DESCR COM_AXIS errm_online_dummy _CNV_S_6_ERRM_DTC_R_478_CM 6 0. 5. AXIS_PTS_REF ldp_nr_2_id_err_dtc /end AXIS_DESCR
/end CHARACTERISTIC
/begin CHARACTERISTIC fmy_id_fsd_h_rng_1.dtc "DTC table declaration for the diagnosis instance XX" MAP 0xa0803778 _REC_MAP_20_u2_u2_u2 65535. _CNV_A_R_LINEAR_____0_CM 0. 65535. DISPLAY_IDENTIFIER ID_ERR_DTC_FSD_H_RNG_1 FORMAT "%5.0"
 /begin AXIS_DESCR COM_AXIS errm_online_dummy _CNV_S_2_ERRM_DTC_R_477_CM 1 0. 1. AXIS_PTS_REF ldp_nr_1_id_err_dtc /end AXIS_DESCR
 /begin AXIS_DESCR COM_AXIS errm_online_dummy _CNV_S_6_ERRM_DTC_R_478_CM 6 0. 5. AXIS_PTS_REF ldp_nr_2_id_err_dtc /end AXIS_DESCR
/end CHARACTERISTIC
/begin CHARACTERISTIC fmy_id_fsd_h_rng_2.dtc "DTC table declaration for the diagnosis instance XX" MAP 0xa080378c _REC_MAP_20_u2_u2_u2 65535. _CNV_A_R_LINEAR_____0_CM 0. 65535. DISPLAY_IDENTIFIER ID_ERR_DTC_FSD_H_RNG_2 FORMAT "%5.0"
 /begin AXIS_DESCR COM_AXIS errm_online_dummy _CNV_S_2_ERRM_DTC_R_477_CM 1 0. 1. AXIS_PTS_REF ldp_nr_1_id_err_dtc /end AXIS_DESCR
 /begin AXIS_DESCR COM_AXIS errm_online_dummy _CNV_S_6_ERRM_DTC_R_478_CM 6 0. 5. AXIS_PTS_REF ldp_nr_2_id_err_dtc /end AXIS_DESCR
/end CHARACTERISTIC
/begin CHARACTERISTIC fmy_id_cyl_bal_lam_0.dtc "DTC table declaration for the diagnosis instance XX" MAP 0xa0803390 _REC_MAP_20_u2_u2_u2 65535. _CNV_A_R_LINEAR_____0_CM 0. 65535. DISPLAY_IDENTIFIER ID_ERR_DTC_CYL_BAL_LAM_0 FORMAT "%5.0"
 /begin AXIS_DESCR COM_AXIS errm_online_dummy _CNV_S_2_ERRM_DTC_R_477_CM 1 0. 1. AXIS_PTS_REF ldp_nr_1_id_err_dtc /end AXIS_DESCR
 /begin AXIS_DESCR COM_AXIS errm_online_dummy _CNV_S_6_ERRM_DTC_R_478_CM 6 0. 5. AXIS_PTS_REF ldp_nr_2_id_err_dtc /end AXIS_DESCR
/end CHARACTERISTIC
/begin CHARACTERISTIC fmy_id_cyl_bal_lam_1.dtc "DTC table declaration for the diagnosis instance XX" MAP 0xa08033a4 _REC_MAP_20_u2_u2_u2 65535. _CNV_A_R_LINEAR_____0_CM 0. 65535. DISPLAY_IDENTIFIER ID_ERR_DTC_CYL_BAL_LAM_1 FORMAT "%5.0"
 /begin AXIS_DESCR COM_AXIS errm_online_dummy _CNV_S_2_ERRM_DTC_R_477_CM 1 0. 1. AXIS_PTS_REF ldp_nr_1_id_err_dtc /end AXIS_DESCR
 /begin AXIS_DESCR COM_AXIS errm_online_dummy _CNV_S_6_ERRM_DTC_R_478_CM 6 0. 5. AXIS_PTS_REF ldp_nr_2_id_err_dtc /end AXIS_DESCR
/end CHARACTERISTIC
/begin CHARACTERISTIC fmy_id_cyl_bal_lam_2.dtc "DTC table declaration for the diagnosis instance XX" MAP 0xa08033b8 _REC_MAP_20_u2_u2_u2 65535. _CNV_A_R_LINEAR_____0_CM 0. 65535. DISPLAY_IDENTIFIER ID_ERR_DTC_CYL_BAL_LAM_2 FORMAT "%5.0"
 /begin AXIS_DESCR COM_AXIS errm_online_dummy _CNV_S_2_ERRM_DTC_R_477_CM 1 0. 1. AXIS_PTS_REF ldp_nr_1_id_err_dtc /end AXIS_DESCR
 /begin AXIS_DESCR COM_AXIS errm_online_dummy _CNV_S_6_ERRM_DTC_R_478_CM 6 0. 5. AXIS_PTS_REF ldp_nr_2_id_err_dtc /end AXIS_DESCR
/end CHARACTERISTIC
/begin CHARACTERISTIC fmy_id_cyl_bal_lam_3.dtc "DTC table declaration for the diagnosis instance XX" MAP 0xa08033cc _REC_MAP_20_u2_u2_u2 65535. _CNV_A_R_LINEAR_____0_CM 0. 65535. DISPLAY_IDENTIFIER ID_ERR_DTC_CYL_BAL_LAM_3 FORMAT "%5.0"
 /begin AXIS_DESCR COM_AXIS errm_online_dummy _CNV_S_2_ERRM_DTC_R_477_CM 1 0. 1. AXIS_PTS_REF ldp_nr_1_id_err_dtc /end AXIS_DESCR
 /begin AXIS_DESCR COM_AXIS errm_online_dummy _CNV_S_6_ERRM_DTC_R_478_CM 6 0. 5. AXIS_PTS_REF ldp_nr_2_id_err_dtc /end AXIS_DESCR
/end CHARACTERISTIC
/begin CHARACTERISTIC fmy_id_cyl_bal_lam_4.dtc "DTC table declaration for the diagnosis instance XX" MAP 0xa08033e0 _REC_MAP_20_u2_u2_u2 65535. _CNV_A_R_LINEAR_____0_CM 0. 65535. DISPLAY_IDENTIFIER ID_ERR_DTC_CYL_BAL_LAM_4 FORMAT "%5.0"
 /begin AXIS_DESCR COM_AXIS errm_online_dummy _CNV_S_2_ERRM_DTC_R_477_CM 1 0. 1. AXIS_PTS_REF ldp_nr_1_id_err_dtc /end AXIS_DESCR
 /begin AXIS_DESCR COM_AXIS errm_online_dummy _CNV_S_6_ERRM_DTC_R_478_CM 6 0. 5. AXIS_PTS_REF ldp_nr_2_id_err_dtc /end AXIS_DESCR
/end CHARACTERISTIC
/begin CHARACTERISTIC fmy_id_cyl_bal_lam_5.dtc "DTC table declaration for the diagnosis instance XX" MAP 0xa08033f4 _REC_MAP_20_u2_u2_u2 65535. _CNV_A_R_LINEAR_____0_CM 0. 65535. DISPLAY_IDENTIFIER ID_ERR_DTC_CYL_BAL_LAM_5 FORMAT "%5.0"
 /begin AXIS_DESCR COM_AXIS errm_online_dummy _CNV_S_2_ERRM_DTC_R_477_CM 1 0. 1. AXIS_PTS_REF ldp_nr_1_id_err_dtc /end AXIS_DESCR
 /begin AXIS_DESCR COM_AXIS errm_online_dummy _CNV_S_6_ERRM_DTC_R_478_CM 6 0. 5. AXIS_PTS_REF ldp_nr_2_id_err_dtc /end AXIS_DESCR
/end CHARACTERISTIC
/begin CHARACTERISTIC fmy_id_cyl_bal_lam_6.dtc "DTC table declaration for the diagnosis instance XX" MAP 0xa0803408 _REC_MAP_20_u2_u2_u2 65535. _CNV_A_R_LINEAR_____0_CM 0. 65535. DISPLAY_IDENTIFIER ID_ERR_DTC_CYL_BAL_LAM_6 FORMAT "%5.0"
 /begin AXIS_DESCR COM_AXIS errm_online_dummy _CNV_S_2_ERRM_DTC_R_477_CM 1 0. 1. AXIS_PTS_REF ldp_nr_1_id_err_dtc /end AXIS_DESCR
 /begin AXIS_DESCR COM_AXIS errm_online_dummy _CNV_S_6_ERRM_DTC_R_478_CM 6 0. 5. AXIS_PTS_REF ldp_nr_2_id_err_dtc /end AXIS_DESCR
/end CHARACTERISTIC
/begin CHARACTERISTIC fmy_id_cyl_bal_lam_7.dtc "DTC table declaration for the diagnosis instance XX" MAP 0xa080341c _REC_MAP_20_u2_u2_u2 65535. _CNV_A_R_LINEAR_____0_CM 0. 65535. DISPLAY_IDENTIFIER ID_ERR_DTC_CYL_BAL_LAM_7 FORMAT "%5.0"
 /begin AXIS_DESCR COM_AXIS errm_online_dummy _CNV_S_2_ERRM_DTC_R_477_CM 1 0. 1. AXIS_PTS_REF ldp_nr_1_id_err_dtc /end AXIS_DESCR
 /begin AXIS_DESCR COM_AXIS errm_online_dummy _CNV_S_6_ERRM_DTC_R_478_CM 6 0. 5. AXIS_PTS_REF ldp_nr_2_id_err_dtc /end AXIS_DESCR
/end CHARACTERISTIC
/begin CHARACTERISTIC fmy_id_cyl_bal_er_0.dtc "DTC table declaration for the diagnosis instance XX" MAP 0xa08032f0 _REC_MAP_20_u2_u2_u2 65535. _CNV_A_R_LINEAR_____0_CM 0. 65535. DISPLAY_IDENTIFIER ID_ERR_DTC_CYL_BAL_ER_0 FORMAT "%5.0"
 /begin AXIS_DESCR COM_AXIS errm_online_dummy _CNV_S_2_ERRM_DTC_R_477_CM 1 0. 1. AXIS_PTS_REF ldp_nr_1_id_err_dtc /end AXIS_DESCR
 /begin AXIS_DESCR COM_AXIS errm_online_dummy _CNV_S_6_ERRM_DTC_R_478_CM 6 0. 5. AXIS_PTS_REF ldp_nr_2_id_err_dtc /end AXIS_DESCR
/end CHARACTERISTIC
/begin CHARACTERISTIC fmy_id_cyl_bal_er_1.dtc "DTC table declaration for the diagnosis instance XX" MAP 0xa0803304 _REC_MAP_20_u2_u2_u2 65535. _CNV_A_R_LINEAR_____0_CM 0. 65535. DISPLAY_IDENTIFIER ID_ERR_DTC_CYL_BAL_ER_1 FORMAT "%5.0"
 /begin AXIS_DESCR COM_AXIS errm_online_dummy _CNV_S_2_ERRM_DTC_R_477_CM 1 0. 1. AXIS_PTS_REF ldp_nr_1_id_err_dtc /end AXIS_DESCR
 /begin AXIS_DESCR COM_AXIS errm_online_dummy _CNV_S_6_ERRM_DTC_R_478_CM 6 0. 5. AXIS_PTS_REF ldp_nr_2_id_err_dtc /end AXIS_DESCR
/end CHARACTERISTIC
/begin CHARACTERISTIC fmy_id_cyl_bal_er_2.dtc "DTC table declaration for the diagnosis instance XX" MAP 0xa0803318 _REC_MAP_20_u2_u2_u2 65535. _CNV_A_R_LINEAR_____0_CM 0. 65535. DISPLAY_IDENTIFIER ID_ERR_DTC_CYL_BAL_ER_2 FORMAT "%5.0"
 /begin AXIS_DESCR COM_AXIS errm_online_dummy _CNV_S_2_ERRM_DTC_R_477_CM 1 0. 1. AXIS_PTS_REF ldp_nr_1_id_err_dtc /end AXIS_DESCR
 /begin AXIS_DESCR COM_AXIS errm_online_dummy _CNV_S_6_ERRM_DTC_R_478_CM 6 0. 5. AXIS_PTS_REF ldp_nr_2_id_err_dtc /end AXIS_DESCR
/end CHARACTERISTIC
/begin CHARACTERISTIC fmy_id_cyl_bal_er_3.dtc "DTC table declaration for the diagnosis instance XX" MAP 0xa080332c _REC_MAP_20_u2_u2_u2 65535. _CNV_A_R_LINEAR_____0_CM 0. 65535. DISPLAY_IDENTIFIER ID_ERR_DTC_CYL_BAL_ER_3 FORMAT "%5.0"
 /begin AXIS_DESCR COM_AXIS errm_online_dummy _CNV_S_2_ERRM_DTC_R_477_CM 1 0. 1. AXIS_PTS_REF ldp_nr_1_id_err_dtc /end AXIS_DESCR
 /begin AXIS_DESCR COM_AXIS errm_online_dummy _CNV_S_6_ERRM_DTC_R_478_CM 6 0. 5. AXIS_PTS_REF ldp_nr_2_id_err_dtc /end AXIS_DESCR
/end CHARACTERISTIC
/begin CHARACTERISTIC fmy_id_cyl_bal_er_4.dtc "DTC table declaration for the diagnosis instance XX" MAP 0xa0803340 _REC_MAP_20_u2_u2_u2 65535. _CNV_A_R_LINEAR_____0_CM 0. 65535. DISPLAY_IDENTIFIER ID_ERR_DTC_CYL_BAL_ER_4 FORMAT "%5.0"
 /begin AXIS_DESCR COM_AXIS errm_online_dummy _CNV_S_2_ERRM_DTC_R_477_CM 1 0. 1. AXIS_PTS_REF ldp_nr_1_id_err_dtc /end AXIS_DESCR
 /begin AXIS_DESCR COM_AXIS errm_online_dummy _CNV_S_6_ERRM_DTC_R_478_CM 6 0. 5. AXIS_PTS_REF ldp_nr_2_id_err_dtc /end AXIS_DESCR
/end CHARACTERISTIC
/begin CHARACTERISTIC fmy_id_cyl_bal_er_5.dtc "DTC table declaration for the diagnosis instance XX" MAP 0xa0803354 _REC_MAP_20_u2_u2_u2 65535. _CNV_A_R_LINEAR_____0_CM 0. 65535. DISPLAY_IDENTIFIER ID_ERR_DTC_CYL_BAL_ER_5 FORMAT "%5.0"
 /begin AXIS_DESCR COM_AXIS errm_online_dummy _CNV_S_2_ERRM_DTC_R_477_CM 1 0. 1. AXIS_PTS_REF ldp_nr_1_id_err_dtc /end AXIS_DESCR
 /begin AXIS_DESCR COM_AXIS errm_online_dummy _CNV_S_6_ERRM_DTC_R_478_CM 6 0. 5. AXIS_PTS_REF ldp_nr_2_id_err_dtc /end AXIS_DESCR
/end CHARACTERISTIC
/begin CHARACTERISTIC fmy_id_cyl_bal_er_6.dtc "DTC table declaration for the diagnosis instance XX" MAP 0xa0803368 _REC_MAP_20_u2_u2_u2 65535. _CNV_A_R_LINEAR_____0_CM 0. 65535. DISPLAY_IDENTIFIER ID_ERR_DTC_CYL_BAL_ER_6 FORMAT "%5.0"
 /begin AXIS_DESCR COM_AXIS errm_online_dummy _CNV_S_2_ERRM_DTC_R_477_CM 1 0. 1. AXIS_PTS_REF ldp_nr_1_id_err_dtc /end AXIS_DESCR
 /begin AXIS_DESCR COM_AXIS errm_online_dummy _CNV_S_6_ERRM_DTC_R_478_CM 6 0. 5. AXIS_PTS_REF ldp_nr_2_id_err_dtc /end AXIS_DESCR
/end CHARACTERISTIC
/begin CHARACTERISTIC fmy_id_cyl_bal_er_7.dtc "DTC table declaration for the diagnosis instance XX" MAP 0xa080337c _REC_MAP_20_u2_u2_u2 65535. _CNV_A_R_LINEAR_____0_CM 0. 65535. DISPLAY_IDENTIFIER ID_ERR_DTC_CYL_BAL_ER_7 FORMAT "%5.0"
 /begin AXIS_DESCR COM_AXIS errm_online_dummy _CNV_S_2_ERRM_DTC_R_477_CM 1 0. 1. AXIS_PTS_REF ldp_nr_1_id_err_dtc /end AXIS_DESCR
 /begin AXIS_DESCR COM_AXIS errm_online_dummy _CNV_S_6_ERRM_DTC_R_478_CM 6 0. 5. AXIS_PTS_REF ldp_nr_2_id_err_dtc /end AXIS_DESCR
/end CHARACTERISTIC
/begin CHARACTERISTIC fmy_id_mon_3.dtc "DTC table declaration for the diagnosis instance XX" MAP 0xa0804074 _REC_MAP_20_u2_u2_u2 65535. _CNV_A_R_LINEAR_____0_CM 0. 65535. DISPLAY_IDENTIFIER ID_ERR_DTC_MON_3 FORMAT "%5.0"
 /begin AXIS_DESCR COM_AXIS errm_online_dummy _CNV_S_2_ERRM_DTC_R_477_CM 1 0. 1. AXIS_PTS_REF ldp_nr_1_id_err_dtc /end AXIS_DESCR
 /begin AXIS_DESCR COM_AXIS errm_online_dummy _CNV_S_6_ERRM_DTC_R_478_CM 6 0. 5. AXIS_PTS_REF ldp_nr_2_id_err_dtc /end AXIS_DESCR
/end CHARACTERISTIC
/begin CHARACTERISTIC fmy_id_maf_frq_rng_0.dtc "DTC table declaration for the diagnosis instance XX" MAP 0xa0803ebc _REC_MAP_20_u2_u2_u2 65535. _CNV_A_R_LINEAR_____0_CM 0. 65535. DISPLAY_IDENTIFIER ID_ERR_DTC_MAF_FRQ_RNG_0 FORMAT "%5.0"
 /begin AXIS_DESCR COM_AXIS errm_online_dummy _CNV_S_2_ERRM_DTC_R_477_CM 1 0. 1. AXIS_PTS_REF ldp_nr_1_id_err_dtc /end AXIS_DESCR
 /begin AXIS_DESCR COM_AXIS errm_online_dummy _CNV_S_6_ERRM_DTC_R_478_CM 6 0. 5. AXIS_PTS_REF ldp_nr_2_id_err_dtc /end AXIS_DESCR
/end CHARACTERISTIC
/begin CHARACTERISTIC fmy_id_maf_frq_grd_0.dtc "DTC table declaration for the diagnosis instance XX" MAP 0xa0803e94 _REC_MAP_20_u2_u2_u2 65535. _CNV_A_R_LINEAR_____0_CM 0. 65535. DISPLAY_IDENTIFIER ID_ERR_DTC_MAF_FRQ_GRD_0 FORMAT "%5.0"
 /begin AXIS_DESCR COM_AXIS errm_online_dummy _CNV_S_2_ERRM_DTC_R_477_CM 1 0. 1. AXIS_PTS_REF ldp_nr_1_id_err_dtc /end AXIS_DESCR
 /begin AXIS_DESCR COM_AXIS errm_online_dummy _CNV_S_6_ERRM_DTC_R_478_CM 6 0. 5. AXIS_PTS_REF ldp_nr_2_id_err_dtc /end AXIS_DESCR
/end CHARACTERISTIC
/begin CHARACTERISTIC fmy_id_maf_frq_el_0.dtc "DTC table declaration for the diagnosis instance XX" MAP 0xa0803e6c _REC_MAP_20_u2_u2_u2 65535. _CNV_A_R_LINEAR_____0_CM 0. 65535. DISPLAY_IDENTIFIER ID_ERR_DTC_MAF_FRQ_EL_0 FORMAT "%5.0"
 /begin AXIS_DESCR COM_AXIS errm_online_dummy _CNV_S_2_ERRM_DTC_R_477_CM 1 0. 1. AXIS_PTS_REF ldp_nr_1_id_err_dtc /end AXIS_DESCR
 /begin AXIS_DESCR COM_AXIS errm_online_dummy _CNV_S_6_ERRM_DTC_R_478_CM 6 0. 5. AXIS_PTS_REF ldp_nr_2_id_err_dtc /end AXIS_DESCR
/end CHARACTERISTIC
/begin CHARACTERISTIC fmy_id_maf_frq_rng_1.dtc "DTC table declaration for the diagnosis instance XX" MAP 0xa0803ed0 _REC_MAP_20_u2_u2_u2 65535. _CNV_A_R_LINEAR_____0_CM 0. 65535. DISPLAY_IDENTIFIER ID_ERR_DTC_MAF_FRQ_RNG_1 FORMAT "%5.0"
 /begin AXIS_DESCR COM_AXIS errm_online_dummy _CNV_S_2_ERRM_DTC_R_477_CM 1 0. 1. AXIS_PTS_REF ldp_nr_1_id_err_dtc /end AXIS_DESCR
 /begin AXIS_DESCR COM_AXIS errm_online_dummy _CNV_S_6_ERRM_DTC_R_478_CM 6 0. 5. AXIS_PTS_REF ldp_nr_2_id_err_dtc /end AXIS_DESCR
/end CHARACTERISTIC
/begin CHARACTERISTIC fmy_id_maf_frq_grd_1.dtc "DTC table declaration for the diagnosis instance XX" MAP 0xa0803ea8 _REC_MAP_20_u2_u2_u2 65535. _CNV_A_R_LINEAR_____0_CM 0. 65535. DISPLAY_IDENTIFIER ID_ERR_DTC_MAF_FRQ_GRD_1 FORMAT "%5.0"
 /begin AXIS_DESCR COM_AXIS errm_online_dummy _CNV_S_2_ERRM_DTC_R_477_CM 1 0. 1. AXIS_PTS_REF ldp_nr_1_id_err_dtc /end AXIS_DESCR
 /begin AXIS_DESCR COM_AXIS errm_online_dummy _CNV_S_6_ERRM_DTC_R_478_CM 6 0. 5. AXIS_PTS_REF ldp_nr_2_id_err_dtc /end AXIS_DESCR
/end CHARACTERISTIC
/begin CHARACTERISTIC fmy_id_maf_frq_el_1.dtc "DTC table declaration for the diagnosis instance XX" MAP 0xa0803e80 _REC_MAP_20_u2_u2_u2 65535. _CNV_A_R_LINEAR_____0_CM 0. 65535. DISPLAY_IDENTIFIER ID_ERR_DTC_MAF_FRQ_EL_1 FORMAT "%5.0"
 /begin AXIS_DESCR COM_AXIS errm_online_dummy _CNV_S_2_ERRM_DTC_R_477_CM 1 0. 1. AXIS_PTS_REF ldp_nr_1_id_err_dtc /end AXIS_DESCR
 /begin AXIS_DESCR COM_AXIS errm_online_dummy _CNV_S_6_ERRM_DTC_R_478_CM 6 0. 5. AXIS_PTS_REF ldp_nr_2_id_err_dtc /end AXIS_DESCR
/end CHARACTERISTIC
/begin CHARACTERISTIC fmy_id_tps_1_1.dtc "DTC table declaration for the diagnosis instance XX" MAP 0xa0804b00 _REC_MAP_20_u2_u2_u2 65535. _CNV_A_R_LINEAR_____0_CM 0. 65535. DISPLAY_IDENTIFIER ID_ERR_DTC_TPS_1_1 FORMAT "%5.0"
 /begin AXIS_DESCR COM_AXIS errm_online_dummy _CNV_S_2_ERRM_DTC_R_477_CM 1 0. 1. AXIS_PTS_REF ldp_nr_1_id_err_dtc /end AXIS_DESCR
 /begin AXIS_DESCR COM_AXIS errm_online_dummy _CNV_S_6_ERRM_DTC_R_478_CM 6 0. 5. AXIS_PTS_REF ldp_nr_2_id_err_dtc /end AXIS_DESCR
/end CHARACTERISTIC
/begin CHARACTERISTIC fmy_id_tps_1_2.dtc "DTC table declaration for the diagnosis instance XX" MAP 0xa0804b14 _REC_MAP_20_u2_u2_u2 65535. _CNV_A_R_LINEAR_____0_CM 0. 65535. DISPLAY_IDENTIFIER ID_ERR_DTC_TPS_1_2 FORMAT "%5.0"
 /begin AXIS_DESCR COM_AXIS errm_online_dummy _CNV_S_2_ERRM_DTC_R_477_CM 1 0. 1. AXIS_PTS_REF ldp_nr_1_id_err_dtc /end AXIS_DESCR
 /begin AXIS_DESCR COM_AXIS errm_online_dummy _CNV_S_6_ERRM_DTC_R_478_CM 6 0. 5. AXIS_PTS_REF ldp_nr_2_id_err_dtc /end AXIS_DESCR
/end CHARACTERISTIC
/begin CHARACTERISTIC fmy_id_tps_2_1.dtc "DTC table declaration for the diagnosis instance XX" MAP 0xa0804b28 _REC_MAP_20_u2_u2_u2 65535. _CNV_A_R_LINEAR_____0_CM 0. 65535. DISPLAY_IDENTIFIER ID_ERR_DTC_TPS_2_1 FORMAT "%5.0"
 /begin AXIS_DESCR COM_AXIS errm_online_dummy _CNV_S_2_ERRM_DTC_R_477_CM 1 0. 1. AXIS_PTS_REF ldp_nr_1_id_err_dtc /end AXIS_DESCR
 /begin AXIS_DESCR COM_AXIS errm_online_dummy _CNV_S_6_ERRM_DTC_R_478_CM 6 0. 5. AXIS_PTS_REF ldp_nr_2_id_err_dtc /end AXIS_DESCR
/end CHARACTERISTIC
/begin CHARACTERISTIC fmy_id_tps_2_2.dtc "DTC table declaration for the diagnosis instance XX" MAP 0xa0804b3c _REC_MAP_20_u2_u2_u2 65535. _CNV_A_R_LINEAR_____0_CM 0. 65535. DISPLAY_IDENTIFIER ID_ERR_DTC_TPS_2_2 FORMAT "%5.0"
 /begin AXIS_DESCR COM_AXIS errm_online_dummy _CNV_S_2_ERRM_DTC_R_477_CM 1 0. 1. AXIS_PTS_REF ldp_nr_1_id_err_dtc /end AXIS_DESCR
 /begin AXIS_DESCR COM_AXIS errm_online_dummy _CNV_S_6_ERRM_DTC_R_478_CM 6 0. 5. AXIS_PTS_REF ldp_nr_2_id_err_dtc /end AXIS_DESCR
/end CHARACTERISTIC
/begin CHARACTERISTIC fmy_id_tps_maf_1_1.dtc "DTC table declaration for the diagnosis instance XX" MAP 0xa0804ba0 _REC_MAP_20_u2_u2_u2 65535. _CNV_A_R_LINEAR_____0_CM 0. 65535. DISPLAY_IDENTIFIER ID_ERR_DTC_TPS_MAF_1_1 FORMAT "%5.0"
 /begin AXIS_DESCR COM_AXIS errm_online_dummy _CNV_S_2_ERRM_DTC_R_477_CM 1 0. 1. AXIS_PTS_REF ldp_nr_1_id_err_dtc /end AXIS_DESCR
 /begin AXIS_DESCR COM_AXIS errm_online_dummy _CNV_S_6_ERRM_DTC_R_478_CM 6 0. 5. AXIS_PTS_REF ldp_nr_2_id_err_dtc /end AXIS_DESCR
/end CHARACTERISTIC
/begin CHARACTERISTIC fmy_id_tps_maf_1_2.dtc "DTC table declaration for the diagnosis instance XX" MAP 0xa0804bb4 _REC_MAP_20_u2_u2_u2 65535. _CNV_A_R_LINEAR_____0_CM 0. 65535. DISPLAY_IDENTIFIER ID_ERR_DTC_TPS_MAF_1_2 FORMAT "%5.0"
 /begin AXIS_DESCR COM_AXIS errm_online_dummy _CNV_S_2_ERRM_DTC_R_477_CM 1 0. 1. AXIS_PTS_REF ldp_nr_1_id_err_dtc /end AXIS_DESCR
 /begin AXIS_DESCR COM_AXIS errm_online_dummy _CNV_S_6_ERRM_DTC_R_478_CM 6 0. 5. AXIS_PTS_REF ldp_nr_2_id_err_dtc /end AXIS_DESCR
/end CHARACTERISTIC
/begin CHARACTERISTIC fmy_id_tps_maf_2_1.dtc "DTC table declaration for the diagnosis instance XX" MAP 0xa0804bc8 _REC_MAP_20_u2_u2_u2 65535. _CNV_A_R_LINEAR_____0_CM 0. 65535. DISPLAY_IDENTIFIER ID_ERR_DTC_TPS_MAF_2_1 FORMAT "%5.0"
 /begin AXIS_DESCR COM_AXIS errm_online_dummy _CNV_S_2_ERRM_DTC_R_477_CM 1 0. 1. AXIS_PTS_REF ldp_nr_1_id_err_dtc /end AXIS_DESCR
 /begin AXIS_DESCR COM_AXIS errm_online_dummy _CNV_S_6_ERRM_DTC_R_478_CM 6 0. 5. AXIS_PTS_REF ldp_nr_2_id_err_dtc /end AXIS_DESCR
/end CHARACTERISTIC
/begin CHARACTERISTIC fmy_id_tps_maf_2_2.dtc "DTC table declaration for the diagnosis instance XX" MAP 0xa0804bdc _REC_MAP_20_u2_u2_u2 65535. _CNV_A_R_LINEAR_____0_CM 0. 65535. DISPLAY_IDENTIFIER ID_ERR_DTC_TPS_MAF_2_2 FORMAT "%5.0"
 /begin AXIS_DESCR COM_AXIS errm_online_dummy _CNV_S_2_ERRM_DTC_R_477_CM 1 0. 1. AXIS_PTS_REF ldp_nr_1_id_err_dtc /end AXIS_DESCR
 /begin AXIS_DESCR COM_AXIS errm_online_dummy _CNV_S_6_ERRM_DTC_R_478_CM 6 0. 5. AXIS_PTS_REF ldp_nr_2_id_err_dtc /end AXIS_DESCR
/end CHARACTERISTIC
/begin CHARACTERISTIC fmy_id_tps_ratio_1.dtc "DTC table declaration for the diagnosis instance XX" MAP 0xa0804bf0 _REC_MAP_20_u2_u2_u2 65535. _CNV_A_R_LINEAR_____0_CM 0. 65535. DISPLAY_IDENTIFIER ID_ERR_DTC_TPS_RATIO_1 FORMAT "%5.0"
 /begin AXIS_DESCR COM_AXIS errm_online_dummy _CNV_S_2_ERRM_DTC_R_477_CM 1 0. 1. AXIS_PTS_REF ldp_nr_1_id_err_dtc /end AXIS_DESCR
 /begin AXIS_DESCR COM_AXIS errm_online_dummy _CNV_S_6_ERRM_DTC_R_478_CM 6 0. 5. AXIS_PTS_REF ldp_nr_2_id_err_dtc /end AXIS_DESCR
/end CHARACTERISTIC
/begin CHARACTERISTIC fmy_id_tps_ratio_2.dtc "DTC table declaration for the diagnosis instance XX" MAP 0xa0804c04 _REC_MAP_20_u2_u2_u2 65535. _CNV_A_R_LINEAR_____0_CM 0. 65535. DISPLAY_IDENTIFIER ID_ERR_DTC_TPS_RATIO_2 FORMAT "%5.0"
 /begin AXIS_DESCR COM_AXIS errm_online_dummy _CNV_S_2_ERRM_DTC_R_477_CM 1 0. 1. AXIS_PTS_REF ldp_nr_1_id_err_dtc /end AXIS_DESCR
 /begin AXIS_DESCR COM_AXIS errm_online_dummy _CNV_S_6_ERRM_DTC_R_478_CM 6 0. 5. AXIS_PTS_REF ldp_nr_2_id_err_dtc /end AXIS_DESCR
/end CHARACTERISTIC
/begin CHARACTERISTIC fmy_id_tps_ad_1.dtc "DTC table declaration for the diagnosis instance XX" MAP 0xa0804b50 _REC_MAP_20_u2_u2_u2 65535. _CNV_A_R_LINEAR_____0_CM 0. 65535. DISPLAY_IDENTIFIER ID_ERR_DTC_TPS_AD_1 FORMAT "%5.0"
 /begin AXIS_DESCR COM_AXIS errm_online_dummy _CNV_S_2_ERRM_DTC_R_477_CM 1 0. 1. AXIS_PTS_REF ldp_nr_1_id_err_dtc /end AXIS_DESCR
 /begin AXIS_DESCR COM_AXIS errm_online_dummy _CNV_S_6_ERRM_DTC_R_478_CM 6 0. 5. AXIS_PTS_REF ldp_nr_2_id_err_dtc /end AXIS_DESCR
/end CHARACTERISTIC
/begin CHARACTERISTIC fmy_id_tps_ad_2.dtc "DTC table declaration for the diagnosis instance XX" MAP 0xa0804b64 _REC_MAP_20_u2_u2_u2 65535. _CNV_A_R_LINEAR_____0_CM 0. 65535. DISPLAY_IDENTIFIER ID_ERR_DTC_TPS_AD_2 FORMAT "%5.0"
 /begin AXIS_DESCR COM_AXIS errm_online_dummy _CNV_S_2_ERRM_DTC_R_477_CM 1 0. 1. AXIS_PTS_REF ldp_nr_1_id_err_dtc /end AXIS_DESCR
 /begin AXIS_DESCR COM_AXIS errm_online_dummy _CNV_S_6_ERRM_DTC_R_478_CM 6 0. 5. AXIS_PTS_REF ldp_nr_2_id_err_dtc /end AXIS_DESCR
/end CHARACTERISTIC
/begin CHARACTERISTIC fmy_id_etc_pwm_1.dtc "DTC table declaration for the diagnosis instance XX" MAP 0xa0803700 _REC_MAP_20_u2_u2_u2 65535. _CNV_A_R_LINEAR_____0_CM 0. 65535. DISPLAY_IDENTIFIER ID_ERR_DTC_ETC_PWM_1 FORMAT "%5.0"
 /begin AXIS_DESCR COM_AXIS errm_online_dummy _CNV_S_2_ERRM_DTC_R_477_CM 1 0. 1. AXIS_PTS_REF ldp_nr_1_id_err_dtc /end AXIS_DESCR
 /begin AXIS_DESCR COM_AXIS errm_online_dummy _CNV_S_6_ERRM_DTC_R_478_CM 6 0. 5. AXIS_PTS_REF ldp_nr_2_id_err_dtc /end AXIS_DESCR
/end CHARACTERISTIC
/begin CHARACTERISTIC fmy_id_etc_pwm_2.dtc "DTC table declaration for the diagnosis instance XX" MAP 0xa0803714 _REC_MAP_20_u2_u2_u2 65535. _CNV_A_R_LINEAR_____0_CM 0. 65535. DISPLAY_IDENTIFIER ID_ERR_DTC_ETC_PWM_2 FORMAT "%5.0"
 /begin AXIS_DESCR COM_AXIS errm_online_dummy _CNV_S_2_ERRM_DTC_R_477_CM 1 0. 1. AXIS_PTS_REF ldp_nr_1_id_err_dtc /end AXIS_DESCR
 /begin AXIS_DESCR COM_AXIS errm_online_dummy _CNV_S_6_ERRM_DTC_R_478_CM 6 0. 5. AXIS_PTS_REF ldp_nr_2_id_err_dtc /end AXIS_DESCR
/end CHARACTERISTIC
/begin CHARACTERISTIC fmy_id_etc_ctl_1.dtc "DTC table declaration for the diagnosis instance XX" MAP 0xa08036b0 _REC_MAP_20_u2_u2_u2 65535. _CNV_A_R_LINEAR_____0_CM 0. 65535. DISPLAY_IDENTIFIER ID_ERR_DTC_ETC_CTL_1 FORMAT "%5.0"
 /begin AXIS_DESCR COM_AXIS errm_online_dummy _CNV_S_2_ERRM_DTC_R_477_CM 1 0. 1. AXIS_PTS_REF ldp_nr_1_id_err_dtc /end AXIS_DESCR
 /begin AXIS_DESCR COM_AXIS errm_online_dummy _CNV_S_6_ERRM_DTC_R_478_CM 6 0. 5. AXIS_PTS_REF ldp_nr_2_id_err_dtc /end AXIS_DESCR
/end CHARACTERISTIC
/begin CHARACTERISTIC fmy_id_etc_ctl_2.dtc "DTC table declaration for the diagnosis instance XX" MAP 0xa08036c4 _REC_MAP_20_u2_u2_u2 65535. _CNV_A_R_LINEAR_____0_CM 0. 65535. DISPLAY_IDENTIFIER ID_ERR_DTC_ETC_CTL_2 FORMAT "%5.0"
 /begin AXIS_DESCR COM_AXIS errm_online_dummy _CNV_S_2_ERRM_DTC_R_477_CM 1 0. 1. AXIS_PTS_REF ldp_nr_1_id_err_dtc /end AXIS_DESCR
 /begin AXIS_DESCR COM_AXIS errm_online_dummy _CNV_S_6_ERRM_DTC_R_478_CM 6 0. 5. AXIS_PTS_REF ldp_nr_2_id_err_dtc /end AXIS_DESCR
/end CHARACTERISTIC
/begin CHARACTERISTIC fmy_id_tps_ad_spr_1.dtc "DTC table declaration for the diagnosis instance XX" MAP 0xa0804b78 _REC_MAP_20_u2_u2_u2 65535. _CNV_A_R_LINEAR_____0_CM 0. 65535. DISPLAY_IDENTIFIER ID_ERR_DTC_TPS_AD_SPR_1 FORMAT "%5.0"
 /begin AXIS_DESCR COM_AXIS errm_online_dummy _CNV_S_2_ERRM_DTC_R_477_CM 1 0. 1. AXIS_PTS_REF ldp_nr_1_id_err_dtc /end AXIS_DESCR
 /begin AXIS_DESCR COM_AXIS errm_online_dummy _CNV_S_6_ERRM_DTC_R_478_CM 6 0. 5. AXIS_PTS_REF ldp_nr_2_id_err_dtc /end AXIS_DESCR
/end CHARACTERISTIC
/begin CHARACTERISTIC fmy_id_tps_ad_spr_2.dtc "DTC table declaration for the diagnosis instance XX" MAP 0xa0804b8c _REC_MAP_20_u2_u2_u2 65535. _CNV_A_R_LINEAR_____0_CM 0. 65535. DISPLAY_IDENTIFIER ID_ERR_DTC_TPS_AD_SPR_2 FORMAT "%5.0"
 /begin AXIS_DESCR COM_AXIS errm_online_dummy _CNV_S_2_ERRM_DTC_R_477_CM 1 0. 1. AXIS_PTS_REF ldp_nr_1_id_err_dtc /end AXIS_DESCR
 /begin AXIS_DESCR COM_AXIS errm_online_dummy _CNV_S_6_ERRM_DTC_R_478_CM 6 0. 5. AXIS_PTS_REF ldp_nr_2_id_err_dtc /end AXIS_DESCR
/end CHARACTERISTIC
/begin CHARACTERISTIC fmy_id_etc_dr_1.dtc "DTC table declaration for the diagnosis instance XX" MAP 0xa08036d8 _REC_MAP_20_u2_u2_u2 65535. _CNV_A_R_LINEAR_____0_CM 0. 65535. DISPLAY_IDENTIFIER ID_ERR_DTC_ETC_DR_1 FORMAT "%5.0"
 /begin AXIS_DESCR COM_AXIS errm_online_dummy _CNV_S_2_ERRM_DTC_R_477_CM 1 0. 1. AXIS_PTS_REF ldp_nr_1_id_err_dtc /end AXIS_DESCR
 /begin AXIS_DESCR COM_AXIS errm_online_dummy _CNV_S_6_ERRM_DTC_R_478_CM 6 0. 5. AXIS_PTS_REF ldp_nr_2_id_err_dtc /end AXIS_DESCR
/end CHARACTERISTIC
/begin CHARACTERISTIC fmy_id_etc_dr_2.dtc "DTC table declaration for the diagnosis instance XX" MAP 0xa08036ec _REC_MAP_20_u2_u2_u2 65535. _CNV_A_R_LINEAR_____0_CM 0. 65535. DISPLAY_IDENTIFIER ID_ERR_DTC_ETC_DR_2 FORMAT "%5.0"
 /begin AXIS_DESCR COM_AXIS errm_online_dummy _CNV_S_2_ERRM_DTC_R_477_CM 1 0. 1. AXIS_PTS_REF ldp_nr_1_id_err_dtc /end AXIS_DESCR
 /begin AXIS_DESCR COM_AXIS errm_online_dummy _CNV_S_6_ERRM_DTC_R_478_CM 6 0. 5. AXIS_PTS_REF ldp_nr_2_id_err_dtc /end AXIS_DESCR
/end CHARACTERISTIC
/begin CHARACTERISTIC fmy_id_tps_st_chk_1.dtc "DTC table declaration for the diagnosis instance XX" MAP 0xa0804c18 _REC_MAP_20_u2_u2_u2 65535. _CNV_A_R_LINEAR_____0_CM 0. 65535. DISPLAY_IDENTIFIER ID_ERR_DTC_TPS_ST_CHK_1 FORMAT "%5.0"
 /begin AXIS_DESCR COM_AXIS errm_online_dummy _CNV_S_2_ERRM_DTC_R_477_CM 1 0. 1. AXIS_PTS_REF ldp_nr_1_id_err_dtc /end AXIS_DESCR
 /begin AXIS_DESCR COM_AXIS errm_online_dummy _CNV_S_6_ERRM_DTC_R_478_CM 6 0. 5. AXIS_PTS_REF ldp_nr_2_id_err_dtc /end AXIS_DESCR
/end CHARACTERISTIC
/begin CHARACTERISTIC fmy_id_tps_st_chk_2.dtc "DTC table declaration for the diagnosis instance XX" MAP 0xa0804c2c _REC_MAP_20_u2_u2_u2 65535. _CNV_A_R_LINEAR_____0_CM 0. 65535. DISPLAY_IDENTIFIER ID_ERR_DTC_TPS_ST_CHK_2 FORMAT "%5.0"
 /begin AXIS_DESCR COM_AXIS errm_online_dummy _CNV_S_2_ERRM_DTC_R_477_CM 1 0. 1. AXIS_PTS_REF ldp_nr_1_id_err_dtc /end AXIS_DESCR
 /begin AXIS_DESCR COM_AXIS errm_online_dummy _CNV_S_6_ERRM_DTC_R_478_CM 6 0. 5. AXIS_PTS_REF ldp_nr_2_id_err_dtc /end AXIS_DESCR
/end CHARACTERISTIC
/begin CHARACTERISTIC fmy_id_com_1_tq_loss_cord.dtc "DTC table declaration for the diagnosis instance XX" MAP 0xa0802ee0 _REC_MAP_20_u2_u2_u2 65535. _CNV_A_R_LINEAR_____0_CM 0. 65535. DISPLAY_IDENTIFIER ID_ERR_DTC_COM_1_TQ_LOSS_CORD FORMAT "%5.0"
 /begin AXIS_DESCR COM_AXIS errm_online_dummy _CNV_S_2_ERRM_DTC_R_477_CM 1 0. 1. AXIS_PTS_REF ldp_nr_1_id_err_dtc /end AXIS_DESCR
 /begin AXIS_DESCR COM_AXIS errm_online_dummy _CNV_S_6_ERRM_DTC_R_478_CM 6 0. 5. AXIS_PTS_REF ldp_nr_2_id_err_dtc /end AXIS_DESCR
/end CHARACTERISTIC
/begin CHARACTERISTIC fmy_id_com_1_swi_gear.dtc "DTC table declaration for the diagnosis instance XX" MAP 0xa0802e90 _REC_MAP_20_u2_u2_u2 65535. _CNV_A_R_LINEAR_____0_CM 0. 65535. DISPLAY_IDENTIFIER ID_ERR_DTC_COM_1_SWI_GEAR FORMAT "%5.0"
 /begin AXIS_DESCR COM_AXIS errm_online_dummy _CNV_S_2_ERRM_DTC_R_477_CM 1 0. 1. AXIS_PTS_REF ldp_nr_1_id_err_dtc /end AXIS_DESCR
 /begin AXIS_DESCR COM_AXIS errm_online_dummy _CNV_S_6_ERRM_DTC_R_478_CM 6 0. 5. AXIS_PTS_REF ldp_nr_2_id_err_dtc /end AXIS_DESCR
/end CHARACTERISTIC
/begin CHARACTERISTIC fmy_id_com_1_veh_mod.dtc "DTC table declaration for the diagnosis instance XX" MAP 0xa0802f30 _REC_MAP_20_u2_u2_u2 65535. _CNV_A_R_LINEAR_____0_CM 0. 65535. DISPLAY_IDENTIFIER ID_ERR_DTC_COM_1_VEH_MOD FORMAT "%5.0"
 /begin AXIS_DESCR COM_AXIS errm_online_dummy _CNV_S_2_ERRM_DTC_R_477_CM 1 0. 1. AXIS_PTS_REF ldp_nr_1_id_err_dtc /end AXIS_DESCR
 /begin AXIS_DESCR COM_AXIS errm_online_dummy _CNV_S_6_ERRM_DTC_R_478_CM 6 0. 5. AXIS_PTS_REF ldp_nr_2_id_err_dtc /end AXIS_DESCR
/end CHARACTERISTIC
/begin CHARACTERISTIC fmy_id_com_1_brake_tcs.dtc "DTC table declaration for the diagnosis instance XX" MAP 0xa0802e68 _REC_MAP_20_u2_u2_u2 65535. _CNV_A_R_LINEAR_____0_CM 0. 65535. DISPLAY_IDENTIFIER ID_ERR_DTC_COM_1_BRAKE_TCS FORMAT "%5.0"
 /begin AXIS_DESCR COM_AXIS errm_online_dummy _CNV_S_2_ERRM_DTC_R_477_CM 1 0. 1. AXIS_PTS_REF ldp_nr_1_id_err_dtc /end AXIS_DESCR
 /begin AXIS_DESCR COM_AXIS errm_online_dummy _CNV_S_6_ERRM_DTC_R_478_CM 6 0. 5. AXIS_PTS_REF ldp_nr_2_id_err_dtc /end AXIS_DESCR
/end CHARACTERISTIC
/begin CHARACTERISTIC fmy_id_com_1_tq_driv_asi.dtc "DTC table declaration for the diagnosis instance XX" MAP 0xa0802ecc _REC_MAP_20_u2_u2_u2 65535. _CNV_A_R_LINEAR_____0_CM 0. 65535. DISPLAY_IDENTIFIER ID_ERR_DTC_COM_1_TQ_DRIV_ASI FORMAT "%5.0"
 /begin AXIS_DESCR COM_AXIS errm_online_dummy _CNV_S_2_ERRM_DTC_R_477_CM 1 0. 1. AXIS_PTS_REF ldp_nr_1_id_err_dtc /end AXIS_DESCR
 /begin AXIS_DESCR COM_AXIS errm_online_dummy _CNV_S_6_ERRM_DTC_R_478_CM 6 0. 5. AXIS_PTS_REF ldp_nr_2_id_err_dtc /end AXIS_DESCR
/end CHARACTERISTIC
/begin CHARACTERISTIC fmy_id_com_1_tq_tcs.dtc "DTC table declaration for the diagnosis instance XX" MAP 0xa0802f08 _REC_MAP_20_u2_u2_u2 65535. _CNV_A_R_LINEAR_____0_CM 0. 65535. DISPLAY_IDENTIFIER ID_ERR_DTC_COM_1_TQ_TCS FORMAT "%5.0"
 /begin AXIS_DESCR COM_AXIS errm_online_dummy _CNV_S_2_ERRM_DTC_R_477_CM 1 0. 1. AXIS_PTS_REF ldp_nr_1_id_err_dtc /end AXIS_DESCR
 /begin AXIS_DESCR COM_AXIS errm_online_dummy _CNV_S_6_ERRM_DTC_R_478_CM 6 0. 5. AXIS_PTS_REF ldp_nr_2_id_err_dtc /end AXIS_DESCR
/end CHARACTERISTIC
/begin CHARACTERISTIC fmy_id_com_1_tqb_tcs.dtc "DTC table declaration for the diagnosis instance XX" MAP 0xa0802f1c _REC_MAP_20_u2_u2_u2 65535. _CNV_A_R_LINEAR_____0_CM 0. 65535. DISPLAY_IDENTIFIER ID_ERR_DTC_COM_1_TQB_TCS FORMAT "%5.0"
 /begin AXIS_DESCR COM_AXIS errm_online_dummy _CNV_S_2_ERRM_DTC_R_477_CM 1 0. 1. AXIS_PTS_REF ldp_nr_1_id_err_dtc /end AXIS_DESCR
 /begin AXIS_DESCR COM_AXIS errm_online_dummy _CNV_S_6_ERRM_DTC_R_478_CM 6 0. 5. AXIS_PTS_REF ldp_nr_2_id_err_dtc /end AXIS_DESCR
/end CHARACTERISTIC
/begin CHARACTERISTIC fmy_id_com_1_wheel_tcs.dtc "DTC table declaration for the diagnosis instance XX" MAP 0xa0802f58 _REC_MAP_20_u2_u2_u2 65535. _CNV_A_R_LINEAR_____0_CM 0. 65535. DISPLAY_IDENTIFIER ID_ERR_DTC_COM_1_WHEEL_TCS FORMAT "%5.0"
 /begin AXIS_DESCR COM_AXIS errm_online_dummy _CNV_S_2_ERRM_DTC_R_477_CM 1 0. 1. AXIS_PTS_REF ldp_nr_1_id_err_dtc /end AXIS_DESCR
 /begin AXIS_DESCR COM_AXIS errm_online_dummy _CNV_S_6_ERRM_DTC_R_478_CM 6 0. 5. AXIS_PTS_REF ldp_nr_2_id_err_dtc /end AXIS_DESCR
/end CHARACTERISTIC
/begin CHARACTERISTIC fmy_id_com_1_req_tqdw.dtc "DTC table declaration for the diagnosis instance XX" MAP 0xa0802e7c _REC_MAP_20_u2_u2_u2 65535. _CNV_A_R_LINEAR_____0_CM 0. 65535. DISPLAY_IDENTIFIER ID_ERR_DTC_COM_1_REQ_TQDW FORMAT "%5.0"
 /begin AXIS_DESCR COM_AXIS errm_online_dummy _CNV_S_2_ERRM_DTC_R_477_CM 1 0. 1. AXIS_PTS_REF ldp_nr_1_id_err_dtc /end AXIS_DESCR
 /begin AXIS_DESCR COM_AXIS errm_online_dummy _CNV_S_6_ERRM_DTC_R_478_CM 6 0. 5. AXIS_PTS_REF ldp_nr_2_id_err_dtc /end AXIS_DESCR
/end CHARACTERISTIC
/begin CHARACTERISTIC fmy_id_com_1_tq_pste.dtc "DTC table declaration for the diagnosis instance XX" MAP 0xa0802ef4 _REC_MAP_20_u2_u2_u2 65535. _CNV_A_R_LINEAR_____0_CM 0. 65535. DISPLAY_IDENTIFIER ID_ERR_DTC_COM_1_TQ_PSTE FORMAT "%5.0"
 /begin AXIS_DESCR COM_AXIS errm_online_dummy _CNV_S_2_ERRM_DTC_R_477_CM 1 0. 1. AXIS_PTS_REF ldp_nr_1_id_err_dtc /end AXIS_DESCR
 /begin AXIS_DESCR COM_AXIS errm_online_dummy _CNV_S_6_ERRM_DTC_R_478_CM 6 0. 5. AXIS_PTS_REF ldp_nr_2_id_err_dtc /end AXIS_DESCR
/end CHARACTERISTIC
/begin CHARACTERISTIC fmy_id_com_1_ang_pste.dtc "DTC table declaration for the diagnosis instance XX" MAP 0xa0802e2c _REC_MAP_20_u2_u2_u2 65535. _CNV_A_R_LINEAR_____0_CM 0. 65535. DISPLAY_IDENTIFIER ID_ERR_DTC_COM_1_ANG_PSTE FORMAT "%5.0"
 /begin AXIS_DESCR COM_AXIS errm_online_dummy _CNV_S_2_ERRM_DTC_R_477_CM 1 0. 1. AXIS_PTS_REF ldp_nr_1_id_err_dtc /end AXIS_DESCR
 /begin AXIS_DESCR COM_AXIS errm_online_dummy _CNV_S_6_ERRM_DTC_R_478_CM 6 0. 5. AXIS_PTS_REF ldp_nr_2_id_err_dtc /end AXIS_DESCR
/end CHARACTERISTIC
/begin CHARACTERISTIC fmy_id_com_1_ac_trv.dtc "DTC table declaration for the diagnosis instance XX" MAP 0xa0802e18 _REC_MAP_20_u2_u2_u2 65535. _CNV_A_R_LINEAR_____0_CM 0. 65535. DISPLAY_IDENTIFIER ID_ERR_DTC_COM_1_AC_TRV FORMAT "%5.0"
 /begin AXIS_DESCR COM_AXIS errm_online_dummy _CNV_S_2_ERRM_DTC_R_477_CM 1 0. 1. AXIS_PTS_REF ldp_nr_1_id_err_dtc /end AXIS_DESCR
 /begin AXIS_DESCR COM_AXIS errm_online_dummy _CNV_S_6_ERRM_DTC_R_478_CM 6 0. 5. AXIS_PTS_REF ldp_nr_2_id_err_dtc /end AXIS_DESCR
/end CHARACTERISTIC
/begin CHARACTERISTIC fmy_id_com_1_ac_lgt.dtc "DTC table declaration for the diagnosis instance XX" MAP 0xa0802e04 _REC_MAP_20_u2_u2_u2 65535. _CNV_A_R_LINEAR_____0_CM 0. 65535. DISPLAY_IDENTIFIER ID_ERR_DTC_COM_1_AC_LGT FORMAT "%5.0"
 /begin AXIS_DESCR COM_AXIS errm_online_dummy _CNV_S_2_ERRM_DTC_R_477_CM 1 0. 1. AXIS_PTS_REF ldp_nr_1_id_err_dtc /end AXIS_DESCR
 /begin AXIS_DESCR COM_AXIS errm_online_dummy _CNV_S_6_ERRM_DTC_R_478_CM 6 0. 5. AXIS_PTS_REF ldp_nr_2_id_err_dtc /end AXIS_DESCR
/end CHARACTERISTIC
/begin CHARACTERISTIC fmy_id_com_1_tq_ars.dtc "DTC table declaration for the diagnosis instance XX" MAP 0xa0802eb8 _REC_MAP_20_u2_u2_u2 65535. _CNV_A_R_LINEAR_____0_CM 0. 65535. DISPLAY_IDENTIFIER ID_ERR_DTC_COM_1_TQ_ARS FORMAT "%5.0"
 /begin AXIS_DESCR COM_AXIS errm_online_dummy _CNV_S_2_ERRM_DTC_R_477_CM 1 0. 1. AXIS_PTS_REF ldp_nr_1_id_err_dtc /end AXIS_DESCR
 /begin AXIS_DESCR COM_AXIS errm_online_dummy _CNV_S_6_ERRM_DTC_R_478_CM 6 0. 5. AXIS_PTS_REF ldp_nr_2_id_err_dtc /end AXIS_DESCR
/end CHARACTERISTIC
/begin CHARACTERISTIC fmy_id_com_1_ars.dtc "DTC table declaration for the diagnosis instance XX" MAP 0xa0802e40 _REC_MAP_20_u2_u2_u2 65535. _CNV_A_R_LINEAR_____0_CM 0. 65535. DISPLAY_IDENTIFIER ID_ERR_DTC_COM_1_ARS FORMAT "%5.0"
 /begin AXIS_DESCR COM_AXIS errm_online_dummy _CNV_S_2_ERRM_DTC_R_477_CM 1 0. 1. AXIS_PTS_REF ldp_nr_1_id_err_dtc /end AXIS_DESCR
 /begin AXIS_DESCR COM_AXIS errm_online_dummy _CNV_S_6_ERRM_DTC_R_478_CM 6 0. 5. AXIS_PTS_REF ldp_nr_2_id_err_dtc /end AXIS_DESCR
/end CHARACTERISTIC
/begin CHARACTERISTIC fmy_id_com_1_vs.dtc "DTC table declaration for the diagnosis instance XX" MAP 0xa0802f44 _REC_MAP_20_u2_u2_u2 65535. _CNV_A_R_LINEAR_____0_CM 0. 65535. DISPLAY_IDENTIFIER ID_ERR_DTC_COM_1_VS FORMAT "%5.0"
 /begin AXIS_DESCR COM_AXIS errm_online_dummy _CNV_S_2_ERRM_DTC_R_477_CM 1 0. 1. AXIS_PTS_REF ldp_nr_1_id_err_dtc /end AXIS_DESCR
 /begin AXIS_DESCR COM_AXIS errm_online_dummy _CNV_S_6_ERRM_DTC_R_478_CM 6 0. 5. AXIS_PTS_REF ldp_nr_2_id_err_dtc /end AXIS_DESCR
/end CHARACTERISTIC
/begin CHARACTERISTIC fmy_id_com_1_tcs.dtc "DTC table declaration for the diagnosis instance XX" MAP 0xa0802ea4 _REC_MAP_20_u2_u2_u2 65535. _CNV_A_R_LINEAR_____0_CM 0. 65535. DISPLAY_IDENTIFIER ID_ERR_DTC_COM_1_TCS FORMAT "%5.0"
 /begin AXIS_DESCR COM_AXIS errm_online_dummy _CNV_S_2_ERRM_DTC_R_477_CM 1 0. 1. AXIS_PTS_REF ldp_nr_1_id_err_dtc /end AXIS_DESCR
 /begin AXIS_DESCR COM_AXIS errm_online_dummy _CNV_S_6_ERRM_DTC_R_478_CM 6 0. 5. AXIS_PTS_REF ldp_nr_2_id_err_dtc /end AXIS_DESCR
/end CHARACTERISTIC
/begin CHARACTERISTIC fmy_id_com_1_boff.dtc "DTC table declaration for the diagnosis instance XX" MAP 0xa0802e54 _REC_MAP_20_u2_u2_u2 65535. _CNV_A_R_LINEAR_____0_CM 0. 65535. DISPLAY_IDENTIFIER ID_ERR_DTC_COM_1_BOFF FORMAT "%5.0"
 /begin AXIS_DESCR COM_AXIS errm_online_dummy _CNV_S_2_ERRM_DTC_R_477_CM 1 0. 1. AXIS_PTS_REF ldp_nr_1_id_err_dtc /end AXIS_DESCR
 /begin AXIS_DESCR COM_AXIS errm_online_dummy _CNV_S_6_ERRM_DTC_R_478_CM 6 0. 5. AXIS_PTS_REF ldp_nr_2_id_err_dtc /end AXIS_DESCR
/end CHARACTERISTIC
/begin CHARACTERISTIC fmy_id_com_2_efp_crash.dtc "DTC table declaration for the diagnosis instance XX" MAP 0xa0802fe4 _REC_MAP_20_u2_u2_u2 65535. _CNV_A_R_LINEAR_____0_CM 0. 65535. DISPLAY_IDENTIFIER ID_ERR_DTC_COM_2_EFP_CRASH FORMAT "%5.0"
 /begin AXIS_DESCR COM_AXIS errm_online_dummy _CNV_S_2_ERRM_DTC_R_477_CM 1 0. 1. AXIS_PTS_REF ldp_nr_1_id_err_dtc /end AXIS_DESCR
 /begin AXIS_DESCR COM_AXIS errm_online_dummy _CNV_S_6_ERRM_DTC_R_478_CM 6 0. 5. AXIS_PTS_REF ldp_nr_2_id_err_dtc /end AXIS_DESCR
/end CHARACTERISTIC
/begin CHARACTERISTIC fmy_id_com_2_gb.dtc "DTC table declaration for the diagnosis instance XX" MAP 0xa0803020 _REC_MAP_20_u2_u2_u2 65535. _CNV_A_R_LINEAR_____0_CM 0. 65535. DISPLAY_IDENTIFIER ID_ERR_DTC_COM_2_GB FORMAT "%5.0"
 /begin AXIS_DESCR COM_AXIS errm_online_dummy _CNV_S_2_ERRM_DTC_R_477_CM 1 0. 1. AXIS_PTS_REF ldp_nr_1_id_err_dtc /end AXIS_DESCR
 /begin AXIS_DESCR COM_AXIS errm_online_dummy _CNV_S_6_ERRM_DTC_R_478_CM 6 0. 5. AXIS_PTS_REF ldp_nr_2_id_err_dtc /end AXIS_DESCR
/end CHARACTERISTIC
/begin CHARACTERISTIC fmy_id_com_2_etcu.dtc "DTC table declaration for the diagnosis instance XX" MAP 0xa0802ff8 _REC_MAP_20_u2_u2_u2 65535. _CNV_A_R_LINEAR_____0_CM 0. 65535. DISPLAY_IDENTIFIER ID_ERR_DTC_COM_2_ETCU FORMAT "%5.0"
 /begin AXIS_DESCR COM_AXIS errm_online_dummy _CNV_S_2_ERRM_DTC_R_477_CM 1 0. 1. AXIS_PTS_REF ldp_nr_1_id_err_dtc /end AXIS_DESCR
 /begin AXIS_DESCR COM_AXIS errm_online_dummy _CNV_S_6_ERRM_DTC_R_478_CM 6 0. 5. AXIS_PTS_REF ldp_nr_2_id_err_dtc /end AXIS_DESCR
/end CHARACTERISTIC
/begin CHARACTERISTIC fmy_id_com_2_tq_etcu.dtc "DTC table declaration for the diagnosis instance XX" MAP 0xa08030fc _REC_MAP_20_u2_u2_u2 65535. _CNV_A_R_LINEAR_____0_CM 0. 65535. DISPLAY_IDENTIFIER ID_ERR_DTC_COM_2_TQ_ETCU FORMAT "%5.0"
 /begin AXIS_DESCR COM_AXIS errm_online_dummy _CNV_S_2_ERRM_DTC_R_477_CM 1 0. 1. AXIS_PTS_REF ldp_nr_1_id_err_dtc /end AXIS_DESCR
 /begin AXIS_DESCR COM_AXIS errm_online_dummy _CNV_S_6_ERRM_DTC_R_478_CM 6 0. 5. AXIS_PTS_REF ldp_nr_2_id_err_dtc /end AXIS_DESCR
/end CHARACTERISTIC
/begin CHARACTERISTIC fmy_id_com_2_state_veh.dtc "DTC table declaration for the diagnosis instance XX" MAP 0xa0803098 _REC_MAP_20_u2_u2_u2 65535. _CNV_A_R_LINEAR_____0_CM 0. 65535. DISPLAY_IDENTIFIER ID_ERR_DTC_COM_2_STATE_VEH FORMAT "%5.0"
 /begin AXIS_DESCR COM_AXIS errm_online_dummy _CNV_S_2_ERRM_DTC_R_477_CM 1 0. 1. AXIS_PTS_REF ldp_nr_1_id_err_dtc /end AXIS_DESCR
 /begin AXIS_DESCR COM_AXIS errm_online_dummy _CNV_S_6_ERRM_DTC_R_478_CM 6 0. 5. AXIS_PTS_REF ldp_nr_2_id_err_dtc /end AXIS_DESCR
/end CHARACTERISTIC
/begin CHARACTERISTIC fmy_id_com_2_cas_2.dtc "DTC table declaration for the diagnosis instance XX" MAP 0xa0802fbc _REC_MAP_20_u2_u2_u2 65535. _CNV_A_R_LINEAR_____0_CM 0. 65535. DISPLAY_IDENTIFIER ID_ERR_DTC_COM_2_CAS_2 FORMAT "%5.0"
 /begin AXIS_DESCR COM_AXIS errm_online_dummy _CNV_S_2_ERRM_DTC_R_477_CM 1 0. 1. AXIS_PTS_REF ldp_nr_1_id_err_dtc /end AXIS_DESCR
 /begin AXIS_DESCR COM_AXIS errm_online_dummy _CNV_S_6_ERRM_DTC_R_478_CM 6 0. 5. AXIS_PTS_REF ldp_nr_2_id_err_dtc /end AXIS_DESCR
/end CHARACTERISTIC
/begin CHARACTERISTIC fmy_id_com_2_acc.dtc "DTC table declaration for the diagnosis instance XX" MAP 0xa0802f80 _REC_MAP_20_u2_u2_u2 65535. _CNV_A_R_LINEAR_____0_CM 0. 65535. DISPLAY_IDENTIFIER ID_ERR_DTC_COM_2_ACC FORMAT "%5.0"
 /begin AXIS_DESCR COM_AXIS errm_online_dummy _CNV_S_2_ERRM_DTC_R_477_CM 1 0. 1. AXIS_PTS_REF ldp_nr_1_id_err_dtc /end AXIS_DESCR
 /begin AXIS_DESCR COM_AXIS errm_online_dummy _CNV_S_6_ERRM_DTC_R_478_CM 6 0. 5. AXIS_PTS_REF ldp_nr_2_id_err_dtc /end AXIS_DESCR
/end CHARACTERISTIC
/begin CHARACTERISTIC fmy_id_com_2_km_icl.dtc "DTC table declaration for the diagnosis instance XX" MAP 0xa0803070 _REC_MAP_20_u2_u2_u2 65535. _CNV_A_R_LINEAR_____0_CM 0. 65535. DISPLAY_IDENTIFIER ID_ERR_DTC_COM_2_KM_ICL FORMAT "%5.0"
 /begin AXIS_DESCR COM_AXIS errm_online_dummy _CNV_S_2_ERRM_DTC_R_477_CM 1 0. 1. AXIS_PTS_REF ldp_nr_1_id_err_dtc /end AXIS_DESCR
 /begin AXIS_DESCR COM_AXIS errm_online_dummy _CNV_S_6_ERRM_DTC_R_478_CM 6 0. 5. AXIS_PTS_REF ldp_nr_2_id_err_dtc /end AXIS_DESCR
/end CHARACTERISTIC
/begin CHARACTERISTIC fmy_id_com_2_t_icl.dtc "DTC table declaration for the diagnosis instance XX" MAP 0xa08030d4 _REC_MAP_20_u2_u2_u2 65535. _CNV_A_R_LINEAR_____0_CM 0. 65535. DISPLAY_IDENTIFIER ID_ERR_DTC_COM_2_T_ICL FORMAT "%5.0"
 /begin AXIS_DESCR COM_AXIS errm_online_dummy _CNV_S_2_ERRM_DTC_R_477_CM 1 0. 1. AXIS_PTS_REF ldp_nr_1_id_err_dtc /end AXIS_DESCR
 /begin AXIS_DESCR COM_AXIS errm_online_dummy _CNV_S_6_ERRM_DTC_R_478_CM 6 0. 5. AXIS_PTS_REF ldp_nr_2_id_err_dtc /end AXIS_DESCR
/end CHARACTERISTIC
/begin CHARACTERISTIC fmy_id_com_2_tam_icl.dtc "DTC table declaration for the diagnosis instance XX" MAP 0xa08030e8 _REC_MAP_20_u2_u2_u2 65535. _CNV_A_R_LINEAR_____0_CM 0. 65535. DISPLAY_IDENTIFIER ID_ERR_DTC_COM_2_TAM_ICL FORMAT "%5.0"
 /begin AXIS_DESCR COM_AXIS errm_online_dummy _CNV_S_2_ERRM_DTC_R_477_CM 1 0. 1. AXIS_PTS_REF ldp_nr_1_id_err_dtc /end AXIS_DESCR
 /begin AXIS_DESCR COM_AXIS errm_online_dummy _CNV_S_6_ERRM_DTC_R_478_CM 6 0. 5. AXIS_PTS_REF ldp_nr_2_id_err_dtc /end AXIS_DESCR
/end CHARACTERISTIC
/begin CHARACTERISTIC fmy_id_com_2_t_clk.dtc "DTC table declaration for the diagnosis instance XX" MAP 0xa08030c0 _REC_MAP_20_u2_u2_u2 65535. _CNV_A_R_LINEAR_____0_CM 0. 65535. DISPLAY_IDENTIFIER ID_ERR_DTC_COM_2_T_CLK FORMAT "%5.0"
 /begin AXIS_DESCR COM_AXIS errm_online_dummy _CNV_S_2_ERRM_DTC_R_477_CM 1 0. 1. AXIS_PTS_REF ldp_nr_1_id_err_dtc /end AXIS_DESCR
 /begin AXIS_DESCR COM_AXIS errm_online_dummy _CNV_S_6_ERRM_DTC_R_478_CM 6 0. 5. AXIS_PTS_REF ldp_nr_2_id_err_dtc /end AXIS_DESCR
/end CHARACTERISTIC
/begin CHARACTERISTIC fmy_id_com_2_boff.dtc "DTC table declaration for the diagnosis instance XX" MAP 0xa0802f94 _REC_MAP_20_u2_u2_u2 65535. _CNV_A_R_LINEAR_____0_CM 0. 65535. DISPLAY_IDENTIFIER ID_ERR_DTC_COM_2_BOFF FORMAT "%5.0"
 /begin AXIS_DESCR COM_AXIS errm_online_dummy _CNV_S_2_ERRM_DTC_R_477_CM 1 0. 1. AXIS_PTS_REF ldp_nr_1_id_err_dtc /end AXIS_DESCR
 /begin AXIS_DESCR COM_AXIS errm_online_dummy _CNV_S_6_ERRM_DTC_R_478_CM 6 0. 5. AXIS_PTS_REF ldp_nr_2_id_err_dtc /end AXIS_DESCR
/end CHARACTERISTIC
/begin CHARACTERISTIC fmy_id_com_2_t_absl_icl.dtc "DTC table declaration for the diagnosis instance XX" MAP 0xa08030ac _REC_MAP_20_u2_u2_u2 65535. _CNV_A_R_LINEAR_____0_CM 0. 65535. DISPLAY_IDENTIFIER ID_ERR_DTC_COM_2_T_ABSL_ICL FORMAT "%5.0"
 /begin AXIS_DESCR COM_AXIS errm_online_dummy _CNV_S_2_ERRM_DTC_R_477_CM 1 0. 1. AXIS_PTS_REF ldp_nr_1_id_err_dtc /end AXIS_DESCR
 /begin AXIS_DESCR COM_AXIS errm_online_dummy _CNV_S_6_ERRM_DTC_R_478_CM 6 0. 5. AXIS_PTS_REF ldp_nr_2_id_err_dtc /end AXIS_DESCR
/end CHARACTERISTIC
/begin CHARACTERISTIC fmy_id_com_2_cas.dtc "DTC table declaration for the diagnosis instance XX" MAP 0xa0802fa8 _REC_MAP_20_u2_u2_u2 65535. _CNV_A_R_LINEAR_____0_CM 0. 65535. DISPLAY_IDENTIFIER ID_ERR_DTC_COM_2_CAS FORMAT "%5.0"
 /begin AXIS_DESCR COM_AXIS errm_online_dummy _CNV_S_2_ERRM_DTC_R_477_CM 1 0. 1. AXIS_PTS_REF ldp_nr_1_id_err_dtc /end AXIS_DESCR
 /begin AXIS_DESCR COM_AXIS errm_online_dummy _CNV_S_6_ERRM_DTC_R_478_CM 6 0. 5. AXIS_PTS_REF ldp_nr_2_id_err_dtc /end AXIS_DESCR
/end CHARACTERISTIC
/begin CHARACTERISTIC fmy_id_com_2_etcu_disp.dtc "DTC table declaration for the diagnosis instance XX" MAP 0xa080300c _REC_MAP_20_u2_u2_u2 65535. _CNV_A_R_LINEAR_____0_CM 0. 65535. DISPLAY_IDENTIFIER ID_ERR_DTC_COM_2_ETCU_DISP FORMAT "%5.0"
 /begin AXIS_DESCR COM_AXIS errm_online_dummy _CNV_S_2_ERRM_DTC_R_477_CM 1 0. 1. AXIS_PTS_REF ldp_nr_1_id_err_dtc /end AXIS_DESCR
 /begin AXIS_DESCR COM_AXIS errm_online_dummy _CNV_S_6_ERRM_DTC_R_478_CM 6 0. 5. AXIS_PTS_REF ldp_nr_2_id_err_dtc /end AXIS_DESCR
/end CHARACTERISTIC
/begin CHARACTERISTIC fmy_id_com_2_pow_off.dtc "DTC table declaration for the diagnosis instance XX" MAP 0xa0803084 _REC_MAP_20_u2_u2_u2 65535. _CNV_A_R_LINEAR_____0_CM 0. 65535. DISPLAY_IDENTIFIER ID_ERR_DTC_COM_2_POW_OFF FORMAT "%5.0"
 /begin AXIS_DESCR COM_AXIS errm_online_dummy _CNV_S_2_ERRM_DTC_R_477_CM 1 0. 1. AXIS_PTS_REF ldp_nr_1_id_err_dtc /end AXIS_DESCR
 /begin AXIS_DESCR COM_AXIS errm_online_dummy _CNV_S_6_ERRM_DTC_R_478_CM 6 0. 5. AXIS_PTS_REF ldp_nr_2_id_err_dtc /end AXIS_DESCR
/end CHARACTERISTIC
/begin CHARACTERISTIC fmy_id_com_2_abs_icl.dtc "DTC table declaration for the diagnosis instance XX" MAP 0xa0802f6c _REC_MAP_20_u2_u2_u2 65535. _CNV_A_R_LINEAR_____0_CM 0. 65535. DISPLAY_IDENTIFIER ID_ERR_DTC_COM_2_ABS_ICL FORMAT "%5.0"
 /begin AXIS_DESCR COM_AXIS errm_online_dummy _CNV_S_2_ERRM_DTC_R_477_CM 1 0. 1. AXIS_PTS_REF ldp_nr_1_id_err_dtc /end AXIS_DESCR
 /begin AXIS_DESCR COM_AXIS errm_online_dummy _CNV_S_6_ERRM_DTC_R_478_CM 6 0. 5. AXIS_PTS_REF ldp_nr_2_id_err_dtc /end AXIS_DESCR
/end CHARACTERISTIC
/begin CHARACTERISTIC fmy_id_com_2_trl.dtc "DTC table declaration for the diagnosis instance XX" MAP 0xa0803110 _REC_MAP_20_u2_u2_u2 65535. _CNV_A_R_LINEAR_____0_CM 0. 65535. DISPLAY_IDENTIFIER ID_ERR_DTC_COM_2_TRL FORMAT "%5.0"
 /begin AXIS_DESCR COM_AXIS errm_online_dummy _CNV_S_2_ERRM_DTC_R_477_CM 1 0. 1. AXIS_PTS_REF ldp_nr_1_id_err_dtc /end AXIS_DESCR
 /begin AXIS_DESCR COM_AXIS errm_online_dummy _CNV_S_6_ERRM_DTC_R_478_CM 6 0. 5. AXIS_PTS_REF ldp_nr_2_id_err_dtc /end AXIS_DESCR
/end CHARACTERISTIC
/begin CHARACTERISTIC fmy_id_com_2_hiv.dtc "DTC table declaration for the diagnosis instance XX" MAP 0xa0803048 _REC_MAP_20_u2_u2_u2 65535. _CNV_A_R_LINEAR_____0_CM 0. 65535. DISPLAY_IDENTIFIER ID_ERR_DTC_COM_2_HIV FORMAT "%5.0"
 /begin AXIS_DESCR COM_AXIS errm_online_dummy _CNV_S_2_ERRM_DTC_R_477_CM 1 0. 1. AXIS_PTS_REF ldp_nr_1_id_err_dtc /end AXIS_DESCR
 /begin AXIS_DESCR COM_AXIS errm_online_dummy _CNV_S_6_ERRM_DTC_R_478_CM 6 0. 5. AXIS_PTS_REF ldp_nr_2_id_err_dtc /end AXIS_DESCR
/end CHARACTERISTIC
/begin CHARACTERISTIC fmy_id_com_2_icl.dtc "DTC table declaration for the diagnosis instance XX" MAP 0xa080305c _REC_MAP_20_u2_u2_u2 65535. _CNV_A_R_LINEAR_____0_CM 0. 65535. DISPLAY_IDENTIFIER ID_ERR_DTC_COM_2_ICL FORMAT "%5.0"
 /begin AXIS_DESCR COM_AXIS errm_online_dummy _CNV_S_2_ERRM_DTC_R_477_CM 1 0. 1. AXIS_PTS_REF ldp_nr_1_id_err_dtc /end AXIS_DESCR
 /begin AXIS_DESCR COM_AXIS errm_online_dummy _CNV_S_6_ERRM_DTC_R_478_CM 6 0. 5. AXIS_PTS_REF ldp_nr_2_id_err_dtc /end AXIS_DESCR
/end CHARACTERISTIC
/begin CHARACTERISTIC fmy_id_com_2_gear_rev.dtc "DTC table declaration for the diagnosis instance XX" MAP 0xa0803034 _REC_MAP_20_u2_u2_u2 65535. _CNV_A_R_LINEAR_____0_CM 0. 65535. DISPLAY_IDENTIFIER ID_ERR_DTC_COM_2_GEAR_REV FORMAT "%5.0"
 /begin AXIS_DESCR COM_AXIS errm_online_dummy _CNV_S_2_ERRM_DTC_R_477_CM 1 0. 1. AXIS_PTS_REF ldp_nr_1_id_err_dtc /end AXIS_DESCR
 /begin AXIS_DESCR COM_AXIS errm_online_dummy _CNV_S_6_ERRM_DTC_R_478_CM 6 0. 5. AXIS_PTS_REF ldp_nr_2_id_err_dtc /end AXIS_DESCR
/end CHARACTERISTIC
/begin CHARACTERISTIC fmy_id_com_2_cdn_door.dtc "DTC table declaration for the diagnosis instance XX" MAP 0xa0802fd0 _REC_MAP_20_u2_u2_u2 65535. _CNV_A_R_LINEAR_____0_CM 0. 65535. DISPLAY_IDENTIFIER ID_ERR_DTC_COM_2_CDN_DOOR FORMAT "%5.0"
 /begin AXIS_DESCR COM_AXIS errm_online_dummy _CNV_S_2_ERRM_DTC_R_477_CM 1 0. 1. AXIS_PTS_REF ldp_nr_1_id_err_dtc /end AXIS_DESCR
 /begin AXIS_DESCR COM_AXIS errm_online_dummy _CNV_S_6_ERRM_DTC_R_478_CM 6 0. 5. AXIS_PTS_REF ldp_nr_2_id_err_dtc /end AXIS_DESCR
/end CHARACTERISTIC
/begin CHARACTERISTIC fmy_id_com_3_boff.dtc "DTC table declaration for the diagnosis instance XX" MAP 0xa0803124 _REC_MAP_20_u2_u2_u2 65535. _CNV_A_R_LINEAR_____0_CM 0. 65535. DISPLAY_IDENTIFIER ID_ERR_DTC_COM_3_BOFF FORMAT "%5.0"
 /begin AXIS_DESCR COM_AXIS errm_online_dummy _CNV_S_2_ERRM_DTC_R_477_CM 1 0. 1. AXIS_PTS_REF ldp_nr_1_id_err_dtc /end AXIS_DESCR
 /begin AXIS_DESCR COM_AXIS errm_online_dummy _CNV_S_6_ERRM_DTC_R_478_CM 6 0. 5. AXIS_PTS_REF ldp_nr_2_id_err_dtc /end AXIS_DESCR
/end CHARACTERISTIC
/begin CHARACTERISTIC fmy_id_com_3_efp.dtc "DTC table declaration for the diagnosis instance XX" MAP 0xa0803138 _REC_MAP_20_u2_u2_u2 65535. _CNV_A_R_LINEAR_____0_CM 0. 65535. DISPLAY_IDENTIFIER ID_ERR_DTC_COM_3_EFP FORMAT "%5.0"
 /begin AXIS_DESCR COM_AXIS errm_online_dummy _CNV_S_2_ERRM_DTC_R_477_CM 1 0. 1. AXIS_PTS_REF ldp_nr_1_id_err_dtc /end AXIS_DESCR
 /begin AXIS_DESCR COM_AXIS errm_online_dummy _CNV_S_6_ERRM_DTC_R_478_CM 6 0. 5. AXIS_PTS_REF ldp_nr_2_id_err_dtc /end AXIS_DESCR
/end CHARACTERISTIC
/begin CHARACTERISTIC fmy_id_com_3_tq_etcu.dtc "DTC table declaration for the diagnosis instance XX" MAP 0xa080319c _REC_MAP_20_u2_u2_u2 65535. _CNV_A_R_LINEAR_____0_CM 0. 65535. DISPLAY_IDENTIFIER ID_ERR_DTC_COM_3_TQ_ETCU FORMAT "%5.0"
 /begin AXIS_DESCR COM_AXIS errm_online_dummy _CNV_S_2_ERRM_DTC_R_477_CM 1 0. 1. AXIS_PTS_REF ldp_nr_1_id_err_dtc /end AXIS_DESCR
 /begin AXIS_DESCR COM_AXIS errm_online_dummy _CNV_S_6_ERRM_DTC_R_478_CM 6 0. 5. AXIS_PTS_REF ldp_nr_2_id_err_dtc /end AXIS_DESCR
/end CHARACTERISTIC
/begin CHARACTERISTIC fmy_id_com_3_etcu.dtc "DTC table declaration for the diagnosis instance XX" MAP 0xa080314c _REC_MAP_20_u2_u2_u2 65535. _CNV_A_R_LINEAR_____0_CM 0. 65535. DISPLAY_IDENTIFIER ID_ERR_DTC_COM_3_ETCU FORMAT "%5.0"
 /begin AXIS_DESCR COM_AXIS errm_online_dummy _CNV_S_2_ERRM_DTC_R_477_CM 1 0. 1. AXIS_PTS_REF ldp_nr_1_id_err_dtc /end AXIS_DESCR
 /begin AXIS_DESCR COM_AXIS errm_online_dummy _CNV_S_6_ERRM_DTC_R_478_CM 6 0. 5. AXIS_PTS_REF ldp_nr_2_id_err_dtc /end AXIS_DESCR
/end CHARACTERISTIC
/begin CHARACTERISTIC fmy_id_com_3_etcu_disp.dtc "DTC table declaration for the diagnosis instance XX" MAP 0xa0803160 _REC_MAP_20_u2_u2_u2 65535. _CNV_A_R_LINEAR_____0_CM 0. 65535. DISPLAY_IDENTIFIER ID_ERR_DTC_COM_3_ETCU_DISP FORMAT "%5.0"
 /begin AXIS_DESCR COM_AXIS errm_online_dummy _CNV_S_2_ERRM_DTC_R_477_CM 1 0. 1. AXIS_PTS_REF ldp_nr_1_id_err_dtc /end AXIS_DESCR
 /begin AXIS_DESCR COM_AXIS errm_online_dummy _CNV_S_6_ERRM_DTC_R_478_CM 6 0. 5. AXIS_PTS_REF ldp_nr_2_id_err_dtc /end AXIS_DESCR
/end CHARACTERISTIC
/begin CHARACTERISTIC fmy_id_com_3_etcu_obd.dtc "DTC table declaration for the diagnosis instance XX" MAP 0xa0803174 _REC_MAP_20_u2_u2_u2 65535. _CNV_A_R_LINEAR_____0_CM 0. 65535. DISPLAY_IDENTIFIER ID_ERR_DTC_COM_3_ETCU_OBD FORMAT "%5.0"
 /begin AXIS_DESCR COM_AXIS errm_online_dummy _CNV_S_2_ERRM_DTC_R_477_CM 1 0. 1. AXIS_PTS_REF ldp_nr_1_id_err_dtc /end AXIS_DESCR
 /begin AXIS_DESCR COM_AXIS errm_online_dummy _CNV_S_6_ERRM_DTC_R_478_CM 6 0. 5. AXIS_PTS_REF ldp_nr_2_id_err_dtc /end AXIS_DESCR
/end CHARACTERISTIC
/begin CHARACTERISTIC fmy_id_com_3_gb.dtc "DTC table declaration for the diagnosis instance XX" MAP 0xa0803188 _REC_MAP_20_u2_u2_u2 65535. _CNV_A_R_LINEAR_____0_CM 0. 65535. DISPLAY_IDENTIFIER ID_ERR_DTC_COM_3_GB FORMAT "%5.0"
 /begin AXIS_DESCR COM_AXIS errm_online_dummy _CNV_S_2_ERRM_DTC_R_477_CM 1 0. 1. AXIS_PTS_REF ldp_nr_1_id_err_dtc /end AXIS_DESCR
 /begin AXIS_DESCR COM_AXIS errm_online_dummy _CNV_S_6_ERRM_DTC_R_478_CM 6 0. 5. AXIS_PTS_REF ldp_nr_2_id_err_dtc /end AXIS_DESCR
/end CHARACTERISTIC
/begin CHARACTERISTIC fmy_id_teg_sens_1.dtc "DTC table declaration for the diagnosis instance XX" MAP 0xa08049c0 _REC_MAP_20_u2_u2_u2 65535. _CNV_A_R_LINEAR_____0_CM 0. 65535. DISPLAY_IDENTIFIER ID_ERR_DTC_TEG_SENS_1 FORMAT "%5.0"
 /begin AXIS_DESCR COM_AXIS errm_online_dummy _CNV_S_2_ERRM_DTC_R_477_CM 1 0. 1. AXIS_PTS_REF ldp_nr_1_id_err_dtc /end AXIS_DESCR
 /begin AXIS_DESCR COM_AXIS errm_online_dummy _CNV_S_6_ERRM_DTC_R_478_CM 6 0. 5. AXIS_PTS_REF ldp_nr_2_id_err_dtc /end AXIS_DESCR
/end CHARACTERISTIC
/begin CHARACTERISTIC fmy_id_teg_sens_2.dtc "DTC table declaration for the diagnosis instance XX" MAP 0xa08049d4 _REC_MAP_20_u2_u2_u2 65535. _CNV_A_R_LINEAR_____0_CM 0. 65535. DISPLAY_IDENTIFIER ID_ERR_DTC_TEG_SENS_2 FORMAT "%5.0"
 /begin AXIS_DESCR COM_AXIS errm_online_dummy _CNV_S_2_ERRM_DTC_R_477_CM 1 0. 1. AXIS_PTS_REF ldp_nr_1_id_err_dtc /end AXIS_DESCR
 /begin AXIS_DESCR COM_AXIS errm_online_dummy _CNV_S_6_ERRM_DTC_R_478_CM 6 0. 5. AXIS_PTS_REF ldp_nr_2_id_err_dtc /end AXIS_DESCR
/end CHARACTERISTIC
/begin CHARACTERISTIC fmy_id_amp_plaus_cus.dtc "DTC table declaration for the diagnosis instance XX" MAP 0xa0802a30 _REC_MAP_20_u2_u2_u2 65535. _CNV_A_R_LINEAR_____0_CM 0. 65535. DISPLAY_IDENTIFIER ID_ERR_DTC_AMP_PLAUS_CUS FORMAT "%5.0"
 /begin AXIS_DESCR COM_AXIS errm_online_dummy _CNV_S_2_ERRM_DTC_R_477_CM 1 0. 1. AXIS_PTS_REF ldp_nr_1_id_err_dtc /end AXIS_DESCR
 /begin AXIS_DESCR COM_AXIS errm_online_dummy _CNV_S_6_ERRM_DTC_R_478_CM 6 0. 5. AXIS_PTS_REF ldp_nr_2_id_err_dtc /end AXIS_DESCR
/end CHARACTERISTIC
/begin CHARACTERISTIC fmy_id_tcha_prs_low.dtc "DTC table declaration for the diagnosis instance XX" MAP 0xa08048e4 _REC_MAP_20_u2_u2_u2 65535. _CNV_A_R_LINEAR_____0_CM 0. 65535. DISPLAY_IDENTIFIER ID_ERR_DTC_TCHA_PRS_LOW FORMAT "%5.0"
 /begin AXIS_DESCR COM_AXIS errm_online_dummy _CNV_S_2_ERRM_DTC_R_477_CM 1 0. 1. AXIS_PTS_REF ldp_nr_1_id_err_dtc /end AXIS_DESCR
 /begin AXIS_DESCR COM_AXIS errm_online_dummy _CNV_S_6_ERRM_DTC_R_478_CM 6 0. 5. AXIS_PTS_REF ldp_nr_2_id_err_dtc /end AXIS_DESCR
/end CHARACTERISTIC
/begin CHARACTERISTIC fmy_id_tcha_leak.dtc "DTC table declaration for the diagnosis instance XX" MAP 0xa08048a8 _REC_MAP_20_u2_u2_u2 65535. _CNV_A_R_LINEAR_____0_CM 0. 65535. DISPLAY_IDENTIFIER ID_ERR_DTC_TCHA_LEAK FORMAT "%5.0"
 /begin AXIS_DESCR COM_AXIS errm_online_dummy _CNV_S_2_ERRM_DTC_R_477_CM 1 0. 1. AXIS_PTS_REF ldp_nr_1_id_err_dtc /end AXIS_DESCR
 /begin AXIS_DESCR COM_AXIS errm_online_dummy _CNV_S_6_ERRM_DTC_R_478_CM 6 0. 5. AXIS_PTS_REF ldp_nr_2_id_err_dtc /end AXIS_DESCR
/end CHARACTERISTIC
/begin CHARACTERISTIC fmy_id_tcha_prs_dif.dtc "DTC table declaration for the diagnosis instance XX" MAP 0xa08048bc _REC_MAP_20_u2_u2_u2 65535. _CNV_A_R_LINEAR_____0_CM 0. 65535. DISPLAY_IDENTIFIER ID_ERR_DTC_TCHA_PRS_DIF FORMAT "%5.0"
 /begin AXIS_DESCR COM_AXIS errm_online_dummy _CNV_S_2_ERRM_DTC_R_477_CM 1 0. 1. AXIS_PTS_REF ldp_nr_1_id_err_dtc /end AXIS_DESCR
 /begin AXIS_DESCR COM_AXIS errm_online_dummy _CNV_S_6_ERRM_DTC_R_478_CM 6 0. 5. AXIS_PTS_REF ldp_nr_2_id_err_dtc /end AXIS_DESCR
/end CHARACTERISTIC
/begin CHARACTERISTIC fmy_id_tcha_prs_high.dtc "DTC table declaration for the diagnosis instance XX" MAP 0xa08048d0 _REC_MAP_20_u2_u2_u2 65535. _CNV_A_R_LINEAR_____0_CM 0. 65535. DISPLAY_IDENTIFIER ID_ERR_DTC_TCHA_PRS_HIGH FORMAT "%5.0"
 /begin AXIS_DESCR COM_AXIS errm_online_dummy _CNV_S_2_ERRM_DTC_R_477_CM 1 0. 1. AXIS_PTS_REF ldp_nr_1_id_err_dtc /end AXIS_DESCR
 /begin AXIS_DESCR COM_AXIS errm_online_dummy _CNV_S_6_ERRM_DTC_R_478_CM 6 0. 5. AXIS_PTS_REF ldp_nr_2_id_err_dtc /end AXIS_DESCR
/end CHARACTERISTIC
/begin CHARACTERISTIC fmy_id_put_plaus.dtc "DTC table declaration for the diagnosis instance XX" MAP 0xa08043f8 _REC_MAP_20_u2_u2_u2 65535. _CNV_A_R_LINEAR_____0_CM 0. 65535. DISPLAY_IDENTIFIER ID_ERR_DTC_PUT_PLAUS FORMAT "%5.0"
 /begin AXIS_DESCR COM_AXIS errm_online_dummy _CNV_S_2_ERRM_DTC_R_477_CM 1 0. 1. AXIS_PTS_REF ldp_nr_1_id_err_dtc /end AXIS_DESCR
 /begin AXIS_DESCR COM_AXIS errm_online_dummy _CNV_S_6_ERRM_DTC_R_478_CM 6 0. 5. AXIS_PTS_REF ldp_nr_2_id_err_dtc /end AXIS_DESCR
/end CHARACTERISTIC
/begin CHARACTERISTIC fmy_id_map_plaus.dtc "DTC table declaration for the diagnosis instance XX" MAP 0xa0803ef8 _REC_MAP_20_u2_u2_u2 65535. _CNV_A_R_LINEAR_____0_CM 0. 65535. DISPLAY_IDENTIFIER ID_ERR_DTC_MAP_PLAUS FORMAT "%5.0"
 /begin AXIS_DESCR COM_AXIS errm_online_dummy _CNV_S_2_ERRM_DTC_R_477_CM 1 0. 1. AXIS_PTS_REF ldp_nr_1_id_err_dtc /end AXIS_DESCR
 /begin AXIS_DESCR COM_AXIS errm_online_dummy _CNV_S_6_ERRM_DTC_R_478_CM 6 0. 5. AXIS_PTS_REF ldp_nr_2_id_err_dtc /end AXIS_DESCR
/end CHARACTERISTIC
/begin CHARACTERISTIC fmy_id_tq_cst.dtc "DTC table declaration for the diagnosis instance XX" MAP 0xa0804c40 _REC_MAP_20_u2_u2_u2 65535. _CNV_A_R_LINEAR_____0_CM 0. 65535. DISPLAY_IDENTIFIER ID_ERR_DTC_TQ_CST FORMAT "%5.0"
 /begin AXIS_DESCR COM_AXIS errm_online_dummy _CNV_S_2_ERRM_DTC_R_477_CM 1 0. 1. AXIS_PTS_REF ldp_nr_1_id_err_dtc /end AXIS_DESCR
 /begin AXIS_DESCR COM_AXIS errm_online_dummy _CNV_S_6_ERRM_DTC_R_478_CM 6 0. 5. AXIS_PTS_REF ldp_nr_2_id_err_dtc /end AXIS_DESCR
/end CHARACTERISTIC
/begin CHARACTERISTIC fmy_id_gen_el.dtc "DTC table declaration for the diagnosis instance XX" MAP 0xa08038b8 _REC_MAP_20_u2_u2_u2 65535. _CNV_A_R_LINEAR_____0_CM 0. 65535. DISPLAY_IDENTIFIER ID_ERR_DTC_GEN_EL FORMAT "%5.0"
 /begin AXIS_DESCR COM_AXIS errm_online_dummy _CNV_S_2_ERRM_DTC_R_477_CM 1 0. 1. AXIS_PTS_REF ldp_nr_1_id_err_dtc /end AXIS_DESCR
 /begin AXIS_DESCR COM_AXIS errm_online_dummy _CNV_S_6_ERRM_DTC_R_478_CM 6 0. 5. AXIS_PTS_REF ldp_nr_2_id_err_dtc /end AXIS_DESCR
/end CHARACTERISTIC
/begin CHARACTERISTIC fmy_id_gen_mec.dtc "DTC table declaration for the diagnosis instance XX" MAP 0xa08038f4 _REC_MAP_20_u2_u2_u2 65535. _CNV_A_R_LINEAR_____0_CM 0. 65535. DISPLAY_IDENTIFIER ID_ERR_DTC_GEN_MEC FORMAT "%5.0"
 /begin AXIS_DESCR COM_AXIS errm_online_dummy _CNV_S_2_ERRM_DTC_R_477_CM 1 0. 1. AXIS_PTS_REF ldp_nr_1_id_err_dtc /end AXIS_DESCR
 /begin AXIS_DESCR COM_AXIS errm_online_dummy _CNV_S_6_ERRM_DTC_R_478_CM 6 0. 5. AXIS_PTS_REF ldp_nr_2_id_err_dtc /end AXIS_DESCR
/end CHARACTERISTIC
/begin CHARACTERISTIC fmy_id_gen_h_temp.dtc "DTC table declaration for the diagnosis instance XX" MAP 0xa08038cc _REC_MAP_20_u2_u2_u2 65535. _CNV_A_R_LINEAR_____0_CM 0. 65535. DISPLAY_IDENTIFIER ID_ERR_DTC_GEN_H_TEMP FORMAT "%5.0"
 /begin AXIS_DESCR COM_AXIS errm_online_dummy _CNV_S_2_ERRM_DTC_R_477_CM 1 0. 1. AXIS_PTS_REF ldp_nr_1_id_err_dtc /end AXIS_DESCR
 /begin AXIS_DESCR COM_AXIS errm_online_dummy _CNV_S_6_ERRM_DTC_R_478_CM 6 0. 5. AXIS_PTS_REF ldp_nr_2_id_err_dtc /end AXIS_DESCR
/end CHARACTERISTIC
/begin CHARACTERISTIC fmy_id_gen_typ_not_plaus.dtc "DTC table declaration for the diagnosis instance XX" MAP 0xa080391c _REC_MAP_20_u2_u2_u2 65535. _CNV_A_R_LINEAR_____0_CM 0. 65535. DISPLAY_IDENTIFIER ID_ERR_DTC_GEN_TYP_NOT_PLAUS FORMAT "%5.0"
 /begin AXIS_DESCR COM_AXIS errm_online_dummy _CNV_S_2_ERRM_DTC_R_477_CM 1 0. 1. AXIS_PTS_REF ldp_nr_1_id_err_dtc /end AXIS_DESCR
 /begin AXIS_DESCR COM_AXIS errm_online_dummy _CNV_S_6_ERRM_DTC_R_478_CM 6 0. 5. AXIS_PTS_REF ldp_nr_2_id_err_dtc /end AXIS_DESCR
/end CHARACTERISTIC
/begin CHARACTERISTIC fmy_id_gen_msg_lost.dtc "DTC table declaration for the diagnosis instance XX" MAP 0xa0803908 _REC_MAP_20_u2_u2_u2 65535. _CNV_A_R_LINEAR_____0_CM 0. 65535. DISPLAY_IDENTIFIER ID_ERR_DTC_GEN_MSG_LOST FORMAT "%5.0"
 /begin AXIS_DESCR COM_AXIS errm_online_dummy _CNV_S_2_ERRM_DTC_R_477_CM 1 0. 1. AXIS_PTS_REF ldp_nr_1_id_err_dtc /end AXIS_DESCR
 /begin AXIS_DESCR COM_AXIS errm_online_dummy _CNV_S_6_ERRM_DTC_R_478_CM 6 0. 5. AXIS_PTS_REF ldp_nr_2_id_err_dtc /end AXIS_DESCR
/end CHARACTERISTIC
/begin CHARACTERISTIC fmy_id_gen_clc_v_not_plaus.dtc "DTC table declaration for the diagnosis instance XX" MAP 0xa080387c _REC_MAP_20_u2_u2_u2 65535. _CNV_A_R_LINEAR_____0_CM 0. 65535. DISPLAY_IDENTIFIER ID_ERR_DTC_GEN_CLC_V_NOT_PLAUS FORMAT "%5.0"
 /begin AXIS_DESCR COM_AXIS errm_online_dummy _CNV_S_2_ERRM_DTC_R_477_CM 1 0. 1. AXIS_PTS_REF ldp_nr_1_id_err_dtc /end AXIS_DESCR
 /begin AXIS_DESCR COM_AXIS errm_online_dummy _CNV_S_6_ERRM_DTC_R_478_CM 6 0. 5. AXIS_PTS_REF ldp_nr_2_id_err_dtc /end AXIS_DESCR
/end CHARACTERISTIC
/begin CHARACTERISTIC fmy_id_gen_h_temp_clc.dtc "DTC table declaration for the diagnosis instance XX" MAP 0xa08038e0 _REC_MAP_20_u2_u2_u2 65535. _CNV_A_R_LINEAR_____0_CM 0. 65535. DISPLAY_IDENTIFIER ID_ERR_DTC_GEN_H_TEMP_CLC FORMAT "%5.0"
 /begin AXIS_DESCR COM_AXIS errm_online_dummy _CNV_S_2_ERRM_DTC_R_477_CM 1 0. 1. AXIS_PTS_REF ldp_nr_1_id_err_dtc /end AXIS_DESCR
 /begin AXIS_DESCR COM_AXIS errm_online_dummy _CNV_S_6_ERRM_DTC_R_478_CM 6 0. 5. AXIS_PTS_REF ldp_nr_2_id_err_dtc /end AXIS_DESCR
/end CHARACTERISTIC
/begin CHARACTERISTIC fmy_id_gen_ctl_not_plaus.dtc "DTC table declaration for the diagnosis instance XX" MAP 0xa0803890 _REC_MAP_20_u2_u2_u2 65535. _CNV_A_R_LINEAR_____0_CM 0. 65535. DISPLAY_IDENTIFIER ID_ERR_DTC_GEN_CTL_NOT_PLAUS FORMAT "%5.0"
 /begin AXIS_DESCR COM_AXIS errm_online_dummy _CNV_S_2_ERRM_DTC_R_477_CM 1 0. 1. AXIS_PTS_REF ldp_nr_1_id_err_dtc /end AXIS_DESCR
 /begin AXIS_DESCR COM_AXIS errm_online_dummy _CNV_S_6_ERRM_DTC_R_478_CM 6 0. 5. AXIS_PTS_REF ldp_nr_2_id_err_dtc /end AXIS_DESCR
/end CHARACTERISTIC
/begin CHARACTERISTIC fmy_id_slv_ivvt_in.dtc "DTC table declaration for the diagnosis instance XX" MAP 0xa08046dc _REC_MAP_20_u2_u2_u2 65535. _CNV_A_R_LINEAR_____0_CM 0. 65535. DISPLAY_IDENTIFIER ID_ERR_DTC_SLV_IVVT_IN FORMAT "%5.0"
 /begin AXIS_DESCR COM_AXIS errm_online_dummy _CNV_S_2_ERRM_DTC_R_477_CM 1 0. 1. AXIS_PTS_REF ldp_nr_1_id_err_dtc /end AXIS_DESCR
 /begin AXIS_DESCR COM_AXIS errm_online_dummy _CNV_S_6_ERRM_DTC_R_478_CM 6 0. 5. AXIS_PTS_REF ldp_nr_2_id_err_dtc /end AXIS_DESCR
/end CHARACTERISTIC
/begin CHARACTERISTIC fmy_id_slv_ivvt_ex.dtc "DTC table declaration for the diagnosis instance XX" MAP 0xa08046a0 _REC_MAP_20_u2_u2_u2 65535. _CNV_A_R_LINEAR_____0_CM 0. 65535. DISPLAY_IDENTIFIER ID_ERR_DTC_SLV_IVVT_EX FORMAT "%5.0"
 /begin AXIS_DESCR COM_AXIS errm_online_dummy _CNV_S_2_ERRM_DTC_R_477_CM 1 0. 1. AXIS_PTS_REF ldp_nr_1_id_err_dtc /end AXIS_DESCR
 /begin AXIS_DESCR COM_AXIS errm_online_dummy _CNV_S_6_ERRM_DTC_R_478_CM 6 0. 5. AXIS_PTS_REF ldp_nr_2_id_err_dtc /end AXIS_DESCR
/end CHARACTERISTIC
/begin CHARACTERISTIC fmy_id_conv_mon_1.dtc "DTC table declaration for the diagnosis instance XX" MAP 0xa08031b0 _REC_MAP_20_u2_u2_u2 65535. _CNV_A_R_LINEAR_____0_CM 0. 65535. DISPLAY_IDENTIFIER ID_ERR_DTC_CONV_MON_1 FORMAT "%5.0"
 /begin AXIS_DESCR COM_AXIS errm_online_dummy _CNV_S_2_ERRM_DTC_R_477_CM 1 0. 1. AXIS_PTS_REF ldp_nr_1_id_err_dtc /end AXIS_DESCR
 /begin AXIS_DESCR COM_AXIS errm_online_dummy _CNV_S_6_ERRM_DTC_R_478_CM 6 0. 5. AXIS_PTS_REF ldp_nr_2_id_err_dtc /end AXIS_DESCR
/end CHARACTERISTIC
/begin CHARACTERISTIC fmy_id_n_32_mon_1.dtc "DTC table declaration for the diagnosis instance XX" MAP 0xa08040d8 _REC_MAP_20_u2_u2_u2 65535. _CNV_A_R_LINEAR_____0_CM 0. 65535. DISPLAY_IDENTIFIER ID_ERR_DTC_N_32_MON_1 FORMAT "%5.0"
 /begin AXIS_DESCR COM_AXIS errm_online_dummy _CNV_S_2_ERRM_DTC_R_477_CM 1 0. 1. AXIS_PTS_REF ldp_nr_1_id_err_dtc /end AXIS_DESCR
 /begin AXIS_DESCR COM_AXIS errm_online_dummy _CNV_S_6_ERRM_DTC_R_478_CM 6 0. 5. AXIS_PTS_REF ldp_nr_2_id_err_dtc /end AXIS_DESCR
/end CHARACTERISTIC
/begin CHARACTERISTIC fmy_id_pvs_mon_1.dtc "DTC table declaration for the diagnosis instance XX" MAP 0xa080445c _REC_MAP_20_u2_u2_u2 65535. _CNV_A_R_LINEAR_____0_CM 0. 65535. DISPLAY_IDENTIFIER ID_ERR_DTC_PVS_MON_1 FORMAT "%5.0"
 /begin AXIS_DESCR COM_AXIS errm_online_dummy _CNV_S_2_ERRM_DTC_R_477_CM 1 0. 1. AXIS_PTS_REF ldp_nr_1_id_err_dtc /end AXIS_DESCR
 /begin AXIS_DESCR COM_AXIS errm_online_dummy _CNV_S_6_ERRM_DTC_R_478_CM 6 0. 5. AXIS_PTS_REF ldp_nr_2_id_err_dtc /end AXIS_DESCR
/end CHARACTERISTIC
/begin CHARACTERISTIC fmy_id_tq_dif_isc_mon_1.dtc "DTC table declaration for the diagnosis instance XX" MAP 0xa0804c54 _REC_MAP_20_u2_u2_u2 65535. _CNV_A_R_LINEAR_____0_CM 0. 65535. DISPLAY_IDENTIFIER ID_ERR_DTC_TQ_DIF_ISC_MON_1 FORMAT "%5.0"
 /begin AXIS_DESCR COM_AXIS errm_online_dummy _CNV_S_2_ERRM_DTC_R_477_CM 1 0. 1. AXIS_PTS_REF ldp_nr_1_id_err_dtc /end AXIS_DESCR
 /begin AXIS_DESCR COM_AXIS errm_online_dummy _CNV_S_6_ERRM_DTC_R_478_CM 6 0. 5. AXIS_PTS_REF ldp_nr_2_id_err_dtc /end AXIS_DESCR
/end CHARACTERISTIC
/begin CHARACTERISTIC fmy_id_tq_req_mon_1.dtc "DTC table declaration for the diagnosis instance XX" MAP 0xa0804c90 _REC_MAP_20_u2_u2_u2 65535. _CNV_A_R_LINEAR_____0_CM 0. 65535. DISPLAY_IDENTIFIER ID_ERR_DTC_TQ_REQ_MON_1 FORMAT "%5.0"
 /begin AXIS_DESCR COM_AXIS errm_online_dummy _CNV_S_2_ERRM_DTC_R_477_CM 1 0. 1. AXIS_PTS_REF ldp_nr_1_id_err_dtc /end AXIS_DESCR
 /begin AXIS_DESCR COM_AXIS errm_online_dummy _CNV_S_6_ERRM_DTC_R_478_CM 6 0. 5. AXIS_PTS_REF ldp_nr_2_id_err_dtc /end AXIS_DESCR
/end CHARACTERISTIC
/begin CHARACTERISTIC fmy_id_tq_ext_mon_1.dtc "DTC table declaration for the diagnosis instance XX" MAP 0xa0804c68 _REC_MAP_20_u2_u2_u2 65535. _CNV_A_R_LINEAR_____0_CM 0. 65535. DISPLAY_IDENTIFIER ID_ERR_DTC_TQ_EXT_MON_1 FORMAT "%5.0"
 /begin AXIS_DESCR COM_AXIS errm_online_dummy _CNV_S_2_ERRM_DTC_R_477_CM 1 0. 1. AXIS_PTS_REF ldp_nr_1_id_err_dtc /end AXIS_DESCR
 /begin AXIS_DESCR COM_AXIS errm_online_dummy _CNV_S_6_ERRM_DTC_R_478_CM 6 0. 5. AXIS_PTS_REF ldp_nr_2_id_err_dtc /end AXIS_DESCR
/end CHARACTERISTIC
/begin CHARACTERISTIC fmy_id_tqi_av_mon_1.dtc "DTC table declaration for the diagnosis instance XX" MAP 0xa0804ca4 _REC_MAP_20_u2_u2_u2 65535. _CNV_A_R_LINEAR_____0_CM 0. 65535. DISPLAY_IDENTIFIER ID_ERR_DTC_TQI_AV_MON_1 FORMAT "%5.0"
 /begin AXIS_DESCR COM_AXIS errm_online_dummy _CNV_S_2_ERRM_DTC_R_477_CM 1 0. 1. AXIS_PTS_REF ldp_nr_1_id_err_dtc /end AXIS_DESCR
 /begin AXIS_DESCR COM_AXIS errm_online_dummy _CNV_S_6_ERRM_DTC_R_478_CM 6 0. 5. AXIS_PTS_REF ldp_nr_2_id_err_dtc /end AXIS_DESCR
/end CHARACTERISTIC
/begin CHARACTERISTIC fmy_id_tqi_n_max_mon_1.dtc "DTC table declaration for the diagnosis instance XX" MAP 0xa0804ccc _REC_MAP_20_u2_u2_u2 65535. _CNV_A_R_LINEAR_____0_CM 0. 65535. DISPLAY_IDENTIFIER ID_ERR_DTC_TQI_N_MAX_MON_1 FORMAT "%5.0"
 /begin AXIS_DESCR COM_AXIS errm_online_dummy _CNV_S_2_ERRM_DTC_R_477_CM 1 0. 1. AXIS_PTS_REF ldp_nr_1_id_err_dtc /end AXIS_DESCR
 /begin AXIS_DESCR COM_AXIS errm_online_dummy _CNV_S_6_ERRM_DTC_R_478_CM 6 0. 5. AXIS_PTS_REF ldp_nr_2_id_err_dtc /end AXIS_DESCR
/end CHARACTERISTIC
/begin CHARACTERISTIC fmy_id_mff_mon_1.dtc "DTC table declaration for the diagnosis instance XX" MAP 0xa0803f98 _REC_MAP_20_u2_u2_u2 65535. _CNV_A_R_LINEAR_____0_CM 0. 65535. DISPLAY_IDENTIFIER ID_ERR_DTC_MFF_MON_1 FORMAT "%5.0"
 /begin AXIS_DESCR COM_AXIS errm_online_dummy _CNV_S_2_ERRM_DTC_R_477_CM 1 0. 1. AXIS_PTS_REF ldp_nr_1_id_err_dtc /end AXIS_DESCR
 /begin AXIS_DESCR COM_AXIS errm_online_dummy _CNV_S_6_ERRM_DTC_R_478_CM 6 0. 5. AXIS_PTS_REF ldp_nr_2_id_err_dtc /end AXIS_DESCR
/end CHARACTERISTIC
/begin CHARACTERISTIC fmy_id_cru_inh_mon_1.dtc "DTC table declaration for the diagnosis instance XX" MAP 0xa0803228 _REC_MAP_20_u2_u2_u2 65535. _CNV_A_R_LINEAR_____0_CM 0. 65535. DISPLAY_IDENTIFIER ID_ERR_DTC_CRU_INH_MON_1 FORMAT "%5.0"
 /begin AXIS_DESCR COM_AXIS errm_online_dummy _CNV_S_2_ERRM_DTC_R_477_CM 1 0. 1. AXIS_PTS_REF ldp_nr_1_id_err_dtc /end AXIS_DESCR
 /begin AXIS_DESCR COM_AXIS errm_online_dummy _CNV_S_6_ERRM_DTC_R_478_CM 6 0. 5. AXIS_PTS_REF ldp_nr_2_id_err_dtc /end AXIS_DESCR
/end CHARACTERISTIC
/begin CHARACTERISTIC fmy_id_swi_afs_mon.dtc "DTC table declaration for the diagnosis instance XX" MAP 0xa080477c _REC_MAP_20_u2_u2_u2 65535. _CNV_A_R_LINEAR_____0_CM 0. 65535. DISPLAY_IDENTIFIER ID_ERR_DTC_SWI_AFS_MON FORMAT "%5.0"
 /begin AXIS_DESCR COM_AXIS errm_online_dummy _CNV_S_2_ERRM_DTC_R_477_CM 1 0. 1. AXIS_PTS_REF ldp_nr_1_id_err_dtc /end AXIS_DESCR
 /begin AXIS_DESCR COM_AXIS errm_online_dummy _CNV_S_6_ERRM_DTC_R_478_CM 6 0. 5. AXIS_PTS_REF ldp_nr_2_id_err_dtc /end AXIS_DESCR
/end CHARACTERISTIC
/begin CHARACTERISTIC fmy_id_iv_0.dtc "DTC table declaration for the diagnosis instance XX" MAP 0xa0803bd8 _REC_MAP_20_u2_u2_u2 65535. _CNV_A_R_LINEAR_____0_CM 0. 65535. DISPLAY_IDENTIFIER ID_ERR_DTC_IV_0 FORMAT "%5.0"
 /begin AXIS_DESCR COM_AXIS errm_online_dummy _CNV_S_2_ERRM_DTC_R_477_CM 1 0. 1. AXIS_PTS_REF ldp_nr_1_id_err_dtc /end AXIS_DESCR
 /begin AXIS_DESCR COM_AXIS errm_online_dummy _CNV_S_6_ERRM_DTC_R_478_CM 6 0. 5. AXIS_PTS_REF ldp_nr_2_id_err_dtc /end AXIS_DESCR
/end CHARACTERISTIC
/begin CHARACTERISTIC fmy_id_iv_1.dtc "DTC table declaration for the diagnosis instance XX" MAP 0xa0803bec _REC_MAP_20_u2_u2_u2 65535. _CNV_A_R_LINEAR_____0_CM 0. 65535. DISPLAY_IDENTIFIER ID_ERR_DTC_IV_1 FORMAT "%5.0"
 /begin AXIS_DESCR COM_AXIS errm_online_dummy _CNV_S_2_ERRM_DTC_R_477_CM 1 0. 1. AXIS_PTS_REF ldp_nr_1_id_err_dtc /end AXIS_DESCR
 /begin AXIS_DESCR COM_AXIS errm_online_dummy _CNV_S_6_ERRM_DTC_R_478_CM 6 0. 5. AXIS_PTS_REF ldp_nr_2_id_err_dtc /end AXIS_DESCR
/end CHARACTERISTIC
/begin CHARACTERISTIC fmy_id_iv_2.dtc "DTC table declaration for the diagnosis instance XX" MAP 0xa0803c00 _REC_MAP_20_u2_u2_u2 65535. _CNV_A_R_LINEAR_____0_CM 0. 65535. DISPLAY_IDENTIFIER ID_ERR_DTC_IV_2 FORMAT "%5.0"
 /begin AXIS_DESCR COM_AXIS errm_online_dummy _CNV_S_2_ERRM_DTC_R_477_CM 1 0. 1. AXIS_PTS_REF ldp_nr_1_id_err_dtc /end AXIS_DESCR
 /begin AXIS_DESCR COM_AXIS errm_online_dummy _CNV_S_6_ERRM_DTC_R_478_CM 6 0. 5. AXIS_PTS_REF ldp_nr_2_id_err_dtc /end AXIS_DESCR
/end CHARACTERISTIC
/begin CHARACTERISTIC fmy_id_iv_3.dtc "DTC table declaration for the diagnosis instance XX" MAP 0xa0803c14 _REC_MAP_20_u2_u2_u2 65535. _CNV_A_R_LINEAR_____0_CM 0. 65535. DISPLAY_IDENTIFIER ID_ERR_DTC_IV_3 FORMAT "%5.0"
 /begin AXIS_DESCR COM_AXIS errm_online_dummy _CNV_S_2_ERRM_DTC_R_477_CM 1 0. 1. AXIS_PTS_REF ldp_nr_1_id_err_dtc /end AXIS_DESCR
 /begin AXIS_DESCR COM_AXIS errm_online_dummy _CNV_S_6_ERRM_DTC_R_478_CM 6 0. 5. AXIS_PTS_REF ldp_nr_2_id_err_dtc /end AXIS_DESCR
/end CHARACTERISTIC
/begin CHARACTERISTIC fmy_id_iv_4.dtc "DTC table declaration for the diagnosis instance XX" MAP 0xa0803c28 _REC_MAP_20_u2_u2_u2 65535. _CNV_A_R_LINEAR_____0_CM 0. 65535. DISPLAY_IDENTIFIER ID_ERR_DTC_IV_4 FORMAT "%5.0"
 /begin AXIS_DESCR COM_AXIS errm_online_dummy _CNV_S_2_ERRM_DTC_R_477_CM 1 0. 1. AXIS_PTS_REF ldp_nr_1_id_err_dtc /end AXIS_DESCR
 /begin AXIS_DESCR COM_AXIS errm_online_dummy _CNV_S_6_ERRM_DTC_R_478_CM 6 0. 5. AXIS_PTS_REF ldp_nr_2_id_err_dtc /end AXIS_DESCR
/end CHARACTERISTIC
/begin CHARACTERISTIC fmy_id_iv_5.dtc "DTC table declaration for the diagnosis instance XX" MAP 0xa0803c3c _REC_MAP_20_u2_u2_u2 65535. _CNV_A_R_LINEAR_____0_CM 0. 65535. DISPLAY_IDENTIFIER ID_ERR_DTC_IV_5 FORMAT "%5.0"
 /begin AXIS_DESCR COM_AXIS errm_online_dummy _CNV_S_2_ERRM_DTC_R_477_CM 1 0. 1. AXIS_PTS_REF ldp_nr_1_id_err_dtc /end AXIS_DESCR
 /begin AXIS_DESCR COM_AXIS errm_online_dummy _CNV_S_6_ERRM_DTC_R_478_CM 6 0. 5. AXIS_PTS_REF ldp_nr_2_id_err_dtc /end AXIS_DESCR
/end CHARACTERISTIC
/begin CHARACTERISTIC fmy_id_iv_6.dtc "DTC table declaration for the diagnosis instance XX" MAP 0xa0803c50 _REC_MAP_20_u2_u2_u2 65535. _CNV_A_R_LINEAR_____0_CM 0. 65535. DISPLAY_IDENTIFIER ID_ERR_DTC_IV_6 FORMAT "%5.0"
 /begin AXIS_DESCR COM_AXIS errm_online_dummy _CNV_S_2_ERRM_DTC_R_477_CM 1 0. 1. AXIS_PTS_REF ldp_nr_1_id_err_dtc /end AXIS_DESCR
 /begin AXIS_DESCR COM_AXIS errm_online_dummy _CNV_S_6_ERRM_DTC_R_478_CM 6 0. 5. AXIS_PTS_REF ldp_nr_2_id_err_dtc /end AXIS_DESCR
/end CHARACTERISTIC
/begin CHARACTERISTIC fmy_id_iv_7.dtc "DTC table declaration for the diagnosis instance XX" MAP 0xa0803c64 _REC_MAP_20_u2_u2_u2 65535. _CNV_A_R_LINEAR_____0_CM 0. 65535. DISPLAY_IDENTIFIER ID_ERR_DTC_IV_7 FORMAT "%5.0"
 /begin AXIS_DESCR COM_AXIS errm_online_dummy _CNV_S_2_ERRM_DTC_R_477_CM 1 0. 1. AXIS_PTS_REF ldp_nr_1_id_err_dtc /end AXIS_DESCR
 /begin AXIS_DESCR COM_AXIS errm_online_dummy _CNV_S_6_ERRM_DTC_R_478_CM 6 0. 5. AXIS_PTS_REF ldp_nr_2_id_err_dtc /end AXIS_DESCR
/end CHARACTERISTIC
/begin CHARACTERISTIC fmy_id_iv_sc_0.dtc "DTC table declaration for the diagnosis instance XX" MAP 0xa0803c78 _REC_MAP_20_u2_u2_u2 65535. _CNV_A_R_LINEAR_____0_CM 0. 65535. DISPLAY_IDENTIFIER ID_ERR_DTC_IV_SC_0 FORMAT "%5.0"
 /begin AXIS_DESCR COM_AXIS errm_online_dummy _CNV_S_2_ERRM_DTC_R_477_CM 1 0. 1. AXIS_PTS_REF ldp_nr_1_id_err_dtc /end AXIS_DESCR
 /begin AXIS_DESCR COM_AXIS errm_online_dummy _CNV_S_6_ERRM_DTC_R_478_CM 6 0. 5. AXIS_PTS_REF ldp_nr_2_id_err_dtc /end AXIS_DESCR
/end CHARACTERISTIC
/begin CHARACTERISTIC fmy_id_iv_sc_1.dtc "DTC table declaration for the diagnosis instance XX" MAP 0xa0803c8c _REC_MAP_20_u2_u2_u2 65535. _CNV_A_R_LINEAR_____0_CM 0. 65535. DISPLAY_IDENTIFIER ID_ERR_DTC_IV_SC_1 FORMAT "%5.0"
 /begin AXIS_DESCR COM_AXIS errm_online_dummy _CNV_S_2_ERRM_DTC_R_477_CM 1 0. 1. AXIS_PTS_REF ldp_nr_1_id_err_dtc /end AXIS_DESCR
 /begin AXIS_DESCR COM_AXIS errm_online_dummy _CNV_S_6_ERRM_DTC_R_478_CM 6 0. 5. AXIS_PTS_REF ldp_nr_2_id_err_dtc /end AXIS_DESCR
/end CHARACTERISTIC
/begin CHARACTERISTIC fmy_id_iv_sc_2.dtc "DTC table declaration for the diagnosis instance XX" MAP 0xa0803ca0 _REC_MAP_20_u2_u2_u2 65535. _CNV_A_R_LINEAR_____0_CM 0. 65535. DISPLAY_IDENTIFIER ID_ERR_DTC_IV_SC_2 FORMAT "%5.0"
 /begin AXIS_DESCR COM_AXIS errm_online_dummy _CNV_S_2_ERRM_DTC_R_477_CM 1 0. 1. AXIS_PTS_REF ldp_nr_1_id_err_dtc /end AXIS_DESCR
 /begin AXIS_DESCR COM_AXIS errm_online_dummy _CNV_S_6_ERRM_DTC_R_478_CM 6 0. 5. AXIS_PTS_REF ldp_nr_2_id_err_dtc /end AXIS_DESCR
/end CHARACTERISTIC
/begin CHARACTERISTIC fmy_id_iv_sc_3.dtc "DTC table declaration for the diagnosis instance XX" MAP 0xa0803cb4 _REC_MAP_20_u2_u2_u2 65535. _CNV_A_R_LINEAR_____0_CM 0. 65535. DISPLAY_IDENTIFIER ID_ERR_DTC_IV_SC_3 FORMAT "%5.0"
 /begin AXIS_DESCR COM_AXIS errm_online_dummy _CNV_S_2_ERRM_DTC_R_477_CM 1 0. 1. AXIS_PTS_REF ldp_nr_1_id_err_dtc /end AXIS_DESCR
 /begin AXIS_DESCR COM_AXIS errm_online_dummy _CNV_S_6_ERRM_DTC_R_478_CM 6 0. 5. AXIS_PTS_REF ldp_nr_2_id_err_dtc /end AXIS_DESCR
/end CHARACTERISTIC
/begin CHARACTERISTIC fmy_id_iv_sc_4.dtc "DTC table declaration for the diagnosis instance XX" MAP 0xa0803cc8 _REC_MAP_20_u2_u2_u2 65535. _CNV_A_R_LINEAR_____0_CM 0. 65535. DISPLAY_IDENTIFIER ID_ERR_DTC_IV_SC_4 FORMAT "%5.0"
 /begin AXIS_DESCR COM_AXIS errm_online_dummy _CNV_S_2_ERRM_DTC_R_477_CM 1 0. 1. AXIS_PTS_REF ldp_nr_1_id_err_dtc /end AXIS_DESCR
 /begin AXIS_DESCR COM_AXIS errm_online_dummy _CNV_S_6_ERRM_DTC_R_478_CM 6 0. 5. AXIS_PTS_REF ldp_nr_2_id_err_dtc /end AXIS_DESCR
/end CHARACTERISTIC
/begin CHARACTERISTIC fmy_id_iv_sc_5.dtc "DTC table declaration for the diagnosis instance XX" MAP 0xa0803cdc _REC_MAP_20_u2_u2_u2 65535. _CNV_A_R_LINEAR_____0_CM 0. 65535. DISPLAY_IDENTIFIER ID_ERR_DTC_IV_SC_5 FORMAT "%5.0"
 /begin AXIS_DESCR COM_AXIS errm_online_dummy _CNV_S_2_ERRM_DTC_R_477_CM 1 0. 1. AXIS_PTS_REF ldp_nr_1_id_err_dtc /end AXIS_DESCR
 /begin AXIS_DESCR COM_AXIS errm_online_dummy _CNV_S_6_ERRM_DTC_R_478_CM 6 0. 5. AXIS_PTS_REF ldp_nr_2_id_err_dtc /end AXIS_DESCR
/end CHARACTERISTIC
/begin CHARACTERISTIC fmy_id_iv_sc_6.dtc "DTC table declaration for the diagnosis instance XX" MAP 0xa0803cf0 _REC_MAP_20_u2_u2_u2 65535. _CNV_A_R_LINEAR_____0_CM 0. 65535. DISPLAY_IDENTIFIER ID_ERR_DTC_IV_SC_6 FORMAT "%5.0"
 /begin AXIS_DESCR COM_AXIS errm_online_dummy _CNV_S_2_ERRM_DTC_R_477_CM 1 0. 1. AXIS_PTS_REF ldp_nr_1_id_err_dtc /end AXIS_DESCR
 /begin AXIS_DESCR COM_AXIS errm_online_dummy _CNV_S_6_ERRM_DTC_R_478_CM 6 0. 5. AXIS_PTS_REF ldp_nr_2_id_err_dtc /end AXIS_DESCR
/end CHARACTERISTIC
/begin CHARACTERISTIC fmy_id_iv_sc_7.dtc "DTC table declaration for the diagnosis instance XX" MAP 0xa0803d04 _REC_MAP_20_u2_u2_u2 65535. _CNV_A_R_LINEAR_____0_CM 0. 65535. DISPLAY_IDENTIFIER ID_ERR_DTC_IV_SC_7 FORMAT "%5.0"
 /begin AXIS_DESCR COM_AXIS errm_online_dummy _CNV_S_2_ERRM_DTC_R_477_CM 1 0. 1. AXIS_PTS_REF ldp_nr_1_id_err_dtc /end AXIS_DESCR
 /begin AXIS_DESCR COM_AXIS errm_online_dummy _CNV_S_6_ERRM_DTC_R_478_CM 6 0. 5. AXIS_PTS_REF ldp_nr_2_id_err_dtc /end AXIS_DESCR
/end CHARACTERISTIC
/begin CHARACTERISTIC fmy_id_pbk_iv_1.dtc "DTC table declaration for the diagnosis instance XX" MAP 0xa080422c _REC_MAP_20_u2_u2_u2 65535. _CNV_A_R_LINEAR_____0_CM 0. 65535. DISPLAY_IDENTIFIER ID_ERR_DTC_PBK_IV_1 FORMAT "%5.0"
 /begin AXIS_DESCR COM_AXIS errm_online_dummy _CNV_S_2_ERRM_DTC_R_477_CM 1 0. 1. AXIS_PTS_REF ldp_nr_1_id_err_dtc /end AXIS_DESCR
 /begin AXIS_DESCR COM_AXIS errm_online_dummy _CNV_S_6_ERRM_DTC_R_478_CM 6 0. 5. AXIS_PTS_REF ldp_nr_2_id_err_dtc /end AXIS_DESCR
/end CHARACTERISTIC
/begin CHARACTERISTIC fmy_id_pbk_iv_2.dtc "DTC table declaration for the diagnosis instance XX" MAP 0xa0804240 _REC_MAP_20_u2_u2_u2 65535. _CNV_A_R_LINEAR_____0_CM 0. 65535. DISPLAY_IDENTIFIER ID_ERR_DTC_PBK_IV_2 FORMAT "%5.0"
 /begin AXIS_DESCR COM_AXIS errm_online_dummy _CNV_S_2_ERRM_DTC_R_477_CM 1 0. 1. AXIS_PTS_REF ldp_nr_1_id_err_dtc /end AXIS_DESCR
 /begin AXIS_DESCR COM_AXIS errm_online_dummy _CNV_S_6_ERRM_DTC_R_478_CM 6 0. 5. AXIS_PTS_REF ldp_nr_2_id_err_dtc /end AXIS_DESCR
/end CHARACTERISTIC
/begin CHARACTERISTIC fmy_id_pbk_iv_3.dtc "DTC table declaration for the diagnosis instance XX" MAP 0xa0804254 _REC_MAP_20_u2_u2_u2 65535. _CNV_A_R_LINEAR_____0_CM 0. 65535. DISPLAY_IDENTIFIER ID_ERR_DTC_PBK_IV_3 FORMAT "%5.0"
 /begin AXIS_DESCR COM_AXIS errm_online_dummy _CNV_S_2_ERRM_DTC_R_477_CM 1 0. 1. AXIS_PTS_REF ldp_nr_1_id_err_dtc /end AXIS_DESCR
 /begin AXIS_DESCR COM_AXIS errm_online_dummy _CNV_S_6_ERRM_DTC_R_478_CM 6 0. 5. AXIS_PTS_REF ldp_nr_2_id_err_dtc /end AXIS_DESCR
/end CHARACTERISTIC
/begin AXIS_PTS ldp_nr_1_id_err_dtc "" 0xa0802916 errm_online_dummy _REC_AXS_20_u2 1. _CNV_S_2_ERRM_DTC_R_477_CM 1 0. 1. /end AXIS_PTS
/begin AXIS_PTS ldp_nr_2_id_err_dtc "" 0xa080291c errm_online_dummy _REC_AXS_20_u2 5. _CNV_S_6_ERRM_DTC_R_478_CM 6 0. 5. /end AXIS_PTS
/begin COMPU_METHOD _CNV_A_R_LINEAR_____0_CM "" RAT_FUNC "%6.3" "-" COEFFS 0 1. 0. 0 0 1 /end COMPU_METHOD
/begin COMPU_METHOD _CNV_S_2_ERRM_DTC_R_477_CM "" TAB_VERB "%6.3" "-" COMPU_TAB_REF _CNV_S_2_ERRM_DTC_R_477 /end COMPU_METHOD
/begin COMPU_VTAB _CNV_S_2_ERRM_DTC_R_477 "" TAB_VERB 2 0 "OBD" 1 "CUS" /end COMPU_VTAB
/begin COMPU_METHOD _CNV_S_6_ERRM_DTC_R_478_CM "" TAB_VERB "%6.3" "-" COMPU_TAB_REF _CNV_S_6_ERRM_DTC_R_478 /end COMPU_METHOD
/begin COMPU_VTAB _CNV_S_6_ERRM_DTC_R_478 "" TAB_VERB 6 0 "SYM0" 1 "SYM1" 2 "SYM2" 3 "SYM3" 4 "GLOBAL" 5 "DTC" /end COMPU_VTAB
/begin RECORD_LAYOUT _REC_AXS_20_u2 NO_AXIS_PTS_X 1 UWORD AXIS_PTS_X 2 UWORD INDEX_INCR DIRECT /end RECORD_LAYOUT
/begin RECORD_LAYOUT _REC_MAP_20_u2_u2_u2 FNC_VALUES 1 UWORD COLUMN_DIR DIRECT /end RECORD_LAYOUT
/begin FUNCTION ERRM_DTC_Management "DTC_Management"
 /begin DEF_CHARACTERISTIC fmy_id_syn_crk_cam_ex_1.dtc fmy_id_tooth_off_in_1.dtc fmy_id_tooth_off_ex_1.dtc fmy_id_plaus_cam_in_2.dtc fmy_id_plaus_cam_ex_2.dtc fmy_id_syn_crk_cam_in_2.dtc fmy_id_syn_crk_cam_ex_2.dtc fmy_id_tooth_off_in_2.dtc fmy_id_tooth_off_ex_2.dtc fmy_id_can_boff.dtc fmy_id_rly_main.dtc fmy_id_rly_main_dly.dtc fmy_id_rly_accout.dtc fmy_id_isc.dtc fmy_id_isc_cst.dtc fmy_id_im_bls_plaus.dtc fmy_id_im_bts_plaus.dtc fmy_id_msw_tog.dtc fmy_id_msw_2.dtc fmy_id_msw_3.dtc fmy_id_mis_0.dtc fmy_id_mis_1.dtc fmy_id_mis_2.dtc fmy_id_mis_3.dtc fmy_id_mis_4.dtc fmy_id_mis_5.dtc fmy_id_mis_6.dtc fmy_id_mis_7.dtc fmy_id_mis_mpl.dtc fmy_id_mis_ftl_l.dtc fmy_id_ef.dtc fmy_id_tecu.dtc fmy_id_ebox_cfa.dtc fmy_id_ecu_ram.dtc fmy_id_tqi_lim.dtc fmy_id_dmtls.dtc fmy_id_dmtl_pump.dtc fmy_id_dmtlm.dtc fmy_id_rough_leak.dtc fmy_id_small_leak.dtc fmy_id_chk_fuc.dtc fmy_id_sof.dtc fmy_id_sof_req.dtc fmy_id_rly_crcv_heat.dtc fmy_id_rly_st.dtc fmy_id_bsd.dtc fmy_id_poil_swi.dtc fmy_id_tout_efp_can.dtc fmy_id_diagcps.dtc fmy_id_dcc.dtc fmy_id_ldm.dtc fmy_id_dmtlh.dtc fmy_id_cs.dtc fmy_id_spi_mps.dtc fmy_id_spi_knk.dtc fmy_id_sens_poil.dtc fmy_id_poil_dr.dtc fmy_id_bn_tq_dcc.dtc fmy_id_bn_tq_pste_2.dtc fmy_id_bn_tq_pste_3.dtc fmy_id_bn_ars.dtc fmy_id_bn_cas.dtc fmy_id_bn_tq_tcs.dtc fmy_id_bn_vs_tcs.dtc fmy_id_bn_tcs.dtc fmy_id_bn_tq_etcu.dtc fmy_id_bn_etcu.dtc fmy_id_bn_etcu_2.dtc fmy_id_bn_etcu_3.dtc fmy_id_bn_etcu_disp.dtc fmy_id_bn_tq_amt.dtc fmy_id_bn_acc.dtc fmy_id_bn_t_icl.dtc fmy_id_bn_veh_mod.dtc fmy_id_bn_km_icl.dtc fmy_id_bn_icl.dtc fmy_id_bn_pow_vb.dtc fmy_id_bn_pow_gen.dtc fmy_id_bn_msw.dtc fmy_id_bn_ang_pste.dtc fmy_id_bn_gear_rev.dtc fmy_id_bn_ltg_hdlp_l.dtc fmy_id_bn_ldm.dtc fmy_id_bn_trl.dtc fmy_id_bn_hiv.dtc fmy_id_bn_t_clk.dtc fmy_id_bn_efp_crash.dtc fmy_id_bn_cdn_door.dtc fmy_id_bn_req_pbr.dtc fmy_id_bn_pbr.dtc fmy_id_bn_efp.dtc fmy_id_load_tps_plaus.dtc fmy_id_egy_min.dtc fmy_id_locan_boff.dtc fmy_id_cwp_plaus.dtc fmy_id_cwp_int_off.dtc fmy_id_cwp_pwr.dtc fmy_id_cwp_com_plaus.dtc fmy_id_qoil_sens.dtc fmy_id_bat_sens.dtc fmy_id_bat_sens_it.dtc fmy_id_bat_sens_it_el.dtc fmy_id_ecu_nvmy.dtc fmy_id_gs.dtc fmy_id_plaus_igk_bn.dtc fmy_id_tq_req_can.dtc fmy_id_map_sens_1.dtc fmy_id_map_sens_2.dtc fmy_id_dtc_trm.dtc fmy_id_mec_ivvt_in_1.dtc fmy_id_mec_ivvt_in_2.dtc fmy_id_mec_ivvt_ex.dtc fmy_id_tout_nox_sens_1.dtc fmy_id_tout_nox_sens_2.dtc fmy_id_vvl_rot.dtc fmy_id_rly_vvl.dtc fmy_id_nox_sens_1.dtc fmy_id_ns_obd_1_1.dtc fmy_id_ns_obd_1_2.dtc fmy_id_ovl_ecu_vvl.dtc fmy_id_dr_sc_vvl.dtc fmy_id_crit_ovl_ecu_vvl.dtc fmy_id_nox_sens_2.dtc fmy_id_cur_h_vvl.dtc fmy_id_teg_pcat_down.dtc fmy_id_t_seg_er.dtc fmy_id_seg_ad_er.dtc fmy_id_vs_plaus.dtc fmy_id_ftl_obd.dtc fmy_id_ftl_le_can.dtc fmy_id_ftl_ri_can.dtc fmy_id_tia_plaus.dtc fmy_id_tam_can.dtc fmy_id_tam_plaus.dtc fmy_id_map_shift_1.dtc fmy_id_map_shift_2.dtc fmy_id_cat_diag_1.dtc fmy_id_cat_diag_2.dtc fmy_id_cat_diag_afl_1.dtc fmy_id_cat_diag_afl_2.dtc fmy_id_scg_ls_down_1.dtc fmy_id_scp_ls_down_1.dtc fmy_id_oc_ls_down_1.dtc fmy_id_puc_ls_down_1.dtc fmy_id_fl_ls_down_1.dtc fmy_id_lsl_up_if_1.dtc fmy_id_el_lsl_up_1.dtc fmy_id_lsh_up_1.dtc fmy_id_lsh_down_1.dtc fmy_id_vls_down_dif_1.dtc fmy_id_lsh_lsl_up_1.dtc fmy_id_air_lsl_up_1.dtc fmy_id_pue_ls_down_1.dtc fmy_id_swt_ls_down_1.dtc fmy_id_obd_lsh_down_1.dtc fmy_id_dyn_vld_ls_up_1.dtc fmy_id_puc_vld_ls_up_1.dtc fmy_id_obd_vld_lsh_up_1.dtc fmy_id_chk_ls_down_1.dtc fmy_id_shift_afl_lsl_up_1.dtc fmy_id_shift_afr_lsl_up_1.dtc fmy_id_oc_lsl_up_1.dtc fmy_id_delta_i_lam_1.dtc fmy_id_ofs_lsl_up_1.dtc fmy_id_ttip_mes_lsh_up_1.dtc fmy_id_ctl_lsl_up_1.dtc fmy_id_chg_ls_down.dtc fmy_id_scg_ls_down_2.dtc fmy_id_scp_ls_down_2.dtc fmy_id_oc_ls_down_2.dtc fmy_id_puc_ls_down_2.dtc fmy_id_fl_ls_down_2.dtc fmy_id_lsl_up_if_2.dtc fmy_id_el_lsl_up_2.dtc fmy_id_lsh_up_2.dtc fmy_id_lsh_down_2.dtc fmy_id_vls_down_dif_2.dtc fmy_id_lsh_lsl_up_2.dtc fmy_id_air_lsl_up_2.dtc fmy_id_pue_ls_down_2.dtc fmy_id_swt_ls_down_2.dtc fmy_id_obd_lsh_down_2.dtc fmy_id_dyn_vld_ls_up_2.dtc fmy_id_puc_vld_ls_up_2.dtc fmy_id_obd_vld_lsh_up_2.dtc fmy_id_chk_ls_down_2.dtc fmy_id_shift_afl_lsl_up_2.dtc fmy_id_shift_afr_lsl_up_2.dtc fmy_id_oc_lsl_up_2.dtc fmy_id_delta_i_lam_2.dtc fmy_id_ofs_lsl_up_2.dtc fmy_id_ttip_mes_lsh_up_2.dtc fmy_id_ctl_lsl_up_2.dtc fmy_id_chg_ls_up.dtc fmy_id_alter_com.dtc fmy_id_cwp_com.dtc fmy_id_qoil_com.dtc fmy_id_sens_bat_smt_com.dtc fmy_id_ecraspwm_fb.dtc fmy_id_ecras_el.dtc fmy_id_ecras_up_fb.dtc fmy_id_ecras_down_fb.dtc fmy_id_warm_rst.dtc fmy_id_acr_ad.dtc fmy_id_sens_acr.dtc fmy_id_acr_ctl.dtc fmy_id_acr_dr.dtc fmy_id_var_cod.dtc fmy_id_veh_pow_var.dtc fmy_id_fup_mfp_plaus.dtc fmy_id_h_prs_sys.dtc fmy_id_fup_0.dtc fmy_id_fup_1.dtc fmy_id_vcv_fpc_0.dtc fmy_id_fup_efp.dtc fmy_id_efppwm_plaus.dtc fmy_id_l_prs_sys.dtc fmy_id_vcv_fpc_1.dtc fmy_id_fsd_1.dtc fmy_id_fsd_2.dtc fmy_id_fsd_lam_lim_1.dtc fmy_id_fsd_lam_lim_2.dtc fmy_id_fsd_h_rng_1.dtc fmy_id_fsd_h_rng_2.dtc fmy_id_cyl_bal_lam_0.dtc fmy_id_cyl_bal_lam_1.dtc fmy_id_cyl_bal_lam_2.dtc fmy_id_cyl_bal_lam_3.dtc fmy_id_cyl_bal_lam_4.dtc fmy_id_cyl_bal_lam_5.dtc fmy_id_cyl_bal_lam_6.dtc fmy_id_cyl_bal_lam_7.dtc fmy_id_cyl_bal_er_0.dtc fmy_id_cyl_bal_er_1.dtc fmy_id_cyl_bal_er_2.dtc fmy_id_cyl_bal_er_3.dtc fmy_id_cyl_bal_er_4.dtc fmy_id_cyl_bal_er_5.dtc fmy_id_cyl_bal_er_6.dtc fmy_id_cyl_bal_er_7.dtc fmy_id_mon_3.dtc fmy_id_maf_frq_rng_0.dtc fmy_id_maf_frq_grd_0.dtc fmy_id_maf_frq_el_0.dtc fmy_id_maf_frq_rng_1.dtc fmy_id_maf_frq_grd_1.dtc fmy_id_maf_frq_el_1.dtc fmy_id_tps_1_1.dtc fmy_id_tps_1_2.dtc fmy_id_tps_2_1.dtc fmy_id_tps_2_2.dtc fmy_id_tps_maf_1_1.dtc fmy_id_tps_maf_1_2.dtc fmy_id_tps_maf_2_1.dtc fmy_id_tps_maf_2_2.dtc fmy_id_tps_ratio_1.dtc fmy_id_tps_ratio_2.dtc fmy_id_tps_ad_1.dtc fmy_id_tps_ad_2.dtc fmy_id_etc_pwm_1.dtc fmy_id_etc_pwm_2.dtc fmy_id_etc_ctl_1.dtc fmy_id_etc_ctl_2.dtc fmy_id_tps_ad_spr_1.dtc fmy_id_tps_ad_spr_2.dtc fmy_id_etc_dr_1.dtc fmy_id_etc_dr_2.dtc fmy_id_tps_st_chk_1.dtc fmy_id_tps_st_chk_2.dtc fmy_id_com_1_tq_loss_cord.dtc fmy_id_com_1_swi_gear.dtc fmy_id_com_1_veh_mod.dtc fmy_id_com_1_brake_tcs.dtc fmy_id_com_1_tq_driv_asi.dtc fmy_id_com_1_tq_tcs.dtc fmy_id_com_1_tqb_tcs.dtc fmy_id_com_1_wheel_tcs.dtc fmy_id_com_1_req_tqdw.dtc fmy_id_com_1_tq_pste.dtc fmy_id_com_1_ang_pste.dtc fmy_id_com_1_ac_trv.dtc fmy_id_com_1_ac_lgt.dtc fmy_id_com_1_tq_ars.dtc fmy_id_com_1_ars.dtc fmy_id_com_1_vs.dtc fmy_id_com_1_tcs.dtc fmy_id_com_1_boff.dtc fmy_id_com_2_efp_crash.dtc fmy_id_com_2_gb.dtc fmy_id_com_2_etcu.dtc fmy_id_com_2_tq_etcu.dtc fmy_id_com_2_state_veh.dtc fmy_id_com_2_cas_2.dtc fmy_id_com_2_acc.dtc fmy_id_com_2_km_icl.dtc fmy_id_com_2_t_icl.dtc fmy_id_com_2_tam_icl.dtc fmy_id_com_2_t_clk.dtc fmy_id_com_2_boff.dtc fmy_id_com_2_t_absl_icl.dtc fmy_id_com_2_cas.dtc fmy_id_com_2_etcu_disp.dtc fmy_id_com_2_pow_off.dtc fmy_id_com_2_abs_icl.dtc fmy_id_com_2_trl.dtc fmy_id_com_2_hiv.dtc fmy_id_com_2_icl.dtc fmy_id_com_2_gear_rev.dtc fmy_id_com_2_cdn_door.dtc fmy_id_com_3_boff.dtc fmy_id_com_3_efp.dtc fmy_id_com_3_tq_etcu.dtc fmy_id_com_3_etcu.dtc fmy_id_com_3_etcu_disp.dtc fmy_id_com_3_etcu_obd.dtc fmy_id_com_3_gb.dtc fmy_id_teg_sens_1.dtc fmy_id_teg_sens_2.dtc fmy_id_amp_plaus_cus.dtc fmy_id_tcha_prs_low.dtc fmy_id_tcha_leak.dtc fmy_id_tcha_prs_dif.dtc fmy_id_tcha_prs_high.dtc fmy_id_put_plaus.dtc fmy_id_map_plaus.dtc fmy_id_tq_cst.dtc fmy_id_gen_el.dtc fmy_id_gen_mec.dtc fmy_id_gen_h_temp.dtc fmy_id_gen_typ_not_plaus.dtc fmy_id_gen_msg_lost.dtc fmy_id_gen_clc_v_not_plaus.dtc fmy_id_gen_h_temp_clc.dtc fmy_id_gen_ctl_not_plaus.dtc fmy_id_slv_ivvt_in.dtc fmy_id_slv_ivvt_ex.dtc fmy_id_conv_mon_1.dtc fmy_id_n_32_mon_1.dtc fmy_id_pvs_mon_1.dtc fmy_id_tq_dif_isc_mon_1.dtc fmy_id_tq_req_mon_1.dtc fmy_id_tq_ext_mon_1.dtc fmy_id_tqi_av_mon_1.dtc fmy_id_tqi_n_max_mon_1.dtc fmy_id_mff_mon_1.dtc fmy_id_cru_inh_mon_1.dtc fmy_id_swi_afs_mon.dtc fmy_id_iv_0.dtc fmy_id_iv_1.dtc fmy_id_iv_2.dtc fmy_id_iv_3.dtc fmy_id_iv_4.dtc fmy_id_iv_5.dtc fmy_id_iv_6.dtc fmy_id_iv_7.dtc fmy_id_iv_sc_0.dtc fmy_id_iv_sc_1.dtc fmy_id_iv_sc_2.dtc fmy_id_iv_sc_3.dtc fmy_id_iv_sc_4.dtc fmy_id_iv_sc_5.dtc fmy_id_iv_sc_6.dtc fmy_id_iv_sc_7.dtc fmy_id_pbk_iv_1.dtc fmy_id_pbk_iv_2.dtc fmy_id_pbk_iv_3.dtc /end DEF_CHARACTERISTIC
/end FUNCTION
/end MODULE
/end PROJECT
