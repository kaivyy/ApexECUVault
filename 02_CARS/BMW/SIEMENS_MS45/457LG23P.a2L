ASAP2_VERSION 1 31
/begin PROJECT MS45 "BMW Motorsteuerung R6"
/begin HEADER "_default_HeaderComment" PROJECT_NO _57 /end HEADER
/begin MODULE _default_ModuleName "_default_ModuleLongIdentifier"
/begin MOD_COMMON "_default_ModCommonComment" DEPOSIT ABSOLUTE BYTE_ORDER MSB_FIRST ALIGNMENT_BYTE 1 ALIGNMENT_WORD 2 ALIGNMENT_LONG 4 ALIGNMENT_FLOAT32_IEEE 4 ALIGNMENT_FLOAT64_IEEE 8 /end MOD_COMMON
/begin MEASUREMENT t_mff_ad_min "Time indicating the minimum time for next requested lambda Adaptation" UWORD _CNV_A_R_LINEAR_____24_CM 1 100. 0. 6553.5 DISPLAY_IDENTIFIER T_MFF_AD_MIN ECU_ADDRESS 0x3fd4ac BYTE_ORDER MSB_LAST FORMAT "%6.1" /end MEASUREMENT
/begin MEASUREMENT lv_mff_ad_end "Logical value signals the temporary end of  lambda Adaptation" UBYTE _CNV_S_2_RANGE______2_CM 1 100. 0. 1. DISPLAY_IDENTIFIER LV_MFF_AD_END ECU_ADDRESS 0x3fe531 /end MEASUREMENT
/begin MEASUREMENT lv_mff_ad_ena_first "Logical value which indicates the first lambda Adaptation phase " UBYTE _CNV_S_2_RANGE______2_CM 1 100. 0. 1. DISPLAY_IDENTIFIER LV_MFF_AD_ENA_FIRST ECU_ADDRESS 0x3fe534 /end MEASUREMENT
/begin MEASUREMENT lv_lamb_ad_afs_req "Boolean for Combustion Manager to force lambda eq. 1 conditions for lambda Adaptation" UBYTE _CNV_S_2_RANGE______2_CM 1 100. 0. 1. DISPLAY_IDENTIFIER LV_LAMB_AD_AFS_REQ ECU_ADDRESS 0x3fe532 /end MEASUREMENT
/begin CHARACTERISTIC c_mff_ad_cor_crlc "Correlation constant  Lambdaadapatation at  LV_IS = 0" VALUE 0xffe4079d _REC_VAL_20_u1 0.99610001 _CNV_A_R_LINEAR_____29_CM 0. 0.99610001 DISPLAY_IDENTIFIER C_MFF_AD_COR_CRLC FORMAT "%5.3" /end CHARACTERISTIC
/begin CHARACTERISTIC c_lam_ad_sum_p_is "P component jump delay between two Adaptations in Idle" VALUE 0xffe40784 _REC_VAL_20_u1 254. _CNV_A_R_LINEAR_____0_CM 1. 255. DISPLAY_IDENTIFIER C_LAM_AD_SUM_P_IS FORMAT "%3.0" /end CHARACTERISTIC
/begin CHARACTERISTIC c_lam_ad_sum_p "P component jump delay between two Adaptations out of Idle" VALUE 0xffe40783 _REC_VAL_20_u1 255. _CNV_A_R_LINEAR_____0_CM 0. 255. DISPLAY_IDENTIFIER C_LAM_AD_SUM_P FORMAT "%3.0" /end CHARACTERISTIC
/begin CHARACTERISTIC ip_mff_ad_add_fac "Multiplicative factor on additive Adaptation value during warm-up" MAP 0xffe46c98 _REC_MAP_20_u1_u1_u2 0.99610001 _CNV_A_R_LINEAR_____29_CM 0. 0.99610001 DISPLAY_IDENTIFIER IP_MFF_AD_ADD_FAC FORMAT "%5.3"
 /begin AXIS_DESCR COM_AXIS tco _CNV_A_R_LINEAR_____11_CM 5 -48. 142.5 FORMAT "%5.1" AXIS_PTS_REF ldpm_tco_1_mff_ad /end AXIS_DESCR
 /begin AXIS_DESCR COM_AXIS online_dummy _CNV_A_R_LINEAR_____274_CM 5 -695. 694.97 FORMAT "%7.2" AXIS_PTS_REF ldp_mff_ad_add_mmv_2_mff_add /end AXIS_DESCR
/end CHARACTERISTIC
/begin CHARACTERISTIC ip_mff_ad_fac_fac "Multiplicative factor on multiplicative Adaptation value during warm-up" MAP 0xffe46cb1 _REC_MAP_20_u1_u1_u2 0.99610001 _CNV_A_R_LINEAR_____29_CM 0. 0.99610001 DISPLAY_IDENTIFIER IP_MFF_AD_FAC_FAC FORMAT "%5.3"
 /begin AXIS_DESCR COM_AXIS tco _CNV_A_R_LINEAR_____11_CM 5 -48. 142.5 FORMAT "%5.1" AXIS_PTS_REF ldpm_tco_1_mff_ad /end AXIS_DESCR
 /begin AXIS_DESCR COM_AXIS online_dummy _CNV_A_R_LINEAR_____262_CM 5 -50. 49.99847412 FORMAT "%7.3" AXIS_PTS_REF ldp_mff_ad_fac_mmv_2_mff_fac /end AXIS_DESCR
/end CHARACTERISTIC
/begin CHARACTERISTIC c_n_mff_ad_add_max "Maximum engine speed for additive Adaptation value calculation" VALUE 0xffe407ed _REC_VAL_20_u1 8160. _CNV_A_R_LINEAR_____15_CM 0. 8160. DISPLAY_IDENTIFIER C_N_MFF_AD_ADD_MAX FORMAT "%4.0" /end CHARACTERISTIC
/begin CHARACTERISTIC c_maf_mff_ad_add_max "Maximum MAF for additive Adaptation value calculation" VALUE 0xffe417bc _REC_VAL_20_u2 1389. _CNV_A_R_LINEAR_____108_CM 0. 1389. DISPLAY_IDENTIFIER C_MAF_MFF_AD_ADD_MAX FORMAT "%7.2" /end CHARACTERISTIC
/begin CHARACTERISTIC c_mff_ad_add_min "Minimum value of adaptive additive factor for injection" VALUE 0xffe4045a _REC_VAL_20_s2 1388.978806 _CNV_A_R_LINEAR_____257_CM -694.5 694.478806 DISPLAY_IDENTIFIER C_MFF_AD_ADD_MIN FORMAT "%7.2" /end CHARACTERISTIC
/begin CHARACTERISTIC c_mff_ad_add_max "Maximum value of adaptive additive factor for injection" VALUE 0xffe40458 _REC_VAL_20_s2 1388.978806 _CNV_A_R_LINEAR_____257_CM -694.5 694.478806 DISPLAY_IDENTIFIER C_MFF_AD_ADD_MAX FORMAT "%7.2" /end CHARACTERISTIC
/begin CHARACTERISTIC id_t_mff_ad_add "Minimum time for next requested lambda Adaptation according to additive factor difference" CURVE 0xffe48dc0 _REC_CUR_20_u2_u2 6553.5 _CNV_A_R_LINEAR_____24_CM 0. 6553.5 DISPLAY_IDENTIFIER ID_T_MFF_AD_ADD FORMAT "%6.1"
 /begin AXIS_DESCR COM_AXIS online_dummy _CNV_A_R_LINEAR_____274_CM 8 -695. 694.97 FORMAT "%7.2" AXIS_PTS_REF ldp_mff_ad_add_mmv_delta_add /end AXIS_DESCR
/end CHARACTERISTIC
/begin CHARACTERISTIC lc_mff_ad_add "Logical calibration to allow forced lambda-1 conditions for offset Adaptation" VALUE 0xffe40fa7 _REC_VAL_20_u1 1. _CNV_A_R_LINEAR_____0_CM 0. 1. DISPLAY_IDENTIFIER LC_MFF_AD_ADD FORMAT "%2.0" /end CHARACTERISTIC
/begin MEASUREMENT lv_mff_ad_cdn "Boolean for time scheduler indicating good conditions for lambda Adaptation" UBYTE _CNV_S_2_RANGE______2_CM 1 100. 0. 1. DISPLAY_IDENTIFIER LV_MFF_AD_CDN ECU_ADDRESS 0x3fe533 /end MEASUREMENT
/begin CHARACTERISTIC c_t_mff_ad_min_max "Maximum time to set temporary end of Adaptation flag" VALUE 0xffe419ae _REC_VAL_20_u2 6553.5 _CNV_A_R_LINEAR_____24_CM 0. 6553.5 DISPLAY_IDENTIFIER C_T_MFF_AD_MIN_MAX FORMAT "%6.1" /end CHARACTERISTIC
/begin CHARACTERISTIC ip_mff_ad_fac "Weighting factor for MFF_AD_FAC versus N" CURVE 0xffe40d1a _REC_CUR_20_u1_u1 0.99610001 _CNV_A_R_LINEAR_____29_CM 0. 0.99610001 DISPLAY_IDENTIFIER IP_MFF_AD_FAC FORMAT "%5.3"
 /begin AXIS_DESCR COM_AXIS n_32 _CNV_A_R_LINEAR_____15_CM 6 0. 8160. FORMAT "%4.0" AXIS_PTS_REF ldpm_n_32_1_mff_ad /end AXIS_DESCR
/end CHARACTERISTIC
/begin CHARACTERISTIC ip_mff_ad_add "Weighting factor for MFF_AD_ADD versus N" CURVE 0xffe40d14 _REC_CUR_20_u1_u1 1.99220002 _CNV_A_R_LINEAR_____39_CM 0. 1.99220002 DISPLAY_IDENTIFIER IP_MFF_AD_ADD FORMAT "%5.3"
 /begin AXIS_DESCR COM_AXIS n_32 _CNV_A_R_LINEAR_____15_CM 6 0. 8160. FORMAT "%4.0" AXIS_PTS_REF ldpm_n_32_1_mff_ad /end AXIS_DESCR
/end CHARACTERISTIC
/begin AXIS_PTS ldp_mff_ad_add_mmv_delta_add "" 0xffe50f1e online_dummy _REC_AXS_20_u2 1389.97 _CNV_A_R_LINEAR_____274_CM 8 -695. 694.97 DISPLAY_IDENTIFIER LDP_MFF_AD_ADD_MMV_DELTA_ADD FORMAT "%7.2" /end AXIS_PTS
/begin AXIS_PTS ldpm_tco_1_mff_ad "" 0xffe4142d tco _REC_AXS_20_u1 190.5 _CNV_A_R_LINEAR_____11_CM 5 -48. 142.5 DISPLAY_IDENTIFIER LDPM_TCO_1_MFF_AD FORMAT "%5.1" /end AXIS_PTS
/begin AXIS_PTS ldp_mff_ad_add_mmv_2_mff_add "" 0xffe50f12 online_dummy _REC_AXS_20_u2 1389.97 _CNV_A_R_LINEAR_____274_CM 5 -695. 694.97 DISPLAY_IDENTIFIER LDP_MFF_AD_ADD_MMV_2_MFF_ADD FORMAT "%7.2" /end AXIS_PTS
/begin AXIS_PTS ldp_mff_ad_fac_mmv_2_mff_fac "" 0xffe50f30 online_dummy _REC_AXS_20_u2 99.99847412 _CNV_A_R_LINEAR_____262_CM 5 -50. 49.99847412 DISPLAY_IDENTIFIER LDP_MFF_AD_FAC_MMV_2_MFF_FAC FORMAT "%7.3" /end AXIS_PTS
/begin AXIS_PTS ldpm_n_32_1_mff_ad "" 0xffe41395 n_32 _REC_AXS_20_u1 8160. _CNV_A_R_LINEAR_____15_CM 6 0. 8160. DISPLAY_IDENTIFIER LDPM_N_32_1_MFF_AD FORMAT "%4.0" /end AXIS_PTS
/begin CHARACTERISTIC c_maf_mff_ad_fac_l_min "Minimum MAF for multiplicative Adaptation value calculation at lower area" VALUE 0xffe417c0 _REC_VAL_20_u2 1389. _CNV_A_R_LINEAR_____108_CM 0. 1389. DISPLAY_IDENTIFIER C_MAF_MFF_AD_FAC_L_MIN FORMAT "%7.2" /end CHARACTERISTIC
/begin CHARACTERISTIC c_n_mff_ad_fac_h_min "Minimum engine speed for multiplicative Adaptation value calculation at higher area" VALUE 0xffe407ef _REC_VAL_20_u1 8160. _CNV_A_R_LINEAR_____15_CM 0. 8160. DISPLAY_IDENTIFIER C_N_MFF_AD_FAC_H_MIN FORMAT "%4.0" /end CHARACTERISTIC
/begin CHARACTERISTIC lc_mff_ad_fac_l "Logical calibration to allow forced lambda-1 conditions for gain Adaptation at lower area" VALUE 0xffe40fa9 _REC_VAL_20_u1 1. _CNV_A_R_LINEAR_____0_CM 0. 1. DISPLAY_IDENTIFIER LC_MFF_AD_FAC_L FORMAT "%2.0" /end CHARACTERISTIC
/begin CHARACTERISTIC lc_mff_ad_fac_h "Logical calibration to allow forced lambda-1 conditions for gain Adaptation at higher area" VALUE 0xffe40fa8 _REC_VAL_20_u1 1. _CNV_A_R_LINEAR_____0_CM 0. 1. DISPLAY_IDENTIFIER LC_MFF_AD_FAC_H FORMAT "%2.0" /end CHARACTERISTIC
/begin CHARACTERISTIC c_mff_ad_cor_crlc_is "Correlation constant  Lambdaadapatation at  LV_IS = 1" VALUE 0xffe4079f _REC_VAL_20_u1 0.99610001 _CNV_A_R_LINEAR_____29_CM 0. 0.99610001 DISPLAY_IDENTIFIER C_MFF_AD_COR_CRLC_IS FORMAT "%5.3" /end CHARACTERISTIC
/begin CHARACTERISTIC c_mff_ad_cor_crlc_h "Correlation constant  Lambda Adapatation at  the higher area" VALUE 0xffe4079e _REC_VAL_20_u1 0.99610001 _CNV_A_R_LINEAR_____29_CM 0. 0.99610001 DISPLAY_IDENTIFIER C_MFF_AD_COR_CRLC_H FORMAT "%5.3" /end CHARACTERISTIC
/begin CHARACTERISTIC c_mff_ad_fac_l_min "Minimum value of adaptive multiplicative factor for injection at lower area" VALUE 0xffe40462 _REC_VAL_20_s2 99.99847412 _CNV_A_R_LINEAR_____111_CM -50. 49.99847412 DISPLAY_IDENTIFIER C_MFF_AD_FAC_L_MIN FORMAT "%7.3" /end CHARACTERISTIC
/begin CHARACTERISTIC c_mff_ad_fac_h_min "Minimum value of adaptive multiplicative factor for injection at higher area" VALUE 0xffe4045e _REC_VAL_20_s2 99.99847412 _CNV_A_R_LINEAR_____111_CM -50. 49.99847412 DISPLAY_IDENTIFIER C_MFF_AD_FAC_H_MIN FORMAT "%7.3" /end CHARACTERISTIC
/begin CHARACTERISTIC c_mff_ad_fac_l_max "Maximum value of adaptive multiplicative factor for injection at lower area" VALUE 0xffe40460 _REC_VAL_20_s2 99.99847412 _CNV_A_R_LINEAR_____111_CM -50. 49.99847412 DISPLAY_IDENTIFIER C_MFF_AD_FAC_L_MAX FORMAT "%7.3" /end CHARACTERISTIC
/begin CHARACTERISTIC c_mff_ad_fac_h_max "Maximum value of adaptive multiplicative factor for injection at higher area" VALUE 0xffe4045c _REC_VAL_20_s2 99.99847412 _CNV_A_R_LINEAR_____111_CM -50. 49.99847412 DISPLAY_IDENTIFIER C_MFF_AD_FAC_H_MAX FORMAT "%7.3" /end CHARACTERISTIC
/begin CHARACTERISTIC c_n_mff_ad_fac_l_min "Minimum engine speed for multiplicative Adaptation value calculation at lower area" VALUE 0xffe407f0 _REC_VAL_20_u1 8160. _CNV_A_R_LINEAR_____15_CM 0. 8160. DISPLAY_IDENTIFIER C_N_MFF_AD_FAC_L_MIN FORMAT "%4.0" /end CHARACTERISTIC
/begin CHARACTERISTIC c_n_mff_ad_fac_h_max "Maximum engine speed for multiplicative Adaptation value calculation at higher area" VALUE 0xffe407ee _REC_VAL_20_u1 8160. _CNV_A_R_LINEAR_____15_CM 0. 8160. DISPLAY_IDENTIFIER C_N_MFF_AD_FAC_H_MAX FORMAT "%4.0" /end CHARACTERISTIC
/begin CHARACTERISTIC c_maf_mff_ad_fac_h_max "Maximum MAF for multiplicative Adaptation value calculation at higher area" VALUE 0xffe417be _REC_VAL_20_u2 1389. _CNV_A_R_LINEAR_____108_CM 0. 1389. DISPLAY_IDENTIFIER C_MAF_MFF_AD_FAC_H_MAX FORMAT "%7.2" /end CHARACTERISTIC
/begin CHARACTERISTIC c_maf_kgh_ad_fac_l "MAF_KGH threshold for consideration of only lower value MFF_AD_FAC_MMV_L" VALUE 0xffe4179a _REC_VAL_20_u2 2047.96875 _CNV_A_R_LINEAR_____115_CM 0. 2047.96875 DISPLAY_IDENTIFIER C_MAF_KGH_AD_FAC_L FORMAT "%7.2" /end CHARACTERISTIC
/begin CHARACTERISTIC c_maf_kgh_ad_fac_h "MAF_KGH threshold for consideration of only upper value MFF_AD_FAC_MMV_L" VALUE 0xffe41798 _REC_VAL_20_u2 2047.96875 _CNV_A_R_LINEAR_____115_CM 0. 2047.96875 DISPLAY_IDENTIFIER C_MAF_KGH_AD_FAC_H FORMAT "%7.2" /end CHARACTERISTIC
/begin CHARACTERISTIC id_t_mff_ad_fac_l "Minimum time for next requested lambda Adaptation according to multiplicative factor difference of lower area" CURVE 0xffe48de0 _REC_CUR_20_u2_u2 6553.5 _CNV_A_R_LINEAR_____24_CM 0. 6553.5 DISPLAY_IDENTIFIER ID_T_MFF_AD_FAC_L FORMAT "%6.1"
 /begin AXIS_DESCR COM_AXIS online_dummy _CNV_A_R_LINEAR_____262_CM 8 -50. 49.99847412 FORMAT "%7.3" AXIS_PTS_REF ldp_mff_ad_fac_mmv_delta_l /end AXIS_DESCR
/end CHARACTERISTIC
/begin CHARACTERISTIC id_t_mff_ad_fac_h "Minimum time for next requested lambda Adaptation according to multiplicative factor difference of higher area" CURVE 0xffe48dd0 _REC_CUR_20_u2_u2 6553.5 _CNV_A_R_LINEAR_____24_CM 0. 6553.5 DISPLAY_IDENTIFIER ID_T_MFF_AD_FAC_H FORMAT "%6.1"
 /begin AXIS_DESCR COM_AXIS online_dummy _CNV_A_R_LINEAR_____262_CM 8 -50. 49.99847412 FORMAT "%7.3" AXIS_PTS_REF ldp_mff_ad_fac_mmv_delta_h /end AXIS_DESCR
/end CHARACTERISTIC
/begin AXIS_PTS ldp_mff_ad_fac_mmv_delta_h "" 0xffe50f3c online_dummy _REC_AXS_20_u2 99.99847412 _CNV_A_R_LINEAR_____262_CM 8 -50. 49.99847412 DISPLAY_IDENTIFIER LDP_MFF_AD_FAC_MMV_DELTA_H FORMAT "%7.3" /end AXIS_PTS
/begin AXIS_PTS ldp_mff_ad_fac_mmv_delta_l "" 0xffe50f4e online_dummy _REC_AXS_20_u2 99.99847412 _CNV_A_R_LINEAR_____262_CM 8 -50. 49.99847412 DISPLAY_IDENTIFIER LDP_MFF_AD_FAC_MMV_DELTA_L FORMAT "%7.3" /end AXIS_PTS
/begin AXIS_PTS ldp_n_32_maf_mff_ad_fac_l_max "" 0xffe4111b n_32 _REC_AXS_20_u1 816. _CNV_A_R_LINEAR_____15_CM 6 0. 8160. DISPLAY_IDENTIFIER LDP_N_32_MAF_MFF_AD_FAC_L_MAX FORMAT "%4.0" /end AXIS_PTS
/begin CHARACTERISTIC ip_maf_mff_ad_fac_l_max "Maximum MAF for multiplicative adaptive learning at lower area" CURVE 0xffe40d02 _REC_CUR_20_u1_u1 1389. _CNV_A_R_LINEAR_____27_CM 0. 1389. DISPLAY_IDENTIFIER IP_MAF_MFF_AD_FAC_L_MAX FORMAT "%4.0"
 /begin AXIS_DESCR COM_AXIS n_32 _CNV_A_R_LINEAR_____15_CM 6 0. 8160. FORMAT "%4.0" AXIS_PTS_REF ldp_n_32_maf_mff_ad_fac_l_max /end AXIS_DESCR
/end CHARACTERISTIC
/begin AXIS_PTS ldpm_n_32_maf_mff_ad_fac_l_min "" 0xffe413e6 n_32 _REC_AXS_20_u1 816. _CNV_A_R_LINEAR_____15_CM 6 0. 8160. DISPLAY_IDENTIFIER LDPM_N_32_MAF_MFF_AD_FAC_L_MIN FORMAT "%4.0" /end AXIS_PTS
/begin AXIS_PTS ldpm_n_32_maf_mff_ad_fac_h_min "" 0xffe413df n_32 _REC_AXS_20_u1 816. _CNV_A_R_LINEAR_____15_CM 6 0. 8160. DISPLAY_IDENTIFIER LDPM_N_32_MAF_MFF_AD_FAC_H_MIN FORMAT "%4.0" /end AXIS_PTS
/begin CHARACTERISTIC ip_maf_mff_ad_fac_l_min "Minimum MAF for multiplicative adaptive learning at lower area" CURVE 0xffe40d08 _REC_CUR_20_u1_u1 1389. _CNV_A_R_LINEAR_____27_CM 0. 1389. DISPLAY_IDENTIFIER IP_MAF_MFF_AD_FAC_L_MIN FORMAT "%4.0"
 /begin AXIS_DESCR COM_AXIS n_32 _CNV_A_R_LINEAR_____15_CM 6 0. 8160. FORMAT "%4.0" AXIS_PTS_REF ldpm_n_32_maf_mff_ad_fac_l_min /end AXIS_DESCR
/end CHARACTERISTIC
/begin CHARACTERISTIC ip_maf_mff_ad_fac_h_min "Minimum MAF for multiplicative adaptive learning at higher area" CURVE 0xffe40cfc _REC_CUR_20_u1_u1 1389. _CNV_A_R_LINEAR_____27_CM 0. 1389. DISPLAY_IDENTIFIER IP_MAF_MFF_AD_FAC_H_MIN FORMAT "%4.0"
 /begin AXIS_DESCR COM_AXIS n_32 _CNV_A_R_LINEAR_____15_CM 6 0. 8160. FORMAT "%4.0" AXIS_PTS_REF ldpm_n_32_maf_mff_ad_fac_h_min /end AXIS_DESCR
/end CHARACTERISTIC
/begin MEASUREMENT lam_bank_1.ls_up.bf.lv_lsl_ofs "State of the Offset measurement" ULONG _CNV_S_2_RANGE______2_CM 1 100. 0. 1. DISPLAY_IDENTIFIER LV_LSL_OFS_1 ECU_ADDRESS 0x3fc50c BYTE_ORDER MSB_LAST BIT_MASK 0x80000000 /end MEASUREMENT
/begin MEASUREMENT lam_bank_1.ls_up.bf.lv_lsl_out "Work-around for Vs check with CJ110" ULONG _CNV_S_2_RANGE______2_CM 1 100. 0. 1. DISPLAY_IDENTIFIER LV_LSL_OUT_1 ECU_ADDRESS 0x3fc50c BYTE_ORDER MSB_LAST BIT_MASK 0x2000000 /end MEASUREMENT
/begin MEASUREMENT lam_bank_1.ls_up.bf.lv_lsl_ofs_puls "State of the offset measurement for lambda stimulation" ULONG _CNV_S_2_RANGE______2_CM 1 100. 0. 1. DISPLAY_IDENTIFIER LV_LSL_OFS_PULS_1 ECU_ADDRESS 0x3fc50c BYTE_ORDER MSB_LAST BIT_MASK 0x40000000 /end MEASUREMENT
/begin MEASUREMENT lam_bank_1.ls_up.bf.lv_vls_lsl_ofs_lim "Boolean flag showing limited output voltage offset adjustment" ULONG _CNV_S_2_RANGE______2_CM 1 100. 0. 1. DISPLAY_IDENTIFIER LV_VLS_LSL_OFS_LIM_1 ECU_ADDRESS 0x3fc50c BYTE_ORDER MSB_LAST BIT_MASK 0x1000000 /end MEASUREMENT
/begin MEASUREMENT lam_bank_1.ls_up.vls_lsl_cor "corrected output signal of the lambda sensor" UWORD _CNV_A_R_LINEAR_____3_CM 1 100. 0. 4.99511719 DISPLAY_IDENTIFIER VLS_LSL_COR_1 ECU_ADDRESS 0x3fc51c BYTE_ORDER MSB_LAST FORMAT "%5.3" /end MEASUREMENT
/begin MEASUREMENT lam_bank_1.ls_up.vls_lsl_ofs "output signal offset for the linear Lambda sensor" SWORD _CNV_A_R_LINEAR_____3_CM 1 100. -4.99511719 4.99511719 DISPLAY_IDENTIFIER VLS_LSL_OFS_1 ECU_ADDRESS 0x3fc52a BYTE_ORDER MSB_LAST FORMAT "%5.2" /end MEASUREMENT
/begin MEASUREMENT lam_bank_1.ls_up.iplsl_cor "Compensated nominal pumping current ( after sensor/sensor dispersion compensation at new and aged )" SWORD _CNV_A_R_LINEAR_____284_CM 1 100. -12.596 12.596 DISPLAY_IDENTIFIER IPLSL_COR_1 ECU_ADDRESS 0x3fc52e BYTE_ORDER MSB_LAST FORMAT "%7.4" /end MEASUREMENT
/begin MEASUREMENT lam_bank_1.ls_ready.bf.lv_up_ls "operability status of the lambda sensor (delayed)" ULONG _CNV_S_2_RANGE______2_CM 1 100. 0. 1. DISPLAY_IDENTIFIER LV_UP_LS_1 ECU_ADDRESS 0x3fc4d4 BYTE_ORDER MSB_LAST BIT_MASK 0x80000000 /end MEASUREMENT
/begin MEASUREMENT lam_bank_1.ls_ready.bf.lv_up_ls_raw "instantaneous operability status of the lambda sensor (undelayed)" ULONG _CNV_S_2_RANGE______2_CM 1 100. 0. 1. DISPLAY_IDENTIFIER LV_UP_LS_RAW_1 ECU_ADDRESS 0x3fc4d4 BYTE_ORDER MSB_LAST BIT_MASK 0x10000000 /end MEASUREMENT
/begin MEASUREMENT lam_bank_1.ls_ready.bf.lv_up_ls_cdn "operability status of the lambda sensor at forced activation" ULONG _CNV_S_2_RANGE______2_CM 1 100. 0. 1. DISPLAY_IDENTIFIER LV_UP_LS_CDN_1 ECU_ADDRESS 0x3fc4d4 BYTE_ORDER MSB_LAST BIT_MASK 0x40000000 /end MEASUREMENT
/begin MEASUREMENT lam_bank_1.ls_ready.lamb_mmv_ready "mean value of the lambda sensor signal" UWORD _CNV_A_R_LINEAR_____285_CM 1 100. 0. 2. DISPLAY_IDENTIFIER LAMB_MMV_READY_1 ECU_ADDRESS 0x3fc4d8 BYTE_ORDER MSB_LAST FORMAT "%5.3" /end MEASUREMENT
/begin MEASUREMENT lam_bank_1.ls_ready.lamb_de_int "value as a measure of the sensor variation" UWORD _CNV_A_R_LINEAR_____118_CM 1 100. 0. 63.99902344 DISPLAY_IDENTIFIER LAMB_DE_INT_1 ECU_ADDRESS 0x3fc4da BYTE_ORDER MSB_LAST FORMAT "%7.4" /end MEASUREMENT
/begin MEASUREMENT lam_bank_1.ls_ready.t_deac_ls_ready "Timer for forced activation" UWORD _CNV_A_R_LINEAR_____198_CM 1 100. 0. 1310.7 DISPLAY_IDENTIFIER T_DEAC_LS_READY_1 ECU_ADDRESS 0x3fc4dc BYTE_ORDER MSB_LAST FORMAT "%7.2" /end MEASUREMENT
/begin MEASUREMENT lam_bank_1.ls_ready.t_dly_ls_ready "Timer for delay time" UWORD _CNV_A_R_LINEAR_____198_CM 1 100. 0. 1310.7 DISPLAY_IDENTIFIER T_DLY_LS_READY_1 ECU_ADDRESS 0x3fc4de BYTE_ORDER MSB_LAST FORMAT "%7.2" /end MEASUREMENT
/begin MEASUREMENT lam_bank_1.ls_ready.t_lamb_de_clr "Timer for sensor dispersion calculation up to the reset" UWORD _CNV_A_R_LINEAR_____198_CM 1 100. 0. 1310.7 DISPLAY_IDENTIFIER T_LAMB_DE_CLR_1 ECU_ADDRESS 0x3fc4e0 BYTE_ORDER MSB_LAST FORMAT "%7.2" /end MEASUREMENT
/begin MEASUREMENT lam_bank_1.lam_dly.bf.lv_delta_lamb "activation signal for trim-controller" ULONG _CNV_S_2_RANGE______2_CM 1 100. 0. 1. DISPLAY_IDENTIFIER LV_DELTA_LAMB_1 ECU_ADDRESS 0x3fc2d4 BYTE_ORDER MSB_LAST BIT_MASK 0x40000000 /end MEASUREMENT
/begin MEASUREMENT lam_bank_1.lam_dly.bf.lv_lam_dly_i_act "activation signal for the calculation of the trim-controller I-share" ULONG _CNV_S_2_RANGE______2_CM 1 100. 0. 1. DISPLAY_IDENTIFIER LV_LAM_DLY_I_ACT_1 ECU_ADDRESS 0x3fc2d4 BYTE_ORDER MSB_LAST BIT_MASK 0x20000000 /end MEASUREMENT
/begin MEASUREMENT lam_bank_1.lam_dly.bf.lv_lam_dly_p_act "activation signal for the calculation of the trim-controller I-share" ULONG _CNV_S_2_RANGE______2_CM 1 100. 0. 1. DISPLAY_IDENTIFIER LV_LAM_DLY_P_ACT_1 ECU_ADDRESS 0x3fc2d4 BYTE_ORDER MSB_LAST BIT_MASK 0x10000000 /end MEASUREMENT
/begin MEASUREMENT lam_bank_1.lam_dly.delta_lamb_p "l-shift from P-share" SWORD _CNV_A_R_LINEAR_____285_CM 1 100. -0.125 0.125 DISPLAY_IDENTIFIER DELTA_LAMB_P_1 ECU_ADDRESS 0x3fc2de BYTE_ORDER MSB_LAST FORMAT "%7.4" /end MEASUREMENT
/begin MEASUREMENT lam_bank_1.lam_dly.delta_lamb_i_ad_h_res "adaptation value for lambda-shift with high resolution" SWORD _CNV_A_R_LINEAR_____286_CM 1 100. -0.125 0.124996 DISPLAY_IDENTIFIER DELTA_LAMB_I_AD_H_RES_1 ECU_ADDRESS 0x3fc2ea BYTE_ORDER MSB_LAST FORMAT "%8.6" /end MEASUREMENT
/begin MEASUREMENT lam_bank_1.lam_dly.delta_lamb "l-shift from downstream trim controller" SWORD _CNV_A_R_LINEAR_____285_CM 1 100. -0.125 0.125 DISPLAY_IDENTIFIER DELTA_LAMB_1 ECU_ADDRESS 0x3fc2ec BYTE_ORDER MSB_LAST FORMAT "%7.4" /end MEASUREMENT
/begin MEASUREMENT lam_bank_1.lam_dly.maf_int_dly "integral of air mass flow since LAM activation" UWORD _CNV_A_R_LINEAR_____287_CM 1 100. 0. 1820.398 DISPLAY_IDENTIFIER MAF_INT_DLY_1 ECU_ADDRESS 0x3fc2f2 BYTE_ORDER MSB_LAST FORMAT "%7.2" /end MEASUREMENT
/begin MEASUREMENT lam_bank_1.lam_dly.vls_dif_dly "difference between setpoint and actual downstream LS signal" SWORD _CNV_A_R_LINEAR_____3_CM 1 100. -4.99511719 4.99511719 DISPLAY_IDENTIFIER VLS_DIF_DLY_1 ECU_ADDRESS 0x3fc2dc BYTE_ORDER MSB_LAST FORMAT "%5.2" /end MEASUREMENT
/begin MEASUREMENT lam_bank_1.lam_dly.delta_lamb_i "l-shift from I-share" SWORD _CNV_A_R_LINEAR_____285_CM 1 100. -0.125 0.125 DISPLAY_IDENTIFIER DELTA_LAMB_I_1 ECU_ADDRESS 0x3fc2e2 BYTE_ORDER MSB_LAST FORMAT "%7.4" /end MEASUREMENT
/begin MEASUREMENT lam_bank_1.lam_dly.delta_lamb_p_h_res "lambda-shift from P-share with high resolution" SWORD _CNV_A_R_LINEAR_____288_CM 1 100. -0.125 0.125 DISPLAY_IDENTIFIER DELTA_LAMB_P_H_RES_1 ECU_ADDRESS 0x3fc2e0 BYTE_ORDER MSB_LAST FORMAT "%8.5" /end MEASUREMENT
/begin MEASUREMENT lam_bank_1.lam_dly.delta_lamb_i_h_res "lambda-shift from I-share with high resolution" SWORD _CNV_A_R_LINEAR_____286_CM 1 100. -0.125 0.124996 DISPLAY_IDENTIFIER DELTA_LAMB_I_H_RES_1 ECU_ADDRESS 0x3fc2e8 BYTE_ORDER MSB_LAST FORMAT "%8.6" /end MEASUREMENT
/begin MEASUREMENT lam_bank_1.lam_dly.delta_lamb_h_res "lambda-shift from from downstream trim controller with high resolution" SWORD _CNV_A_R_LINEAR_____288_CM 1 100. -0.125 0.125 DISPLAY_IDENTIFIER DELTA_LAMB_H_RES_1 ECU_ADDRESS 0x3fc2ee BYTE_ORDER MSB_LAST FORMAT "%8.5" /end MEASUREMENT
/begin MEASUREMENT lam_bank_1.lam_dly.delta_lamb_i_h_res_save "saved high word of I-share with high resolution (saved in case diagnosis is switched on)" SWORD _CNV_A_R_LINEAR_____286_CM 1 100. -0.125 0.124996 DISPLAY_IDENTIFIER DELTA_LAMB_I_H_RES_SAVE_1 ECU_ADDRESS 0x3fc2f0 BYTE_ORDER MSB_LAST FORMAT "%8.6" /end MEASUREMENT
/begin MEASUREMENT lam_bank_1.lam_dly.delta_lamb_i_mmv "moving mean value of i-share from Trim control" SLONG _CNV_A_R_LINEAR_____289_CM 1 100. -0.125 0.125 DISPLAY_IDENTIFIER DELTA_LAMB_I_MMV_1 ECU_ADDRESS 0x3fc2e4 BYTE_ORDER MSB_LAST FORMAT "%9.8" /end MEASUREMENT
/begin MEASUREMENT lam_bank_1.lam_sti.bf.lv_lamb_puls_on "activation state variable for the forced stimulation" ULONG _CNV_S_2_RANGE______2_CM 1 100. 0. 1. DISPLAY_IDENTIFIER LV_LAMB_PULS_ON_1 ECU_ADDRESS 0x3fc578 BYTE_ORDER MSB_LAST BIT_MASK 0x80000000 /end MEASUREMENT
/begin MEASUREMENT lam_bank_1.lam_sti.bf.lv_lamb_puls_on_ls_diag "activation state variable for the forced stimulation in requested mode" ULONG _CNV_S_2_RANGE______2_CM 1 100. 0. 1. DISPLAY_IDENTIFIER LV_LAMB_PULS_ON_LS_DIAG_1 ECU_ADDRESS 0x3fc578 BYTE_ORDER MSB_LAST BIT_MASK 0x40000000 /end MEASUREMENT
/begin MEASUREMENT lam_bank_1.lam_sti.bf.lv_delta_lamb_puls_on "flag that indicates that the forced stimulation is activated or deactivated due to cat purge" ULONG _CNV_S_2_RANGE______2_CM 1 100. 0. 1. DISPLAY_IDENTIFIER LV_DELTA_LAMB_PULS_ON_1 ECU_ADDRESS 0x3fc578 BYTE_ORDER MSB_LAST BIT_MASK 0x20000000 /end MEASUREMENT
/begin MEASUREMENT lam_bank_1.lam_sti.bf.lv_lamb_puls_mst_cbk "" ULONG _CNV_S_2_RANGE______2_CM 1 100. 0. 1. DISPLAY_IDENTIFIER LV_LAMB_PULS_MST_CBK_1 ECU_ADDRESS 0x3fc578 BYTE_ORDER MSB_LAST BIT_MASK 0x10000000 /end MEASUREMENT
/begin MEASUREMENT lam_bank_1.lam_sti.bf.lv_lamb_puls_syn_cbk_old "" ULONG _CNV_S_2_RANGE______2_CM 1 100. 0. 1. DISPLAY_IDENTIFIER LV_LAMB_PULS_SYN_CBK_OLD_1 ECU_ADDRESS 0x3fc578 BYTE_ORDER MSB_LAST BIT_MASK 0x8000000 /end MEASUREMENT
/begin MEASUREMENT lam_bank_1.lam_sti.lamb_puls_osc "Output signal of the forced stimulation" SBYTE _CNV_A_R_LINEAR_____290_CM 1 100. -0.125 0.124023 DISPLAY_IDENTIFIER LAMB_PULS_OSC_1 ECU_ADDRESS 0x3fc58a FORMAT "%7.4" /end MEASUREMENT
/begin MEASUREMENT lam_bank_1.lam_sti.maf_int_lamb_puls "MAF-integral for the activation of the forced stimulation" UWORD _CNV_A_R_LINEAR_____273_CM 1 100. 0. 1820.4167 DISPLAY_IDENTIFIER MAF_INT_LAMB_PULS_1 ECU_ADDRESS 0x3fc580 BYTE_ORDER MSB_LAST FORMAT "%9.4" /end MEASUREMENT
/begin MEASUREMENT lam_bank_1.lsl_ad.bf.lv_lsl_gain_ad_req "Request for Fuel Cut Off Ip measurement" ULONG _CNV_S_2_RANGE______2_CM 1 100. 0. 1. DISPLAY_IDENTIFIER LV_LSL_GAIN_AD_REQ_1 ECU_ADDRESS 0x3fc5c8 BYTE_ORDER MSB_LAST BIT_MASK 0x80000000 /end MEASUREMENT
/begin MEASUREMENT lam_bank_1.lsl_ad.bf.lv_iplsl_vld_fcut "Valid Ip sample during fuel cut was found" ULONG _CNV_S_2_RANGE______2_CM 1 100. 0. 1. DISPLAY_IDENTIFIER LV_IPLSL_VLD_FCUT_1 ECU_ADDRESS 0x3fc5c8 BYTE_ORDER MSB_LAST BIT_MASK 0x20000000 /end MEASUREMENT
/begin MEASUREMENT lam_bank_1.lsl_ad.bf.lv_lsl_fcut_mes "Fuel Cut  Ip Measurement  ready" ULONG _CNV_S_2_RANGE______2_CM 1 100. 0. 1. DISPLAY_IDENTIFIER LV_LSL_FCUT_MES_1 ECU_ADDRESS 0x3fc5c8 BYTE_ORDER MSB_LAST BIT_MASK 0x10000000 /end MEASUREMENT
/begin MEASUREMENT lam_bank_1.lsl_ad.bf.lv_lsl_fcut_mes_not "No Fuel Cut  Ip Measurement  possible" ULONG _CNV_S_2_RANGE______2_CM 1 100. 0. 1. DISPLAY_IDENTIFIER LV_LSL_FCUT_MES_NOT_1 ECU_ADDRESS 0x3fc5c8 BYTE_ORDER MSB_LAST BIT_MASK 0x8000000 /end MEASUREMENT
/begin MEASUREMENT lam_bank_1.lsl_ad.bf.lv_lsl_fcut_ad_not "No Fuel Cut  WRAF sensor gain adaptation  possible" ULONG _CNV_S_2_RANGE______2_CM 1 100. 0. 1. DISPLAY_IDENTIFIER LV_LSL_FCUT_AD_NOT_1 ECU_ADDRESS 0x3fc5c8 BYTE_ORDER MSB_LAST BIT_MASK 0x4000000 /end MEASUREMENT
/begin MEASUREMENT lam_bank_1.lsl_ad.bf.lv_lsl_gain_ad_req_vld "Validation of request for Fuel Cut Off Ip measurement" ULONG _CNV_S_2_RANGE______2_CM 1 100. 0. 1. DISPLAY_IDENTIFIER LV_LSL_GAIN_AD_REQ_VLD_1 ECU_ADDRESS 0x3fc5c8 BYTE_ORDER MSB_LAST BIT_MASK 0x40000000 /end MEASUREMENT
/begin MEASUREMENT lam_bank_1.lsl_ad.iplsl_cor_mmv_fcut "Moving mean of  corrected pumping current during fuel cut" SWORD _CNV_A_R_LINEAR_____284_CM 1 100. -12.596 12.596 DISPLAY_IDENTIFIER IPLSL_COR_MMV_FCUT_1 ECU_ADDRESS 0x3fc5cc BYTE_ORDER MSB_LAST FORMAT "%7.4" /end MEASUREMENT
/begin MEASUREMENT lam_bank_1.lsl_ad.iplsl_purge "Except adaptation,  compensated pumping current during fuel cut at purged condition" SWORD _CNV_A_R_LINEAR_____284_CM 1 100. -12.596 12.596 DISPLAY_IDENTIFIER IPLSL_PURGE_1 ECU_ADDRESS 0x3fc5d0 BYTE_ORDER MSB_LAST FORMAT "%7.4" /end MEASUREMENT
/begin MEASUREMENT lam_bank_1.lsl_ad.iplsl_mv_purge "Arithmetic mean of compensated pumping current during fuel cut at purged condition" SWORD _CNV_A_R_LINEAR_____284_CM 1 100. -12.596 12.596 DISPLAY_IDENTIFIER IPLSL_MV_PURGE_1 ECU_ADDRESS 0x3fc5d2 BYTE_ORDER MSB_LAST FORMAT "%7.4" /end MEASUREMENT
/begin MEASUREMENT lam_bank_1.lsl_ad.iplsl_cor_beg_purge "Corrected pumping current during fuel cut at begin of purged condition" SWORD _CNV_A_R_LINEAR_____284_CM 1 100. -12.596 12.596 DISPLAY_IDENTIFIER IPLSL_COR_BEG_PURGE_1 ECU_ADDRESS 0x3fc5d4 BYTE_ORDER MSB_LAST FORMAT "%7.4" /end MEASUREMENT
/begin MEASUREMENT lam_bank_1.lsl_ad.iplsl_cor_chg_purge "Corrected pumping current during fuel cut at begin of purged condition" SWORD _CNV_A_R_LINEAR_____284_CM 1 100. -12.596 12.596 DISPLAY_IDENTIFIER IPLSL_COR_CHG_PURGE_1 ECU_ADDRESS 0x3fc5d6 BYTE_ORDER MSB_LAST FORMAT "%7.4" /end MEASUREMENT
/begin MEASUREMENT lam_bank_1.lsl_ad.iplsl_vari_purge "Variance of  corrected pumping current during fuel cut at purged condition" UWORD _CNV_A_R_LINEAR_____299_CM 1 100. 0. 619.7000000000001 DISPLAY_IDENTIFIER IPLSL_VARI_PURGE_1 ECU_ADDRESS 0x3fc5d8 BYTE_ORDER MSB_LAST FORMAT "%7.3" /end MEASUREMENT
/begin MEASUREMENT lam_bank_1.lsl_ad.iplsl_vld_mmv_fcut "Moving mean of  valid samples pumping current during fuel cut" SWORD _CNV_A_R_LINEAR_____284_CM 1 100. -12.596 12.596 DISPLAY_IDENTIFIER IPLSL_VLD_MMV_FCUT_1 ECU_ADDRESS 0x3fc5da BYTE_ORDER MSB_LAST FORMAT "%7.4" /end MEASUREMENT
/begin MEASUREMENT lam_bank_1.lsl_ad.iplsl_vld_vari_fcut "Moving variance of  valid samples pumping current during fuel cut" UWORD _CNV_A_R_LINEAR_____299_CM 1 100. 0. 619.7000000000001 DISPLAY_IDENTIFIER IPLSL_VLD_VARI_FCUT_1 ECU_ADDRESS 0x3fc5e0 BYTE_ORDER MSB_LAST FORMAT "%7.3" /end MEASUREMENT
/begin MEASUREMENT lam_bank_1.lsl_ad.t_dur_int "Timer for IPLSL integration" UBYTE _CNV_A_R_LINEAR_____24_CM 1 100. 0. 25.5 DISPLAY_IDENTIFIER T_DUR_INT_1 ECU_ADDRESS 0x3fc5e6 FORMAT "%4.1" /end MEASUREMENT
/begin MEASUREMENT lam_bank_1.lsl_ad.state_lsl_fcut "State of fuel cut analyzer state machine" UBYTE _CNV_S_5_RANGE_STAT_300_CM 1 100. 0. 4. DISPLAY_IDENTIFIER STATE_LSL_FCUT_1 ECU_ADDRESS 0x3fc5e7 /end MEASUREMENT
/begin MEASUREMENT lam_bank_1.lsl_ad.state_lsl_gain_ad "State of WRAF adaptive  indicator" UBYTE _CNV_S_4_RANGE_STAT_301_CM 1 100. 0. 3. DISPLAY_IDENTIFIER STATE_LSL_GAIN_AD_1 ECU_ADDRESS 0x3fc5e8 /end MEASUREMENT
/begin MEASUREMENT lam_bank_1.lsl_ad.fac_lsl_cor_ad "Factor for  WRAF sensor gain adaptation" UWORD _CNV_A_R_LINEAR_____20_CM 1 100. 0. 1.99996948 DISPLAY_IDENTIFIER FAC_LSL_COR_AD_1 ECU_ADDRESS 0x3fc5ea BYTE_ORDER MSB_LAST FORMAT "%7.5" /end MEASUREMENT
/begin MEASUREMENT lam_bank_1.lsl_ad.iplsl_max_vld_mmv_fcut "Moving mean of valid samples pumping current during fuel cut at adapted maximum" SWORD _CNV_A_R_LINEAR_____284_CM 1 100. -12.596 12.596 DISPLAY_IDENTIFIER IPLSL_MAX_VLD_MMV_FCUT_1 ECU_ADDRESS 0x3fc5dc BYTE_ORDER MSB_LAST FORMAT "%7.4" /end MEASUREMENT
/begin MEASUREMENT lam_bank_1.lsl_ad.iplsl_min_vld_mmv_fcut "Moving mean of valid samples pumping current during fuel cut at adapted minimum" SWORD _CNV_A_R_LINEAR_____284_CM 1 100. -12.596 12.596 DISPLAY_IDENTIFIER IPLSL_MIN_VLD_MMV_FCUT_1 ECU_ADDRESS 0x3fc5de BYTE_ORDER MSB_LAST FORMAT "%7.4" /end MEASUREMENT
/begin MEASUREMENT lam_bank_1.lsl_ad.iplsl_max_vld_vari_fcut "Moving variance of valid samples pumping current during fuel cut at adapted maximum" UWORD _CNV_A_R_LINEAR_____299_CM 1 100. 0. 619.7000000000001 DISPLAY_IDENTIFIER IPLSL_MAX_VLD_VARI_FCUT_1 ECU_ADDRESS 0x3fc5e2 BYTE_ORDER MSB_LAST FORMAT "%7.3" /end MEASUREMENT
/begin MEASUREMENT lam_bank_1.lsl_ad.iplsl_min_vld_vari_fcut "Moving variance of valid samples pumping current during fuel cut at adapted minimum" UWORD _CNV_A_R_LINEAR_____299_CM 1 100. 0. 619.7000000000001 DISPLAY_IDENTIFIER IPLSL_MIN_VLD_VARI_FCUT_1 ECU_ADDRESS 0x3fc5e4 BYTE_ORDER MSB_LAST FORMAT "%7.3" /end MEASUREMENT
/begin MEASUREMENT lam_bank_1.lsl_ad.ctr_fac_lsl_cor_ad "Counter of number of WRAF sensor gain adaptations" UWORD _CNV_A_R_LINEAR_____0_CM 1 100. 0. 65535. DISPLAY_IDENTIFIER CTR_FAC_LSL_COR_AD_1 ECU_ADDRESS 0x3fc5ec BYTE_ORDER MSB_LAST FORMAT "%5.0" /end MEASUREMENT
/begin MEASUREMENT lam_bank_1.lsl_ad.fac_min_lsl_cor_ad "Adapted minimum of factor for WRAF sensor gain adaptation" UWORD _CNV_A_R_LINEAR_____20_CM 1 100. 0. 1.99996948 DISPLAY_IDENTIFIER FAC_MIN_LSL_COR_AD_1 ECU_ADDRESS 0x3fc5ee BYTE_ORDER MSB_LAST FORMAT "%7.5" /end MEASUREMENT
/begin MEASUREMENT lam_bank_1.lsl_ad.fac_max_lsl_cor_ad "Adapted maximum of factor for WRAF sensor gain adaptation" UWORD _CNV_A_R_LINEAR_____20_CM 1 100. 0. 1.99996948 DISPLAY_IDENTIFIER FAC_MAX_LSL_COR_AD_1 ECU_ADDRESS 0x3fc5f0 BYTE_ORDER MSB_LAST FORMAT "%7.5" /end MEASUREMENT
/begin MEASUREMENT lam_bank_1.lsl_ad.fac_min_lsl_cor_ad_amp "Ambient pressure during adaptation of the minimum of the factor for WRAF sensor gain adaptation" UWORD _CNV_A_R_LINEAR_____49_CM 1 100. 0. 5434. DISPLAY_IDENTIFIER FAC_MIN_LSL_COR_AD_AMP_1 ECU_ADDRESS 0x3fc5f2 BYTE_ORDER MSB_LAST FORMAT "%7.2" /end MEASUREMENT
/begin MEASUREMENT lam_bank_1.lsl_ad.fac_max_lsl_cor_ad_amp "Ambient pressure during adaptation of the maximum of the factor for WRAF sensor gain adaptation" UWORD _CNV_A_R_LINEAR_____49_CM 1 100. 0. 5434. DISPLAY_IDENTIFIER FAC_MAX_LSL_COR_AD_AMP_1 ECU_ADDRESS 0x3fc5f4 BYTE_ORDER MSB_LAST FORMAT "%7.2" /end MEASUREMENT
/begin MEASUREMENT lam_bank_1.lsl_ad.fac_min_lsl_cor_ad_tia "TIA during adaptation of the minimum of the factor for WRAF sensor gain adaptation" UBYTE _CNV_A_R_LINEAR_____11_CM 1 100. -48. 142.5 DISPLAY_IDENTIFIER FAC_MIN_LSL_COR_AD_TIA_1 ECU_ADDRESS 0x3fc5f6 FORMAT "%5.1" /end MEASUREMENT
/begin MEASUREMENT lam_bank_1.lsl_ad.fac_max_lsl_cor_ad_tia "TIA during adaptation of the maximum of the factor for WRAF sensor gain adaptation" UBYTE _CNV_A_R_LINEAR_____11_CM 1 100. -48. 142.5 DISPLAY_IDENTIFIER FAC_MAX_LSL_COR_AD_TIA_1 ECU_ADDRESS 0x3fc5f7 FORMAT "%5.1" /end MEASUREMENT
/begin MEASUREMENT lam_bank_1.lsl_ad.fac_min_lsl_cor_ad_map "MAP during adaptation of the maximum of the factor for WRAF sensor gain adaptation" UWORD _CNV_A_R_LINEAR_____49_CM 1 100. 0. 5434. DISPLAY_IDENTIFIER FAC_MIN_LSL_COR_AD_MAP_1 ECU_ADDRESS 0x3fc5f8 BYTE_ORDER MSB_LAST FORMAT "%7.2" /end MEASUREMENT
/begin MEASUREMENT lam_bank_1.lsl_ad.fac_max_lsl_cor_ad_map "MAP during adaptation of the maximum of the factor for WRAF sensor gain adaptation" UWORD _CNV_A_R_LINEAR_____49_CM 1 100. 0. 5434. DISPLAY_IDENTIFIER FAC_MAX_LSL_COR_AD_MAP_1 ECU_ADDRESS 0x3fc5fa BYTE_ORDER MSB_LAST FORMAT "%7.2" /end MEASUREMENT
/begin MEASUREMENT lam_bank_1.lsl_ad.fac_max_lsl_cor_ad_tam "TAM during adaptation of the maximum of the factor for WRAF sensor gain adaptation" UBYTE _CNV_A_R_LINEAR_____302_CM 1 100. -40. 63. DISPLAY_IDENTIFIER FAC_MAX_LSL_COR_AD_TAM_1 ECU_ADDRESS 0x3fc5fd FORMAT "%5.1" /end MEASUREMENT
/begin MEASUREMENT lam_bank_1.lsl_ad.fac_min_lsl_cor_ad_tam "TAM during adaptation of the minimum of the factor for WRAF sensor gain adaptation" UBYTE _CNV_A_R_LINEAR_____302_CM 1 100. -40. 63. DISPLAY_IDENTIFIER FAC_MIN_LSL_COR_AD_TAM_1 ECU_ADDRESS 0x3fc5fc FORMAT "%5.1" /end MEASUREMENT
/begin MEASUREMENT lam_bank_1.lsl_ad.fac_min_lsl_cor_ad_n_32 "N during adaptation of the minimum of the factor for WRAF sensor gain adaptation" UBYTE _CNV_A_R_LINEAR_____15_CM 1 100. 0. 8160. DISPLAY_IDENTIFIER FAC_MIN_LSL_COR_AD_N_32_1 ECU_ADDRESS 0x3fc5fe FORMAT "%4.0" /end MEASUREMENT
/begin MEASUREMENT lam_bank_1.lsl_ad.fac_max_lsl_cor_ad_n_32 "N during adaptation of the maximum of the factor for WRAF sensor gain adaptation" UBYTE _CNV_A_R_LINEAR_____15_CM 1 100. 0. 8160. DISPLAY_IDENTIFIER FAC_MAX_LSL_COR_AD_N_32_1 ECU_ADDRESS 0x3fc5ff FORMAT "%4.0" /end MEASUREMENT
/begin MEASUREMENT lam_bank_1.lsl_ad.fac_max_lsl_cor_ad_maf_kgh "MAF during adaptation of the minimum of the factor for WRAF sensor gain adaptation" UWORD _CNV_A_R_LINEAR_____115_CM 1 100. 0. 2047.96875 DISPLAY_IDENTIFIER FAC_MAX_LSL_COR_AD_MAF_KGH_1 ECU_ADDRESS 0x3fc602 BYTE_ORDER MSB_LAST FORMAT "%7.2" /end MEASUREMENT
/begin MEASUREMENT lam_bank_1.lsl_ad.fac_min_lsl_cor_ad_maf_kgh "MAF during adaptation of the minimum of the factor for WRAF sensor gain adaptation" UWORD _CNV_A_R_LINEAR_____115_CM 1 100. 0. 2047.96875 DISPLAY_IDENTIFIER FAC_MIN_LSL_COR_AD_MAF_KGH_1 ECU_ADDRESS 0x3fc600 BYTE_ORDER MSB_LAST FORMAT "%7.2" /end MEASUREMENT
/begin MEASUREMENT lam_bank_1.lsl_ad.fac_min_lsl_cor_ad_ttip "TTIP_i upstream during adaptation of the minimum of the factor for WRAF sensor gain adaptation" SWORD _CNV_A_R_LINEAR_____303_CM 1 100. -2048. 2047.938 DISPLAY_IDENTIFIER FAC_MIN_LSL_COR_AD_TTIP_1 ECU_ADDRESS 0x3fc604 BYTE_ORDER MSB_LAST FORMAT "%8.2" /end MEASUREMENT
/begin MEASUREMENT lam_bank_1.lsl_ad.fac_max_lsl_cor_ad_ttip "TTIP_i upstream during adaptation of the maximum of the factor for WRAF sensor gain adaptation" SWORD _CNV_A_R_LINEAR_____303_CM 1 100. -2048. 2047.938 DISPLAY_IDENTIFIER FAC_MAX_LSL_COR_AD_TTIP_1 ECU_ADDRESS 0x3fc606 BYTE_ORDER MSB_LAST FORMAT "%8.2" /end MEASUREMENT
/begin MEASUREMENT lam_bank_1.lsl_ad.fac_min_lsl_cor_ad_teg_dyn "TEG_DYN_i during adaptation of the minimum of the factor for WRAF sensor gain adaptation" UWORD _CNV_A_R_LINEAR_____6_CM 1 100. 0. 2047. DISPLAY_IDENTIFIER FAC_MIN_LSL_COR_AD_TEG_DYN_1 ECU_ADDRESS 0x3fc608 BYTE_ORDER MSB_LAST FORMAT "%7.2" /end MEASUREMENT
/begin MEASUREMENT lam_bank_1.lsl_ad.fac_max_lsl_cor_ad_teg_dyn "TEG_DYN_i during adaptation of the maximum of the factor for WRAF sensor gain adaptation" UWORD _CNV_A_R_LINEAR_____6_CM 1 100. 0. 2047. DISPLAY_IDENTIFIER FAC_MAX_LSL_COR_AD_TEG_DYN_1 ECU_ADDRESS 0x3fc60a BYTE_ORDER MSB_LAST FORMAT "%7.2" /end MEASUREMENT
/begin MEASUREMENT lam_bank_1.lam_inci.bf.lv_inh_lscl "inhibit signal for controller deactivation" ULONG _CNV_S_2_RANGE______2_CM 1 100. 0. 1. DISPLAY_IDENTIFIER LV_INH_LSCL_1 ECU_ADDRESS 0x3fc568 BYTE_ORDER MSB_LAST BIT_MASK 0x10000000 /end MEASUREMENT
/begin MEASUREMENT lam_bank_1.lam_inci.bf.lv_lam_stop "activation signal for the controller stop-mode" ULONG _CNV_S_2_RANGE______2_CM 1 100. 0. 1. DISPLAY_IDENTIFIER LV_LAM_STOP_1 ECU_ADDRESS 0x3fc568 BYTE_ORDER MSB_LAST BIT_MASK 0x80000000 /end MEASUREMENT
/begin MEASUREMENT lam_bank_1.lam_inci.bf.lv_lam_once_act "closed loop had been enabled in this DC cylinder bank i" ULONG _CNV_S_2_RANGE______2_CM 1 100. 0. 1. DISPLAY_IDENTIFIER LV_LAM_ONCE_ACT_1 ECU_ADDRESS 0x3fc568 BYTE_ORDER MSB_LAST BIT_MASK 0x20000000 /end MEASUREMENT
/begin MEASUREMENT lam_bank_1.lam_inci.bf.lv_lscl_inh_err "Logical value if lambda controller is inhibit due to a present error" ULONG _CNV_S_2_RANGE______2_CM 1 100. 0. 1. DISPLAY_IDENTIFIER LV_LSCL_INH_ERR_1 ECU_ADDRESS 0x3fc568 BYTE_ORDER MSB_LAST BIT_MASK 0x4000000 /end MEASUREMENT
/begin MEASUREMENT lam_bank_1.lam_inci.soi_dly "crank shaft angle difference between the start of injection and the end of the exhaust cycle" UWORD _CNV_A_R_LINEAR_____159_CM 1 100. 0. 1620. DISPLAY_IDENTIFIER SOI_DLY_1 ECU_ADDRESS 0x3fc56c BYTE_ORDER MSB_LAST FORMAT "%4.0" /end MEASUREMENT
/begin MEASUREMENT lam_bank_1.lam_inci.delta_lamb_sp "corrective intervention for lambda set point" SWORD _CNV_A_R_LINEAR_____288_CM 1 100. -0.125 0.125 DISPLAY_IDENTIFIER DELTA_LAMB_SP_1 ECU_ADDRESS 0x3fc574 BYTE_ORDER MSB_LAST FORMAT "%8.5" /end MEASUREMENT
/begin MEASUREMENT lam_bank_1.lam_inci.delta_lamb_av_cor "corrective intervention for measured lambda signal" SWORD _CNV_A_R_LINEAR_____288_CM 1 100. -0.125 0.125 DISPLAY_IDENTIFIER DELTA_LAMB_AV_COR_1 ECU_ADDRESS 0x3fc576 BYTE_ORDER MSB_LAST FORMAT "%8.5" /end MEASUREMENT
/begin MEASUREMENT lam_bank_1.lam_ad.bf.lv_lam_adj_ad "logical value activates the shift of the lambda-controller" ULONG _CNV_S_2_RANGE______2_CM 1 100. 0. 1. DISPLAY_IDENTIFIER LV_LAM_ADJ_AD_1 ECU_ADDRESS 0x3fc290 BYTE_ORDER MSB_LAST BIT_MASK 0x80000000 /end MEASUREMENT
/begin MEASUREMENT lam_bank_1.lam_ad.bf.lv_lam_ad_stop "Logical variable indicates passing stop of the lambda Adaptation" ULONG _CNV_S_2_RANGE______2_CM 1 100. 0. 1. DISPLAY_IDENTIFIER LV_LAM_AD_STOP_1 ECU_ADDRESS 0x3fc290 BYTE_ORDER MSB_LAST BIT_MASK 0x40000000 /end MEASUREMENT
/begin MEASUREMENT lam_bank_1.lam_ad.bf.lv_mff_ad_fac_h_lim "Limitation of multiplicative adapted factor of upper area" ULONG _CNV_S_2_RANGE______2_CM 1 100. 0. 1. DISPLAY_IDENTIFIER LV_MFF_AD_FAC_H_LIM_1 ECU_ADDRESS 0x3fc290 BYTE_ORDER MSB_LAST BIT_MASK 0x10000000 /end MEASUREMENT
/begin MEASUREMENT lam_bank_1.lam_ad.bf.lv_mff_ad_add_lim "Limitation of additive adapted factor" ULONG _CNV_S_2_RANGE______2_CM 1 100. 0. 1. DISPLAY_IDENTIFIER LV_MFF_AD_ADD_LIM_1 ECU_ADDRESS 0x3fc290 BYTE_ORDER MSB_LAST BIT_MASK 0x8000000 /end MEASUREMENT
/begin MEASUREMENT lam_bank_1.lam_ad.bf.lv_mff_ad_fac_l_lim "Limitation of multiplicative adapted factor of lower area" ULONG _CNV_S_2_RANGE______2_CM 1 100. 0. 1. DISPLAY_IDENTIFIER LV_MFF_AD_FAC_L_LIM_1 ECU_ADDRESS 0x3fc290 BYTE_ORDER MSB_LAST BIT_MASK 0x20000000 /end MEASUREMENT
/begin MEASUREMENT lam_bank_1.lam_ad.mff_ad_add_mmv_rel "Relative additive adaptive factor" SWORD _CNV_A_R_LINEAR_____257_CM 1 100. -694.5 694.478806 DISPLAY_IDENTIFIER MFF_AD_ADD_MMV_REL_1 ECU_ADDRESS 0x3fc294 BYTE_ORDER MSB_LAST FORMAT "%7.2" /end MEASUREMENT
/begin MEASUREMENT lam_bank_1.lam_ad.mff_ad_add_mmv_rel_quo "Relative additive adaptive factor quotient" SWORD _CNV_A_R_LINEAR_____321_CM 1 100. -100. 99.99694824 DISPLAY_IDENTIFIER MFF_AD_ADD_MMV_REL_QUO_1 ECU_ADDRESS 0x3fc296 BYTE_ORDER MSB_LAST FORMAT "%8.3" /end MEASUREMENT
/begin MEASUREMENT lam_bank_1.lam_ad.mff_ad_fac_mmv_rel "Relative Multiplicative adaptive factor" SWORD _CNV_A_R_LINEAR_____111_CM 1 100. -50. 49.99847412 DISPLAY_IDENTIFIER MFF_AD_FAC_MMV_REL_1 ECU_ADDRESS 0x3fc29e BYTE_ORDER MSB_LAST FORMAT "%7.3" /end MEASUREMENT
/begin MEASUREMENT lam_bank_1.lam_ad.mff_ad_add_mmv "Additive adaptive factor" SWORD _CNV_A_R_LINEAR_____257_CM 1 100. -694.5 694.478806 DISPLAY_IDENTIFIER MFF_AD_ADD_MMV_1 ECU_ADDRESS 0x3fc298 BYTE_ORDER MSB_LAST FORMAT "%7.2" /end MEASUREMENT
/begin MEASUREMENT lam_bank_1.lam_ad.mff_ad_fac_mmv "Multiplicative adaptive factor" SWORD _CNV_A_R_LINEAR_____111_CM 1 100. -50. 49.99847412 DISPLAY_IDENTIFIER MFF_AD_FAC_MMV_1 ECU_ADDRESS 0x3fc2a0 BYTE_ORDER MSB_LAST FORMAT "%7.3" /end MEASUREMENT
/begin MEASUREMENT lam_bank_1.lam_ad.lam_adj_ad "output value for the lambda controller shift" SWORD _CNV_A_R_LINEAR_____111_CM 1 100. -50. 49.99847412 DISPLAY_IDENTIFIER LAM_ADJ_AD_1 ECU_ADDRESS 0x3fc2b2 BYTE_ORDER MSB_LAST FORMAT "%7.3" /end MEASUREMENT
/begin MEASUREMENT lam_bank_1.lam_ad.mff_ad_add_mmv_delta "Difference of additive adaptive factor to previous Adaptation" SWORD _CNV_A_R_LINEAR_____257_CM 1 100. -694.5 694.478806 DISPLAY_IDENTIFIER MFF_AD_ADD_MMV_DELTA_1 ECU_ADDRESS 0x3fc29a BYTE_ORDER MSB_LAST FORMAT "%7.2" /end MEASUREMENT
/begin MEASUREMENT lam_bank_1.lam_ad.mff_ad_add_mmv_delta_h_res "Difference of additive adaptive factor to previous Adaptation" SWORD _CNV_A_R_LINEAR_____322_CM 1 100. -10.85 10.85 DISPLAY_IDENTIFIER MFF_AD_ADD_MMV_DELTA_H_RES_1 ECU_ADDRESS 0x3fc29c BYTE_ORDER MSB_LAST FORMAT "%7.2" /end MEASUREMENT
/begin MEASUREMENT lam_bank_1.lam_ad.mff_ad_fac_mmv_delta_l "Difference of multiplicative adaptive factor of lower area to previous Adaptation" SWORD _CNV_A_R_LINEAR_____111_CM 1 100. -50. 49.99847412 DISPLAY_IDENTIFIER MFF_AD_FAC_MMV_DELTA_L_1 ECU_ADDRESS 0x3fc2ae BYTE_ORDER MSB_LAST FORMAT "%7.3" /end MEASUREMENT
/begin MEASUREMENT lam_bank_1.lam_ad.mff_sae_ad_mmv_rel "Relative adaptive correction for cylinder bank i for scantool" SWORD _CNV_A_R_LINEAR_____321_CM 1 100. -100. 99.99694824 DISPLAY_IDENTIFIER MFF_SAE_AD_MMV_REL_1 ECU_ADDRESS 0x3fc2ba BYTE_ORDER MSB_LAST FORMAT "%8.3" /end MEASUREMENT
/begin MEASUREMENT lam_bank_1.lam_ad.lam_ad_sum_p "Counter indicating the number of observed p jumps reported by the lambda controller" UBYTE _CNV_A_R_LINEAR_____0_CM 1 100. 1. 255. DISPLAY_IDENTIFIER LAM_AD_SUM_P_1 ECU_ADDRESS 0x3fc2bc FORMAT "%3.0" /end MEASUREMENT
/begin MEASUREMENT lam_bank_1.lam_ad.state_mff_ad "State indicating the status of the lambda Adaptation, e.g. to concerned time scheduler with CP" UBYTE _CNV_S_8_STATE_MFF__323_CM 1 100. 0. 7. DISPLAY_IDENTIFIER STATE_MFF_AD_1 ECU_ADDRESS 0x3fc2bd /end MEASUREMENT
/begin MEASUREMENT lam_bank_1.lam_ad.t_mff_ad_fac "Time indicating the time for next requested multiplicative lambda Adaptation" UWORD _CNV_A_R_LINEAR_____24_CM 1 100. 0. 6553.5 DISPLAY_IDENTIFIER T_MFF_AD_FAC_1 ECU_ADDRESS 0x3fc2b6 BYTE_ORDER MSB_LAST FORMAT "%6.1" /end MEASUREMENT
/begin MEASUREMENT lam_bank_1.lam_ad.t_mff_ad_add "Time indicating the time for next requested additive lambda Adaptation" UWORD _CNV_A_R_LINEAR_____24_CM 1 100. 0. 6553.5 DISPLAY_IDENTIFIER T_MFF_AD_ADD_1 ECU_ADDRESS 0x3fc2b8 BYTE_ORDER MSB_LAST FORMAT "%6.1" /end MEASUREMENT
/begin MEASUREMENT lam_bank_1.lam_ad.mff_ad_fac_mmv_delta_h "Difference of multiplicative adaptive factor of upper area to previous Adaptation" SWORD _CNV_A_R_LINEAR_____111_CM 1 100. -50. 49.99847412 DISPLAY_IDENTIFIER MFF_AD_FAC_MMV_DELTA_H_1 ECU_ADDRESS 0x3fc2b0 BYTE_ORDER MSB_LAST FORMAT "%7.3" /end MEASUREMENT
/begin MEASUREMENT lam_bank_1.lam_ad.mff_ad_fac_mmv_l "Multiplicative adaptive factor lower part load" SWORD _CNV_A_R_LINEAR_____111_CM 1 100. -50. 49.99847412 DISPLAY_IDENTIFIER MFF_AD_FAC_MMV_L_1 ECU_ADDRESS 0x3fc2a4 BYTE_ORDER MSB_LAST FORMAT "%7.3" /end MEASUREMENT
/begin MEASUREMENT lam_bank_1.lam_ad.mff_ad_fac_mmv_h "Multiplicative adaptive factor higher part load" SWORD _CNV_A_R_LINEAR_____111_CM 1 100. -50. 49.99847412 DISPLAY_IDENTIFIER MFF_AD_FAC_MMV_H_1 ECU_ADDRESS 0x3fc2a6 BYTE_ORDER MSB_LAST FORMAT "%7.3" /end MEASUREMENT
/begin MEASUREMENT lam_bank_1.lsh_up.bf.lv_lsh_up_cll_ctl "Boolean variable indicating closed loop control mode active" ULONG _CNV_S_2_RANGE______2_CM 1 100. 0. 1. DISPLAY_IDENTIFIER LV_LSH_UP_CLL_CTL_1 ECU_ADDRESS 0x3fc418 BYTE_ORDER MSB_LAST BIT_MASK 0x80000000 /end MEASUREMENT
/begin MEASUREMENT lam_bank_1.lsh_up.bf.lv_v_efc_lsh_up_lim_bol "Boolean flag indicating effective heater voltage limited due to sum of voltage components falling below zero." ULONG _CNV_S_2_RANGE______2_CM 1 100. 0. 1. DISPLAY_IDENTIFIER LV_V_EFC_LSH_UP_LIM_BOL_1 ECU_ADDRESS 0x3fc418 BYTE_ORDER MSB_LAST BIT_MASK 0x40000000 /end MEASUREMENT
/begin MEASUREMENT lam_bank_1.lsh_up.bf.lv_v_efc_lsh_up_lim_tol "Boolean flag indicating effective heater voltage limited due to exceeding threshold for period of time." ULONG _CNV_S_2_RANGE______2_CM 1 100. 0. 1. DISPLAY_IDENTIFIER LV_V_EFC_LSH_UP_LIM_TOL_1 ECU_ADDRESS 0x3fc418 BYTE_ORDER MSB_LAST BIT_MASK 0x20000000 /end MEASUREMENT
/begin MEASUREMENT lam_bank_1.lsh_up.bf.lv_v_efc_lsh_up_lim_max "Boolean flag indicating effective heater voltage limited due to exceeding absolute maximum voltage spec." ULONG _CNV_S_2_RANGE______2_CM 1 100. 0. 1. DISPLAY_IDENTIFIER LV_V_EFC_LSH_UP_LIM_MAX_1 ECU_ADDRESS 0x3fc418 BYTE_ORDER MSB_LAST BIT_MASK 0x10000000 /end MEASUREMENT
/begin MEASUREMENT lam_bank_1.lsh_up.bf.lv_pow_ctl_act "???" ULONG _CNV_S_2_RANGE______2_CM 1 100. 0. 1. DISPLAY_IDENTIFIER LV_POW_CTL_ACT_1 ECU_ADDRESS 0x3fc418 BYTE_ORDER MSB_LAST BIT_MASK 0x8000000 /end MEASUREMENT
/begin MEASUREMENT lam_bank_1.lsh_up.t_lsh_up "Timer to determine the duration of heating phase" UWORD _CNV_A_R_LINEAR_____24_CM 1 100. 0. 6553.5 DISPLAY_IDENTIFIER T_LSH_UP_1 ECU_ADDRESS 0x3fc428 BYTE_ORDER MSB_LAST FORMAT "%5.1" /end MEASUREMENT
/begin MEASUREMENT lam_bank_1.lsh_up.lshpwm_up "" UBYTE _CNV_A_R_LINEAR_____9_CM 1 100. 0. 99.609375 DISPLAY_IDENTIFIER LSHPWM_UP_1 ECU_ADDRESS 0x3fc420 FORMAT "%4.1" /end MEASUREMENT
/begin MEASUREMENT lam_bank_1.lsh_up.v_efc_lsh_up "Effective value of heater voltage" UBYTE _CNV_A_R_LINEAR_____34_CM 1 100. 0. 25.8984 DISPLAY_IDENTIFIER V_EFC_LSH_UP_1 ECU_ADDRESS 0x3fc421 FORMAT "%3.1" /end MEASUREMENT
/begin MEASUREMENT lam_bank_1.lsh_up.t_lsh_up_tol "Timer to determine the duration of high voltage phases" UBYTE _CNV_A_R_LINEAR_____24_CM 1 100. 0. 25.5 DISPLAY_IDENTIFIER T_LSH_UP_TOL_1 ECU_ADDRESS 0x3fc424 FORMAT "%4.1" /end MEASUREMENT
/begin MEASUREMENT lam_bank_1.lsh_up.t_lsh_up_lim "Timer to determine the duration of heating phases after a high voltage phase" UBYTE _CNV_A_R_LINEAR_____24_CM 1 100. 0. 25.5 DISPLAY_IDENTIFIER T_LSH_UP_LIM_1 ECU_ADDRESS 0x3fc425 FORMAT "%4.1" /end MEASUREMENT
/begin MEASUREMENT lam_bank_1.lsh_up.state_lsh_up "Heating state recognition" ULONG _CNV_S_7_STATE_LSH__324_CM 1 100. 0. 6. DISPLAY_IDENTIFIER STATE_LSH_UP_1 ECU_ADDRESS 0x3fc41c BYTE_ORDER MSB_LAST /end MEASUREMENT
/begin MEASUREMENT lam_bank_1.lsh_up.v_efc_lsh_up_clc "Effective calculated heater voltage value prior to overvoltage protection" UWORD _CNV_A_R_LINEAR_____325_CM 1 100. 0. 25.999603 DISPLAY_IDENTIFIER V_EFC_LSH_UP_CLC_1 ECU_ADDRESS 0x3fc422 BYTE_ORDER MSB_LAST FORMAT "%7.4" /end MEASUREMENT
/begin MEASUREMENT lam_bank_1.lsh_up.v_efc_lsh_up_ctl_add "Additive effective heater voltage from closed loop controller" SBYTE _CNV_A_R_LINEAR_____326_CM 1 100. -13.05 12.95 DISPLAY_IDENTIFIER V_EFC_LSH_UP_CTL_ADD_1 ECU_ADDRESS 0x3fc426 FORMAT "%5.1" /end MEASUREMENT
/begin MEASUREMENT lam_bank_1.lsh_up.v_efc_lsh_up_ctl_p_add "Additive effective heater voltage from closed loop controller, P term" SWORD _CNV_A_R_LINEAR_____327_CM 1 100. -13.05 13.05 DISPLAY_IDENTIFIER V_EFC_LSH_UP_CTL_P_ADD_1 ECU_ADDRESS 0x3fc42a BYTE_ORDER MSB_LAST FORMAT "%8.4" /end MEASUREMENT
/begin MEASUREMENT lam_bank_1.lsh_up.v_efc_lsh_up_ctl_i_add "Additive effective heater voltage from closed loop controller, I term" SWORD _CNV_A_R_LINEAR_____327_CM 1 100. -13.05 13.05 DISPLAY_IDENTIFIER V_EFC_LSH_UP_CTL_I_ADD_1 ECU_ADDRESS 0x3fc42c BYTE_ORDER MSB_LAST FORMAT "%8.4" /end MEASUREMENT
/begin MEASUREMENT lam_bank_1.lsh_up.ttip_ls_up_dif_set_mes "Difference between actual and set oxygen sensor tip temperature" SWORD _CNV_A_R_LINEAR_____303_CM 1 100. -2048. 2047.938 DISPLAY_IDENTIFIER TTIP_LS_UP_DIF_SET_MES_1 ECU_ADDRESS 0x3fc42e BYTE_ORDER MSB_LAST FORMAT "%8.2" /end MEASUREMENT
/begin MEASUREMENT lam_bank_1.lam_stic.lamb_puls "Lambda deviation for the lambda controller" SBYTE _CNV_A_R_LINEAR_____290_CM 1 100. -0.125 0.124023 DISPLAY_IDENTIFIER LAMB_PULS_1 ECU_ADDRESS 0x3fc5a4 FORMAT "%7.4" /end MEASUREMENT
/begin MEASUREMENT lam_bank_1.lam_dyw.lam_mv_dyw "LAM_MV-meanvalue" SWORD _CNV_A_R_LINEAR_____111_CM 1 100. -50. 49.99847412 DISPLAY_IDENTIFIER LAM_MV_DYW_1 ECU_ADDRESS 0x3fc61c BYTE_ORDER MSB_LAST FORMAT "%5.4" /end MEASUREMENT
/begin MEASUREMENT lam_bank_1.lam_dyw.bf.lv_lam_dyw "Conditions for the limited dynamic for LAM detected" ULONG _CNV_S_2_RANGE______2_CM 1 100. 0. 1. DISPLAY_IDENTIFIER LV_LAM_DYW_1 ECU_ADDRESS 0x3fc618 BYTE_ORDER MSB_LAST BIT_MASK 0x80000000 /end MEASUREMENT
/begin MEASUREMENT lam_bank_1.lam_puc_inci.bf.lv_inh_int_puc "catalyst purge function inhibited" ULONG _CNV_S_2_RANGE______2_CM 1 100. 0. 1. DISPLAY_IDENTIFIER LV_INH_INT_PUC_1 ECU_ADDRESS 0x3fc590 BYTE_ORDER MSB_LAST BIT_MASK 0x40000000 /end MEASUREMENT
/begin MEASUREMENT lam_bank_1.lam_puc_inci.bf.lv_act_int_puc_afl "state of the enrichment function for pre and main cat balancing" ULONG _CNV_S_2_RANGE______2_CM 1 100. 0. 1. DISPLAY_IDENTIFIER LV_ACT_INT_PUC_AFL_1 ECU_ADDRESS 0x3fc590 BYTE_ORDER MSB_LAST BIT_MASK 0x80000000 /end MEASUREMENT
/begin MEASUREMENT lam_bank_1.lam_puc_inci.temp_main_cat "modeled or assumed temperature of main cat" UWORD _CNV_A_R_LINEAR_____343_CM 1 100. -33. 990.984375 DISPLAY_IDENTIFIER TEMP_MAIN_CAT_1 ECU_ADDRESS 0x3fc594 BYTE_ORDER MSB_LAST FORMAT "%6.2" /end MEASUREMENT
/begin MEASUREMENT lam_bank_1.lam_puc_inci.temp_pcat "modeled or assumed temperature of pre cat" UWORD _CNV_A_R_LINEAR_____343_CM 1 100. -33. 990.984375 DISPLAY_IDENTIFIER TEMP_PCAT_1 ECU_ADDRESS 0x3fc596 BYTE_ORDER MSB_LAST FORMAT "%6.2" /end MEASUREMENT
/begin MEASUREMENT lam_bank_1.lsh_up_inci.lv_inh_lsh_up "Boolean flag indicating project specific application conditions for heating not met" UBYTE _CNV_S_2_RANGE______2_CM 1 100. 0. 1. DISPLAY_IDENTIFIER LV_INH_LSH_UP_1 ECU_ADDRESS 0x3fc434 /end MEASUREMENT
/begin MEASUREMENT lam_bank_1.lsh_up_inci.lv_inh_lsh_up_cll_ctl "Boolean flag indicating project specific application conditions closed loop heater control not met" UBYTE _CNV_S_2_RANGE______2_CM 1 100. 0. 1. DISPLAY_IDENTIFIER LV_INH_LSH_UP_CLL_CTL_1 ECU_ADDRESS 0x3fc435 /end MEASUREMENT
/begin MEASUREMENT lam_bank_1.lam_puc.bf.lv_act_int_puc "state of enrichment function for pre and main cat balancing" ULONG _CNV_S_2_RANGE______2_CM 1 100. 0. 1. DISPLAY_IDENTIFIER LV_ACT_INT_PUC_1 ECU_ADDRESS 0x3fc2f4 BYTE_ORDER MSB_LAST BIT_MASK 0x80000000 /end MEASUREMENT
/begin MEASUREMENT lam_bank_1.lam_puc.bf.lv_pcat_purge_puc "state of enrichment function for pre cat balancing after PUC phase" ULONG _CNV_S_2_RANGE______2_CM 1 100. 0. 1. DISPLAY_IDENTIFIER LV_PCAT_PURGE_PUC_1 ECU_ADDRESS 0x3fc2f4 BYTE_ORDER MSB_LAST BIT_MASK 0x40000000 /end MEASUREMENT
/begin MEASUREMENT lam_bank_1.lam_puc.bf.lv_pcat_purge_sa "state of enrichment function for pre cat balancing after SA phase" ULONG _CNV_S_2_RANGE______2_CM 1 100. 0. 1. DISPLAY_IDENTIFIER LV_PCAT_PURGE_SA_1 ECU_ADDRESS 0x3fc2f4 BYTE_ORDER MSB_LAST BIT_MASK 0x20000000 /end MEASUREMENT
/begin MEASUREMENT lam_bank_1.lam_puc.bf.lv_pcat_purge_hst "state of enrichment function for pre cat balancing after HST phase" ULONG _CNV_S_2_RANGE______2_CM 1 100. 0. 1. DISPLAY_IDENTIFIER LV_PCAT_PURGE_HST_1 ECU_ADDRESS 0x3fc2f4 BYTE_ORDER MSB_LAST BIT_MASK 0x10000000 /end MEASUREMENT
/begin MEASUREMENT lam_bank_1.lam_puc.bf.lv_pcat_purge_ch "state of enrichment function for pre cat balancing after CH phase" ULONG _CNV_S_2_RANGE______2_CM 1 100. 0. 1. DISPLAY_IDENTIFIER LV_PCAT_PURGE_CH_1 ECU_ADDRESS 0x3fc2f4 BYTE_ORDER MSB_LAST BIT_MASK 0x8000000 /end MEASUREMENT
/begin MEASUREMENT lam_bank_1.lam_puc.bf.lv_main_cat_purge "state of enrichment function for main cat balancing" ULONG _CNV_S_2_RANGE______2_CM 1 100. 0. 1. DISPLAY_IDENTIFIER LV_MAIN_CAT_PURGE_1 ECU_ADDRESS 0x3fc2f4 BYTE_ORDER MSB_LAST BIT_MASK 0x4000000 /end MEASUREMENT
/begin MEASUREMENT lam_bank_1.lam_puc.bf.lv_vls_down_puc_act_max "Logical indicating that downstream sensor signal is/was below calibration limit" ULONG _CNV_S_2_RANGE______2_CM 1 100. 0. 1. DISPLAY_IDENTIFIER LV_VLS_DOWN_PUC_ACT_MAX_1 ECU_ADDRESS 0x3fc2f4 BYTE_ORDER MSB_LAST BIT_MASK 0x2000000 /end MEASUREMENT
/begin MEASUREMENT lam_bank_1.lam_puc.bf.lv_down_ramp_act "flag indicating that down ramping from lambda setpoint shift to zero is active" ULONG _CNV_S_2_RANGE______2_CM 1 100. 0. 1. DISPLAY_IDENTIFIER LV_DOWN_RAMP_ACT_1 ECU_ADDRESS 0x3fc2f4 BYTE_ORDER MSB_LAST BIT_MASK 0x1000000 /end MEASUREMENT
/begin MEASUREMENT lam_bank_1.lam_puc.bf.lv_puc_trig "trigger bit for cat purge after PUC (needed if transition to LV_PUC = 0 but other conditions are not yet fulfilled)" ULONG _CNV_S_2_RANGE______2_CM 1 100. 0. 1. DISPLAY_IDENTIFIER LV_PUC_TRIG_1 ECU_ADDRESS 0x3fc2f4 BYTE_ORDER MSB_LAST BIT_MASK 0x800000 /end MEASUREMENT
/begin MEASUREMENT lam_bank_1.lam_puc.maf_int_act_puc "value of the mass air flow integral for the function deactivation" ULONG _CNV_A_R_LINEAR_____348_CM 1 100. 0. 1820.398 DISPLAY_IDENTIFIER MAF_INT_ACT_PUC_1 ECU_ADDRESS 0x3fc2f8 BYTE_ORDER MSB_LAST FORMAT "%12.7" /end MEASUREMENT
/begin MEASUREMENT lam_bank_1.lam_puc.maf_int_cat_load "Measurment of the purge amount of the pre catalyst" ULONG _CNV_A_R_LINEAR_____348_CM 1 100. 0. 1820.398 DISPLAY_IDENTIFIER MAF_INT_CAT_LOAD_1 ECU_ADDRESS 0x3fc2fc BYTE_ORDER MSB_LAST FORMAT "%12.7" /end MEASUREMENT
/begin MEASUREMENT lam_bank_1.lam_puc.maf_int_cat_load_main "Measurment of the purge amount of the main catalyst" ULONG _CNV_A_R_LINEAR_____348_CM 1 100. 0. 1820.398 DISPLAY_IDENTIFIER MAF_INT_CAT_LOAD_MAIN_1 ECU_ADDRESS 0x3fc300 BYTE_ORDER MSB_LAST FORMAT "%12.7" /end MEASUREMENT
/begin MEASUREMENT lam_bank_1.lam_puc.maf_int_purge_rest "Estimated rest integral for catalyst purge" ULONG _CNV_A_R_LINEAR_____348_CM 1 100. 0. 1820.398 DISPLAY_IDENTIFIER MAF_INT_PURGE_REST_1 ECU_ADDRESS 0x3fc304 BYTE_ORDER MSB_LAST FORMAT "%12.7" /end MEASUREMENT
/begin MEASUREMENT lam_bank_1.lam_puc.maf_int_sample_step "MAF integral to be added/ subtracted each sample step" ULONG _CNV_A_R_LINEAR_____348_CM 1 100. 0. 1820.398 DISPLAY_IDENTIFIER MAF_INT_SAMPLE_STEP_1 ECU_ADDRESS 0x3fc308 BYTE_ORDER MSB_LAST FORMAT "%12.7" /end MEASUREMENT
/begin MEASUREMENT lam_bank_1.lam_puc.maf_int_tot_purge "total MAF integral for pre and main cat purge" ULONG _CNV_A_R_LINEAR_____348_CM 1 100. 0. 1820.398 DISPLAY_IDENTIFIER MAF_INT_TOT_PURGE_1 ECU_ADDRESS 0x3fc30c BYTE_ORDER MSB_LAST FORMAT "%12.7" /end MEASUREMENT
/begin MEASUREMENT lam_bank_1.lam_puc.fac_add_pcat_main_cat_puc "additional weighting factor for IP_FAC_PCAT_MAIN_CAT_PUC" UBYTE _CNV_A_R_LINEAR_____129_CM 1 100. 0. 3.984375 DISPLAY_IDENTIFIER FAC_ADD_PCAT_MAIN_CAT_PUC_1 ECU_ADDRESS 0x3fc310 FORMAT "%4.2" /end MEASUREMENT
/begin MEASUREMENT lam_bank_1.lam_puc.quo_maf_int_purge "quotient: current MAF rest integral / total MAF integral" UBYTE _CNV_A_R_LINEAR_____50_CM 1 100. 0. 0.996094 DISPLAY_IDENTIFIER QUO_MAF_INT_PURGE_1 ECU_ADDRESS 0x3fc311 FORMAT "%5.3" /end MEASUREMENT
/begin MEASUREMENT lam_bank_1.lam_puc.delta_lamb_sp_puc "Lambda controller setpoint shift" UBYTE _CNV_A_R_LINEAR_____285_CM 1 100. 0. 0.125 DISPLAY_IDENTIFIER DELTA_LAMB_SP_PUC_1 ECU_ADDRESS 0x3fc312 FORMAT "%5.3" /end MEASUREMENT
/begin MEASUREMENT lam_bank_2.ls_up.bf.lv_lsl_ofs "State of the Offset measurement" ULONG _CNV_S_2_RANGE______2_CM 1 100. 0. 1. DISPLAY_IDENTIFIER LV_LSL_OFS_2 ECU_ADDRESS 0x3fc9c4 BYTE_ORDER MSB_LAST BIT_MASK 0x80000000 /end MEASUREMENT
/begin MEASUREMENT lam_bank_2.ls_up.bf.lv_lsl_out "Work-around for Vs check with CJ110" ULONG _CNV_S_2_RANGE______2_CM 1 100. 0. 1. DISPLAY_IDENTIFIER LV_LSL_OUT_2 ECU_ADDRESS 0x3fc9c4 BYTE_ORDER MSB_LAST BIT_MASK 0x2000000 /end MEASUREMENT
/begin MEASUREMENT lam_bank_2.ls_up.bf.lv_lsl_ofs_puls "State of the offset measurement for lambda stimulation" ULONG _CNV_S_2_RANGE______2_CM 1 100. 0. 1. DISPLAY_IDENTIFIER LV_LSL_OFS_PULS_2 ECU_ADDRESS 0x3fc9c4 BYTE_ORDER MSB_LAST BIT_MASK 0x40000000 /end MEASUREMENT
/begin MEASUREMENT lam_bank_2.ls_up.bf.lv_vls_lsl_ofs_lim "Boolean flag showing limited output voltage offset adjustment" ULONG _CNV_S_2_RANGE______2_CM 1 100. 0. 1. DISPLAY_IDENTIFIER LV_VLS_LSL_OFS_LIM_2 ECU_ADDRESS 0x3fc9c4 BYTE_ORDER MSB_LAST BIT_MASK 0x1000000 /end MEASUREMENT
/begin MEASUREMENT lam_bank_2.ls_up.vls_lsl_cor "corrected output signal of the lambda sensor" UWORD _CNV_A_R_LINEAR_____3_CM 1 100. 0. 4.99511719 DISPLAY_IDENTIFIER VLS_LSL_COR_2 ECU_ADDRESS 0x3fc9d4 BYTE_ORDER MSB_LAST FORMAT "%5.3" /end MEASUREMENT
/begin MEASUREMENT lam_bank_2.ls_up.vls_lsl_ofs "output signal offset for the linear Lambda sensor" SWORD _CNV_A_R_LINEAR_____3_CM 1 100. -4.99511719 4.99511719 DISPLAY_IDENTIFIER VLS_LSL_OFS_2 ECU_ADDRESS 0x3fc9e2 BYTE_ORDER MSB_LAST FORMAT "%5.2" /end MEASUREMENT
/begin MEASUREMENT lam_bank_2.ls_up.iplsl_cor "Compensated nominal pumping current ( after sensor/sensor dispersion compensation at new and aged )" SWORD _CNV_A_R_LINEAR_____284_CM 1 100. -12.596 12.596 DISPLAY_IDENTIFIER IPLSL_COR_2 ECU_ADDRESS 0x3fc9e6 BYTE_ORDER MSB_LAST FORMAT "%7.4" /end MEASUREMENT
/begin MEASUREMENT lam_bank_2.ls_ready.bf.lv_up_ls "operability status of the lambda sensor (delayed)" ULONG _CNV_S_2_RANGE______2_CM 1 100. 0. 1. DISPLAY_IDENTIFIER LV_UP_LS_2 ECU_ADDRESS 0x3fc98c BYTE_ORDER MSB_LAST BIT_MASK 0x80000000 /end MEASUREMENT
/begin MEASUREMENT lam_bank_2.ls_ready.bf.lv_up_ls_raw "instantaneous operability status of the lambda sensor (undelayed)" ULONG _CNV_S_2_RANGE______2_CM 1 100. 0. 1. DISPLAY_IDENTIFIER LV_UP_LS_RAW_2 ECU_ADDRESS 0x3fc98c BYTE_ORDER MSB_LAST BIT_MASK 0x10000000 /end MEASUREMENT
/begin MEASUREMENT lam_bank_2.ls_ready.bf.lv_up_ls_cdn "operability status of the lambda sensor at forced activation" ULONG _CNV_S_2_RANGE______2_CM 1 100. 0. 1. DISPLAY_IDENTIFIER LV_UP_LS_CDN_2 ECU_ADDRESS 0x3fc98c BYTE_ORDER MSB_LAST BIT_MASK 0x40000000 /end MEASUREMENT
/begin MEASUREMENT lam_bank_2.ls_ready.lamb_mmv_ready "mean value of the lambda sensor signal" UWORD _CNV_A_R_LINEAR_____285_CM 1 100. 0. 2. DISPLAY_IDENTIFIER LAMB_MMV_READY_2 ECU_ADDRESS 0x3fc990 BYTE_ORDER MSB_LAST FORMAT "%5.3" /end MEASUREMENT
/begin MEASUREMENT lam_bank_2.ls_ready.lamb_de_int "value as a measure of the sensor variation" UWORD _CNV_A_R_LINEAR_____118_CM 1 100. 0. 63.99902344 DISPLAY_IDENTIFIER LAMB_DE_INT_2 ECU_ADDRESS 0x3fc992 BYTE_ORDER MSB_LAST FORMAT "%7.4" /end MEASUREMENT
/begin MEASUREMENT lam_bank_2.ls_ready.t_deac_ls_ready "Timer for forced activation" UWORD _CNV_A_R_LINEAR_____198_CM 1 100. 0. 1310.7 DISPLAY_IDENTIFIER T_DEAC_LS_READY_2 ECU_ADDRESS 0x3fc994 BYTE_ORDER MSB_LAST FORMAT "%7.2" /end MEASUREMENT
/begin MEASUREMENT lam_bank_2.ls_ready.t_dly_ls_ready "Timer for delay time" UWORD _CNV_A_R_LINEAR_____198_CM 1 100. 0. 1310.7 DISPLAY_IDENTIFIER T_DLY_LS_READY_2 ECU_ADDRESS 0x3fc996 BYTE_ORDER MSB_LAST FORMAT "%7.2" /end MEASUREMENT
/begin MEASUREMENT lam_bank_2.ls_ready.t_lamb_de_clr "Timer for sensor dispersion calculation up to the reset" UWORD _CNV_A_R_LINEAR_____198_CM 1 100. 0. 1310.7 DISPLAY_IDENTIFIER T_LAMB_DE_CLR_2 ECU_ADDRESS 0x3fc998 BYTE_ORDER MSB_LAST FORMAT "%7.2" /end MEASUREMENT
/begin MEASUREMENT lam_bank_2.lam_dly.bf.lv_delta_lamb "activation signal for trim-controller" ULONG _CNV_S_2_RANGE______2_CM 1 100. 0. 1. DISPLAY_IDENTIFIER LV_DELTA_LAMB_2 ECU_ADDRESS 0x3fc78c BYTE_ORDER MSB_LAST BIT_MASK 0x40000000 /end MEASUREMENT
/begin MEASUREMENT lam_bank_2.lam_dly.bf.lv_lam_dly_i_act "activation signal for the calculation of the trim-controller I-share" ULONG _CNV_S_2_RANGE______2_CM 1 100. 0. 1. DISPLAY_IDENTIFIER LV_LAM_DLY_I_ACT_2 ECU_ADDRESS 0x3fc78c BYTE_ORDER MSB_LAST BIT_MASK 0x20000000 /end MEASUREMENT
/begin MEASUREMENT lam_bank_2.lam_dly.bf.lv_lam_dly_p_act "activation signal for the calculation of the trim-controller I-share" ULONG _CNV_S_2_RANGE______2_CM 1 100. 0. 1. DISPLAY_IDENTIFIER LV_LAM_DLY_P_ACT_2 ECU_ADDRESS 0x3fc78c BYTE_ORDER MSB_LAST BIT_MASK 0x10000000 /end MEASUREMENT
/begin MEASUREMENT lam_bank_2.lam_dly.delta_lamb_p "l-shift from P-share" SWORD _CNV_A_R_LINEAR_____285_CM 1 100. -0.125 0.125 DISPLAY_IDENTIFIER DELTA_LAMB_P_2 ECU_ADDRESS 0x3fc796 BYTE_ORDER MSB_LAST FORMAT "%7.4" /end MEASUREMENT
/begin MEASUREMENT lam_bank_2.lam_dly.delta_lamb_i_ad_h_res "adaptation value for lambda-shift with high resolution" SWORD _CNV_A_R_LINEAR_____286_CM 1 100. -0.125 0.124996 DISPLAY_IDENTIFIER DELTA_LAMB_I_AD_H_RES_2 ECU_ADDRESS 0x3fc7a2 BYTE_ORDER MSB_LAST FORMAT "%8.6" /end MEASUREMENT
/begin MEASUREMENT lam_bank_2.lam_dly.delta_lamb "l-shift from downstream trim controller" SWORD _CNV_A_R_LINEAR_____285_CM 1 100. -0.125 0.125 DISPLAY_IDENTIFIER DELTA_LAMB_2 ECU_ADDRESS 0x3fc7a4 BYTE_ORDER MSB_LAST FORMAT "%7.4" /end MEASUREMENT
/begin MEASUREMENT lam_bank_2.lam_dly.maf_int_dly "integral of air mass flow since LAM activation" UWORD _CNV_A_R_LINEAR_____287_CM 1 100. 0. 1820.398 DISPLAY_IDENTIFIER MAF_INT_DLY_2 ECU_ADDRESS 0x3fc7aa BYTE_ORDER MSB_LAST FORMAT "%7.2" /end MEASUREMENT
/begin MEASUREMENT lam_bank_2.lam_dly.vls_dif_dly "difference between setpoint and actual downstream LS signal" SWORD _CNV_A_R_LINEAR_____3_CM 1 100. -4.99511719 4.99511719 DISPLAY_IDENTIFIER VLS_DIF_DLY_2 ECU_ADDRESS 0x3fc794 BYTE_ORDER MSB_LAST FORMAT "%5.2" /end MEASUREMENT
/begin MEASUREMENT lam_bank_2.lam_dly.delta_lamb_i "l-shift from I-share" SWORD _CNV_A_R_LINEAR_____285_CM 1 100. -0.125 0.125 DISPLAY_IDENTIFIER DELTA_LAMB_I_2 ECU_ADDRESS 0x3fc79a BYTE_ORDER MSB_LAST FORMAT "%7.4" /end MEASUREMENT
/begin MEASUREMENT lam_bank_2.lam_dly.delta_lamb_p_h_res "lambda-shift from P-share with high resolution" SWORD _CNV_A_R_LINEAR_____288_CM 1 100. -0.125 0.125 DISPLAY_IDENTIFIER DELTA_LAMB_P_H_RES_2 ECU_ADDRESS 0x3fc798 BYTE_ORDER MSB_LAST FORMAT "%8.5" /end MEASUREMENT
/begin MEASUREMENT lam_bank_2.lam_dly.delta_lamb_i_h_res "lambda-shift from I-share with high resolution" SWORD _CNV_A_R_LINEAR_____286_CM 1 100. -0.125 0.124996 DISPLAY_IDENTIFIER DELTA_LAMB_I_H_RES_2 ECU_ADDRESS 0x3fc7a0 BYTE_ORDER MSB_LAST FORMAT "%8.6" /end MEASUREMENT
/begin MEASUREMENT lam_bank_2.lam_dly.delta_lamb_h_res "lambda-shift from from downstream trim controller with high resolution" SWORD _CNV_A_R_LINEAR_____288_CM 1 100. -0.125 0.125 DISPLAY_IDENTIFIER DELTA_LAMB_H_RES_2 ECU_ADDRESS 0x3fc7a6 BYTE_ORDER MSB_LAST FORMAT "%8.5" /end MEASUREMENT
/begin MEASUREMENT lam_bank_2.lam_dly.delta_lamb_i_h_res_save "saved high word of I-share with high resolution (saved in case diagnosis is switched on)" SWORD _CNV_A_R_LINEAR_____286_CM 1 100. -0.125 0.124996 DISPLAY_IDENTIFIER DELTA_LAMB_I_H_RES_SAVE_2 ECU_ADDRESS 0x3fc7a8 BYTE_ORDER MSB_LAST FORMAT "%8.6" /end MEASUREMENT
/begin MEASUREMENT lam_bank_2.lam_dly.delta_lamb_i_mmv "moving mean value of i-share from Trim control" SLONG _CNV_A_R_LINEAR_____289_CM 1 100. -0.125 0.125 DISPLAY_IDENTIFIER DELTA_LAMB_I_MMV_2 ECU_ADDRESS 0x3fc79c BYTE_ORDER MSB_LAST FORMAT "%9.8" /end MEASUREMENT
/begin MEASUREMENT lam_bank_2.lam_sti.bf.lv_lamb_puls_on "activation state variable for the forced stimulation" ULONG _CNV_S_2_RANGE______2_CM 1 100. 0. 1. DISPLAY_IDENTIFIER LV_LAMB_PULS_ON_2 ECU_ADDRESS 0x3fca30 BYTE_ORDER MSB_LAST BIT_MASK 0x80000000 /end MEASUREMENT
/begin MEASUREMENT lam_bank_2.lam_sti.bf.lv_lamb_puls_on_ls_diag "activation state variable for the forced stimulation in requested mode" ULONG _CNV_S_2_RANGE______2_CM 1 100. 0. 1. DISPLAY_IDENTIFIER LV_LAMB_PULS_ON_LS_DIAG_2 ECU_ADDRESS 0x3fca30 BYTE_ORDER MSB_LAST BIT_MASK 0x40000000 /end MEASUREMENT
/begin MEASUREMENT lam_bank_2.lam_sti.bf.lv_delta_lamb_puls_on "flag that indicates that the forced stimulation is activated or deactivated due to cat purge" ULONG _CNV_S_2_RANGE______2_CM 1 100. 0. 1. DISPLAY_IDENTIFIER LV_DELTA_LAMB_PULS_ON_2 ECU_ADDRESS 0x3fca30 BYTE_ORDER MSB_LAST BIT_MASK 0x20000000 /end MEASUREMENT
/begin MEASUREMENT lam_bank_2.lam_sti.bf.lv_lamb_puls_mst_cbk "" ULONG _CNV_S_2_RANGE______2_CM 1 100. 0. 1. DISPLAY_IDENTIFIER LV_LAMB_PULS_MST_CBK_2 ECU_ADDRESS 0x3fca30 BYTE_ORDER MSB_LAST BIT_MASK 0x10000000 /end MEASUREMENT
/begin MEASUREMENT lam_bank_2.lam_sti.bf.lv_lamb_puls_syn_cbk_old "" ULONG _CNV_S_2_RANGE______2_CM 1 100. 0. 1. DISPLAY_IDENTIFIER LV_LAMB_PULS_SYN_CBK_OLD_2 ECU_ADDRESS 0x3fca30 BYTE_ORDER MSB_LAST BIT_MASK 0x8000000 /end MEASUREMENT
/begin MEASUREMENT lam_bank_2.lam_sti.lamb_puls_osc "Output signal of the forced stimulation" SBYTE _CNV_A_R_LINEAR_____290_CM 1 100. -0.125 0.124023 DISPLAY_IDENTIFIER LAMB_PULS_OSC_2 ECU_ADDRESS 0x3fca42 FORMAT "%7.4" /end MEASUREMENT
/begin MEASUREMENT lam_bank_2.lam_sti.maf_int_lamb_puls "MAF-integral for the activation of the forced stimulation" UWORD _CNV_A_R_LINEAR_____273_CM 1 100. 0. 1820.4167 DISPLAY_IDENTIFIER MAF_INT_LAMB_PULS_2 ECU_ADDRESS 0x3fca38 BYTE_ORDER MSB_LAST FORMAT "%9.4" /end MEASUREMENT
/begin MEASUREMENT lam_bank_2.lsl_ad.bf.lv_lsl_gain_ad_req "Request for Fuel Cut Off Ip measurement" ULONG _CNV_S_2_RANGE______2_CM 1 100. 0. 1. DISPLAY_IDENTIFIER LV_LSL_GAIN_AD_REQ_2 ECU_ADDRESS 0x3fca80 BYTE_ORDER MSB_LAST BIT_MASK 0x80000000 /end MEASUREMENT
/begin MEASUREMENT lam_bank_2.lsl_ad.bf.lv_iplsl_vld_fcut "Valid Ip sample during fuel cut was found" ULONG _CNV_S_2_RANGE______2_CM 1 100. 0. 1. DISPLAY_IDENTIFIER LV_IPLSL_VLD_FCUT_2 ECU_ADDRESS 0x3fca80 BYTE_ORDER MSB_LAST BIT_MASK 0x20000000 /end MEASUREMENT
/begin MEASUREMENT lam_bank_2.lsl_ad.bf.lv_lsl_fcut_mes "Fuel Cut  Ip Measurement  ready" ULONG _CNV_S_2_RANGE______2_CM 1 100. 0. 1. DISPLAY_IDENTIFIER LV_LSL_FCUT_MES_2 ECU_ADDRESS 0x3fca80 BYTE_ORDER MSB_LAST BIT_MASK 0x10000000 /end MEASUREMENT
/begin MEASUREMENT lam_bank_2.lsl_ad.bf.lv_lsl_fcut_mes_not "No Fuel Cut  Ip Measurement  possible" ULONG _CNV_S_2_RANGE______2_CM 1 100. 0. 1. DISPLAY_IDENTIFIER LV_LSL_FCUT_MES_NOT_2 ECU_ADDRESS 0x3fca80 BYTE_ORDER MSB_LAST BIT_MASK 0x8000000 /end MEASUREMENT
/begin MEASUREMENT lam_bank_2.lsl_ad.bf.lv_lsl_fcut_ad_not "No Fuel Cut  WRAF sensor gain adaptation  possible" ULONG _CNV_S_2_RANGE______2_CM 1 100. 0. 1. DISPLAY_IDENTIFIER LV_LSL_FCUT_AD_NOT_2 ECU_ADDRESS 0x3fca80 BYTE_ORDER MSB_LAST BIT_MASK 0x4000000 /end MEASUREMENT
/begin MEASUREMENT lam_bank_2.lsl_ad.bf.lv_lsl_gain_ad_req_vld "Validation of request for Fuel Cut Off Ip measurement" ULONG _CNV_S_2_RANGE______2_CM 1 100. 0. 1. DISPLAY_IDENTIFIER LV_LSL_GAIN_AD_REQ_VLD_2 ECU_ADDRESS 0x3fca80 BYTE_ORDER MSB_LAST BIT_MASK 0x40000000 /end MEASUREMENT
/begin MEASUREMENT lam_bank_2.lsl_ad.iplsl_cor_mmv_fcut "Moving mean of  corrected pumping current during fuel cut" SWORD _CNV_A_R_LINEAR_____284_CM 1 100. -12.596 12.596 DISPLAY_IDENTIFIER IPLSL_COR_MMV_FCUT_2 ECU_ADDRESS 0x3fca84 BYTE_ORDER MSB_LAST FORMAT "%7.4" /end MEASUREMENT
/begin MEASUREMENT lam_bank_2.lsl_ad.iplsl_purge "Except adaptation,  compensated pumping current during fuel cut at purged condition" SWORD _CNV_A_R_LINEAR_____284_CM 1 100. -12.596 12.596 DISPLAY_IDENTIFIER IPLSL_PURGE_2 ECU_ADDRESS 0x3fca88 BYTE_ORDER MSB_LAST FORMAT "%7.4" /end MEASUREMENT
/begin MEASUREMENT lam_bank_2.lsl_ad.iplsl_mv_purge "Arithmetic mean of compensated pumping current during fuel cut at purged condition" SWORD _CNV_A_R_LINEAR_____284_CM 1 100. -12.596 12.596 DISPLAY_IDENTIFIER IPLSL_MV_PURGE_2 ECU_ADDRESS 0x3fca8a BYTE_ORDER MSB_LAST FORMAT "%7.4" /end MEASUREMENT
/begin MEASUREMENT lam_bank_2.lsl_ad.iplsl_cor_beg_purge "Corrected pumping current during fuel cut at begin of purged condition" SWORD _CNV_A_R_LINEAR_____284_CM 1 100. -12.596 12.596 DISPLAY_IDENTIFIER IPLSL_COR_BEG_PURGE_2 ECU_ADDRESS 0x3fca8c BYTE_ORDER MSB_LAST FORMAT "%7.4" /end MEASUREMENT
/begin MEASUREMENT lam_bank_2.lsl_ad.iplsl_cor_chg_purge "Corrected pumping current during fuel cut at begin of purged condition" SWORD _CNV_A_R_LINEAR_____284_CM 1 100. -12.596 12.596 DISPLAY_IDENTIFIER IPLSL_COR_CHG_PURGE_2 ECU_ADDRESS 0x3fca8e BYTE_ORDER MSB_LAST FORMAT "%7.4" /end MEASUREMENT
/begin MEASUREMENT lam_bank_2.lsl_ad.iplsl_vari_purge "Variance of  corrected pumping current during fuel cut at purged condition" UWORD _CNV_A_R_LINEAR_____299_CM 1 100. 0. 619.7000000000001 DISPLAY_IDENTIFIER IPLSL_VARI_PURGE_2 ECU_ADDRESS 0x3fca90 BYTE_ORDER MSB_LAST FORMAT "%7.3" /end MEASUREMENT
/begin MEASUREMENT lam_bank_2.lsl_ad.iplsl_vld_mmv_fcut "Moving mean of  valid samples pumping current during fuel cut" SWORD _CNV_A_R_LINEAR_____284_CM 1 100. -12.596 12.596 DISPLAY_IDENTIFIER IPLSL_VLD_MMV_FCUT_2 ECU_ADDRESS 0x3fca92 BYTE_ORDER MSB_LAST FORMAT "%7.4" /end MEASUREMENT
/begin MEASUREMENT lam_bank_2.lsl_ad.iplsl_vld_vari_fcut "Moving variance of  valid samples pumping current during fuel cut" UWORD _CNV_A_R_LINEAR_____299_CM 1 100. 0. 619.7000000000001 DISPLAY_IDENTIFIER IPLSL_VLD_VARI_FCUT_2 ECU_ADDRESS 0x3fca98 BYTE_ORDER MSB_LAST FORMAT "%7.3" /end MEASUREMENT
/begin MEASUREMENT lam_bank_2.lsl_ad.t_dur_int "Timer for IPLSL integration" UBYTE _CNV_A_R_LINEAR_____24_CM 1 100. 0. 25.5 DISPLAY_IDENTIFIER T_DUR_INT_2 ECU_ADDRESS 0x3fca9e FORMAT "%4.1" /end MEASUREMENT
/begin MEASUREMENT lam_bank_2.lsl_ad.state_lsl_fcut "State of fuel cut analyzer state machine" UBYTE _CNV_S_5_RANGE_STAT_300_CM 1 100. 0. 4. DISPLAY_IDENTIFIER STATE_LSL_FCUT_2 ECU_ADDRESS 0x3fca9f /end MEASUREMENT
/begin MEASUREMENT lam_bank_2.lsl_ad.state_lsl_gain_ad "State of WRAF adaptive  indicator" UBYTE _CNV_S_4_RANGE_STAT_301_CM 1 100. 0. 3. DISPLAY_IDENTIFIER STATE_LSL_GAIN_AD_2 ECU_ADDRESS 0x3fcaa0 /end MEASUREMENT
/begin MEASUREMENT lam_bank_2.lsl_ad.fac_lsl_cor_ad "Factor for  WRAF sensor gain adaptation" UWORD _CNV_A_R_LINEAR_____20_CM 1 100. 0. 1.99996948 DISPLAY_IDENTIFIER FAC_LSL_COR_AD_2 ECU_ADDRESS 0x3fcaa2 BYTE_ORDER MSB_LAST FORMAT "%7.5" /end MEASUREMENT
/begin MEASUREMENT lam_bank_2.lsl_ad.iplsl_max_vld_mmv_fcut "Moving mean of valid samples pumping current during fuel cut at adapted maximum" SWORD _CNV_A_R_LINEAR_____284_CM 1 100. -12.596 12.596 DISPLAY_IDENTIFIER IPLSL_MAX_VLD_MMV_FCUT_2 ECU_ADDRESS 0x3fca94 BYTE_ORDER MSB_LAST FORMAT "%7.4" /end MEASUREMENT
/begin MEASUREMENT lam_bank_2.lsl_ad.iplsl_min_vld_mmv_fcut "Moving mean of valid samples pumping current during fuel cut at adapted minimum" SWORD _CNV_A_R_LINEAR_____284_CM 1 100. -12.596 12.596 DISPLAY_IDENTIFIER IPLSL_MIN_VLD_MMV_FCUT_2 ECU_ADDRESS 0x3fca96 BYTE_ORDER MSB_LAST FORMAT "%7.4" /end MEASUREMENT
/begin MEASUREMENT lam_bank_2.lsl_ad.iplsl_max_vld_vari_fcut "Moving variance of valid samples pumping current during fuel cut at adapted maximum" UWORD _CNV_A_R_LINEAR_____299_CM 1 100. 0. 619.7000000000001 DISPLAY_IDENTIFIER IPLSL_MAX_VLD_VARI_FCUT_2 ECU_ADDRESS 0x3fca9a BYTE_ORDER MSB_LAST FORMAT "%7.3" /end MEASUREMENT
/begin MEASUREMENT lam_bank_2.lsl_ad.iplsl_min_vld_vari_fcut "Moving variance of valid samples pumping current during fuel cut at adapted minimum" UWORD _CNV_A_R_LINEAR_____299_CM 1 100. 0. 619.7000000000001 DISPLAY_IDENTIFIER IPLSL_MIN_VLD_VARI_FCUT_2 ECU_ADDRESS 0x3fca9c BYTE_ORDER MSB_LAST FORMAT "%7.3" /end MEASUREMENT
/begin MEASUREMENT lam_bank_2.lsl_ad.ctr_fac_lsl_cor_ad "Counter of number of WRAF sensor gain adaptations" UWORD _CNV_A_R_LINEAR_____0_CM 1 100. 0. 65535. DISPLAY_IDENTIFIER CTR_FAC_LSL_COR_AD_2 ECU_ADDRESS 0x3fcaa4 BYTE_ORDER MSB_LAST FORMAT "%5.0" /end MEASUREMENT
/begin MEASUREMENT lam_bank_2.lsl_ad.fac_min_lsl_cor_ad "Adapted minimum of factor for WRAF sensor gain adaptation" UWORD _CNV_A_R_LINEAR_____20_CM 1 100. 0. 1.99996948 DISPLAY_IDENTIFIER FAC_MIN_LSL_COR_AD_2 ECU_ADDRESS 0x3fcaa6 BYTE_ORDER MSB_LAST FORMAT "%7.5" /end MEASUREMENT
/begin MEASUREMENT lam_bank_2.lsl_ad.fac_max_lsl_cor_ad "Adapted maximum of factor for WRAF sensor gain adaptation" UWORD _CNV_A_R_LINEAR_____20_CM 1 100. 0. 1.99996948 DISPLAY_IDENTIFIER FAC_MAX_LSL_COR_AD_2 ECU_ADDRESS 0x3fcaa8 BYTE_ORDER MSB_LAST FORMAT "%7.5" /end MEASUREMENT
/begin MEASUREMENT lam_bank_2.lsl_ad.fac_min_lsl_cor_ad_amp "Ambient pressure during adaptation of the minimum of the factor for WRAF sensor gain adaptation" UWORD _CNV_A_R_LINEAR_____49_CM 1 100. 0. 5434. DISPLAY_IDENTIFIER FAC_MIN_LSL_COR_AD_AMP_2 ECU_ADDRESS 0x3fcaaa BYTE_ORDER MSB_LAST FORMAT "%7.2" /end MEASUREMENT
/begin MEASUREMENT lam_bank_2.lsl_ad.fac_max_lsl_cor_ad_amp "Ambient pressure during adaptation of the maximum of the factor for WRAF sensor gain adaptation" UWORD _CNV_A_R_LINEAR_____49_CM 1 100. 0. 5434. DISPLAY_IDENTIFIER FAC_MAX_LSL_COR_AD_AMP_2 ECU_ADDRESS 0x3fcaac BYTE_ORDER MSB_LAST FORMAT "%7.2" /end MEASUREMENT
/begin MEASUREMENT lam_bank_2.lsl_ad.fac_min_lsl_cor_ad_tia "TIA during adaptation of the minimum of the factor for WRAF sensor gain adaptation" UBYTE _CNV_A_R_LINEAR_____11_CM 1 100. -48. 142.5 DISPLAY_IDENTIFIER FAC_MIN_LSL_COR_AD_TIA_2 ECU_ADDRESS 0x3fcaae FORMAT "%5.1" /end MEASUREMENT
/begin MEASUREMENT lam_bank_2.lsl_ad.fac_max_lsl_cor_ad_tia "TIA during adaptation of the maximum of the factor for WRAF sensor gain adaptation" UBYTE _CNV_A_R_LINEAR_____11_CM 1 100. -48. 142.5 DISPLAY_IDENTIFIER FAC_MAX_LSL_COR_AD_TIA_2 ECU_ADDRESS 0x3fcaaf FORMAT "%5.1" /end MEASUREMENT
/begin MEASUREMENT lam_bank_2.lsl_ad.fac_min_lsl_cor_ad_map "MAP during adaptation of the maximum of the factor for WRAF sensor gain adaptation" UWORD _CNV_A_R_LINEAR_____49_CM 1 100. 0. 5434. DISPLAY_IDENTIFIER FAC_MIN_LSL_COR_AD_MAP_2 ECU_ADDRESS 0x3fcab0 BYTE_ORDER MSB_LAST FORMAT "%7.2" /end MEASUREMENT
/begin MEASUREMENT lam_bank_2.lsl_ad.fac_max_lsl_cor_ad_map "MAP during adaptation of the maximum of the factor for WRAF sensor gain adaptation" UWORD _CNV_A_R_LINEAR_____49_CM 1 100. 0. 5434. DISPLAY_IDENTIFIER FAC_MAX_LSL_COR_AD_MAP_2 ECU_ADDRESS 0x3fcab2 BYTE_ORDER MSB_LAST FORMAT "%7.2" /end MEASUREMENT
/begin MEASUREMENT lam_bank_2.lsl_ad.fac_max_lsl_cor_ad_tam "TAM during adaptation of the maximum of the factor for WRAF sensor gain adaptation" UBYTE _CNV_A_R_LINEAR_____302_CM 1 100. -40. 63. DISPLAY_IDENTIFIER FAC_MAX_LSL_COR_AD_TAM_2 ECU_ADDRESS 0x3fcab5 FORMAT "%5.1" /end MEASUREMENT
/begin MEASUREMENT lam_bank_2.lsl_ad.fac_min_lsl_cor_ad_tam "TAM during adaptation of the minimum of the factor for WRAF sensor gain adaptation" UBYTE _CNV_A_R_LINEAR_____302_CM 1 100. -40. 63. DISPLAY_IDENTIFIER FAC_MIN_LSL_COR_AD_TAM_2 ECU_ADDRESS 0x3fcab4 FORMAT "%5.1" /end MEASUREMENT
/begin MEASUREMENT lam_bank_2.lsl_ad.fac_min_lsl_cor_ad_n_32 "N during adaptation of the minimum of the factor for WRAF sensor gain adaptation" UBYTE _CNV_A_R_LINEAR_____15_CM 1 100. 0. 8160. DISPLAY_IDENTIFIER FAC_MIN_LSL_COR_AD_N_32_2 ECU_ADDRESS 0x3fcab6 FORMAT "%4.0" /end MEASUREMENT
/begin MEASUREMENT lam_bank_2.lsl_ad.fac_max_lsl_cor_ad_n_32 "N during adaptation of the maximum of the factor for WRAF sensor gain adaptation" UBYTE _CNV_A_R_LINEAR_____15_CM 1 100. 0. 8160. DISPLAY_IDENTIFIER FAC_MAX_LSL_COR_AD_N_32_2 ECU_ADDRESS 0x3fcab7 FORMAT "%4.0" /end MEASUREMENT
/begin MEASUREMENT lam_bank_2.lsl_ad.fac_max_lsl_cor_ad_maf_kgh "MAF during adaptation of the minimum of the factor for WRAF sensor gain adaptation" UWORD _CNV_A_R_LINEAR_____115_CM 1 100. 0. 2047.96875 DISPLAY_IDENTIFIER FAC_MAX_LSL_COR_AD_MAF_KGH_2 ECU_ADDRESS 0x3fcaba BYTE_ORDER MSB_LAST FORMAT "%7.2" /end MEASUREMENT
/begin MEASUREMENT lam_bank_2.lsl_ad.fac_min_lsl_cor_ad_maf_kgh "MAF during adaptation of the minimum of the factor for WRAF sensor gain adaptation" UWORD _CNV_A_R_LINEAR_____115_CM 1 100. 0. 2047.96875 DISPLAY_IDENTIFIER FAC_MIN_LSL_COR_AD_MAF_KGH_2 ECU_ADDRESS 0x3fcab8 BYTE_ORDER MSB_LAST FORMAT "%7.2" /end MEASUREMENT
/begin MEASUREMENT lam_bank_2.lsl_ad.fac_min_lsl_cor_ad_ttip "TTIP_i upstream during adaptation of the minimum of the factor for WRAF sensor gain adaptation" SWORD _CNV_A_R_LINEAR_____303_CM 1 100. -2048. 2047.938 DISPLAY_IDENTIFIER FAC_MIN_LSL_COR_AD_TTIP_2 ECU_ADDRESS 0x3fcabc BYTE_ORDER MSB_LAST FORMAT "%8.2" /end MEASUREMENT
/begin MEASUREMENT lam_bank_2.lsl_ad.fac_max_lsl_cor_ad_ttip "TTIP_i upstream during adaptation of the maximum of the factor for WRAF sensor gain adaptation" SWORD _CNV_A_R_LINEAR_____303_CM 1 100. -2048. 2047.938 DISPLAY_IDENTIFIER FAC_MAX_LSL_COR_AD_TTIP_2 ECU_ADDRESS 0x3fcabe BYTE_ORDER MSB_LAST FORMAT "%8.2" /end MEASUREMENT
/begin MEASUREMENT lam_bank_2.lsl_ad.fac_min_lsl_cor_ad_teg_dyn "TEG_DYN_i during adaptation of the minimum of the factor for WRAF sensor gain adaptation" UWORD _CNV_A_R_LINEAR_____6_CM 1 100. 0. 2047. DISPLAY_IDENTIFIER FAC_MIN_LSL_COR_AD_TEG_DYN_2 ECU_ADDRESS 0x3fcac0 BYTE_ORDER MSB_LAST FORMAT "%7.2" /end MEASUREMENT
/begin MEASUREMENT lam_bank_2.lsl_ad.fac_max_lsl_cor_ad_teg_dyn "TEG_DYN_i during adaptation of the maximum of the factor for WRAF sensor gain adaptation" UWORD _CNV_A_R_LINEAR_____6_CM 1 100. 0. 2047. DISPLAY_IDENTIFIER FAC_MAX_LSL_COR_AD_TEG_DYN_2 ECU_ADDRESS 0x3fcac2 BYTE_ORDER MSB_LAST FORMAT "%7.2" /end MEASUREMENT
/begin MEASUREMENT lam_bank_2.lam_inci.bf.lv_inh_lscl "inhibit signal for controller deactivation" ULONG _CNV_S_2_RANGE______2_CM 1 100. 0. 1. DISPLAY_IDENTIFIER LV_INH_LSCL_2 ECU_ADDRESS 0x3fca20 BYTE_ORDER MSB_LAST BIT_MASK 0x10000000 /end MEASUREMENT
/begin MEASUREMENT lam_bank_2.lam_inci.bf.lv_lam_stop "activation signal for the controller stop-mode" ULONG _CNV_S_2_RANGE______2_CM 1 100. 0. 1. DISPLAY_IDENTIFIER LV_LAM_STOP_2 ECU_ADDRESS 0x3fca20 BYTE_ORDER MSB_LAST BIT_MASK 0x80000000 /end MEASUREMENT
/begin MEASUREMENT lam_bank_2.lam_inci.bf.lv_lam_once_act "closed loop had been enabled in this DC cylinder bank i" ULONG _CNV_S_2_RANGE______2_CM 1 100. 0. 1. DISPLAY_IDENTIFIER LV_LAM_ONCE_ACT_2 ECU_ADDRESS 0x3fca20 BYTE_ORDER MSB_LAST BIT_MASK 0x20000000 /end MEASUREMENT
/begin MEASUREMENT lam_bank_2.lam_inci.bf.lv_lscl_inh_err "Logical value if lambda controller is inhibit due to a present error" ULONG _CNV_S_2_RANGE______2_CM 1 100. 0. 1. DISPLAY_IDENTIFIER LV_LSCL_INH_ERR_2 ECU_ADDRESS 0x3fca20 BYTE_ORDER MSB_LAST BIT_MASK 0x4000000 /end MEASUREMENT
/begin MEASUREMENT lam_bank_2.lam_inci.soi_dly "crank shaft angle difference between the start of injection and the end of the exhaust cycle" UWORD _CNV_A_R_LINEAR_____159_CM 1 100. 0. 1620. DISPLAY_IDENTIFIER SOI_DLY_2 ECU_ADDRESS 0x3fca24 BYTE_ORDER MSB_LAST FORMAT "%4.0" /end MEASUREMENT
/begin MEASUREMENT lam_bank_2.lam_inci.delta_lamb_sp "corrective intervention for lambda set point" SWORD _CNV_A_R_LINEAR_____288_CM 1 100. -0.125 0.125 DISPLAY_IDENTIFIER DELTA_LAMB_SP_2 ECU_ADDRESS 0x3fca2c BYTE_ORDER MSB_LAST FORMAT "%8.5" /end MEASUREMENT
/begin MEASUREMENT lam_bank_2.lam_inci.delta_lamb_av_cor "corrective intervention for measured lambda signal" SWORD _CNV_A_R_LINEAR_____288_CM 1 100. -0.125 0.125 DISPLAY_IDENTIFIER DELTA_LAMB_AV_COR_2 ECU_ADDRESS 0x3fca2e BYTE_ORDER MSB_LAST FORMAT "%8.5" /end MEASUREMENT
/begin MEASUREMENT lam_bank_2.lam_ad.bf.lv_lam_adj_ad "logical value activates the shift of the lambda-controller" ULONG _CNV_S_2_RANGE______2_CM 1 100. 0. 1. DISPLAY_IDENTIFIER LV_LAM_ADJ_AD_2 ECU_ADDRESS 0x3fc748 BYTE_ORDER MSB_LAST BIT_MASK 0x80000000 /end MEASUREMENT
/begin MEASUREMENT lam_bank_2.lam_ad.bf.lv_lam_ad_stop "Logical variable indicates passing stop of the lambda Adaptation" ULONG _CNV_S_2_RANGE______2_CM 1 100. 0. 1. DISPLAY_IDENTIFIER LV_LAM_AD_STOP_2 ECU_ADDRESS 0x3fc748 BYTE_ORDER MSB_LAST BIT_MASK 0x40000000 /end MEASUREMENT
/begin MEASUREMENT lam_bank_2.lam_ad.bf.lv_mff_ad_fac_h_lim "Limitation of multiplicative adapted factor of upper area" ULONG _CNV_S_2_RANGE______2_CM 1 100. 0. 1. DISPLAY_IDENTIFIER LV_MFF_AD_FAC_H_LIM_2 ECU_ADDRESS 0x3fc748 BYTE_ORDER MSB_LAST BIT_MASK 0x10000000 /end MEASUREMENT
/begin MEASUREMENT lam_bank_2.lam_ad.bf.lv_mff_ad_add_lim "Limitation of additive adapted factor" ULONG _CNV_S_2_RANGE______2_CM 1 100. 0. 1. DISPLAY_IDENTIFIER LV_MFF_AD_ADD_LIM_2 ECU_ADDRESS 0x3fc748 BYTE_ORDER MSB_LAST BIT_MASK 0x8000000 /end MEASUREMENT
/begin MEASUREMENT lam_bank_2.lam_ad.bf.lv_mff_ad_fac_l_lim "Limitation of multiplicative adapted factor of lower area" ULONG _CNV_S_2_RANGE______2_CM 1 100. 0. 1. DISPLAY_IDENTIFIER LV_MFF_AD_FAC_L_LIM_2 ECU_ADDRESS 0x3fc748 BYTE_ORDER MSB_LAST BIT_MASK 0x20000000 /end MEASUREMENT
/begin MEASUREMENT lam_bank_2.lam_ad.mff_ad_add_mmv_rel "Relative additive adaptive factor" SWORD _CNV_A_R_LINEAR_____257_CM 1 100. -694.5 694.478806 DISPLAY_IDENTIFIER MFF_AD_ADD_MMV_REL_2 ECU_ADDRESS 0x3fc74c BYTE_ORDER MSB_LAST FORMAT "%7.2" /end MEASUREMENT
/begin MEASUREMENT lam_bank_2.lam_ad.mff_ad_add_mmv_rel_quo "Relative additive adaptive factor quotient" SWORD _CNV_A_R_LINEAR_____321_CM 1 100. -100. 99.99694824 DISPLAY_IDENTIFIER MFF_AD_ADD_MMV_REL_QUO_2 ECU_ADDRESS 0x3fc74e BYTE_ORDER MSB_LAST FORMAT "%8.3" /end MEASUREMENT
/begin MEASUREMENT lam_bank_2.lam_ad.mff_ad_fac_mmv_rel "Relative Multiplicative adaptive factor" SWORD _CNV_A_R_LINEAR_____111_CM 1 100. -50. 49.99847412 DISPLAY_IDENTIFIER MFF_AD_FAC_MMV_REL_2 ECU_ADDRESS 0x3fc756 BYTE_ORDER MSB_LAST FORMAT "%7.3" /end MEASUREMENT
/begin MEASUREMENT lam_bank_2.lam_ad.mff_ad_add_mmv "Additive adaptive factor" SWORD _CNV_A_R_LINEAR_____257_CM 1 100. -694.5 694.478806 DISPLAY_IDENTIFIER MFF_AD_ADD_MMV_2 ECU_ADDRESS 0x3fc750 BYTE_ORDER MSB_LAST FORMAT "%7.2" /end MEASUREMENT
/begin MEASUREMENT lam_bank_2.lam_ad.mff_ad_fac_mmv "Multiplicative adaptive factor" SWORD _CNV_A_R_LINEAR_____111_CM 1 100. -50. 49.99847412 DISPLAY_IDENTIFIER MFF_AD_FAC_MMV_2 ECU_ADDRESS 0x3fc758 BYTE_ORDER MSB_LAST FORMAT "%7.3" /end MEASUREMENT
/begin MEASUREMENT lam_bank_2.lam_ad.lam_adj_ad "output value for the lambda controller shift" SWORD _CNV_A_R_LINEAR_____111_CM 1 100. -50. 49.99847412 DISPLAY_IDENTIFIER LAM_ADJ_AD_2 ECU_ADDRESS 0x3fc76a BYTE_ORDER MSB_LAST FORMAT "%7.3" /end MEASUREMENT
/begin MEASUREMENT lam_bank_2.lam_ad.mff_ad_add_mmv_delta "Difference of additive adaptive factor to previous Adaptation" SWORD _CNV_A_R_LINEAR_____257_CM 1 100. -694.5 694.478806 DISPLAY_IDENTIFIER MFF_AD_ADD_MMV_DELTA_2 ECU_ADDRESS 0x3fc752 BYTE_ORDER MSB_LAST FORMAT "%7.2" /end MEASUREMENT
/begin MEASUREMENT lam_bank_2.lam_ad.mff_ad_add_mmv_delta_h_res "Difference of additive adaptive factor to previous Adaptation" SWORD _CNV_A_R_LINEAR_____322_CM 1 100. -10.85 10.85 DISPLAY_IDENTIFIER MFF_AD_ADD_MMV_DELTA_H_RES_2 ECU_ADDRESS 0x3fc754 BYTE_ORDER MSB_LAST FORMAT "%7.2" /end MEASUREMENT
/begin MEASUREMENT lam_bank_2.lam_ad.mff_ad_fac_mmv_delta_l "Difference of multiplicative adaptive factor of lower area to previous Adaptation" SWORD _CNV_A_R_LINEAR_____111_CM 1 100. -50. 49.99847412 DISPLAY_IDENTIFIER MFF_AD_FAC_MMV_DELTA_L_2 ECU_ADDRESS 0x3fc766 BYTE_ORDER MSB_LAST FORMAT "%7.3" /end MEASUREMENT
/begin MEASUREMENT lam_bank_2.lam_ad.mff_sae_ad_mmv_rel "Relative adaptive correction for cylinder bank i for scantool" SWORD _CNV_A_R_LINEAR_____321_CM 1 100. -100. 99.99694824 DISPLAY_IDENTIFIER MFF_SAE_AD_MMV_REL_2 ECU_ADDRESS 0x3fc772 BYTE_ORDER MSB_LAST FORMAT "%8.3" /end MEASUREMENT
/begin MEASUREMENT lam_bank_2.lam_ad.lam_ad_sum_p "Counter indicating the number of observed p jumps reported by the lambda controller" UBYTE _CNV_A_R_LINEAR_____0_CM 1 100. 1. 255. DISPLAY_IDENTIFIER LAM_AD_SUM_P_2 ECU_ADDRESS 0x3fc774 FORMAT "%3.0" /end MEASUREMENT
/begin MEASUREMENT lam_bank_2.lam_ad.state_mff_ad "State indicating the status of the lambda Adaptation, e.g. to concerned time scheduler with CP" UBYTE _CNV_S_8_STATE_MFF__323_CM 1 100. 0. 7. DISPLAY_IDENTIFIER STATE_MFF_AD_2 ECU_ADDRESS 0x3fc775 /end MEASUREMENT
/begin MEASUREMENT lam_bank_2.lam_ad.t_mff_ad_fac "Time indicating the time for next requested multiplicative lambda Adaptation" UWORD _CNV_A_R_LINEAR_____24_CM 1 100. 0. 6553.5 DISPLAY_IDENTIFIER T_MFF_AD_FAC_2 ECU_ADDRESS 0x3fc76e BYTE_ORDER MSB_LAST FORMAT "%6.1" /end MEASUREMENT
/begin MEASUREMENT lam_bank_2.lam_ad.t_mff_ad_add "Time indicating the time for next requested additive lambda Adaptation" UWORD _CNV_A_R_LINEAR_____24_CM 1 100. 0. 6553.5 DISPLAY_IDENTIFIER T_MFF_AD_ADD_2 ECU_ADDRESS 0x3fc770 BYTE_ORDER MSB_LAST FORMAT "%6.1" /end MEASUREMENT
/begin MEASUREMENT lam_bank_2.lam_ad.mff_ad_fac_mmv_delta_h "Difference of multiplicative adaptive factor of upper area to previous Adaptation" SWORD _CNV_A_R_LINEAR_____111_CM 1 100. -50. 49.99847412 DISPLAY_IDENTIFIER MFF_AD_FAC_MMV_DELTA_H_2 ECU_ADDRESS 0x3fc768 BYTE_ORDER MSB_LAST FORMAT "%7.3" /end MEASUREMENT
/begin MEASUREMENT lam_bank_2.lam_ad.mff_ad_fac_mmv_l "Multiplicative adaptive factor lower part load" SWORD _CNV_A_R_LINEAR_____111_CM 1 100. -50. 49.99847412 DISPLAY_IDENTIFIER MFF_AD_FAC_MMV_L_2 ECU_ADDRESS 0x3fc75c BYTE_ORDER MSB_LAST FORMAT "%7.3" /end MEASUREMENT
/begin MEASUREMENT lam_bank_2.lam_ad.mff_ad_fac_mmv_h "Multiplicative adaptive factor higher part load" SWORD _CNV_A_R_LINEAR_____111_CM 1 100. -50. 49.99847412 DISPLAY_IDENTIFIER MFF_AD_FAC_MMV_H_2 ECU_ADDRESS 0x3fc75e BYTE_ORDER MSB_LAST FORMAT "%7.3" /end MEASUREMENT
/begin MEASUREMENT lam_bank_2.lsh_up.bf.lv_lsh_up_cll_ctl "Boolean variable indicating closed loop control mode active" ULONG _CNV_S_2_RANGE______2_CM 1 100. 0. 1. DISPLAY_IDENTIFIER LV_LSH_UP_CLL_CTL_2 ECU_ADDRESS 0x3fc8d0 BYTE_ORDER MSB_LAST BIT_MASK 0x80000000 /end MEASUREMENT
/begin MEASUREMENT lam_bank_2.lsh_up.bf.lv_v_efc_lsh_up_lim_bol "Boolean flag indicating effective heater voltage limited due to sum of voltage components falling below zero." ULONG _CNV_S_2_RANGE______2_CM 1 100. 0. 1. DISPLAY_IDENTIFIER LV_V_EFC_LSH_UP_LIM_BOL_2 ECU_ADDRESS 0x3fc8d0 BYTE_ORDER MSB_LAST BIT_MASK 0x40000000 /end MEASUREMENT
/begin MEASUREMENT lam_bank_2.lsh_up.bf.lv_v_efc_lsh_up_lim_tol "Boolean flag indicating effective heater voltage limited due to exceeding threshold for period of time." ULONG _CNV_S_2_RANGE______2_CM 1 100. 0. 1. DISPLAY_IDENTIFIER LV_V_EFC_LSH_UP_LIM_TOL_2 ECU_ADDRESS 0x3fc8d0 BYTE_ORDER MSB_LAST BIT_MASK 0x20000000 /end MEASUREMENT
/begin MEASUREMENT lam_bank_2.lsh_up.bf.lv_v_efc_lsh_up_lim_max "Boolean flag indicating effective heater voltage limited due to exceeding absolute maximum voltage spec." ULONG _CNV_S_2_RANGE______2_CM 1 100. 0. 1. DISPLAY_IDENTIFIER LV_V_EFC_LSH_UP_LIM_MAX_2 ECU_ADDRESS 0x3fc8d0 BYTE_ORDER MSB_LAST BIT_MASK 0x10000000 /end MEASUREMENT
/begin MEASUREMENT lam_bank_2.lsh_up.bf.lv_pow_ctl_act "???" ULONG _CNV_S_2_RANGE______2_CM 1 100. 0. 1. DISPLAY_IDENTIFIER LV_POW_CTL_ACT_2 ECU_ADDRESS 0x3fc8d0 BYTE_ORDER MSB_LAST BIT_MASK 0x8000000 /end MEASUREMENT
/begin MEASUREMENT lam_bank_2.lsh_up.t_lsh_up "Timer to determine the duration of heating phase" UWORD _CNV_A_R_LINEAR_____24_CM 1 100. 0. 6553.5 DISPLAY_IDENTIFIER T_LSH_UP_2 ECU_ADDRESS 0x3fc8e0 BYTE_ORDER MSB_LAST FORMAT "%5.1" /end MEASUREMENT
/begin MEASUREMENT lam_bank_2.lsh_up.lshpwm_up "" UBYTE _CNV_A_R_LINEAR_____9_CM 1 100. 0. 99.609375 DISPLAY_IDENTIFIER LSHPWM_UP_2 ECU_ADDRESS 0x3fc8d8 FORMAT "%4.1" /end MEASUREMENT
/begin MEASUREMENT lam_bank_2.lsh_up.v_efc_lsh_up "Effective value of heater voltage" UBYTE _CNV_A_R_LINEAR_____34_CM 1 100. 0. 25.8984 DISPLAY_IDENTIFIER V_EFC_LSH_UP_2 ECU_ADDRESS 0x3fc8d9 FORMAT "%3.1" /end MEASUREMENT
/begin MEASUREMENT lam_bank_2.lsh_up.t_lsh_up_tol "Timer to determine the duration of high voltage phases" UBYTE _CNV_A_R_LINEAR_____24_CM 1 100. 0. 25.5 DISPLAY_IDENTIFIER T_LSH_UP_TOL_2 ECU_ADDRESS 0x3fc8dc FORMAT "%4.1" /end MEASUREMENT
/begin MEASUREMENT lam_bank_2.lsh_up.t_lsh_up_lim "Timer to determine the duration of heating phases after a high voltage phase" UBYTE _CNV_A_R_LINEAR_____24_CM 1 100. 0. 25.5 DISPLAY_IDENTIFIER T_LSH_UP_LIM_2 ECU_ADDRESS 0x3fc8dd FORMAT "%4.1" /end MEASUREMENT
/begin MEASUREMENT lam_bank_2.lsh_up.state_lsh_up "Heating state recognition" ULONG _CNV_S_7_STATE_LSH__324_CM 1 100. 0. 6. DISPLAY_IDENTIFIER STATE_LSH_UP_2 ECU_ADDRESS 0x3fc8d4 BYTE_ORDER MSB_LAST /end MEASUREMENT
/begin MEASUREMENT lam_bank_2.lsh_up.v_efc_lsh_up_clc "Effective calculated heater voltage value prior to overvoltage protection" UWORD _CNV_A_R_LINEAR_____325_CM 1 100. 0. 25.999603 DISPLAY_IDENTIFIER V_EFC_LSH_UP_CLC_2 ECU_ADDRESS 0x3fc8da BYTE_ORDER MSB_LAST FORMAT "%7.4" /end MEASUREMENT
/begin MEASUREMENT lam_bank_2.lsh_up.v_efc_lsh_up_ctl_add "Additive effective heater voltage from closed loop controller" SBYTE _CNV_A_R_LINEAR_____326_CM 1 100. -13.05 12.95 DISPLAY_IDENTIFIER V_EFC_LSH_UP_CTL_ADD_2 ECU_ADDRESS 0x3fc8de FORMAT "%5.1" /end MEASUREMENT
/begin MEASUREMENT lam_bank_2.lsh_up.v_efc_lsh_up_ctl_p_add "Additive effective heater voltage from closed loop controller, P term" SWORD _CNV_A_R_LINEAR_____327_CM 1 100. -13.05 13.05 DISPLAY_IDENTIFIER V_EFC_LSH_UP_CTL_P_ADD_2 ECU_ADDRESS 0x3fc8e2 BYTE_ORDER MSB_LAST FORMAT "%8.4" /end MEASUREMENT
/begin MEASUREMENT lam_bank_2.lsh_up.v_efc_lsh_up_ctl_i_add "Additive effective heater voltage from closed loop controller, I term" SWORD _CNV_A_R_LINEAR_____327_CM 1 100. -13.05 13.05 DISPLAY_IDENTIFIER V_EFC_LSH_UP_CTL_I_ADD_2 ECU_ADDRESS 0x3fc8e4 BYTE_ORDER MSB_LAST FORMAT "%8.4" /end MEASUREMENT
/begin MEASUREMENT lam_bank_2.lsh_up.ttip_ls_up_dif_set_mes "Difference between actual and set oxygen sensor tip temperature" SWORD _CNV_A_R_LINEAR_____303_CM 1 100. -2048. 2047.938 DISPLAY_IDENTIFIER TTIP_LS_UP_DIF_SET_MES_2 ECU_ADDRESS 0x3fc8e6 BYTE_ORDER MSB_LAST FORMAT "%8.2" /end MEASUREMENT
/begin MEASUREMENT lam_bank_2.lam_stic.lamb_puls "Lambda deviation for the lambda controller" SBYTE _CNV_A_R_LINEAR_____290_CM 1 100. -0.125 0.124023 DISPLAY_IDENTIFIER LAMB_PULS_2 ECU_ADDRESS 0x3fca5c FORMAT "%7.4" /end MEASUREMENT
/begin MEASUREMENT lam_bank_2.lam_dyw.lam_mv_dyw "LAM_MV-meanvalue" SWORD _CNV_A_R_LINEAR_____111_CM 1 100. -50. 49.99847412 DISPLAY_IDENTIFIER LAM_MV_DYW_2 ECU_ADDRESS 0x3fcad4 BYTE_ORDER MSB_LAST FORMAT "%5.4" /end MEASUREMENT
/begin MEASUREMENT lam_bank_2.lam_dyw.bf.lv_lam_dyw "Conditions for the limited dynamic for LAM detected" ULONG _CNV_S_2_RANGE______2_CM 1 100. 0. 1. DISPLAY_IDENTIFIER LV_LAM_DYW_2 ECU_ADDRESS 0x3fcad0 BYTE_ORDER MSB_LAST BIT_MASK 0x80000000 /end MEASUREMENT
/begin MEASUREMENT lam_bank_2.lam_puc_inci.bf.lv_inh_int_puc "catalyst purge function inhibited" ULONG _CNV_S_2_RANGE______2_CM 1 100. 0. 1. DISPLAY_IDENTIFIER LV_INH_INT_PUC_2 ECU_ADDRESS 0x3fca48 BYTE_ORDER MSB_LAST BIT_MASK 0x40000000 /end MEASUREMENT
/begin MEASUREMENT lam_bank_2.lam_puc_inci.bf.lv_act_int_puc_afl "state of the enrichment function for pre and main cat balancing" ULONG _CNV_S_2_RANGE______2_CM 1 100. 0. 1. DISPLAY_IDENTIFIER LV_ACT_INT_PUC_AFL_2 ECU_ADDRESS 0x3fca48 BYTE_ORDER MSB_LAST BIT_MASK 0x80000000 /end MEASUREMENT
/begin MEASUREMENT lam_bank_2.lam_puc_inci.temp_main_cat "modeled or assumed temperature of main cat" UWORD _CNV_A_R_LINEAR_____343_CM 1 100. -33. 990.984375 DISPLAY_IDENTIFIER TEMP_MAIN_CAT_2 ECU_ADDRESS 0x3fca4c BYTE_ORDER MSB_LAST FORMAT "%6.2" /end MEASUREMENT
/begin MEASUREMENT lam_bank_2.lam_puc_inci.temp_pcat "modeled or assumed temperature of pre cat" UWORD _CNV_A_R_LINEAR_____343_CM 1 100. -33. 990.984375 DISPLAY_IDENTIFIER TEMP_PCAT_2 ECU_ADDRESS 0x3fca4e BYTE_ORDER MSB_LAST FORMAT "%6.2" /end MEASUREMENT
/begin MEASUREMENT lam_bank_2.lsh_up_inci.lv_inh_lsh_up "Boolean flag indicating project specific application conditions for heating not met" UBYTE _CNV_S_2_RANGE______2_CM 1 100. 0. 1. DISPLAY_IDENTIFIER LV_INH_LSH_UP_2 ECU_ADDRESS 0x3fc8ec /end MEASUREMENT
/begin MEASUREMENT lam_bank_2.lsh_up_inci.lv_inh_lsh_up_cll_ctl "Boolean flag indicating project specific application conditions closed loop heater control not met" UBYTE _CNV_S_2_RANGE______2_CM 1 100. 0. 1. DISPLAY_IDENTIFIER LV_INH_LSH_UP_CLL_CTL_2 ECU_ADDRESS 0x3fc8ed /end MEASUREMENT
/begin MEASUREMENT lam_bank_2.lam_puc.bf.lv_act_int_puc "state of enrichment function for pre and main cat balancing" ULONG _CNV_S_2_RANGE______2_CM 1 100. 0. 1. DISPLAY_IDENTIFIER LV_ACT_INT_PUC_2 ECU_ADDRESS 0x3fc7ac BYTE_ORDER MSB_LAST BIT_MASK 0x80000000 /end MEASUREMENT
/begin MEASUREMENT lam_bank_2.lam_puc.bf.lv_pcat_purge_puc "state of enrichment function for pre cat balancing after PUC phase" ULONG _CNV_S_2_RANGE______2_CM 1 100. 0. 1. DISPLAY_IDENTIFIER LV_PCAT_PURGE_PUC_2 ECU_ADDRESS 0x3fc7ac BYTE_ORDER MSB_LAST BIT_MASK 0x40000000 /end MEASUREMENT
/begin MEASUREMENT lam_bank_2.lam_puc.bf.lv_pcat_purge_sa "state of enrichment function for pre cat balancing after SA phase" ULONG _CNV_S_2_RANGE______2_CM 1 100. 0. 1. DISPLAY_IDENTIFIER LV_PCAT_PURGE_SA_2 ECU_ADDRESS 0x3fc7ac BYTE_ORDER MSB_LAST BIT_MASK 0x20000000 /end MEASUREMENT
/begin MEASUREMENT lam_bank_2.lam_puc.bf.lv_pcat_purge_hst "state of enrichment function for pre cat balancing after HST phase" ULONG _CNV_S_2_RANGE______2_CM 1 100. 0. 1. DISPLAY_IDENTIFIER LV_PCAT_PURGE_HST_2 ECU_ADDRESS 0x3fc7ac BYTE_ORDER MSB_LAST BIT_MASK 0x10000000 /end MEASUREMENT
/begin MEASUREMENT lam_bank_2.lam_puc.bf.lv_pcat_purge_ch "state of enrichment function for pre cat balancing after CH phase" ULONG _CNV_S_2_RANGE______2_CM 1 100. 0. 1. DISPLAY_IDENTIFIER LV_PCAT_PURGE_CH_2 ECU_ADDRESS 0x3fc7ac BYTE_ORDER MSB_LAST BIT_MASK 0x8000000 /end MEASUREMENT
/begin MEASUREMENT lam_bank_2.lam_puc.bf.lv_main_cat_purge "state of enrichment function for main cat balancing" ULONG _CNV_S_2_RANGE______2_CM 1 100. 0. 1. DISPLAY_IDENTIFIER LV_MAIN_CAT_PURGE_2 ECU_ADDRESS 0x3fc7ac BYTE_ORDER MSB_LAST BIT_MASK 0x4000000 /end MEASUREMENT
/begin MEASUREMENT lam_bank_2.lam_puc.bf.lv_vls_down_puc_act_max "Logical indicating that downstream sensor signal is/was below calibration limit" ULONG _CNV_S_2_RANGE______2_CM 1 100. 0. 1. DISPLAY_IDENTIFIER LV_VLS_DOWN_PUC_ACT_MAX_2 ECU_ADDRESS 0x3fc7ac BYTE_ORDER MSB_LAST BIT_MASK 0x2000000 /end MEASUREMENT
/begin MEASUREMENT lam_bank_2.lam_puc.bf.lv_down_ramp_act "flag indicating that down ramping from lambda setpoint shift to zero is active" ULONG _CNV_S_2_RANGE______2_CM 1 100. 0. 1. DISPLAY_IDENTIFIER LV_DOWN_RAMP_ACT_2 ECU_ADDRESS 0x3fc7ac BYTE_ORDER MSB_LAST BIT_MASK 0x1000000 /end MEASUREMENT
/begin MEASUREMENT lam_bank_2.lam_puc.bf.lv_puc_trig "trigger bit for cat purge after PUC (needed if transition to LV_PUC = 0 but other conditions are not yet fulfilled)" ULONG _CNV_S_2_RANGE______2_CM 1 100. 0. 1. DISPLAY_IDENTIFIER LV_PUC_TRIG_2 ECU_ADDRESS 0x3fc7ac BYTE_ORDER MSB_LAST BIT_MASK 0x800000 /end MEASUREMENT
/begin MEASUREMENT lam_bank_2.lam_puc.maf_int_act_puc "value of the mass air flow integral for the function deactivation" ULONG _CNV_A_R_LINEAR_____348_CM 1 100. 0. 1820.398 DISPLAY_IDENTIFIER MAF_INT_ACT_PUC_2 ECU_ADDRESS 0x3fc7b0 BYTE_ORDER MSB_LAST FORMAT "%12.7" /end MEASUREMENT
/begin MEASUREMENT lam_bank_2.lam_puc.maf_int_cat_load "Measurment of the purge amount of the pre catalyst" ULONG _CNV_A_R_LINEAR_____348_CM 1 100. 0. 1820.398 DISPLAY_IDENTIFIER MAF_INT_CAT_LOAD_2 ECU_ADDRESS 0x3fc7b4 BYTE_ORDER MSB_LAST FORMAT "%12.7" /end MEASUREMENT
/begin MEASUREMENT lam_bank_2.lam_puc.maf_int_cat_load_main "Measurment of the purge amount of the main catalyst" ULONG _CNV_A_R_LINEAR_____348_CM 1 100. 0. 1820.398 DISPLAY_IDENTIFIER MAF_INT_CAT_LOAD_MAIN_2 ECU_ADDRESS 0x3fc7b8 BYTE_ORDER MSB_LAST FORMAT "%12.7" /end MEASUREMENT
/begin MEASUREMENT lam_bank_2.lam_puc.maf_int_purge_rest "Estimated rest integral for catalyst purge" ULONG _CNV_A_R_LINEAR_____348_CM 1 100. 0. 1820.398 DISPLAY_IDENTIFIER MAF_INT_PURGE_REST_2 ECU_ADDRESS 0x3fc7bc BYTE_ORDER MSB_LAST FORMAT "%12.7" /end MEASUREMENT
/begin MEASUREMENT lam_bank_2.lam_puc.maf_int_sample_step "MAF integral to be added/ subtracted each sample step" ULONG _CNV_A_R_LINEAR_____348_CM 1 100. 0. 1820.398 DISPLAY_IDENTIFIER MAF_INT_SAMPLE_STEP_2 ECU_ADDRESS 0x3fc7c0 BYTE_ORDER MSB_LAST FORMAT "%12.7" /end MEASUREMENT
/begin MEASUREMENT lam_bank_2.lam_puc.maf_int_tot_purge "total MAF integral for pre and main cat purge" ULONG _CNV_A_R_LINEAR_____348_CM 1 100. 0. 1820.398 DISPLAY_IDENTIFIER MAF_INT_TOT_PURGE_2 ECU_ADDRESS 0x3fc7c4 BYTE_ORDER MSB_LAST FORMAT "%12.7" /end MEASUREMENT
/begin MEASUREMENT lam_bank_2.lam_puc.fac_add_pcat_main_cat_puc "additional weighting factor for IP_FAC_PCAT_MAIN_CAT_PUC" UBYTE _CNV_A_R_LINEAR_____129_CM 1 100. 0. 3.984375 DISPLAY_IDENTIFIER FAC_ADD_PCAT_MAIN_CAT_PUC_2 ECU_ADDRESS 0x3fc7c8 FORMAT "%4.2" /end MEASUREMENT
/begin MEASUREMENT lam_bank_2.lam_puc.quo_maf_int_purge "quotient: current MAF rest integral / total MAF integral" UBYTE _CNV_A_R_LINEAR_____50_CM 1 100. 0. 0.996094 DISPLAY_IDENTIFIER QUO_MAF_INT_PURGE_2 ECU_ADDRESS 0x3fc7c9 FORMAT "%5.3" /end MEASUREMENT
/begin MEASUREMENT lam_bank_2.lam_puc.delta_lamb_sp_puc "Lambda controller setpoint shift" UBYTE _CNV_A_R_LINEAR_____285_CM 1 100. 0. 0.125 DISPLAY_IDENTIFIER DELTA_LAMB_SP_PUC_2 ECU_ADDRESS 0x3fc7ca FORMAT "%5.3" /end MEASUREMENT
/begin MEASUREMENT lv_mff_ad_act_1 "Boolean for MFF Adaptation activation" UBYTE _CNV_S_2_RANGE______2_CM 1 100. 0. 1. DISPLAY_IDENTIFIER LV_MFF_AD_ACT_1 ECU_ADDRESS 0x3fe51f /end MEASUREMENT
/begin MEASUREMENT lv_mff_ad_act_2 "Boolean for MFF Adaptation activation" UBYTE _CNV_S_2_RANGE______2_CM 1 100. 0. 1. DISPLAY_IDENTIFIER LV_MFF_AD_ACT_2 ECU_ADDRESS 0x3fe520 /end MEASUREMENT
/begin CHARACTERISTIC c_lam_temp_min_cat_dly "min. TEMP_ CAT threshold for activation" VALUE 0xffe40788 _REC_VAL_20_u1 1023. _CNV_A_R_LINEAR_____352_CM -33. 990. DISPLAY_IDENTIFIER C_LAM_TEMP_MIN_CAT_DLY FORMAT "%4.0" /end CHARACTERISTIC
/begin CHARACTERISTIC c_delta_lamb_i_min "min. limit of I-share" VALUE 0xffe403f4 _REC_VAL_20_s2 0.25 _CNV_A_R_LINEAR_____353_CM -0.125 0.125 DISPLAY_IDENTIFIER C_DELTA_LAMB_I_MIN FORMAT "%8.6" /end CHARACTERISTIC
/begin CHARACTERISTIC c_maf_delta_lamb_p_min "min. MAF threshold for calculation of P-share  " VALUE 0xffe41734 _REC_VAL_20_u2 1389. _CNV_A_R_LINEAR_____108_CM 0. 1389. DISPLAY_IDENTIFIER C_MAF_DELTA_LAMB_P_MIN FORMAT "%7.2" /end CHARACTERISTIC
/begin CHARACTERISTIC c_n_delta_lamb_p_max "max. N threshold for calculation of P-share" VALUE 0xffe407d7 _REC_VAL_20_u1 8160. _CNV_A_R_LINEAR_____15_CM 0. 8160. DISPLAY_IDENTIFIER C_N_DELTA_LAMB_P_MAX FORMAT "%4.0" /end CHARACTERISTIC
/begin CHARACTERISTIC c_n_delta_lamb_p_min "min. N threshold for calculation of P-share" VALUE 0xffe407d8 _REC_VAL_20_u1 8160. _CNV_A_R_LINEAR_____15_CM 0. 8160. DISPLAY_IDENTIFIER C_N_DELTA_LAMB_P_MIN FORMAT "%4.0" /end CHARACTERISTIC
/begin CHARACTERISTIC c_maf_delta_lamb_p_max "max. MAF threshold for calculation of P-share" VALUE 0xffe41732 _REC_VAL_20_u2 1389. _CNV_A_R_LINEAR_____108_CM 0. 1389. DISPLAY_IDENTIFIER C_MAF_DELTA_LAMB_P_MAX FORMAT "%7.2" /end CHARACTERISTIC
/begin CHARACTERISTIC c_cat_diag_max_delta_lamb "threshold of catalyst conversion capability for activation" VALUE 0xffe4064f _REC_VAL_20_u1 1.984375 _CNV_A_R_LINEAR_____248_CM 0. 1.984375 DISPLAY_IDENTIFIER C_CAT_DIAG_MAX_DELTA_LAMB FORMAT "%4.2" /end CHARACTERISTIC
/begin CHARACTERISTIC c_crlc_lam_down_ad "correlation constant for the calculation of the adaptation value" VALUE 0xffe4155a _REC_VAL_20_u2 0.99998474 _CNV_A_R_LINEAR_____37_CM 0. 0.99998474 DISPLAY_IDENTIFIER C_CRLC_LAM_DOWN_AD FORMAT "%7.5" /end CHARACTERISTIC
/begin CHARACTERISTIC ip_delta_lamb_p__vls_dif_dly "l-shift from P-share" CURVE 0xffe49f16 _REC_CUR_20_u2_u2 0.25 _CNV_A_R_LINEAR_____354_CM -0.125 0.125 DISPLAY_IDENTIFIER IP_DELTA_LAMB_P__VLS_DIF_DLY FORMAT "%6.4"
 /begin AXIS_DESCR COM_AXIS online_dummy _CNV_A_R_LINEAR_____355_CM 16 -5. 4.99511719 FORMAT "%5.3" AXIS_PTS_REF ldpm_vls_dif_dly__delta_lamb /end AXIS_DESCR
/end CHARACTERISTIC
/begin CHARACTERISTIC ip_maf_delta_lamb_i_min__n_32 "min. threshold for the I-share calculation" CURVE 0xffe4cdf2 _REC_CUR_20_u2_u1 1389. _CNV_A_R_LINEAR_____108_CM 0. 1389. DISPLAY_IDENTIFIER IP_MAF_DELTA_LAMB_I_MIN__N_32 FORMAT "%7.2"
 /begin AXIS_DESCR COM_AXIS n_32 _CNV_A_R_LINEAR_____15_CM 6 0. 8160. FORMAT "%4.0" AXIS_PTS_REF ldpm_n_32__maf_delta_lamb_i /end AXIS_DESCR
/end CHARACTERISTIC
/begin CHARACTERISTIC ip_maf_delta_lamb_i_max__n_32 "max. threshold for the I-share calculation" CURVE 0xffe4cde6 _REC_CUR_20_u2_u1 1389. _CNV_A_R_LINEAR_____108_CM 0. 1389. DISPLAY_IDENTIFIER IP_MAF_DELTA_LAMB_I_MAX__N_32 FORMAT "%7.2"
 /begin AXIS_DESCR COM_AXIS n_32 _CNV_A_R_LINEAR_____15_CM 6 0. 8160. FORMAT "%4.0" AXIS_PTS_REF ldpm_n_32__maf_delta_lamb_i /end AXIS_DESCR
/end CHARACTERISTIC
/begin CHARACTERISTIC c_maf_int_min_dly "threshold for MAF integral while restart of LAM after inactive " VALUE 0xffe41768 _REC_VAL_20_u2 1820.398 _CNV_A_R_LINEAR_____287_CM 0. 1820.398 DISPLAY_IDENTIFIER C_MAF_INT_MIN_DLY FORMAT "%7.2" /end CHARACTERISTIC
/begin CHARACTERISTIC ip_delta_lamb_i__vls_dif_dly "l-shift from I-share" CURVE 0xffe49ed6 _REC_CUR_20_u2_u2 0.25 _CNV_A_R_LINEAR_____356_CM -0.125 0.125 DISPLAY_IDENTIFIER IP_DELTA_LAMB_I__VLS_DIF_DLY FORMAT "%8.6"
 /begin AXIS_DESCR COM_AXIS online_dummy _CNV_A_R_LINEAR_____355_CM 16 -5. 4.99511719 FORMAT "%5.3" AXIS_PTS_REF ldpm_vls_dif_dly__delta_lamb /end AXIS_DESCR
/end CHARACTERISTIC
/begin CHARACTERISTIC c_delta_lamb_i_ad_ext_adj "external adaptation value for the lambda-shift (scan tool intervention)" VALUE 0xffe403ee _REC_VAL_20_s2 0.25 _CNV_A_R_LINEAR_____353_CM -0.125 0.125 DISPLAY_IDENTIFIER C_DELTA_LAMB_I_AD_EXT_ADJ FORMAT "%8.6" /end CHARACTERISTIC
/begin CHARACTERISTIC ip_vls_sp_dly_2__maf__n_32 "setpoint for downstream fuel trim controller" MAP 0xffe50726 _REC_MAP_20_u2_u2_u1 4.99511719 _CNV_A_R_LINEAR_____3_CM 0. 4.99511719 DISPLAY_IDENTIFIER IP_VLS_SP_DLY_2__MAF__N_32 FORMAT "%5.3"
 /begin AXIS_DESCR COM_AXIS maf _CNV_A_R_LINEAR_____108_CM 8 0. 1389. FORMAT "%7.2" AXIS_PTS_REF ldp_maf__vls_sp_dly_2 /end AXIS_DESCR
 /begin AXIS_DESCR COM_AXIS n_32 _CNV_A_R_LINEAR_____15_CM 8 0. 8160. FORMAT "%4.0" AXIS_PTS_REF ldp_n_32__vls_sp_dly_2 /end AXIS_DESCR
/end CHARACTERISTIC
/begin CHARACTERISTIC ip_fac_cat_eff_delta_lamb "weighting coefficient of catalyst diagnosis result" CURVE 0xffe40b3f _REC_CUR_20_u1_u1 0.9960940000000002 _CNV_A_R_LINEAR_____50_CM 0. 0.996094 DISPLAY_IDENTIFIER IP_FAC_CAT_EFF_DELTA_LAMB FORMAT "%5.3"
 /begin AXIS_DESCR COM_AXIS online_dummy _CNV_A_R_LINEAR_____248_CM 8 0. 1.984375 FORMAT "%4.2" AXIS_PTS_REF ldpm_cat_diag_1_laco /end AXIS_DESCR
/end CHARACTERISTIC
/begin AXIS_PTS ldpm_n_32__maf_delta_lamb_i "" 0xffe413bf n_32 _REC_AXS_20_u1 8160. _CNV_A_R_LINEAR_____15_CM 6 0. 8160. DISPLAY_IDENTIFIER LDPM_N_32__MAF_DELTA_LAMB_I FORMAT "%4.0" /end AXIS_PTS
/begin AXIS_PTS ldpm_maf_cyl__crlc_delta_lamb "" 0xffe51928 maf_cyl _REC_AXS_20_u2 2047.96875 _CNV_A_R_LINEAR_____115_CM 6 0. 2047.96875 DISPLAY_IDENTIFIER LDPM_MAF_CYL__CRLC_DELTA_LAMB FORMAT "%7.2" /end AXIS_PTS
/begin CHARACTERISTIC lc_delta_lamb_p_cat_diag "flag indicating that P-share calculation is active during cat diagnosis" VALUE 0xffe40f4b _REC_VAL_20_u1 1. _CNV_A_R_LINEAR_____0_CM 0. 1. DISPLAY_IDENTIFIER LC_DELTA_LAMB_P_CAT_DIAG FORMAT "%2.0" /end CHARACTERISTIC
/begin CHARACTERISTIC ip_crlc_delta_lamb_i "weighting coefficient for I-share calculation" CURVE 0xffe49140 _REC_CUR_20_u2_u2 0.99998474 _CNV_A_R_LINEAR_____37_CM 0. 0.99998474 DISPLAY_IDENTIFIER IP_CRLC_DELTA_LAMB_I FORMAT "%7.6"
 /begin AXIS_DESCR COM_AXIS maf_cyl _CNV_A_R_LINEAR_____115_CM 6 0. 2047.96875 FORMAT "%7.2" AXIS_PTS_REF ldpm_maf_cyl__crlc_delta_lamb /end AXIS_DESCR
/end CHARACTERISTIC
/begin CHARACTERISTIC ip_crlc_delta_lamb_p "weighting coefficient for P-share calculation" CURVE 0xffe4914c _REC_CUR_20_u2_u2 0.99998474 _CNV_A_R_LINEAR_____37_CM 0. 0.99998474 DISPLAY_IDENTIFIER IP_CRLC_DELTA_LAMB_P FORMAT "%7.6"
 /begin AXIS_DESCR COM_AXIS maf_cyl _CNV_A_R_LINEAR_____115_CM 6 0. 2047.96875 FORMAT "%7.2" AXIS_PTS_REF ldpm_maf_cyl__crlc_delta_lamb /end AXIS_DESCR
/end CHARACTERISTIC
/begin CHARACTERISTIC ip_vls_sp_dly_1__maf__n_32 "setpoint for downstream fuel trim controller" MAP 0xffe506a6 _REC_MAP_20_u2_u2_u1 4.99511719 _CNV_A_R_LINEAR_____3_CM 0. 4.99511719 DISPLAY_IDENTIFIER IP_VLS_SP_DLY_1__MAF__N_32 FORMAT "%5.3"
 /begin AXIS_DESCR COM_AXIS maf _CNV_A_R_LINEAR_____108_CM 8 0. 1389. FORMAT "%7.2" AXIS_PTS_REF ldp_maf__vls_sp_dly_1 /end AXIS_DESCR
 /begin AXIS_DESCR COM_AXIS n_32 _CNV_A_R_LINEAR_____15_CM 8 0. 8160. FORMAT "%4.0" AXIS_PTS_REF ldp_n_32__vls_sp_dly_1 /end AXIS_DESCR
/end CHARACTERISTIC
/begin CHARACTERISTIC ip_delta_vls_down_cat_diag "setpoint for downstream fuel trim controller" CURVE 0xffe49f46 _REC_CUR_20_u2_u1 4.99511719 _CNV_A_R_LINEAR_____3_CM 0. 4.99511719 DISPLAY_IDENTIFIER IP_DELTA_VLS_DOWN_CAT_DIAG FORMAT "%5.3"
 /begin AXIS_DESCR COM_AXIS online_dummy _CNV_A_R_LINEAR_____248_CM 8 0. 1.984375 FORMAT "%4.2" AXIS_PTS_REF ldpm_cat_diag_1_laco /end AXIS_DESCR
/end CHARACTERISTIC
/begin CHARACTERISTIC ip_delta_lamb_i_cat_diag "lambda-shift from I-share in case of active cat diagnosis" CURVE 0xffe49ef6 _REC_CUR_20_u2_u2 0.25 _CNV_A_R_LINEAR_____356_CM -0.125 0.125 DISPLAY_IDENTIFIER IP_DELTA_LAMB_I_CAT_DIAG FORMAT "%8.6"
 /begin AXIS_DESCR COM_AXIS online_dummy _CNV_A_R_LINEAR_____355_CM 16 -5. 4.99511719 FORMAT "%5.3" AXIS_PTS_REF ldpm_vls_dif_dly__delta_lamb /end AXIS_DESCR
/end CHARACTERISTIC
/begin AXIS_PTS ldpm_cat_diag_1_laco "" 0xffe48350 online_dummy _REC_AXS_20_u1 1.984375 _CNV_A_R_LINEAR_____248_CM 8 0. 1.984375 DISPLAY_IDENTIFIER LDPM_CAT_DIAG_1_LACO FORMAT "%4.2" /end AXIS_PTS
/begin CHARACTERISTIC c_crlc_dly_i_mv "Correlation constant for the calculation of the moving mean value of the i-share" VALUE 0xffe41544 _REC_VAL_20_u2 0.9999847 _CNV_A_R_LINEAR_____357_CM 0. 0.9999847 DISPLAY_IDENTIFIER C_CRLC_DLY_I_MV FORMAT "%7.5" /end CHARACTERISTIC
/begin AXIS_PTS ldpm_vls_dif_dly__delta_lamb "" 0xffe51e94 online_dummy _REC_AXS_20_u2 9.99511719 _CNV_A_R_LINEAR_____355_CM 16 -5. 4.99511719 DISPLAY_IDENTIFIER LDPM_VLS_DIF_DLY__DELTA_LAMB FORMAT "%5.3" /end AXIS_PTS
/begin AXIS_PTS ldp_maf__vls_sp_dly_1 "" 0xffe50cf8 maf _REC_AXS_20_u2 1389. _CNV_A_R_LINEAR_____108_CM 8 0. 1389. DISPLAY_IDENTIFIER LDP_MAF__VLS_SP_DLY_1 FORMAT "%7.2" /end AXIS_PTS
/begin AXIS_PTS ldp_n_32__vls_sp_dly_1 "" 0xffe480ac n_32 _REC_AXS_20_u1 8160. _CNV_A_R_LINEAR_____15_CM 8 0. 8160. DISPLAY_IDENTIFIER LDP_N_32__VLS_SP_DLY_1 FORMAT "%4.0" /end AXIS_PTS
/begin AXIS_PTS ldp_maf__vls_sp_dly_2 "" 0xffe50d0a maf _REC_AXS_20_u2 1389. _CNV_A_R_LINEAR_____108_CM 8 0. 1389. DISPLAY_IDENTIFIER LDP_MAF__VLS_SP_DLY_2 FORMAT "%7.2" /end AXIS_PTS
/begin AXIS_PTS ldp_n_32__vls_sp_dly_2 "" 0xffe480b5 n_32 _REC_AXS_20_u1 8160. _CNV_A_R_LINEAR_____15_CM 8 0. 8160. DISPLAY_IDENTIFIER LDP_N_32__VLS_SP_DLY_2 FORMAT "%4.0" /end AXIS_PTS
/begin CHARACTERISTIC c_maf_int_min_dly_i_act_puc "threshold for MAF integral while restart of LAM after PUC " VALUE 0xffe4176a _REC_VAL_20_u2 1820.398 _CNV_A_R_LINEAR_____287_CM 0. 1820.398 DISPLAY_IDENTIFIER C_MAF_INT_MIN_DLY_I_ACT_PUC FORMAT "%7.2" /end CHARACTERISTIC
/begin CHARACTERISTIC c_maf_int_min_dly_p_act_puc "threshold for MAF integral while restart of LAM after PUC " VALUE 0xffe4176c _REC_VAL_20_u2 1820.398 _CNV_A_R_LINEAR_____287_CM 0. 1820.398 DISPLAY_IDENTIFIER C_MAF_INT_MIN_DLY_P_ACT_PUC FORMAT "%7.2" /end CHARACTERISTIC
/begin CHARACTERISTIC c_delta_lamb_i_max "max. limit of I-share" VALUE 0xffe403f0 _REC_VAL_20_s2 0.25 _CNV_A_R_LINEAR_____353_CM -0.125 0.125 DISPLAY_IDENTIFIER C_DELTA_LAMB_I_MAX FORMAT "%8.6" /end CHARACTERISTIC
/begin CHARACTERISTIC c_lamb_sp_min_lam_dly "minimum lambda setpoint for trim controller activation" VALUE 0xffe416ec _REC_VAL_20_u2 2. _CNV_A_R_LINEAR_____285_CM 0. 2. DISPLAY_IDENTIFIER C_LAMB_SP_MIN_LAM_DLY FORMAT "%5.3" /end CHARACTERISTIC
/begin CHARACTERISTIC c_lamb_sp_max_lam_dly "maximum lambda setpoint for trim controller activation" VALUE 0xffe416ea _REC_VAL_20_u2 2. _CNV_A_R_LINEAR_____285_CM 0. 2. DISPLAY_IDENTIFIER C_LAMB_SP_MAX_LAM_DLY FORMAT "%5.3" /end CHARACTERISTIC
/begin CHARACTERISTIC c_lam_mv_dyw "LAM_MV window for the limited dynamic" VALUE 0xffe4169a _REC_VAL_20_u2 99.99847412 _CNV_A_R_LINEAR_____8_CM 0. 99.99847412 DISPLAY_IDENTIFIER C_LAM_MV_DYW FORMAT "%5.2" /end CHARACTERISTIC
/begin CHARACTERISTIC c_n_dyw "N window for the limited dynamic" VALUE 0xffe417fa _REC_VAL_20_u2 8160. _CNV_A_R_LINEAR_____10_CM 0. 8160. DISPLAY_IDENTIFIER C_N_DYW FORMAT "%4.0" /end CHARACTERISTIC
/begin CHARACTERISTIC c_maf_dyw "MAF window for the limited dynamic" VALUE 0xffe4078f _REC_VAL_20_u1 1389. _CNV_A_R_LINEAR_____27_CM 0. 1389. DISPLAY_IDENTIFIER C_MAF_DYW FORMAT "%4.0" /end CHARACTERISTIC
/begin MEASUREMENT lv_n_maf_dyw "Conditions of the limited dynamic for N and MAF detected" UBYTE _CNV_S_2_RANGE______2_CM 1 100. 0. 1. DISPLAY_IDENTIFIER LV_N_MAF_DYW ECU_ADDRESS 0x3fe542 BIT_MASK 0x1 /end MEASUREMENT
/begin MEASUREMENT maf_dyw "MAF-meanvalue" UBYTE _CNV_A_R_LINEAR_____27_CM 1 100. 0. 1389. DISPLAY_IDENTIFIER MAF_DYW ECU_ADDRESS 0x3fe541 FORMAT "%4.0" /end MEASUREMENT
/begin MEASUREMENT n_dyw "N-meanvalue" UWORD _CNV_A_R_LINEAR_____10_CM 1 100. 1. 8160. DISPLAY_IDENTIFIER N_DYW ECU_ADDRESS 0x3fd4c6 BYTE_ORDER MSB_LAST FORMAT "%4.0" /end MEASUREMENT
/begin CHARACTERISTIC c_maf_int_lamb_stop_min "threshold for the air mass flow integral for the activation of the lambda-controller" VALUE 0xffe41754 _REC_VAL_20_u2 1820.398 _CNV_A_R_LINEAR_____287_CM 0. 1820.398 DISPLAY_IDENTIFIER C_MAF_INT_LAMB_STOP_MIN FORMAT "%7.2" /end CHARACTERISTIC
/begin CHARACTERISTIC lc_hom_act_comp "switching variable for the open loop/closed loop operation in stratified mode" VALUE 0xffe40f6b _REC_VAL_20_u1 1. _CNV_A_R_LINEAR_____0_CM 0. 1. DISPLAY_IDENTIFIER LC_HOM_ACT_COMP FORMAT "%2.0" /end CHARACTERISTIC
/begin CHARACTERISTIC lc_lam_off_sawup "switching variable for the open loop/closed loop operation at secondary air" VALUE 0xffe40f92 _REC_VAL_20_u1 1. _CNV_A_R_LINEAR_____0_CM 0. 1. DISPLAY_IDENTIFIER LC_LAM_OFF_SAWUP FORMAT "%2.0" /end CHARACTERISTIC
/begin CHARACTERISTIC ip_ti_wf_max_lam__tco "injection time due to wall-film to stop the lambda-controller" CURVE 0xffe4f54e _REC_CUR_20_u2_u1 262.14 _CNV_A_R_LINEAR_____360_CM -131.072 131.068 DISPLAY_IDENTIFIER IP_TI_WF_MAX_LAM__TCO FORMAT "%6.2"
 /begin AXIS_DESCR COM_AXIS tco _CNV_A_R_LINEAR_____11_CM 6 -48. 142.5 FORMAT "%5.1" AXIS_PTS_REF ldp_tco__ti_wf_max_lam /end AXIS_DESCR
/end CHARACTERISTIC
/begin CHARACTERISTIC ip_t_lam_stop__tco "counter to reactivate the lambda-controller after wall-film" CURVE 0xffe4ea8e _REC_CUR_20_u2_u1 1310.7 _CNV_A_R_LINEAR_____198_CM 0. 1310.7 DISPLAY_IDENTIFIER IP_T_LAM_STOP__TCO FORMAT "%7.2"
 /begin AXIS_DESCR COM_AXIS tco _CNV_A_R_LINEAR_____11_CM 6 -48. 142.5 FORMAT "%5.1" AXIS_PTS_REF ldp_tco__t_lam_stop /end AXIS_DESCR
/end CHARACTERISTIC
/begin MEASUREMENT lv_ctl_gain_swi "Logical variable TCS acknowledge" UBYTE _CNV_S_2_RANGE______21_CM 1 100. 0. 1. DISPLAY_IDENTIFIER LV_CTL_GAIN_SWI ECU_ADDRESS 0x3fe52e BIT_MASK 0x1 /end MEASUREMENT
/begin MEASUREMENT lv_lam_stop_intr "stop-mode activation of lambda-controller by film wall" UBYTE _CNV_S_2_RANGE______21_CM 1 100. 0. 1. DISPLAY_IDENTIFIER LV_LAM_STOP_INTR ECU_ADDRESS 0x3fe52d BIT_MASK 0x1 /end MEASUREMENT
/begin CHARACTERISTIC c_t_dly_lamb_stop "Time delay fore a deactivation of the stop-mode after a offset calculation" VALUE 0xffe4087e _REC_VAL_20_u1 5.08 _CNV_A_R_LINEAR_____198_CM 2.e-002 5.1 DISPLAY_IDENTIFIER C_T_DLY_LAMB_STOP FORMAT "%4.2" /end CHARACTERISTIC
/begin AXIS_PTS ldp_tco__ti_wf_max_lam "" 0xffe411fe tco _REC_AXS_20_u1 190.5 _CNV_A_R_LINEAR_____11_CM 6 -48. 142.5 DISPLAY_IDENTIFIER LDP_TCO__TI_WF_MAX_LAM FORMAT "%5.1" /end AXIS_PTS
/begin AXIS_PTS ldp_tco__t_lam_stop "" 0xffe411de tco _REC_AXS_20_u1 190.5 _CNV_A_R_LINEAR_____11_CM 6 -48. 142.5 DISPLAY_IDENTIFIER LDP_TCO__T_LAM_STOP FORMAT "%5.1" /end AXIS_PTS
/begin CHARACTERISTIC lc_ctl_gain_swi "flag indicating whether lambda controller parameter switch is allowed" VALUE 0xffe40f46 _REC_VAL_20_u1 1. _CNV_S_2_RANGE______21_CM 0. 1. DISPLAY_IDENTIFIER LC_CTL_GAIN_SWI /end CHARACTERISTIC
/begin CHARACTERISTIC c_lamb_sp_afr_thd "rich air_fuel mixture setpoint threshold" VALUE 0xffe416e0 _REC_VAL_20_u2 1. _CNV_A_R_LINEAR_____285_CM 0. 1. DISPLAY_IDENTIFIER C_LAMB_SP_AFR_THD FORMAT "%6.4" /end CHARACTERISTIC
/begin CHARACTERISTIC c_lamb_sp_afr_thd_hys "rich air_fuel mixture setpoint threshold" VALUE 0xffe416e2 _REC_VAL_20_u2 1. _CNV_A_R_LINEAR_____285_CM 0. 1. DISPLAY_IDENTIFIER C_LAMB_SP_AFR_THD_HYS FORMAT "%6.4" /end CHARACTERISTIC
/begin MEASUREMENT maf_int_puc "integral of mass air flow while active PUC" UWORD _CNV_A_R_LINEAR_____287_CM 1 100. 0. 1820.398 DISPLAY_IDENTIFIER MAF_INT_PUC ECU_ADDRESS 0x3fd388 BYTE_ORDER MSB_LAST FORMAT "%7.2" /end MEASUREMENT
/begin CHARACTERISTIC c_vls_down_puc_act_max "max. VLS_DOWN threshold for deactivation " VALUE 0xffe41b70 _REC_VAL_20_u2 4.99511719 _CNV_A_R_LINEAR_____3_CM 0. 4.99511719 DISPLAY_IDENTIFIER C_VLS_DOWN_PUC_ACT_MAX FORMAT "%5.3" /end CHARACTERISTIC
/begin CHARACTERISTIC c_maf_int_puc_min "minimum MAF_INT threshold for cat purge activation after PUC phase" VALUE 0xffe41788 _REC_VAL_20_u2 1820.398 _CNV_A_R_LINEAR_____287_CM 0. 1820.398 DISPLAY_IDENTIFIER C_MAF_INT_PUC_MIN FORMAT "%7.2" /end CHARACTERISTIC
/begin CHARACTERISTIC c_maf_int_pcat_purge_sa "initial value for mass air flow integral for pre cat purge after SA phase" VALUE 0xffe4177c _REC_VAL_20_u2 1820.398 _CNV_A_R_LINEAR_____287_CM 0. 1820.398 DISPLAY_IDENTIFIER C_MAF_INT_PCAT_PURGE_SA FORMAT "%7.2" /end CHARACTERISTIC
/begin CHARACTERISTIC c_maf_int_pcat_purge_hst "initial value for mass air flow integral for pre cat purge after HST phase" VALUE 0xffe4177a _REC_VAL_20_u2 1820.398 _CNV_A_R_LINEAR_____287_CM 0. 1820.398 DISPLAY_IDENTIFIER C_MAF_INT_PCAT_PURGE_HST FORMAT "%7.2" /end CHARACTERISTIC
/begin CHARACTERISTIC c_maf_int_pcat_purge_ch "initial value for mass air flow integral for pre cat purge after CH phase" VALUE 0xffe41778 _REC_VAL_20_u2 1820.398 _CNV_A_R_LINEAR_____287_CM 0. 1820.398 DISPLAY_IDENTIFIER C_MAF_INT_PCAT_PURGE_CH FORMAT "%7.2" /end CHARACTERISTIC
/begin CHARACTERISTIC c_fac_add_pcat_main_cat_puc_sa "additional weighting factor for IP_FAC_PCAT_MAIN_CAT_PUC for main cat purge after SA" VALUE 0xffe40730 _REC_VAL_20_u1 3.984375 _CNV_A_R_LINEAR_____129_CM 0. 3.984375 DISPLAY_IDENTIFIER C_FAC_ADD_PCAT_MAIN_CAT_PUC_SA FORMAT "%4.2" /end CHARACTERISTIC
/begin CHARACTERISTIC c_fac_add_pcat_main_cat_puc_hst "additional weighting factor for IP_FAC_PCAT_MAIN_CAT_PUC for main cat purge after HST" VALUE 0xffe4072f _REC_VAL_20_u1 3.984375 _CNV_A_R_LINEAR_____129_CM 0. 3.984375 DISPLAY_IDENTIFIER C_FAC_ADD_PCAT_MAIN_CAT_PUC_HST FORMAT "%4.2" /end CHARACTERISTIC
/begin CHARACTERISTIC c_fac_add_pcat_main_cat_puc_ch "additional weighting factor for IP_FAC_PCAT_MAIN_CAT_PUC for main cat purge after CH" VALUE 0xffe4072e _REC_VAL_20_u1 3.984375 _CNV_A_R_LINEAR_____129_CM 0. 3.984375 DISPLAY_IDENTIFIER C_FAC_ADD_PCAT_MAIN_CAT_PUC_CH FORMAT "%4.2" /end CHARACTERISTIC
/begin CHARACTERISTIC c_delta_lamb_sp_puc_inc "limitation for DELTA_LAMB_SP_PUC increase" VALUE 0xffe406e6 _REC_VAL_20_u1 0.125 _CNV_A_R_LINEAR_____285_CM 0. 0.125 DISPLAY_IDENTIFIER C_DELTA_LAMB_SP_PUC_INC FORMAT "%5.3" /end CHARACTERISTIC
/begin CHARACTERISTIC c_delta_lamb_sp_puc_dec "limitation for DELTA_LAMB_SP_PUC decrease" VALUE 0xffe406e5 _REC_VAL_20_u1 0.125 _CNV_A_R_LINEAR_____285_CM 0. 0.125 DISPLAY_IDENTIFIER C_DELTA_LAMB_SP_PUC_DEC FORMAT "%5.3" /end CHARACTERISTIC
/begin CHARACTERISTIC ip_delta_lamb_sp_puc "basic value for lambda controller set point shift" MAP 0xffe44dfe _REC_MAP_20_u1_u2_u1 0.125 _CNV_A_R_LINEAR_____285_CM 0. 0.125 DISPLAY_IDENTIFIER IP_DELTA_LAMB_SP_PUC FORMAT "%5.3"
 /begin AXIS_DESCR COM_AXIS maf_cyl _CNV_A_R_LINEAR_____115_CM 6 0. 2047.96875 FORMAT "%7.2" AXIS_PTS_REF ldp_maf_cyl /end AXIS_DESCR
 /begin AXIS_DESCR COM_AXIS lam_bank_1.lam_puc.quo_maf_int_purge _CNV_A_R_LINEAR_____50_CM 8 0. 0.996094 FORMAT "%5.3" AXIS_PTS_REF ldp_quo_maf_int_purge /end AXIS_DESCR
/end CHARACTERISTIC
/begin CHARACTERISTIC ip_maf_int_act_puc "initial value for mass air flow integral for pre cat purge after PUC phase" CURVE 0xffe4ce0e _REC_CUR_20_u2_u2 1820.398 _CNV_A_R_LINEAR_____287_CM 0. 1820.398 DISPLAY_IDENTIFIER IP_MAF_INT_ACT_PUC FORMAT "%7.2"
 /begin AXIS_DESCR COM_AXIS maf_int_puc _CNV_A_R_LINEAR_____287_CM 6 0. 1820.398 FORMAT "%7.2" AXIS_PTS_REF ldp_maf_int_puc /end AXIS_DESCR
/end CHARACTERISTIC
/begin CHARACTERISTIC ip_fac_cat_eff_puc "weighting factor for the lambda shift depending on the result of the catalyst diagnosis" MAP 0xffe451ae _REC_MAP_20_u1_u2_u1 0.9960940000000002 _CNV_A_R_LINEAR_____50_CM 0. 0.996094 DISPLAY_IDENTIFIER IP_FAC_CAT_EFF_PUC FORMAT "%5.3"
 /begin AXIS_DESCR COM_AXIS online_dummy _CNV_A_R_LINEAR_____343_CM 6 -33. 990.984375 FORMAT "%6.2" AXIS_PTS_REF ldp_temp_pcat /end AXIS_DESCR
 /begin AXIS_DESCR COM_AXIS online_dummy _CNV_A_R_LINEAR_____248_CM 6 0. 1.984375 FORMAT "%4.2" AXIS_PTS_REF ldpm_cat_diag /end AXIS_DESCR
/end CHARACTERISTIC
/begin CHARACTERISTIC ip_fac_pcat_main_cat_puc "basic value for lambda controller set point shift" MAP 0xffe4553e _REC_MAP_20_u1_u2_u1 3.984375 _CNV_A_R_LINEAR_____129_CM 0. 3.984375 DISPLAY_IDENTIFIER IP_FAC_PCAT_MAIN_CAT_PUC FORMAT "%4.2"
 /begin AXIS_DESCR COM_AXIS online_dummy _CNV_A_R_LINEAR_____343_CM 6 -33. 990.984375 FORMAT "%6.2" AXIS_PTS_REF ldp_temp_main_cat /end AXIS_DESCR
 /begin AXIS_DESCR COM_AXIS online_dummy _CNV_A_R_LINEAR_____248_CM 6 0. 1.984375 FORMAT "%4.2" AXIS_PTS_REF ldpm_cat_diag /end AXIS_DESCR
/end CHARACTERISTIC
/begin CHARACTERISTIC c_maf_int_act_puc_max "upper limit for MAF_INT_ACT_PUC_i" VALUE 0xffe41746 _REC_VAL_20_u2 1820.398 _CNV_A_R_LINEAR_____287_CM 0. 1820.398 DISPLAY_IDENTIFIER C_MAF_INT_ACT_PUC_MAX FORMAT "%7.2" /end CHARACTERISTIC
/begin AXIS_PTS ldp_maf_int_puc "" 0xffe50d9a maf_int_puc _REC_AXS_20_u2 1820.398 _CNV_A_R_LINEAR_____287_CM 6 0. 1820.398 DISPLAY_IDENTIFIER LDP_MAF_INT_PUC FORMAT "%7.2" /end AXIS_PTS
/begin AXIS_PTS ldp_temp_main_cat "" 0xffe51348 online_dummy _REC_AXS_20_u2 1023.984375 _CNV_A_R_LINEAR_____343_CM 6 -33. 990.984375 DISPLAY_IDENTIFIER LDP_TEMP_MAIN_CAT FORMAT "%6.2" /end AXIS_PTS
/begin AXIS_PTS ldp_maf_cyl "" 0xffe50d1c maf_cyl _REC_AXS_20_u2 2047.96875 _CNV_A_R_LINEAR_____115_CM 6 0. 2047.96875 DISPLAY_IDENTIFIER LDP_MAF_CYL FORMAT "%7.2" /end AXIS_PTS
/begin AXIS_PTS ldp_quo_maf_int_purge "" 0xffe48179 lam_bank_1.lam_puc.quo_maf_int_purge _REC_AXS_20_u1 0.9960940000000002 _CNV_A_R_LINEAR_____50_CM 8 0. 0.996094 DISPLAY_IDENTIFIER LDP_QUO_MAF_INT_PURGE FORMAT "%5.3" /end AXIS_PTS
/begin AXIS_PTS ldpm_cat_diag "" 0xffe4133b online_dummy _REC_AXS_20_u1 1.984375 _CNV_A_R_LINEAR_____248_CM 6 0. 1.984375 DISPLAY_IDENTIFIER LDPM_CAT_DIAG FORMAT "%4.2" /end AXIS_PTS
/begin AXIS_PTS ldp_temp_pcat "" 0xffe51356 online_dummy _REC_AXS_20_u2 1023.984375 _CNV_A_R_LINEAR_____343_CM 6 -33. 990.984375 DISPLAY_IDENTIFIER LDP_TEMP_PCAT FORMAT "%6.2" /end AXIS_PTS
/begin CHARACTERISTIC c_tco_thd_hst "temperature threshold for hot start" VALUE 0xffe40939 _REC_VAL_20_u1 190.5 _CNV_A_R_LINEAR_____11_CM -48. 142.5 DISPLAY_IDENTIFIER C_TCO_THD_HST FORMAT "%5.1" /end CHARACTERISTIC
/begin CHARACTERISTIC c_quo_maf_int_puc_afl "calibration MAF integral quotient for the that LV_ACT_INT_PUC_AFL_i is active" VALUE 0xffe40834 _REC_VAL_20_u1 0.99610001 _CNV_A_R_LINEAR_____29_CM 0. 0.99610001 DISPLAY_IDENTIFIER C_QUO_MAF_INT_PUC_AFL FORMAT "%5.3" /end CHARACTERISTIC
/begin CHARACTERISTIC c_tco_act_puc_min "minimum TCO threshold for cat purge activation" VALUE 0xffe408e4 _REC_VAL_20_u1 190.5 _CNV_A_R_LINEAR_____11_CM -48. 142.5 DISPLAY_IDENTIFIER C_TCO_ACT_PUC_MIN FORMAT "%5.1" /end CHARACTERISTIC
/begin CHARACTERISTIC c_n_max_cat_purge "maximum engine speed for cat purge" VALUE 0xffe407e5 _REC_VAL_20_u1 8160. _CNV_A_R_LINEAR_____15_CM 0. 8160. DISPLAY_IDENTIFIER C_N_MAX_CAT_PURGE FORMAT "%4.0" /end CHARACTERISTIC
/begin CHARACTERISTIC c_temp_dif_pcat_main_cat "temperature difference between pre and main cat" VALUE 0xffe41a68 _REC_VAL_20_u2 1507.3 _CNV_A_R_LINEAR_____280_CM -48. 1459.3 DISPLAY_IDENTIFIER C_TEMP_DIF_PCAT_MAIN_CAT FORMAT "%7.2" /end CHARACTERISTIC
/begin CHARACTERISTIC c_maf_cyl_act_int_puc_max "maximum MAF_CYL threshold for active cat purge function" VALUE 0xffe4172e _REC_VAL_20_u2 2047.96875 _CNV_A_R_LINEAR_____115_CM 0. 2047.96875 DISPLAY_IDENTIFIER C_MAF_CYL_ACT_INT_PUC_MAX FORMAT "%7.2" /end CHARACTERISTIC
/begin CHARACTERISTIC c_thd_delta_lamb_sp_puc "DELTA_LAMB_SP_PUC - threshold to inhibit cat purge function" VALUE 0xffe4094c _REC_VAL_20_u1 0.125 _CNV_A_R_LINEAR_____285_CM 0. 0.125 DISPLAY_IDENTIFIER C_THD_DELTA_LAMB_SP_PUC FORMAT "%5.3" /end CHARACTERISTIC
/begin CHARACTERISTIC c_t_per_lamb_de_is "period duration of the forced stimulation in case of active idle speed" VALUE 0xffe408c2 _REC_VAL_20_u1 10.2 _CNV_A_R_LINEAR_____41_CM 0. 10.2 DISPLAY_IDENTIFIER C_T_PER_LAMB_DE_IS FORMAT "%5.2" /end CHARACTERISTIC
/begin CHARACTERISTIC c_ramp_lamb_de_is "ramp gradient of the forced stimulation in case of active idle speed" VALUE 0xffe40836 _REC_VAL_20_u1 0.9960940000000002 _CNV_A_R_LINEAR_____50_CM 0. 0.996094 DISPLAY_IDENTIFIER C_RAMP_LAMB_DE_IS FORMAT "%5.3" /end CHARACTERISTIC
/begin CHARACTERISTIC c_t_per_lamb_de_ls_diag "period duration of the forced stimulation in the requested mode" VALUE 0xffe408c3 _REC_VAL_20_u1 10.2 _CNV_A_R_LINEAR_____41_CM 0. 10.2 DISPLAY_IDENTIFIER C_T_PER_LAMB_DE_LS_DIAG FORMAT "%5.2" /end CHARACTERISTIC
/begin CHARACTERISTIC c_sp_lamb_de_ls_diag "Amplitude of the forced stimulation in the requested mode" VALUE 0xffe4083f _REC_VAL_20_u1 0.124023 _CNV_A_R_LINEAR_____342_CM 0. 0.124023 DISPLAY_IDENTIFIER C_SP_LAMB_DE_LS_DIAG FORMAT "%5.3" /end CHARACTERISTIC
/begin CHARACTERISTIC c_ramp_lamb_de_ls_diag "ramp gradient of the forced stimulation in the requested mode" VALUE 0xffe40837 _REC_VAL_20_u1 0.9960940000000002 _CNV_A_R_LINEAR_____50_CM 0. 0.996094 DISPLAY_IDENTIFIER C_RAMP_LAMB_DE_LS_DIAG FORMAT "%5.3" /end CHARACTERISTIC
/begin CHARACTERISTIC c_maf_int_lamb_puls_min "threshold for the MAF-integral for the activation of the forced stimulation" VALUE 0xffe41752 _REC_VAL_20_u2 1820.4167 _CNV_A_R_LINEAR_____273_CM 0. 1820.4167 DISPLAY_IDENTIFIER C_MAF_INT_LAMB_PULS_MIN FORMAT "%9.4" /end CHARACTERISTIC
/begin CHARACTERISTIC c_temp_cat_lamb_puls_min "minimum value of the catalyst temperature for the activation of the forced stimulation" VALUE 0xffe41a64 _REC_VAL_20_u2 1023.984375 _CNV_A_R_LINEAR_____343_CM -33. 990.984375 DISPLAY_IDENTIFIER C_TEMP_CAT_LAMB_PULS_MIN FORMAT "%6.2" /end CHARACTERISTIC
/begin CHARACTERISTIC c_delta_lamb_thd_puls_on "DELTA_LAMB lower threshold for activating the forced stimulation" VALUE 0xffe406e8 _REC_VAL_20_u1 0.125 _CNV_A_R_LINEAR_____285_CM 0. 0.125 DISPLAY_IDENTIFIER C_DELTA_LAMB_THD_PULS_ON FORMAT "%5.3" /end CHARACTERISTIC
/begin CHARACTERISTIC c_delta_lamb_thd_puls_off "DELTA_LAMB upper threshold for activating the forced stimulation" VALUE 0xffe406e7 _REC_VAL_20_u1 0.125 _CNV_A_R_LINEAR_____285_CM 0. 0.125 DISPLAY_IDENTIFIER C_DELTA_LAMB_THD_PULS_OFF FORMAT "%5.3" /end CHARACTERISTIC
/begin CHARACTERISTIC ip_sp_lamb_de "amplitude of the forced stimulation" MAP 0xffe46f5b _REC_MAP_20_u1_u1_u1 0.124023 _CNV_A_R_LINEAR_____342_CM 0. 0.124023 DISPLAY_IDENTIFIER IP_SP_LAMB_DE FORMAT "%5.3"
 /begin AXIS_DESCR COM_AXIS n_32 _CNV_A_R_LINEAR_____15_CM 8 0. 8160. FORMAT "%4.0" AXIS_PTS_REF ldpm_n_32_2_egtr /end AXIS_DESCR
 /begin AXIS_DESCR COM_AXIS maf _CNV_A_R_LINEAR_____27_CM 8 0. 1389. FORMAT "%4.0" AXIS_PTS_REF ldpm_maf_hb_2_egtr /end AXIS_DESCR
/end CHARACTERISTIC
/begin CHARACTERISTIC ip_ramp_lamb_de "ramp gradient of the forced stimulation" MAP 0xffe46edb _REC_MAP_20_u1_u1_u1 0.9960940000000002 _CNV_A_R_LINEAR_____50_CM 0. 0.996094 DISPLAY_IDENTIFIER IP_RAMP_LAMB_DE FORMAT "%5.3"
 /begin AXIS_DESCR COM_AXIS n_32 _CNV_A_R_LINEAR_____15_CM 8 0. 8160. FORMAT "%4.0" AXIS_PTS_REF ldpm_n_32_2_egtr /end AXIS_DESCR
 /begin AXIS_DESCR COM_AXIS maf _CNV_A_R_LINEAR_____27_CM 8 0. 1389. FORMAT "%4.0" AXIS_PTS_REF ldpm_maf_hb_2_egtr /end AXIS_DESCR
/end CHARACTERISTIC
/begin CHARACTERISTIC ip_t_per_lamb_de_cat_diag "period duration of the forced stimulation in case of active catalyst diagnosis" MAP 0xffe4785b _REC_MAP_20_u1_u1_u1 10.2 _CNV_A_R_LINEAR_____41_CM 0. 10.2 DISPLAY_IDENTIFIER IP_T_PER_LAMB_DE_CAT_DIAG__N__MA FORMAT "%5.2"
 /begin AXIS_DESCR COM_AXIS n_32 _CNV_A_R_LINEAR_____15_CM 8 0. 8160. FORMAT "%4.0" AXIS_PTS_REF ldpm_n_32_2_egtr /end AXIS_DESCR
 /begin AXIS_DESCR COM_AXIS maf _CNV_A_R_LINEAR_____27_CM 8 0. 1389. FORMAT "%4.0" AXIS_PTS_REF ldpm_maf_hb_2_egtr /end AXIS_DESCR
/end CHARACTERISTIC
/begin CHARACTERISTIC ip_sp_lamb_de_cat_diag "amplitude of the forced stimulation in case of active catalyst diagnosis" MAP 0xffe46f9b _REC_MAP_20_u1_u1_u1 0.124023 _CNV_A_R_LINEAR_____342_CM 0. 0.124023 DISPLAY_IDENTIFIER IP_SP_LAMB_DE_CAT_DIAG__N__MAF FORMAT "%5.3"
 /begin AXIS_DESCR COM_AXIS n_32 _CNV_A_R_LINEAR_____15_CM 8 0. 8160. FORMAT "%4.0" AXIS_PTS_REF ldpm_n_32_2_egtr /end AXIS_DESCR
 /begin AXIS_DESCR COM_AXIS maf _CNV_A_R_LINEAR_____27_CM 8 0. 1389. FORMAT "%4.0" AXIS_PTS_REF ldpm_maf_hb_2_egtr /end AXIS_DESCR
/end CHARACTERISTIC
/begin CHARACTERISTIC ip_ramp_lamb_de_cat_diag "ramp gradient of the forced stimulation in case of active catalyst diagnosis" MAP 0xffe46f1b _REC_MAP_20_u1_u1_u1 0.9960940000000002 _CNV_A_R_LINEAR_____50_CM 0. 0.996094 DISPLAY_IDENTIFIER IP_RAMP_LAMB_DE_CAT_DIAG__N__MAF FORMAT "%5.3"
 /begin AXIS_DESCR COM_AXIS n_32 _CNV_A_R_LINEAR_____15_CM 8 0. 8160. FORMAT "%4.0" AXIS_PTS_REF ldpm_n_32_2_egtr /end AXIS_DESCR
 /begin AXIS_DESCR COM_AXIS maf _CNV_A_R_LINEAR_____27_CM 8 0. 1389. FORMAT "%4.0" AXIS_PTS_REF ldpm_maf_hb_2_egtr /end AXIS_DESCR
/end CHARACTERISTIC
/begin MEASUREMENT ramp_lamb_de "ramp gradient of the forced stimulation" UBYTE _CNV_A_R_LINEAR_____50_CM 1 100. 0. 0.996094 DISPLAY_IDENTIFIER RAMP_LAMB_DE ECU_ADDRESS 0x3fe4da FORMAT "%5.3" /end MEASUREMENT
/begin MEASUREMENT t_per_lamb_de "period time of the forced lambda stimulation" UWORD _CNV_A_R_LINEAR_____4_CM 1 100. 0. 655.35 DISPLAY_IDENTIFIER T_PER_LAMB_DE ECU_ADDRESS 0x3fd382 BYTE_ORDER MSB_LAST FORMAT "%6.2" /end MEASUREMENT
/begin CHARACTERISTIC c_delta_lamb_sp "Permissible deviation of the lambda-controller setpoint for the activation of the lambda alternation" VALUE 0xffe415b4 _REC_VAL_20_u2 2. _CNV_A_R_LINEAR_____285_CM 0. 2. DISPLAY_IDENTIFIER C_DELTA_LAMB_SP FORMAT "%5.3" /end CHARACTERISTIC
/begin MEASUREMENT lv_lamb_puls_ls_diag "amplitude of the forced lambda stimulation" UBYTE _CNV_S_2_RANGE______2_CM 1 100. 0. 1. DISPLAY_IDENTIFIER LV_LAMB_PULS_LS_DIAG ECU_ADDRESS 0x3fe4df /end MEASUREMENT
/begin CHARACTERISTIC c_sp_lamb_de_is "amplitude of the forced stimulation in case of active idle speed" VALUE 0xffe4083e _REC_VAL_20_u1 0.124023 _CNV_A_R_LINEAR_____342_CM 0. 0.124023 DISPLAY_IDENTIFIER C_SP_LAMB_DE_IS FORMAT "%5.3" /end CHARACTERISTIC
/begin CHARACTERISTIC c_sp_lamb_de_dyn_diag "amplitude of the forced stimulation in case of active idle speed" VALUE 0xffe4083d _REC_VAL_20_u1 0.124023 _CNV_A_R_LINEAR_____342_CM 0. 0.124023 DISPLAY_IDENTIFIER C_SP_LAMB_DE_DYN_DIAG FORMAT "%5.3" /end CHARACTERISTIC
/begin CHARACTERISTIC ip_t_per_lamb_de "period duration of the forced stimulation" MAP 0xffe4781b _REC_MAP_20_u1_u1_u1 10.2 _CNV_A_R_LINEAR_____41_CM 0. 10.2 DISPLAY_IDENTIFIER IP_T_PER_LAMB_DE FORMAT "%5.2"
 /begin AXIS_DESCR COM_AXIS n_32 _CNV_A_R_LINEAR_____15_CM 8 0. 8160. FORMAT "%4.0" AXIS_PTS_REF ldpm_n_32_2_egtr /end AXIS_DESCR
 /begin AXIS_DESCR COM_AXIS maf _CNV_A_R_LINEAR_____27_CM 8 0. 1389. FORMAT "%4.0" AXIS_PTS_REF ldpm_maf_hb_2_egtr /end AXIS_DESCR
/end CHARACTERISTIC
/begin CHARACTERISTIC c_lamb_sp "Lambda-controller setpoint meanvalue for the activation of the lambda alternation" VALUE 0xffe416dc _REC_VAL_20_u2 2. _CNV_A_R_LINEAR_____285_CM 0. 2. DISPLAY_IDENTIFIER C_LAMB_SP FORMAT "%5.3" /end CHARACTERISTIC
/begin CHARACTERISTIC c_lamb_dif_thd_afl_off "Lambda-controller setpoint meanvalue for the activation of the lambda alternation" VALUE 0xffe416b2 _REC_VAL_20_u2 0.99997 _CNV_A_R_LINEAR_____175_CM 0. 0.99997 DISPLAY_IDENTIFIER C_LAMB_DIF_THD_AFL_OFF FORMAT "%8.6" /end CHARACTERISTIC
/begin CHARACTERISTIC c_lamb_dif_thd_afl_on "Lambda-controller setpoint meanvalue for the activation of the lambda alternation" VALUE 0xffe40444 _REC_VAL_20_s2 1.99996948 _CNV_A_R_LINEAR_____281_CM -1. 0.99996948 DISPLAY_IDENTIFIER C_LAMB_DIF_THD_AFL_ON FORMAT "%8.5" /end CHARACTERISTIC
/begin CHARACTERISTIC c_lamb_dif_thd_afr_on "Lambda-controller setpoint meanvalue for the activation of the lambda alternation" VALUE 0xffe40448 _REC_VAL_20_s2 1.99996948 _CNV_A_R_LINEAR_____281_CM -1. 0.99996948 DISPLAY_IDENTIFIER C_LAMB_DIF_THD_AFR_ON FORMAT "%8.5" /end CHARACTERISTIC
/begin CHARACTERISTIC c_lamb_dif_thd_afr_off "Lambda-controller setpoint meanvalue for the activation of the lambda alternation" VALUE 0xffe40446 _REC_VAL_20_s2 1. _CNV_A_R_LINEAR_____361_CM -1. 0. DISPLAY_IDENTIFIER C_LAMB_DIF_THD_AFR_OFF FORMAT "%8.6" /end CHARACTERISTIC
/begin CHARACTERISTIC lc_lamb_puls_cor_is "Lambda-controller setpoint meanvalue for the activation of the lambda alternation" VALUE 0xffe40f93 _REC_VAL_20_u1 1. _CNV_A_R_LINEAR_____0_CM 0. 1. DISPLAY_IDENTIFIER LC_LAMB_PULS_COR_IS FORMAT "%2.0" /end CHARACTERISTIC
/begin AXIS_PTS ldpm_maf_hb_2_egtr "" 0xffe483f9 maf _REC_AXS_20_u1 1389. _CNV_A_R_LINEAR_____27_CM 8 0. 1389. DISPLAY_IDENTIFIER LDPM_MAF_HB_2_EGTR FORMAT "%4.0" /end AXIS_PTS
/begin AXIS_PTS ldpm_n_32_2_egtr "" 0xffe4848f n_32 _REC_AXS_20_u1 8160. _CNV_A_R_LINEAR_____15_CM 8 0. 8160. DISPLAY_IDENTIFIER LDPM_N_32_2_EGTR FORMAT "%4.0" /end AXIS_PTS
/begin MEASUREMENT sp_lamb_de "" UBYTE _CNV_A_R_LINEAR_____342_CM 1 100. 0. 0.124023 DISPLAY_IDENTIFIER SP_LAMB_DE ECU_ADDRESS 0x3fe4d9 FORMAT "%5.3" /end MEASUREMENT
/begin MEASUREMENT lv_lamb_puls_cor "amplitude of the forced lambda stimulation" UBYTE _CNV_S_2_RANGE______2_CM 1 100. 0. 1. DISPLAY_IDENTIFIER LV_LAMB_PULS_COR ECU_ADDRESS 0x3fe4e0 /end MEASUREMENT
/begin MEASUREMENT lv_lamb_puls_syn_cbk "flag for synchronisation of bank1 and bank2" UBYTE _CNV_S_2_RANGE______2_CM 1 100. 0. 1. DISPLAY_IDENTIFIER LV_LAMB_PULS_SYN_CBK ECU_ADDRESS 0x3fe4e1 /end MEASUREMENT
/begin MEASUREMENT delta_lamb_puls "amplitude of the forced lambda stimulation" UBYTE _CNV_A_R_LINEAR_____362_CM 1 100. 0. 0.24902344 DISPLAY_IDENTIFIER DELTA_LAMB_PULS ECU_ADDRESS 0x3fe4db FORMAT "%5.3" /end MEASUREMENT
/begin MEASUREMENT delta_sp_lamb_de "amplitude step width for transition phase from nominal to cat diagnosis stimulation" SBYTE _CNV_A_R_LINEAR_____290_CM 1 100. -0.125 0.124023 DISPLAY_IDENTIFIER DELTA_SP_LAMB_DE ECU_ADDRESS 0x3fe4dd FORMAT "%7.4" /end MEASUREMENT
/begin MEASUREMENT delta_t_per_lamb_de "amplitude step width for transition phase from nominal to cat diagnosis stimulation" SBYTE _CNV_A_R_LINEAR_____363_CM 1 100. -5.12 5.08 DISPLAY_IDENTIFIER DELTA_T_PER_LAMB_DE ECU_ADDRESS 0x3fe4de FORMAT "%5.2" /end MEASUREMENT
/begin AXIS_PTS ldp_t_ast_fac_2_sp_lamb_de "" 0xffe512b2 t_ast _REC_AXS_20_u2 6553.5 _CNV_A_R_LINEAR_____24_CM 4 0. 6553.5 DISPLAY_IDENTIFIER LDP_T_AST_FAC_2_SP_LAMB_DE FORMAT "%6.1" /end AXIS_PTS
/begin AXIS_PTS ldp_temp_cat_fac_2_sp_lamb_de "" 0xffe5133e temp_cat _REC_AXS_20_u2 1023.984375 _CNV_A_R_LINEAR_____343_CM 4 -33. 990.984375 DISPLAY_IDENTIFIER LDP_TEMP_CAT_FAC_2_SP_LAMB_DE FORMAT "%6.2" /end AXIS_PTS
/begin AXIS_PTS ldp_cat_diag_fac_1_sp_lamb_de "" 0xffe4100b online_dummy _REC_AXS_20_u1 1.984375 _CNV_A_R_LINEAR_____248_CM 4 0. 1.984375 DISPLAY_IDENTIFIER LDP_CAT_DIAG_FAC_1_SP_LAMB_DE FORMAT "%4.2" /end AXIS_PTS
/begin CHARACTERISTIC ip_fac_2_sp_lamb_de "second factor for forced stimulation amplitude" MAP 0xffe4502e _REC_MAP_20_u1_u2_u2 1.99220002 _CNV_A_R_LINEAR_____39_CM 0. 1.99220002 DISPLAY_IDENTIFIER IP_FAC_2_SP_LAMB_DE FORMAT "%5.3"
 /begin AXIS_DESCR COM_AXIS t_ast _CNV_A_R_LINEAR_____24_CM 4 0. 6553.5 FORMAT "%6.1" AXIS_PTS_REF ldp_t_ast_fac_2_sp_lamb_de /end AXIS_DESCR
 /begin AXIS_DESCR COM_AXIS temp_cat _CNV_A_R_LINEAR_____343_CM 4 -33. 990.984375 FORMAT "%6.2" AXIS_PTS_REF ldp_temp_cat_fac_2_sp_lamb_de /end AXIS_DESCR
/end CHARACTERISTIC
/begin CHARACTERISTIC ip_fac_1_sp_lamb_de "first factor for forced stimulation amplitude" CURVE 0xffe40b17 _REC_CUR_20_u1_u1 1.99220002 _CNV_A_R_LINEAR_____39_CM 0. 1.99220002 DISPLAY_IDENTIFIER IP_FAC_1_SP_LAMB_DE FORMAT "%5.3"
 /begin AXIS_DESCR COM_AXIS online_dummy _CNV_A_R_LINEAR_____248_CM 4 0. 1.984375 FORMAT "%4.2" AXIS_PTS_REF ldp_cat_diag_fac_1_sp_lamb_de /end AXIS_DESCR
/end CHARACTERISTIC
/begin CHARACTERISTIC ip_t_per_lamb_de_dyn_diag "period duration of the forced stimulation in case of active dynamic WRAF sensor  diagnosis" MAP 0xffe4789b _REC_MAP_20_u1_u1_u1 10.2 _CNV_A_R_LINEAR_____41_CM 0. 10.2 DISPLAY_IDENTIFIER IP_T_PER_LAMB_DE_DYN_DIAG FORMAT "%5.2"
 /begin AXIS_DESCR COM_AXIS n_32 _CNV_A_R_LINEAR_____15_CM 8 0. 8160. FORMAT "%4.0" AXIS_PTS_REF ldpm_n_32_2_egtr /end AXIS_DESCR
 /begin AXIS_DESCR COM_AXIS maf _CNV_A_R_LINEAR_____27_CM 8 0. 1389. FORMAT "%4.0" AXIS_PTS_REF ldpm_maf_hb_2_egtr /end AXIS_DESCR
/end CHARACTERISTIC
/begin MEASUREMENT maf_int_sp_o2l "MAF integral set point representing O2 load" UWORD _CNV_A_R_LINEAR_____344_CM 1 100. 0. 182.0389 DISPLAY_IDENTIFIER MAF_INT_SP_O2L ECU_ADDRESS 0x3fd384 BYTE_ORDER MSB_LAST FORMAT "%7.3" /end MEASUREMENT
/begin CHARACTERISTIC ip_t_lsh_temp_thd "Duration until critical water splash sensor temperature reached" CURVE 0xffe40e3a _REC_CUR_20_u1_u2 25.5 _CNV_A_R_LINEAR_____24_CM 0. 25.5 DISPLAY_IDENTIFIER IP_T_LSH_TEMP_THD FORMAT "%4.1"
 /begin AXIS_DESCR COM_AXIS online_dummy _CNV_A_R_LINEAR_____368_CM 6 -2048. 2047.938 FORMAT "%8.2" AXIS_PTS_REF ldpm_temp_ls_ini_1_egcp /end AXIS_DESCR
/end CHARACTERISTIC
/begin CHARACTERISTIC ip_fac_neg_p_lsh_up_ctl "Closed loop controller P-term factor for temperature too high; decrease heater voltage" MAP 0xffe4551a _REC_MAP_20_u1_u1_u2 0.255 _CNV_A_R_LINEAR_____369_CM 0. 0.255 DISPLAY_IDENTIFIER IP_FAC_NEG_P_LSH_UP_CTL FORMAT "%5.3"
 /begin AXIS_DESCR COM_AXIS n_32 _CNV_A_R_LINEAR_____15_CM 6 0. 8160. FORMAT "%4.0" AXIS_PTS_REF ldpm_n_32_1_egcp /end AXIS_DESCR
 /begin AXIS_DESCR COM_AXIS teg_cat_up_mdl_max _CNV_A_R_LINEAR_____6_CM 6 0. 2047. FORMAT "%7.2" AXIS_PTS_REF ldpm_teg_cat_up_mdl_1_egcp /end AXIS_DESCR
/end CHARACTERISTIC
/begin CHARACTERISTIC ip_fac_pos_p_lsh_up_ctl "Closed loop controller P-term factor for temperature too low; increase heater voltage" MAP 0xffe45586 _REC_MAP_20_u1_u1_u2 0.255 _CNV_A_R_LINEAR_____369_CM 0. 0.255 DISPLAY_IDENTIFIER IP_FAC_POS_P_LSH_UP_CTL FORMAT "%5.3"
 /begin AXIS_DESCR COM_AXIS n_32 _CNV_A_R_LINEAR_____15_CM 6 0. 8160. FORMAT "%4.0" AXIS_PTS_REF ldpm_n_32_1_egcp /end AXIS_DESCR
 /begin AXIS_DESCR COM_AXIS teg_cat_up_mdl_max _CNV_A_R_LINEAR_____6_CM 6 0. 2047. FORMAT "%7.2" AXIS_PTS_REF ldpm_teg_cat_up_mdl_1_egcp /end AXIS_DESCR
/end CHARACTERISTIC
/begin CHARACTERISTIC ip_fac_neg_i_lsh_up_ctl "Closed loop controller I-term factor for temperature too high; decrease heater voltage" MAP 0xffe454f6 _REC_MAP_20_u1_u1_u2 0.255 _CNV_A_R_LINEAR_____369_CM 0. 0.255 DISPLAY_IDENTIFIER IP_FAC_NEG_I_LSH_UP_CTL FORMAT "%5.3"
 /begin AXIS_DESCR COM_AXIS n_32 _CNV_A_R_LINEAR_____15_CM 6 0. 8160. FORMAT "%4.0" AXIS_PTS_REF ldpm_n_32_1_egcp /end AXIS_DESCR
 /begin AXIS_DESCR COM_AXIS teg_cat_up_mdl_max _CNV_A_R_LINEAR_____6_CM 6 0. 2047. FORMAT "%7.2" AXIS_PTS_REF ldpm_teg_cat_up_mdl_1_egcp /end AXIS_DESCR
/end CHARACTERISTIC
/begin CHARACTERISTIC ip_fac_pos_i_lsh_up_ctl "Closed loop controller I-term factor for temperature too low; increase heater voltage" MAP 0xffe45562 _REC_MAP_20_u1_u1_u2 0.255 _CNV_A_R_LINEAR_____369_CM 0. 0.255 DISPLAY_IDENTIFIER IP_FAC_POS_I_LSH_UP_CTL FORMAT "%5.3"
 /begin AXIS_DESCR COM_AXIS n_32 _CNV_A_R_LINEAR_____15_CM 6 0. 8160. FORMAT "%4.0" AXIS_PTS_REF ldpm_n_32_1_egcp /end AXIS_DESCR
 /begin AXIS_DESCR COM_AXIS teg_cat_up_mdl_max _CNV_A_R_LINEAR_____6_CM 6 0. 2047. FORMAT "%7.2" AXIS_PTS_REF ldpm_teg_cat_up_mdl_1_egcp /end AXIS_DESCR
/end CHARACTERISTIC
/begin CHARACTERISTIC ip_fac_v_efc_teg "Coorection factor for the assumtion of the heat transfer exclusive for bank 2" CURVE 0xffe40c5d _REC_CUR_20_u1_u1 3.984375 _CNV_A_R_LINEAR_____129_CM 0. 3.984375 DISPLAY_IDENTIFIER IP_FAC_V_EFC_TEG FORMAT "%4.2"
 /begin AXIS_DESCR COM_AXIS vs _CNV_A_R_LINEAR_____23_CM 6 0. 255. FORMAT "%3.0" AXIS_PTS_REF ldp_vs_fac_v_efc_teg /end AXIS_DESCR
/end CHARACTERISTIC
/begin CHARACTERISTIC c_v_efc_lsh_up_tol "voltage threshold to the higher voltage range of the heater" VALUE 0xffe40998 _REC_VAL_20_u1 25.8984 _CNV_A_R_LINEAR_____34_CM 0. 25.8984 DISPLAY_IDENTIFIER C_V_EFC_LSH_UP_TOL FORMAT "%3.1" /end CHARACTERISTIC
/begin CHARACTERISTIC c_v_efc_red "Reduced heater voltage during danger of water splash damage" VALUE 0xffe40999 _REC_VAL_20_u1 25.8984 _CNV_A_R_LINEAR_____34_CM 0. 25.8984 DISPLAY_IDENTIFIER C_V_EFC_RED FORMAT "%3.1" /end CHARACTERISTIC
/begin CHARACTERISTIC c_v_efc_lsh_up_prot "heater voltage in the case of overvoltage conditions" VALUE 0xffe40997 _REC_VAL_20_u1 25.8984 _CNV_A_R_LINEAR_____34_CM 0. 25.8984 DISPLAY_IDENTIFIER C_V_EFC_LSH_UP_PROT FORMAT "%3.1" /end CHARACTERISTIC
/begin CHARACTERISTIC c_t_lsh_up_tol "maximum of the tolerable heating time with in a higher voltage range " VALUE 0xffe408a2 _REC_VAL_20_u1 25.5 _CNV_A_R_LINEAR_____24_CM 0. 25.5 DISPLAY_IDENTIFIER C_T_LSH_UP_TOL FORMAT "%4.1" /end CHARACTERISTIC
/begin CHARACTERISTIC c_v_efc_lsh_up_lim "limited voltage range of the heater" VALUE 0xffe40994 _REC_VAL_20_u1 25.8984 _CNV_A_R_LINEAR_____34_CM 0. 25.8984 DISPLAY_IDENTIFIER C_V_EFC_LSH_UP_LIM FORMAT "%3.1" /end CHARACTERISTIC
/begin CHARACTERISTIC c_vb_prot_max "maximum battery voltage threshold for the detection of overvoltage" VALUE 0xffe409c4 _REC_VAL_20_u1 25.8984 _CNV_A_R_LINEAR_____34_CM 0. 25.8984 DISPLAY_IDENTIFIER C_VB_PROT_MAX FORMAT "%3.1" /end CHARACTERISTIC
/begin CHARACTERISTIC c_t_lsh_rise "Total heating time with increasing heater power" VALUE 0xffe4198c _REC_VAL_20_u2 6553.5 _CNV_A_R_LINEAR_____24_CM 0. 6553.5 DISPLAY_IDENTIFIER C_T_LSH_RISE FORMAT "%5.1" /end CHARACTERISTIC
/begin CHARACTERISTIC c_inc_v_efc "Heater voltage increment to raise temperature" VALUE 0xffe40778 _REC_VAL_20_u1 1.625 _CNV_A_R_LINEAR_____370_CM 0. 1.625 DISPLAY_IDENTIFIER C_INC_V_EFC FORMAT "%5.3" /end CHARACTERISTIC
/begin CHARACTERISTIC c_fac_v_efc_lsh_up_as "Multiplicative correction factor to effective heater voltage" VALUE 0xffe4074e _REC_VAL_20_u1 1.9921875 _CNV_A_R_LINEAR_____117_CM 0. 1.9921875 DISPLAY_IDENTIFIER C_FAC_V_EFC_LSH_UP_AS FORMAT "%5.3" /end CHARACTERISTIC
/begin CHARACTERISTIC c_dec_v_efc "Heater voltage decrement to lower temperature" VALUE 0xffe406e1 _REC_VAL_20_u1 1.625 _CNV_A_R_LINEAR_____370_CM 0. 1.625 DISPLAY_IDENTIFIER C_DEC_V_EFC FORMAT "%5.3" /end CHARACTERISTIC
/begin CHARACTERISTIC ip_v_efc_lsh_up_ini "Initial effective heater voltage" CURVE 0xffe40ec5 _REC_CUR_20_u1_u2 25.8984 _CNV_A_R_LINEAR_____34_CM 0. 25.8984 DISPLAY_IDENTIFIER IP_V_EFC_LSH_UP_INI FORMAT "%3.1"
 /begin AXIS_DESCR COM_AXIS online_dummy _CNV_A_R_LINEAR_____368_CM 6 -2048. 2047.938 FORMAT "%8.2" AXIS_PTS_REF ldpm_temp_ls_ini_1_egcp /end AXIS_DESCR
/end CHARACTERISTIC
/begin CHARACTERISTIC c_v_efc_lsh_up_step "Additional effective heater voltage step on transition from LSH_POW_RED to LSH_POW_RISE" VALUE 0xffe403a1 _REC_VAL_20_s1 26. _CNV_A_R_LINEAR_____326_CM -13.05 12.95 DISPLAY_IDENTIFIER C_V_EFC_LSH_UP_STEP FORMAT "%5.1" /end CHARACTERISTIC
/begin CHARACTERISTIC c_v_efc_lsh_up_as "Effective heater voltage calibration system additive factor" VALUE 0xffe403a0 _REC_VAL_20_s1 26. _CNV_A_R_LINEAR_____326_CM -13.05 12.95 DISPLAY_IDENTIFIER C_V_EFC_LSH_UP_AS FORMAT "%5.1" /end CHARACTERISTIC
/begin CHARACTERISTIC c_t_lsh_up_lim "time after a heating phase with a higher voltage range" VALUE 0xffe408a0 _REC_VAL_20_u1 25.5 _CNV_A_R_LINEAR_____24_CM 0. 25.5 DISPLAY_IDENTIFIER C_T_LSH_UP_LIM FORMAT "%4.1" /end CHARACTERISTIC
/begin CHARACTERISTIC c_t_lsh_up_max_step "time after at which step in max effective heater voltage applied" VALUE 0xffe408a1 _REC_VAL_20_u1 25.5 _CNV_A_R_LINEAR_____24_CM 0. 25.5 DISPLAY_IDENTIFIER C_T_LSH_UP_MAX_STEP FORMAT "%4.1" /end CHARACTERISTIC
/begin CHARACTERISTIC c_v_efc_lsh_up_max "maximum allowed heater voltage " VALUE 0xffe40995 _REC_VAL_20_u1 25.8984 _CNV_A_R_LINEAR_____34_CM 0. 25.8984 DISPLAY_IDENTIFIER C_V_EFC_LSH_UP_MAX FORMAT "%3.1" /end CHARACTERISTIC
/begin CHARACTERISTIC c_v_efc_lsh_up_max_st "absolute maximum permitted effective heater voltage during initial phase; threshold & limit" VALUE 0xffe40996 _REC_VAL_20_u1 25.8984 _CNV_A_R_LINEAR_____34_CM 0. 25.8984 DISPLAY_IDENTIFIER C_V_EFC_LSH_UP_MAX_ST FORMAT "%3.1" /end CHARACTERISTIC
/begin CHARACTERISTIC c_ttip_ls_up_set_1 "Oxygen sensor set temperature for closed loop control" VALUE 0xffe404f8 _REC_VAL_20_s2 4095.938 _CNV_A_R_LINEAR_____303_CM -2048. 2047.938 DISPLAY_IDENTIFIER C_TTIP_LS_UP_SET_1 FORMAT "%8.2" /end CHARACTERISTIC
/begin CHARACTERISTIC c_ttip_ls_up_set_2 "Oxygen sensor set temperature for closed loop control" VALUE 0xffe404fa _REC_VAL_20_s2 4095.938 _CNV_A_R_LINEAR_____303_CM -2048. 2047.938 DISPLAY_IDENTIFIER C_TTIP_LS_UP_SET_2 FORMAT "%8.2" /end CHARACTERISTIC
/begin CHARACTERISTIC c_ttip_ls_up_dif_min_p_add "Minimum required temperature difference in order to calculate P-term of controller" VALUE 0xffe41aec _REC_VAL_20_u2 2047.96875 _CNV_A_R_LINEAR_____367_CM 0. 2047.96875 DISPLAY_IDENTIFIER C_TTIP_LS_UP_DIF_MIN_P_ADD FORMAT "%7.2" /end CHARACTERISTIC
/begin CHARACTERISTIC c_fac_p_lsh_up_ctl "Multiplicative scaling factor for closed loop P-term" VALUE 0xffe4073c _REC_VAL_20_u1 6.348 _CNV_A_R_LINEAR_____371_CM 0. 6.348 DISPLAY_IDENTIFIER C_FAC_P_LSH_UP_CTL FORMAT "%4.2" /end CHARACTERISTIC
/begin CHARACTERISTIC c_fac_i_lsh_up_ctl "Multiplicative scaling factor for closed loop I-term" VALUE 0xffe4073a _REC_VAL_20_u1 6.348 _CNV_A_R_LINEAR_____371_CM 0. 6.348 DISPLAY_IDENTIFIER C_FAC_I_LSH_UP_CTL FORMAT "%4.2" /end CHARACTERISTIC
/begin CHARACTERISTIC c_teg_cat_up_mdl_max_lsh_up "Maximum permited exhaust gas temperature above which LSH switched off" VALUE 0xffe41a40 _REC_VAL_20_u2 2047. _CNV_A_R_LINEAR_____6_CM 0. 2047. DISPLAY_IDENTIFIER C_TEG_CAT_UP_MDL_MAX_LSH_UP FORMAT "%7.2" /end CHARACTERISTIC
/begin CHARACTERISTIC lc_inh_lsh_up_cll_ctl_1 "Boolean constant to permit suspension of closed loop heater control" VALUE 0xffe40f7f _REC_VAL_20_u1 1. _CNV_A_R_LINEAR_____0_CM 0. 1. DISPLAY_IDENTIFIER LC_INH_LSH_UP_CLL_CTL_1 FORMAT "%2.0" /end CHARACTERISTIC
/begin CHARACTERISTIC lc_inh_lsh_up_cll_ctl_2 "Boolean constant to permit suspension of closed loop heater control" VALUE 0xffe40f80 _REC_VAL_20_u1 1. _CNV_A_R_LINEAR_____0_CM 0. 1. DISPLAY_IDENTIFIER LC_INH_LSH_UP_CLL_CTL_2 FORMAT "%2.0" /end CHARACTERISTIC
/begin MEASUREMENT lv_v_efc_lsh_up_prot "Boolean variable indicating effective heater voltage limited due to excessive battery voltage level" UBYTE _CNV_S_2_RANGE______2_CM 1 100. 0. 1. DISPLAY_IDENTIFIER LV_V_EFC_LSH_UP_PROT ECU_ADDRESS 0x3fe565 /end MEASUREMENT
/begin AXIS_PTS ldpm_temp_ls_ini_1_egcp "" 0xffe51e1e online_dummy _REC_AXS_20_u2 4095.938 _CNV_A_R_LINEAR_____368_CM 6 -2048. 2047.938 DISPLAY_IDENTIFIER LDPM_TEMP_LS_INI_1_EGCP FORMAT "%8.2" /end AXIS_PTS
/begin AXIS_PTS ldp_vs_fac_v_efc_teg "" 0xffe4131b vs _REC_AXS_20_u1 255. _CNV_A_R_LINEAR_____23_CM 6 0. 255. DISPLAY_IDENTIFIER LDP_VS_FAC_V_EFC_TEG FORMAT "%3.0" /end AXIS_PTS
/begin CHARACTERISTIC ip_v_efc_lsh_up_ctl "Open loop control effective heater voltage" MAP 0xffe47ef3 _REC_MAP_20_u1_u1_u2 25.8984 _CNV_A_R_LINEAR_____34_CM 0. 25.8984 DISPLAY_IDENTIFIER IP_V_EFC_LSH_UP_CTL FORMAT "%3.1"
 /begin AXIS_DESCR COM_AXIS n_32 _CNV_A_R_LINEAR_____15_CM 6 0. 8160. FORMAT "%4.0" AXIS_PTS_REF ldpm_n_32_1_egcp /end AXIS_DESCR
 /begin AXIS_DESCR COM_AXIS teg_cat_up_mdl_max _CNV_A_R_LINEAR_____6_CM 6 0. 2047. FORMAT "%7.2" AXIS_PTS_REF ldpm_teg_cat_up_mdl_1_egcp /end AXIS_DESCR
/end CHARACTERISTIC
/begin AXIS_PTS ldpm_n_32_1_egcp "" 0xffe41382 n_32 _REC_AXS_20_u1 8160. _CNV_A_R_LINEAR_____15_CM 6 0. 8160. DISPLAY_IDENTIFIER LDPM_N_32_1_EGCP FORMAT "%4.0" /end AXIS_PTS
/begin AXIS_PTS ldpm_teg_cat_up_mdl_1_egcp "" 0xffe51d68 teg_cat_up_mdl_max _REC_AXS_20_u2 2047. _CNV_A_R_LINEAR_____6_CM 6 0. 2047. DISPLAY_IDENTIFIER LDPM_TEG_CAT_UP_MDL_1_EGCP FORMAT "%7.2" /end AXIS_PTS
/begin CHARACTERISTIC lc_lsh_up_1 "Boolean variable to enable oxygen sensor heating" VALUE 0xffe40f9c _REC_VAL_20_u1 1. _CNV_A_R_LINEAR_____0_CM 0. 1. DISPLAY_IDENTIFIER LC_LSH_UP_1 FORMAT "%2.0" /end CHARACTERISTIC
/begin CHARACTERISTIC lc_lsh_up_cll_ctl_1 "Boolean variable to enable closed loop oxygen sensor heater control" VALUE 0xffe40f9e _REC_VAL_20_u1 1. _CNV_A_R_LINEAR_____0_CM 0. 1. DISPLAY_IDENTIFIER LC_LSH_UP_CLL_CTL_1 FORMAT "%2.0" /end CHARACTERISTIC
/begin CHARACTERISTIC lc_lsh_up_2 "Boolean variable to enable oxygen sensor heating" VALUE 0xffe40f9d _REC_VAL_20_u1 1. _CNV_A_R_LINEAR_____0_CM 0. 1. DISPLAY_IDENTIFIER LC_LSH_UP_2 FORMAT "%2.0" /end CHARACTERISTIC
/begin CHARACTERISTIC lc_lsh_up_cll_ctl_2 "Boolean variable to enable closed loop oxygen sensor heater control" VALUE 0xffe40f9f _REC_VAL_20_u1 1. _CNV_A_R_LINEAR_____0_CM 0. 1. DISPLAY_IDENTIFIER LC_LSH_UP_CLL_CTL_2 FORMAT "%2.0" /end CHARACTERISTIC
/begin CHARACTERISTIC c_tco_min_lsl_gain_ad "Minimum coolant temperature to allow Fuel Cut Ip determination" VALUE 0xffe4091a _REC_VAL_20_u1 190.5 _CNV_A_R_LINEAR_____11_CM -48. 142.5 DISPLAY_IDENTIFIER C_TCO_MIN_LSL_GAIN_AD FORMAT "%5.1" /end CHARACTERISTIC
/begin CHARACTERISTIC c_amp_min_lsl_gain_ad "Minimum ambient pressure to allow Fuel Cut Ip determination" VALUE 0xffe414f8 _REC_VAL_20_u2 5434. _CNV_A_R_LINEAR_____49_CM 0. 5434. DISPLAY_IDENTIFIER C_AMP_MIN_LSL_GAIN_AD FORMAT "%7.2" /end CHARACTERISTIC
/begin CHARACTERISTIC c_ttip_min_lsl_gain_ad "Minimum tip temperature to allow Fuel Cut Ip determination" VALUE 0xffe404fe _REC_VAL_20_s2 4095.938 _CNV_A_R_LINEAR_____303_CM -2048. 2047.938 DISPLAY_IDENTIFIER C_TTIP_MIN_LSL_GAIN_AD FORMAT "%8.2" /end CHARACTERISTIC
/begin CHARACTERISTIC c_ttip_max_lsl_gain_ad "Maximum tip temperature to allow Fuel Cut Ip determination" VALUE 0xffe404fc _REC_VAL_20_s2 4095.938 _CNV_A_R_LINEAR_____303_CM -2048. 2047.938 DISPLAY_IDENTIFIER C_TTIP_MAX_LSL_GAIN_AD FORMAT "%8.2" /end CHARACTERISTIC
/begin CHARACTERISTIC c_n_32_max_lsl_gain_ad "Maximum engine speed to allow Fuel Cut Ip determination" VALUE 0xffe407c5 _REC_VAL_20_u1 8160. _CNV_A_R_LINEAR_____15_CM 0. 8160. DISPLAY_IDENTIFIER C_N_32_MAX_LSL_GAIN_AD FORMAT "%4.0" /end CHARACTERISTIC
/begin CHARACTERISTIC c_n_32_min_lsl_gain_ad "Minimum engine speed to allow Fuel Cut Ip determination" VALUE 0xffe407c6 _REC_VAL_20_u1 8160. _CNV_A_R_LINEAR_____15_CM 0. 8160. DISPLAY_IDENTIFIER C_N_32_MIN_LSL_GAIN_AD FORMAT "%4.0" /end CHARACTERISTIC
/begin CHARACTERISTIC c_crlc_iplsl_vld "Correlation constant for filtering valid samples  (is also time constant for adaptation)" VALUE 0xffe41556 _REC_VAL_20_u2 0.99998474 _CNV_A_R_LINEAR_____37_CM 0. 0.99998474 DISPLAY_IDENTIFIER C_CRLC_IPLSL_VLD FORMAT "%7.5" /end CHARACTERISTIC
/begin CHARACTERISTIC c_iplsl_cor_grd_thd_fcut "Maximum gradient of low pass filtered pumping correct to detect stable conditions (end of PURGE)" VALUE 0xffe40412 _REC_VAL_20_s2 25.192 _CNV_A_R_LINEAR_____372_CM -12.596 12.596 DISPLAY_IDENTIFIER C_IPLSL_COR_GRD_THD_FCUT FORMAT "%7.4" /end CHARACTERISTIC
/begin CHARACTERISTIC c_iplsl_cor_thd_fcut "Minimum threshold of the low pass filtered pumping  current to detect stable conditions (end of PURGE)" VALUE 0xffe40414 _REC_VAL_20_s2 25.192 _CNV_A_R_LINEAR_____372_CM -12.596 12.596 DISPLAY_IDENTIFIER C_IPLSL_COR_THD_FCUT FORMAT "%7.4" /end CHARACTERISTIC
/begin CHARACTERISTIC c_iplsl_vari_thd_purge_max "Maximum variance of the low pass filtered pumping  current to confirm stable conditions " VALUE 0xffe40418 _REC_VAL_20_s2 25.192 _CNV_A_R_LINEAR_____372_CM -12.596 12.596 DISPLAY_IDENTIFIER C_IPLSL_VARI_THD_PURGE_MAX FORMAT "%7.4" /end CHARACTERISTIC
/begin CHARACTERISTIC c_iplsl_vari_thd_purge_min "Minimum variance of the low pass filtered pumping  current to confirm that sensor is operable" VALUE 0xffe4167e _REC_VAL_20_u2 619.7000000000001 _CNV_A_R_LINEAR_____299_CM 0. 619.7000000000001 DISPLAY_IDENTIFIER C_IPLSL_VARI_THD_PURGE_MIN FORMAT "%7.3" /end CHARACTERISTIC
/begin CHARACTERISTIC c_t_dur_int "Duration  of Ip acquisition and averaging" VALUE 0xffe40895 _REC_VAL_20_u1 25.4 _CNV_A_R_LINEAR_____24_CM 0.1 25.5 DISPLAY_IDENTIFIER C_T_DUR_INT FORMAT "%3.1" /end CHARACTERISTIC
/begin CHARACTERISTIC c_crlc_iplsl_fcut "Correlation constant for filtering of corrected pumping current " VALUE 0xffe41554 _REC_VAL_20_u2 0.99998474 _CNV_A_R_LINEAR_____37_CM 0. 0.99998474 DISPLAY_IDENTIFIER C_CRLC_IPLSL_FCUT FORMAT "%7.5" /end CHARACTERISTIC
/begin CHARACTERISTIC c_iplsl_fcut "Nominal pumping  current at  fuel cut" VALUE 0xffe40416 _REC_VAL_20_s2 25.192 _CNV_A_R_LINEAR_____284_CM -12.596 12.596 DISPLAY_IDENTIFIER C_IPLSL_FCUT FORMAT "%7.4" /end CHARACTERISTIC
/begin CHARACTERISTIC c_fac_lsl_lim_min "Minimum threshold for WRAF sensor gain adaptation" VALUE 0xffe41610 _REC_VAL_20_u2 1.99996948 _CNV_A_R_LINEAR_____20_CM 0. 1.99996948 DISPLAY_IDENTIFIER C_FAC_LSL_LIM_MIN FORMAT "%7.5" /end CHARACTERISTIC
/begin CHARACTERISTIC c_fac_lsl_lim_max "Maximum threshold for WRAF sensor gain adaptation" VALUE 0xffe4160e _REC_VAL_20_u2 1.99996948 _CNV_A_R_LINEAR_____20_CM 0. 1.99996948 DISPLAY_IDENTIFIER C_FAC_LSL_LIM_MAX FORMAT "%7.5" /end CHARACTERISTIC
/begin CHARACTERISTIC lc_lsl_gain_ad_test "Direct enable of LV_LSL_GAIN_AD_REQ_i  for test purposes" VALUE 0xffe40fa1 _REC_VAL_20_u1 1. _CNV_A_R_LINEAR_____0_CM 0. 1. DISPLAY_IDENTIFIER LC_LSL_GAIN_AD_TEST FORMAT "%2.0" /end CHARACTERISTIC
/begin CHARACTERISTIC ip_fac_iplsl_cor_amp "Factor for AMP  correction" CURVE 0xffe4afe6 _REC_CUR_20_u2_u2 1.99996948 _CNV_A_R_LINEAR_____20_CM 0. 1.99996948 DISPLAY_IDENTIFIER IP_FAC_IPLSL_COR_AMP FORMAT "%7.5"
 /begin AXIS_DESCR COM_AXIS amp _CNV_A_R_LINEAR_____49_CM 16 0. 5434. FORMAT "%7.2" AXIS_PTS_REF ldp_amp__fac_cor /end AXIS_DESCR
/end CHARACTERISTIC
/begin CHARACTERISTIC ip_fac_iplsl_cor_maf_kgh "Factor for MAF  correction" CURVE 0xffe4b006 _REC_CUR_20_u2_u2 1.99996948 _CNV_A_R_LINEAR_____20_CM 0. 1.99996948 DISPLAY_IDENTIFIER IP_FAC_IPLSL_COR_MAF_KGH FORMAT "%7.5"
 /begin AXIS_DESCR COM_AXIS maf_kgh _CNV_A_R_LINEAR_____115_CM 16 0. 2047.96875 FORMAT "%7.2" AXIS_PTS_REF ldp_maf_kgh__fac_cor /end AXIS_DESCR
/end CHARACTERISTIC
/begin CHARACTERISTIC ip_fac_iplsl_cor_ttip_ls_up_mes "Factor for tip temperature  correction" CURVE 0xffe4b046 _REC_CUR_20_u2_u2 1.99996948 _CNV_A_R_LINEAR_____20_CM 0. 1.99996948 DISPLAY_IDENTIFIER IP_FAC_IPLSL_COR_TTIP_LS_UP_MES FORMAT "%7.5"
 /begin AXIS_DESCR COM_AXIS online_dummy _CNV_A_R_LINEAR_____368_CM 16 -2048. 2047.938 FORMAT "%8.2" AXIS_PTS_REF ldp_ttip_ls_up_mes__fac_cor /end AXIS_DESCR
/end CHARACTERISTIC
/begin CHARACTERISTIC c_max_iplsl_vld_vari "Maximum permitted variance of valid Ip sample to allow adaptation" VALUE 0xffe417d2 _REC_VAL_20_u2 619.7000000000001 _CNV_A_R_LINEAR_____299_CM 0. 619.7000000000001 DISPLAY_IDENTIFIER C_MAX_IPLSL_VLD_VARI FORMAT "%7.3" /end CHARACTERISTIC
/begin CHARACTERISTIC ip_fac_iplsl_cor_n_32 "Factor for engine speed  correction" CURVE 0xffe4b026 _REC_CUR_20_u2_u1 1.99996948 _CNV_A_R_LINEAR_____20_CM 0. 1.99996948 DISPLAY_IDENTIFIER IP_FAC_IPLSL_COR_N_32 FORMAT "%7.5"
 /begin AXIS_DESCR COM_AXIS n_32 _CNV_A_R_LINEAR_____15_CM 16 0. 8160. FORMAT "%4.0" AXIS_PTS_REF ldp_n_32__fac_cor /end AXIS_DESCR
/end CHARACTERISTIC
/begin CHARACTERISTIC ip_fac_iplsl_cor_iplsl_cor_chg "Factor for residual gas purging correction" CURVE 0xffe41c2c _REC_CUR_20_u2_u2 1.99996948 _CNV_A_R_LINEAR_____20_CM 0. 1.99996948 DISPLAY_IDENTIFIER IP_FAC_IPLSL_COR__IPLSL__COR_CHG FORMAT "%7.5"
 /begin AXIS_DESCR COM_AXIS online_dummy _CNV_A_R_LINEAR_____373_CM 4 -12.596 12.596 FORMAT "%7.4" AXIS_PTS_REF ldp_iplsl_cor_chg_purge /end AXIS_DESCR
/end CHARACTERISTIC
/begin CHARACTERISTIC lc_fac_min_max_ini_lsl_cor_ad_1 "Enable initialisation of adapted MIN and MAX value of FAC_LSL_COR_AD_1" VALUE 0xffe40f65 _REC_VAL_20_u1 1. _CNV_A_R_LINEAR_____0_CM 0. 1. DISPLAY_IDENTIFIER LC_FAC_MIN_MAX_INI_LSL_COR_AD_1 FORMAT "%2.0" /end CHARACTERISTIC
/begin CHARACTERISTIC lc_lsl_ena_ad "Enable WRAF sensor gain adaptation" VALUE 0xffe40fa0 _REC_VAL_20_u1 1. _CNV_A_R_LINEAR_____0_CM 0. 1. DISPLAY_IDENTIFIER LC_LSL_ENA_AD FORMAT "%2.0" /end CHARACTERISTIC
/begin CHARACTERISTIC lc_fac_min_max_ini_lsl_cor_ad_2 "Enable initialisation of adapted MIN and MAX value of FAC_LSL_COR_AD_2" VALUE 0xffe40f66 _REC_VAL_20_u1 1. _CNV_A_R_LINEAR_____0_CM 0. 1. DISPLAY_IDENTIFIER LC_FAC_MIN_MAX_INI_LSL_COR_AD_2 FORMAT "%2.0" /end CHARACTERISTIC
/begin AXIS_PTS ldp_amp__fac_cor "" 0xffe5095a amp _REC_AXS_20_u2 5434. _CNV_A_R_LINEAR_____49_CM 16 0. 5434. DISPLAY_IDENTIFIER LDP_AMP__FAC_COR FORMAT "%7.2" /end AXIS_PTS
/begin AXIS_PTS ldp_n_32__fac_cor "" 0xffe47ffb n_32 _REC_AXS_20_u1 8160. _CNV_A_R_LINEAR_____15_CM 16 0. 8160. DISPLAY_IDENTIFIER LDP_N_32__FAC_COR FORMAT "%4.0" /end AXIS_PTS
/begin AXIS_PTS ldp_ttip_ls_up_mes__fac_cor "" 0xffe5153e online_dummy _REC_AXS_20_u2 4095.938 _CNV_A_R_LINEAR_____368_CM 16 -2048. 2047.938 DISPLAY_IDENTIFIER LDP_TTIP_LS_UP_MES__FAC_COR FORMAT "%8.2" /end AXIS_PTS
/begin AXIS_PTS ldp_iplsl_cor_chg_purge "" 0xffe50bec online_dummy _REC_AXS_20_u2 25.192 _CNV_A_R_LINEAR_____373_CM 4 -12.596 12.596 DISPLAY_IDENTIFIER LDP_IPLSL_COR_CHG_PURGE FORMAT "%7.4" /end AXIS_PTS
/begin AXIS_PTS ldp_maf_kgh__fac_cor "" 0xffe50e0a maf_kgh _REC_AXS_20_u2 2047.96875 _CNV_A_R_LINEAR_____115_CM 16 0. 2047.96875 DISPLAY_IDENTIFIER LDP_MAF_KGH__FAC_COR FORMAT "%7.2" /end AXIS_PTS
/begin CHARACTERISTIC c_lamb_crlc_ready "Correlation constant for the mean value calculation of the lambda sensor output signal" VALUE 0xffe4078b _REC_VAL_20_u1 0.9960940000000002 _CNV_A_R_LINEAR_____50_CM 0. 0.996094 DISPLAY_IDENTIFIER C_LAMB_CRLC_READY FORMAT "%5.3" /end CHARACTERISTIC
/begin CHARACTERISTIC c_t_lamb_de_clr "time for the sensor dispersion calculation up to the reset" VALUE 0xffe41980 _REC_VAL_20_u2 1310.7 _CNV_A_R_LINEAR_____198_CM 0. 1310.7 DISPLAY_IDENTIFIER C_T_LAMB_DE_CLR FORMAT "%7.2" /end CHARACTERISTIC
/begin CHARACTERISTIC c_lamb_thd_min "minimum value for the sensor signal for the readiness detection " VALUE 0xffe416f8 _REC_VAL_20_u2 2. _CNV_A_R_LINEAR_____285_CM 0. 2. DISPLAY_IDENTIFIER C_LAMB_THD_MIN FORMAT "%5.3" /end CHARACTERISTIC
/begin CHARACTERISTIC c_lamb_thd_max "maximum value for the sensor signal for the readiness detection " VALUE 0xffe416f6 _REC_VAL_20_u2 2. _CNV_A_R_LINEAR_____285_CM 0. 2. DISPLAY_IDENTIFIER C_LAMB_THD_MAX FORMAT "%5.3" /end CHARACTERISTIC
/begin CHARACTERISTIC c_lamb_de_ready "dispersion threshold for the readiness detection " VALUE 0xffe416b0 _REC_VAL_20_u2 63.99902344 _CNV_A_R_LINEAR_____118_CM 0. 63.99902344 DISPLAY_IDENTIFIER C_LAMB_DE_READY FORMAT "%7.4" /end CHARACTERISTIC
/begin CHARACTERISTIC c_maf_int_puc_max_up_ls_ready " maximum MAF intergal during PUC for operability reset " VALUE 0xffe41786 _REC_VAL_20_u2 1820.4167 _CNV_A_R_LINEAR_____273_CM 0. 1820.4167 DISPLAY_IDENTIFIER C_MAF_INT_PUC_MAX_UP_LS_READY FORMAT "%9.4" /end CHARACTERISTIC
/begin CHARACTERISTIC c_ttip_ls_up_ready "Minimum oxygen sensor ceramic temperature for save operation" VALUE 0xffe404f6 _REC_VAL_20_s2 4095. _CNV_A_R_LINEAR_____6_CM -2048. 2047. DISPLAY_IDENTIFIER C_TTIP_LS_UP_READY FORMAT "%8.2" /end CHARACTERISTIC
/begin CHARACTERISTIC id_t_dly_ls_ready__tco_st "Delay time for the readiness detection after engine start" CURVE 0xffe48db0 _REC_CUR_20_u2_u1 1310.7 _CNV_A_R_LINEAR_____198_CM 0. 1310.7 DISPLAY_IDENTIFIER ID_T_DLY_LS_READY__TCO_ST FORMAT "%7.2"
 /begin AXIS_DESCR COM_AXIS tco_st _CNV_A_R_LINEAR_____11_CM 8 -48. 142.5 FORMAT "%5.1" AXIS_PTS_REF ldp_tco_st__t_dly_ls_ready /end AXIS_DESCR
/end CHARACTERISTIC
/begin CHARACTERISTIC id_t_deac_ls_ready__tco_st "Delay time for the readiness detection in case of not accessible sensor temperature" CURVE 0xffe48d90 _REC_CUR_20_u2_u1 1310.7 _CNV_A_R_LINEAR_____198_CM 0. 1310.7 DISPLAY_IDENTIFIER ID_T_DEAC_LS_READY__TCO_ST FORMAT "%7.2"
 /begin AXIS_DESCR COM_AXIS tco_st _CNV_A_R_LINEAR_____11_CM 8 -48. 142.5 FORMAT "%5.1" AXIS_PTS_REF ldp_tco_st__t_deac_ls_ready /end AXIS_DESCR
/end CHARACTERISTIC
/begin AXIS_PTS ldp_tco_st__t_dly_ls_ready "" 0xffe48266 tco_st _REC_AXS_20_u1 190.5 _CNV_A_R_LINEAR_____11_CM 8 -48. 142.5 DISPLAY_IDENTIFIER LDP_TCO_ST__T_DLY_LS_READY FORMAT "%5.1" /end AXIS_PTS
/begin AXIS_PTS ldp_tco_st__t_deac_ls_ready "" 0xffe4825d tco_st _REC_AXS_20_u1 190.5 _CNV_A_R_LINEAR_____11_CM 8 -48. 142.5 DISPLAY_IDENTIFIER LDP_TCO_ST__T_DEAC_LS_READY FORMAT "%5.1" /end AXIS_PTS
/begin CHARACTERISTIC lc_lsl_ofs_is "value to define whether the offset adjustment run while Is/producive or not " VALUE 0xffe40fa2 _REC_VAL_20_u1 1. _CNV_A_R_LINEAR_____0_CM 0. 1. DISPLAY_IDENTIFIER LC_LSL_OFS_IS FORMAT "%2.0" /end CHARACTERISTIC
/begin CHARACTERISTIC c_lamb_av_ofs_min "minimum Lambda-threshold for the offset calculation  " VALUE 0xffe416aa _REC_VAL_20_u2 31.99902344 _CNV_A_R_LINEAR_____206_CM 0. 31.99902344 DISPLAY_IDENTIFIER C_LAMB_AV_OFS_MIN FORMAT "%7.4" /end CHARACTERISTIC
/begin CHARACTERISTIC c_lamb_av_ofs_max "maximum Lambda-threshold for the offset-calculation  " VALUE 0xffe416a8 _REC_VAL_20_u2 31.99902344 _CNV_A_R_LINEAR_____206_CM 0. 31.99902344 DISPLAY_IDENTIFIER C_LAMB_AV_OFS_MAX FORMAT "%7.4" /end CHARACTERISTIC
/begin CHARACTERISTIC c_vls_lsl_ofs_sp "setpoint of the lambda sensor voltage ( valid for Ip = 0 or LAMB = 1)" VALUE 0xffe41b82 _REC_VAL_20_u2 4.99511719 _CNV_A_R_LINEAR_____3_CM 0. 4.99511719 DISPLAY_IDENTIFIER C_VLS_LSL_OFS_SP FORMAT "%5.3" /end CHARACTERISTIC
/begin CHARACTERISTIC c_vls_lsl_ofs_lim "Limit value for the offset as a maximum cwww.de.uion value (absolute value)" VALUE 0xffe41b80 _REC_VAL_20_u2 4.99511719 _CNV_A_R_LINEAR_____3_CM 0. 4.99511719 DISPLAY_IDENTIFIER C_VLS_LSL_OFS_LIM FORMAT "%5.3" /end CHARACTERISTIC
/begin CHARACTERISTIC c_t_lamb_ofs_stop "lock time after a offset calculation up to the next calculation" VALUE 0xffe41982 _REC_VAL_20_u2 65535. _CNV_A_R_LINEAR_____30_CM 0. 65535. DISPLAY_IDENTIFIER C_T_LAMB_OFS_STOP FORMAT "%5.0" /end CHARACTERISTIC
/begin CHARACTERISTIC c_vls_lsl_ofs_dif "maximum deviation of two successive offset values" VALUE 0xffe41b7e _REC_VAL_20_u2 4.99511719 _CNV_A_R_LINEAR_____3_CM 0. 4.99511719 DISPLAY_IDENTIFIER C_VLS_LSL_OFS_DIF FORMAT "%5.3" /end CHARACTERISTIC
/begin CHARACTERISTIC c_t_dly_lsl_ofs "Delay time for the offset calculation" VALUE 0xffe40886 _REC_VAL_20_u1 2.55 _CNV_A_R_LINEAR_____4_CM 0. 2.55 DISPLAY_IDENTIFIER C_T_DLY_LSL_OFS FORMAT "%4.2" /end CHARACTERISTIC
/begin CHARACTERISTIC c_t_dly_lsl_puls "Delay time for the offset calculation" VALUE 0xffe4191c _REC_VAL_20_u2 655.35 _CNV_A_R_LINEAR_____4_CM 0. 655.35 DISPLAY_IDENTIFIER C_T_DLY_LSL_PULS FORMAT "%6.2" /end CHARACTERISTIC
/begin CHARACTERISTIC c_iplsl_gain "Gain of WRAF circuit" VALUE 0xffe4167c _REC_VAL_20_u2 5.0384 _CNV_A_R_LINEAR_____374_CM 0. 5.0384 DISPLAY_IDENTIFIER C_IPLSL_GAIN FORMAT "%7.5" /end CHARACTERISTIC
/begin CHARACTERISTIC ip_fac_iplsl_pres_ex "Factor for exhaust gas pressure correction" CURVE 0xffe4b066 _REC_CUR_20_u2_u2 1.99996948 _CNV_A_R_LINEAR_____20_CM 0. 1.99996948 DISPLAY_IDENTIFIER IP_FAC_IPLSL_PRES_EX FORMAT "%7.5"
 /begin AXIS_DESCR COM_AXIS prs_ex _CNV_A_R_LINEAR_____49_CM 8 0. 5434. FORMAT "%7.2" AXIS_PTS_REF ldp_prs_ex_iplsl_fac /end AXIS_DESCR
/end CHARACTERISTIC
/begin AXIS_PTS ldp_prs_ex_iplsl_fac "" 0xffe51224 prs_ex _REC_AXS_20_u2 5434. _CNV_A_R_LINEAR_____49_CM 8 0. 5434. DISPLAY_IDENTIFIER LDP_PRS_EX_IPLSL_FAC FORMAT "%7.2" /end AXIS_PTS
/begin CHARACTERISTIC c_maf_lam_hys_cat "hysterese after exceeding MAF_LAM_CAT threshold" VALUE 0xffe40791 _REC_VAL_20_u1 21.5 _CNV_A_R_LINEAR_____440_CM 0. 21.5 DISPLAY_IDENTIFIER C_MAF_LAM_HYS_CAT FORMAT "%4.1" /end CHARACTERISTIC
/begin CHARACTERISTIC ip_lamb "characteristic curve of the lambda sensor " CURVE 0xffe4c2e2 _REC_CUR_20_u2_u2 31.99902344 _CNV_A_R_LINEAR_____206_CM 0. 31.99902344 DISPLAY_IDENTIFIER IP_LAMB FORMAT "%7.4"
 /begin AXIS_DESCR COM_AXIS lam_bank_1.ls_up.vls_lsl_cor _CNV_A_R_LINEAR_____3_CM 16 0. 4.99511719 FORMAT "%5.3" AXIS_PTS_REF ldp_vls_lsl_cor_mv_ip_lamb /end AXIS_DESCR
/end CHARACTERISTIC
/begin AXIS_PTS ldp_vls_lsl_cor_mv_ip_lamb "" 0xffe516ce lam_bank_1.ls_up.vls_lsl_cor _REC_AXS_20_u2 4.99511719 _CNV_A_R_LINEAR_____3_CM 16 0. 4.99511719 DISPLAY_IDENTIFIER LDP_VLS_LSL_COR_MV_IP_LAMB FORMAT "%5.3" /end AXIS_PTS
/begin COMPU_METHOD _CNV_A_R_LINEAR_____0_CM "" RAT_FUNC "%6.3" "-" COEFFS 0 1. 0. 0 0 1 /end COMPU_METHOD
/begin COMPU_METHOD _CNV_S_2_RANGE______2_CM "" TAB_VERB "%6.3" "[-]" COMPU_TAB_REF _CNV_S_2_RANGE______2 /end COMPU_METHOD
/begin COMPU_VTAB _CNV_S_2_RANGE______2 "" TAB_VERB 2 0 "0" 1 "1" /end COMPU_VTAB
/begin COMPU_METHOD _CNV_A_R_LINEAR_____3_CM "" RAT_FUNC "%6.3" "V" COEFFS 0 204.7999998974999 0. 0 0 1 /end COMPU_METHOD
/begin COMPU_METHOD _CNV_A_R_LINEAR_____4_CM "" RAT_FUNC "%6.3" "s" COEFFS 0 100. 0. 0 0 1 /end COMPU_METHOD
/begin COMPU_METHOD _CNV_A_R_LINEAR_____6_CM "" RAT_FUNC "%6.3" "°C" COEFFS 0 16. 0. 0 0 1 /end COMPU_METHOD
/begin COMPU_METHOD _CNV_A_R_LINEAR_____8_CM "" RAT_FUNC "%6.3" "%" COEFFS 0 655.3600000071681 0. 0 0 1 /end COMPU_METHOD
/begin COMPU_METHOD _CNV_A_R_LINEAR_____9_CM "" RAT_FUNC "%6.3" "%" COEFFS 0 2.56 0. 0 0 1 /end COMPU_METHOD
/begin COMPU_METHOD _CNV_A_R_LINEAR_____10_CM "" RAT_FUNC "%6.3" "rpm" COEFFS 0 1. 0. 0 0 1 /end COMPU_METHOD
/begin COMPU_METHOD _CNV_A_R_LINEAR_____11_CM "" RAT_FUNC "%6.3" "°C" COEFFS 0 1.333333333333333 64. 0 0 1 /end COMPU_METHOD
/begin COMPU_METHOD _CNV_A_R_LINEAR_____15_CM "" RAT_FUNC "%6.3" "rpm" COEFFS 0 3.125e-002 0. 0 0 1 /end COMPU_METHOD
/begin COMPU_METHOD _CNV_A_R_LINEAR_____20_CM "" RAT_FUNC "%6.3" "-" COEFFS 0 32768.00003968061 0. 0 0 1 /end COMPU_METHOD
/begin COMPU_METHOD _CNV_S_2_RANGE______21_CM "" TAB_VERB "%6.3" "-" COMPU_TAB_REF _CNV_S_2_RANGE______21 /end COMPU_METHOD
/begin COMPU_VTAB _CNV_S_2_RANGE______21 "" TAB_VERB 2 0 "0" 1 "1" /end COMPU_VTAB
/begin COMPU_METHOD _CNV_A_R_LINEAR_____23_CM "" RAT_FUNC "%6.3" "km/h" COEFFS 0 1. 0. 0 0 1 /end COMPU_METHOD
/begin COMPU_METHOD _CNV_A_R_LINEAR_____24_CM "" RAT_FUNC "%6.3" "s" COEFFS 0 10. 0. 0 0 1 /end COMPU_METHOD
/begin COMPU_METHOD _CNV_A_R_LINEAR_____27_CM "" RAT_FUNC "%6.3" "mg/stk" COEFFS 0 0.183585313174946 0. 0 0 1 /end COMPU_METHOD
/begin COMPU_METHOD _CNV_A_R_LINEAR_____29_CM "" RAT_FUNC "%6.3" "-" COEFFS 0 255.9983911655618 0. 0 0 1 /end COMPU_METHOD
/begin COMPU_METHOD _CNV_A_R_LINEAR_____30_CM "" RAT_FUNC "%6.3" "s" COEFFS 0 1. 0. 0 0 1 /end COMPU_METHOD
/begin COMPU_METHOD _CNV_A_R_LINEAR_____34_CM "" RAT_FUNC "%6.3" "V" COEFFS 0 9.846168103048838 0. 0 0 1 /end COMPU_METHOD
/begin COMPU_METHOD _CNV_A_R_LINEAR_____37_CM "" RAT_FUNC "%6.3" "-" COEFFS 0 65536.00007936121 0. 0 0 1 /end COMPU_METHOD
/begin COMPU_METHOD _CNV_A_R_LINEAR_____39_CM "" RAT_FUNC "%6.3" "-" COEFFS 0 127.9991955827809 0. 0 0 1 /end COMPU_METHOD
/begin COMPU_METHOD _CNV_A_R_LINEAR_____41_CM "" RAT_FUNC "%6.3" "s" COEFFS 0 25. 0. 0 0 1 /end COMPU_METHOD
/begin COMPU_METHOD _CNV_A_R_LINEAR_____49_CM "" RAT_FUNC "%6.3" "hPa" COEFFS 0 12.06017666543982 0. 0 0 1 /end COMPU_METHOD
/begin COMPU_METHOD _CNV_A_R_LINEAR_____50_CM "" RAT_FUNC "%6.3" "[-]" COEFFS 0 255.9999357490357 0. 0 0 1 /end COMPU_METHOD
/begin COMPU_METHOD _CNV_A_R_LINEAR_____108_CM "" RAT_FUNC "%6.3" "mg/stk" COEFFS 0 47.18142548596112 0. 0 0 1 /end COMPU_METHOD
/begin COMPU_METHOD _CNV_A_R_LINEAR_____111_CM "" RAT_FUNC "%6.3" "%" COEFFS 0 655.3600000071681 3.584063961170614e-007 0 0 1 /end COMPU_METHOD
/begin COMPU_METHOD _CNV_A_R_LINEAR_____115_CM "" RAT_FUNC "%6.3" "kg/h" COEFFS 0 32. 0. 0 0 1 /end COMPU_METHOD
/begin COMPU_METHOD _CNV_A_R_LINEAR_____117_CM "" RAT_FUNC "%6.3" "-" COEFFS 0 128. 0. 0 0 1 /end COMPU_METHOD
/begin COMPU_METHOD _CNV_A_R_LINEAR_____118_CM "" RAT_FUNC "%6.3" "-" COEFFS 0 1023.999999959999 0. 0 0 1 /end COMPU_METHOD
/begin COMPU_METHOD _CNV_A_R_LINEAR_____129_CM "" RAT_FUNC "%6.3" "[-]" COEFFS 0 64. 0. 0 0 1 /end COMPU_METHOD
/begin COMPU_METHOD _CNV_A_R_LINEAR_____159_CM "" RAT_FUNC "%6.3" "°CRK" COEFFS 0 0.1666666666666667 0. 0 0 1 /end COMPU_METHOD
/begin COMPU_METHOD _CNV_A_R_LINEAR_____175_CM "" RAT_FUNC "%6.3" "-" COEFFS 0 32767.98303949118 0. 0 0 1 /end COMPU_METHOD
/begin COMPU_METHOD _CNV_A_R_LINEAR_____198_CM "" RAT_FUNC "%6.3" "s" COEFFS 0 50. 0. 0 0 1 /end COMPU_METHOD
/begin COMPU_METHOD _CNV_A_R_LINEAR_____206_CM "" RAT_FUNC "%6.3" "-" COEFFS 0 1023.999999919998 0. 0 0 1 /end COMPU_METHOD
/begin COMPU_METHOD _CNV_A_R_LINEAR_____248_CM "" RAT_FUNC "%6.3" "-" COEFFS 0 64. 0. 0 0 1 /end COMPU_METHOD
/begin COMPU_METHOD _CNV_A_R_LINEAR_____257_CM "" RAT_FUNC "%6.3" "mg/stk" COEFFS 0 47.18214541280769 -1.080506262951531e-005 0 0 1 /end COMPU_METHOD
/begin COMPU_METHOD _CNV_A_R_LINEAR_____262_CM "" RAT_FUNC "%6.3" "%" COEFFS 0 655.3600000071681 32768.00000035841 0 0 1 /end COMPU_METHOD
/begin COMPU_METHOD _CNV_A_R_LINEAR_____273_CM "" RAT_FUNC "%6.3" "g" COEFFS 0 35.99999934081027 0. 0 0 1 /end COMPU_METHOD
/begin COMPU_METHOD _CNV_A_R_LINEAR_____274_CM "" RAT_FUNC "%6.3" "mg/stk" COEFFS 0 47.14849960790521 32768.20722749412 0 0 1 /end COMPU_METHOD
/begin COMPU_METHOD _CNV_A_R_LINEAR_____280_CM "" RAT_FUNC "%6.3" "°C" COEFFS 0 43.47840509520334 2086.96344456976 0 0 1 /end COMPU_METHOD
/begin COMPU_METHOD _CNV_A_R_LINEAR_____281_CM "" RAT_FUNC "%6.3" "-" COEFFS 0 32768.00003968061 3.96806062781252e-005 0 0 1 /end COMPU_METHOD
/begin COMPU_METHOD _CNV_A_R_LINEAR_____284_CM "" RAT_FUNC "%6.3" "mA" COEFFS 0 2601.421086059067 -0.499999999996362 0 0 1 /end COMPU_METHOD
/begin COMPU_METHOD _CNV_A_R_LINEAR_____285_CM "" RAT_FUNC "%6.3" "-" COEFFS 0 1024. 0. 0 0 1 /end COMPU_METHOD
/begin COMPU_METHOD _CNV_A_R_LINEAR_____286_CM "" RAT_FUNC "%6.3" "-" COEFFS 0 262144.1943071089 2.428838861669647e-002 0 0 1 /end COMPU_METHOD
/begin COMPU_METHOD _CNV_A_R_LINEAR_____287_CM "" RAT_FUNC "%6.3" "g" COEFFS 0 36.00036915004301 0. 0 0 1 /end COMPU_METHOD
/begin COMPU_METHOD _CNV_A_R_LINEAR_____288_CM "" RAT_FUNC "%6.3" "-" COEFFS 0 16384. 0. 0 0 1 /end COMPU_METHOD
/begin COMPU_METHOD _CNV_A_R_LINEAR_____289_CM "" RAT_FUNC "%6.3" "-" COEFFS 0 17179869180. -0.5 0 0 1 /end COMPU_METHOD
/begin COMPU_METHOD _CNV_A_R_LINEAR_____290_CM "" RAT_FUNC "%6.3" "-" COEFFS 0 1024.001799030612 2.248788264580526e-004 0 0 1 /end COMPU_METHOD
/begin COMPU_METHOD _CNV_A_R_LINEAR_____299_CM "" RAT_FUNC "%6.3" "µA" COEFFS 0 105.7527836049701 0. 0 0 1 /end COMPU_METHOD
/begin COMPU_METHOD _CNV_S_5_RANGE_STAT_300_CM "" TAB_VERB "%6.3" "[-]" COMPU_TAB_REF _CNV_S_5_RANGE_STAT_300 /end COMPU_METHOD
/begin COMPU_VTAB _CNV_S_5_RANGE_STAT_300 "" TAB_VERB 5 0 "0:INIT" 1 "1:WAIT" 2 "2:PURGE" 3 "3:ACQ" 4 "4:ADAPT" /end COMPU_VTAB
/begin COMPU_METHOD _CNV_S_4_RANGE_STAT_301_CM "" TAB_VERB "%6.3" "[-]" COMPU_TAB_REF _CNV_S_4_RANGE_STAT_301 /end COMPU_METHOD
/begin COMPU_VTAB _CNV_S_4_RANGE_STAT_301 "" TAB_VERB 4 0 "0: in_range" 1 "1: low_limit" 2 "2: high_limit" 3 "3: impossible" /end COMPU_VTAB
/begin COMPU_METHOD _CNV_A_R_LINEAR_____302_CM "" RAT_FUNC "%6.3" "°C" COEFFS 0 2. 80. 0 0 1 /end COMPU_METHOD
/begin COMPU_METHOD _CNV_A_R_LINEAR_____303_CM "" RAT_FUNC "%6.3" "°C" COEFFS 0 15.99999804684544 -4.000060547696194e-003 0 0 1 /end COMPU_METHOD
/begin COMPU_METHOD _CNV_A_R_LINEAR_____321_CM "" RAT_FUNC "%6.3" "%" COEFFS 0 327.680000003584 3.584063961170614e-007 0 0 1 /end COMPU_METHOD
/begin COMPU_METHOD _CNV_A_R_LINEAR_____322_CM "" RAT_FUNC "%6.3" "mg/stk" COEFFS 0 3020.046082949309 -0.499999999996362 0 0 1 /end COMPU_METHOD
/begin COMPU_METHOD _CNV_S_8_STATE_MFF__323_CM "" TAB_VERB "%6.3" "[-]" COMPU_TAB_REF _CNV_S_8_STATE_MFF__323 /end COMPU_METHOD
/begin COMPU_VTAB _CNV_S_8_STATE_MFF__323 "" TAB_VERB 8 0 "INIT" 1 "WAIT" 2 "CDN_ADD" 3 "ADAPT_ADD" 4 "CDN_FAC_L" 5 "CDN_FAC_H" 6 "ADAPT_FAC_L" 7 "ADAPT_FAC_H" /end COMPU_VTAB
/begin COMPU_METHOD _CNV_S_7_STATE_LSH__324_CM "" TAB_VERB "%6.3" "[-]" COMPU_TAB_REF _CNV_S_7_STATE_LSH__324 /end COMPU_METHOD
/begin COMPU_VTAB _CNV_S_7_STATE_LSH__324 "" TAB_VERB 7 0 "LSH_OFF" 1 "LSH_POW_RISE" 2 "LSH_POW_RED" 3 "LSH_POW_FALL" 4 "LSH_POW_CTL" 5 "LSH_VB_PROT" 6 "LSH_TEMP_PROT" /end COMPU_VTAB
/begin COMPU_METHOD _CNV_A_R_LINEAR_____325_CM "" RAT_FUNC "%6.3" "V" COEFFS 0 2520.615410935313 0. 0 0 1 /end COMPU_METHOD
/begin COMPU_METHOD _CNV_A_R_LINEAR_____326_CM "" RAT_FUNC "%6.3" "V" COEFFS 0 9.807692307692308 -9.615384615372591e-003 0 0 1 /end COMPU_METHOD
/begin COMPU_METHOD _CNV_A_R_LINEAR_____327_CM "" RAT_FUNC "%6.3" "V" COEFFS 0 2510.919540229885 -0.499999999996362 0 0 1 /end COMPU_METHOD
/begin COMPU_METHOD _CNV_A_R_LINEAR_____342_CM "" RAT_FUNC "%6.3" "-" COEFFS 0 1024.003612233215 0. 0 0 1 /end COMPU_METHOD
/begin COMPU_METHOD _CNV_A_R_LINEAR_____343_CM "" RAT_FUNC "%6.3" "°C" COEFFS 0 64. 2112. 0 0 1 /end COMPU_METHOD
/begin COMPU_METHOD _CNV_A_R_LINEAR_____344_CM "" RAT_FUNC "%6.3" "g" COEFFS 0 179.9999890133373 0. 0 0 1 /end COMPU_METHOD
/begin COMPU_METHOD _CNV_A_R_LINEAR_____348_CM "" RAT_FUNC "%6.3" "g" COEFFS 0 4608.117565499413 0. 0 0 1 /end COMPU_METHOD
/begin COMPU_METHOD _CNV_A_R_LINEAR_____352_CM "" RAT_FUNC "%6.3" "°C" COEFFS 0 0.249266862170088 8.225806451612904 0 0 1 /end COMPU_METHOD
/begin COMPU_METHOD _CNV_A_R_LINEAR_____353_CM "" RAT_FUNC "%6.3" "-" COEFFS 0 262140. -0.5 0 0 1 /end COMPU_METHOD
/begin COMPU_METHOD _CNV_A_R_LINEAR_____354_CM "" RAT_FUNC "%6.3" "-" COEFFS 0 16384. 2048. 0 0 1 /end COMPU_METHOD
/begin COMPU_METHOD _CNV_A_R_LINEAR_____355_CM "" RAT_FUNC "%6.3" "V" COEFFS 0 204.799999948775 1023.999999743875 0 0 1 /end COMPU_METHOD
/begin COMPU_METHOD _CNV_A_R_LINEAR_____356_CM "" RAT_FUNC "%6.3" "-" COEFFS 0 262140. 32767.5 0 0 1 /end COMPU_METHOD
/begin COMPU_METHOD _CNV_A_R_LINEAR_____357_CM "" RAT_FUNC "%6.3" "-" COEFFS 0 65536.00270084133 0. 0 0 1 /end COMPU_METHOD
/begin COMPU_METHOD _CNV_A_R_LINEAR_____360_CM "" RAT_FUNC "%6.3" "ms" COEFFS 0 250. 32768. 0 0 1 /end COMPU_METHOD
/begin COMPU_METHOD _CNV_A_R_LINEAR_____361_CM "" RAT_FUNC "%6.3" "-" COEFFS 0 32768. 0. 0 0 1 /end COMPU_METHOD
/begin COMPU_METHOD _CNV_A_R_LINEAR_____362_CM "" RAT_FUNC "%6.3" "-" COEFFS 0 1023.999989719843 0. 0 0 1 /end COMPU_METHOD
/begin COMPU_METHOD _CNV_A_R_LINEAR_____363_CM "" RAT_FUNC "%6.3" "-" COEFFS 0 25. 0. 0 0 1 /end COMPU_METHOD
/begin COMPU_METHOD _CNV_A_R_LINEAR_____367_CM "" RAT_FUNC "%6.3" "°C" COEFFS 0 15.99975585564965 0. 0 0 1 /end COMPU_METHOD
/begin COMPU_METHOD _CNV_A_R_LINEAR_____368_CM "" RAT_FUNC "%6.3" "°C" COEFFS 0 15.99999804684544 32767.99599993945 0 0 1 /end COMPU_METHOD
/begin COMPU_METHOD _CNV_A_R_LINEAR_____369_CM "" RAT_FUNC "%6.3" "V/K" COEFFS 0 1000. 0. 0 0 1 /end COMPU_METHOD
/begin COMPU_METHOD _CNV_A_R_LINEAR_____370_CM "" RAT_FUNC "%6.3" "V/100ms" COEFFS 0 156.9230769230769 0. 0 0 1 /end COMPU_METHOD
/begin COMPU_METHOD _CNV_A_R_LINEAR_____371_CM "" RAT_FUNC "%6.3" "-" COEFFS 0 40.17013232514178 0. 0 0 1 /end COMPU_METHOD
/begin COMPU_METHOD _CNV_A_R_LINEAR_____372_CM "" RAT_FUNC "%6.3" "mA/100ms" COEFFS 0 2601.421086059067 -0.499999999996362 0 0 1 /end COMPU_METHOD
/begin COMPU_METHOD _CNV_A_R_LINEAR_____373_CM "" RAT_FUNC "%6.3" "mA" COEFFS 0 2601.421086059067 32767.5 0 0 1 /end COMPU_METHOD
/begin COMPU_METHOD _CNV_A_R_LINEAR_____374_CM "" RAT_FUNC "%6.3" "mA/V" COEFFS 0 13007.10543029533 0. 0 0 1 /end COMPU_METHOD
/begin COMPU_METHOD _CNV_A_R_LINEAR_____440_CM "" RAT_FUNC "%6.3" "mg/stk" COEFFS 0 11.86046511627907 0. 0 0 1 /end COMPU_METHOD
/begin RECORD_LAYOUT _REC_VAL_20_u1 FNC_VALUES 1 UBYTE COLUMN_DIR DIRECT /end RECORD_LAYOUT
/begin RECORD_LAYOUT _REC_VAL_20_u2 FNC_VALUES 1 UWORD COLUMN_DIR DIRECT /end RECORD_LAYOUT
/begin RECORD_LAYOUT _REC_CUR_20_u2_u1 FNC_VALUES 1 UWORD COLUMN_DIR DIRECT /end RECORD_LAYOUT
/begin RECORD_LAYOUT _REC_AXS_20_u1 NO_AXIS_PTS_X 1 UBYTE AXIS_PTS_X 2 UBYTE INDEX_INCR DIRECT /end RECORD_LAYOUT
/begin RECORD_LAYOUT _REC_MAP_20_u1_u1_u1 FNC_VALUES 1 UBYTE COLUMN_DIR DIRECT /end RECORD_LAYOUT
/begin RECORD_LAYOUT _REC_CUR_20_u1_u1 FNC_VALUES 1 UBYTE COLUMN_DIR DIRECT /end RECORD_LAYOUT
/begin RECORD_LAYOUT _REC_AXS_20_u2 NO_AXIS_PTS_X 1 UWORD AXIS_PTS_X 2 UWORD INDEX_INCR DIRECT /end RECORD_LAYOUT
/begin RECORD_LAYOUT _REC_MAP_20_u1_u1_u2 FNC_VALUES 1 UBYTE COLUMN_DIR DIRECT /end RECORD_LAYOUT
/begin RECORD_LAYOUT _REC_MAP_20_u2_u2_u1 FNC_VALUES 1 UWORD COLUMN_DIR DIRECT /end RECORD_LAYOUT
/begin RECORD_LAYOUT _REC_CUR_20_u1_u2 FNC_VALUES 1 UBYTE COLUMN_DIR DIRECT /end RECORD_LAYOUT
/begin RECORD_LAYOUT _REC_CUR_20_u2_u2 FNC_VALUES 1 UWORD COLUMN_DIR DIRECT /end RECORD_LAYOUT
/begin RECORD_LAYOUT _REC_VAL_20_s1 FNC_VALUES 1 SBYTE COLUMN_DIR DIRECT /end RECORD_LAYOUT
/begin RECORD_LAYOUT _REC_VAL_20_s2 FNC_VALUES 1 SWORD COLUMN_DIR DIRECT /end RECORD_LAYOUT
/begin RECORD_LAYOUT _REC_MAP_20_u1_u2_u2 FNC_VALUES 1 UBYTE COLUMN_DIR DIRECT /end RECORD_LAYOUT
/begin RECORD_LAYOUT _REC_MAP_20_u1_u2_u1 FNC_VALUES 1 UBYTE COLUMN_DIR DIRECT /end RECORD_LAYOUT
/begin FUNCTION INJ_Catalyst_enrichment_function "_Catalyst enrichment function"
 /begin DEF_CHARACTERISTIC c_vls_down_puc_act_max c_maf_int_puc_min c_maf_int_pcat_purge_sa c_maf_int_pcat_purge_hst c_maf_int_pcat_purge_ch c_fac_add_pcat_main_cat_puc_sa c_fac_add_pcat_main_cat_puc_hst c_fac_add_pcat_main_cat_puc_ch c_delta_lamb_sp_puc_inc c_delta_lamb_sp_puc_dec ip_delta_lamb_sp_puc ip_maf_int_act_puc ip_fac_cat_eff_puc ip_fac_pcat_main_cat_puc c_maf_int_act_puc_max c_tco_thd_hst c_quo_maf_int_puc_afl /end DEF_CHARACTERISTIC
 /begin OUT_MEASUREMENT lam_bank_1.lam_puc.bf.lv_act_int_puc lam_bank_1.lam_puc.bf.lv_pcat_purge_puc lam_bank_1.lam_puc.bf.lv_pcat_purge_sa lam_bank_1.lam_puc.bf.lv_pcat_purge_hst lam_bank_1.lam_puc.bf.lv_pcat_purge_ch lam_bank_1.lam_puc.bf.lv_main_cat_purge lam_bank_1.lam_puc.bf.lv_vls_down_puc_act_max lam_bank_1.lam_puc.bf.lv_down_ramp_act lam_bank_1.lam_puc.bf.lv_puc_trig lam_bank_1.lam_puc.maf_int_act_puc lam_bank_1.lam_puc.maf_int_cat_load lam_bank_1.lam_puc.maf_int_cat_load_main lam_bank_1.lam_puc.maf_int_purge_rest lam_bank_1.lam_puc.maf_int_sample_step lam_bank_1.lam_puc.maf_int_tot_purge lam_bank_1.lam_puc.fac_add_pcat_main_cat_puc lam_bank_1.lam_puc.quo_maf_int_purge lam_bank_1.lam_puc.delta_lamb_sp_puc lam_bank_2.lam_puc.bf.lv_act_int_puc lam_bank_2.lam_puc.bf.lv_pcat_purge_puc lam_bank_2.lam_puc.bf.lv_pcat_purge_sa lam_bank_2.lam_puc.bf.lv_pcat_purge_hst lam_bank_2.lam_puc.bf.lv_pcat_purge_ch lam_bank_2.lam_puc.bf.lv_main_cat_purge lam_bank_2.lam_puc.bf.lv_vls_down_puc_act_max lam_bank_2.lam_puc.bf.lv_down_ramp_act lam_bank_2.lam_puc.bf.lv_puc_trig lam_bank_2.lam_puc.maf_int_act_puc lam_bank_2.lam_puc.maf_int_cat_load lam_bank_2.lam_puc.maf_int_cat_load_main lam_bank_2.lam_puc.maf_int_purge_rest lam_bank_2.lam_puc.maf_int_sample_step lam_bank_2.lam_puc.maf_int_tot_purge lam_bank_2.lam_puc.fac_add_pcat_main_cat_puc lam_bank_2.lam_puc.quo_maf_int_purge lam_bank_2.lam_puc.delta_lamb_sp_puc maf_int_puc /end OUT_MEASUREMENT
/end FUNCTION
/begin FUNCTION INJ_Application_incidences_for_c "_Application incidences for catalyst enrichment function"
 /begin DEF_CHARACTERISTIC c_tco_act_puc_min c_n_max_cat_purge c_temp_dif_pcat_main_cat c_maf_cyl_act_int_puc_max c_thd_delta_lamb_sp_puc /end DEF_CHARACTERISTIC
 /begin OUT_MEASUREMENT lam_bank_1.lam_puc_inci.bf.lv_inh_int_puc lam_bank_1.lam_puc_inci.bf.lv_act_int_puc_afl lam_bank_1.lam_puc_inci.temp_main_cat lam_bank_1.lam_puc_inci.temp_pcat lam_bank_2.lam_puc_inci.bf.lv_inh_int_puc lam_bank_2.lam_puc_inci.bf.lv_act_int_puc_afl lam_bank_2.lam_puc_inci.temp_main_cat lam_bank_2.lam_puc_inci.temp_pcat /end OUT_MEASUREMENT
/end FUNCTION
/begin FUNCTION INJ_Application_Incidences_for_L "_Application Incidences for Lambda adaptation" /end FUNCTION
/begin FUNCTION INJ_Limited_dynamic_for_dynamic_ "_Limited dynamic for dynamic fuel trim" /end FUNCTION
/begin FUNCTION INJ_Application_for_upstream_oxy "_Application for upstream oxygen sensor heater management"
 /begin DEF_CHARACTERISTIC lc_lsh_up_1 lc_lsh_up_cll_ctl_1 lc_lsh_up_2 lc_lsh_up_cll_ctl_2 /end DEF_CHARACTERISTIC
 /begin OUT_MEASUREMENT lam_bank_1.lsh_up_inci.lv_inh_lsh_up lam_bank_1.lsh_up_inci.lv_inh_lsh_up_cll_ctl lam_bank_2.lsh_up_inci.lv_inh_lsh_up lam_bank_2.lsh_up_inci.lv_inh_lsh_up_cll_ctl /end OUT_MEASUREMENT
/end FUNCTION
/begin FUNCTION INJ_Lambda_Adaptation "_Lambda Adaptation"
 /begin DEF_CHARACTERISTIC c_mff_ad_cor_crlc c_lam_ad_sum_p_is c_lam_ad_sum_p ip_mff_ad_add_fac ip_mff_ad_fac_fac c_n_mff_ad_add_max c_maf_mff_ad_add_max c_mff_ad_add_min c_mff_ad_add_max id_t_mff_ad_add lc_mff_ad_add c_t_mff_ad_min_max ip_mff_ad_fac ip_mff_ad_add c_maf_mff_ad_fac_l_min c_n_mff_ad_fac_h_min lc_mff_ad_fac_l lc_mff_ad_fac_h c_mff_ad_cor_crlc_is c_mff_ad_cor_crlc_h c_mff_ad_fac_l_min c_mff_ad_fac_h_min c_mff_ad_fac_l_max c_mff_ad_fac_h_max c_n_mff_ad_fac_l_min c_n_mff_ad_fac_h_max c_maf_mff_ad_fac_h_max c_maf_kgh_ad_fac_l c_maf_kgh_ad_fac_h id_t_mff_ad_fac_l id_t_mff_ad_fac_h ip_maf_mff_ad_fac_l_max ip_maf_mff_ad_fac_l_min ip_maf_mff_ad_fac_h_min /end DEF_CHARACTERISTIC
 /begin OUT_MEASUREMENT t_mff_ad_min lv_mff_ad_end lv_mff_ad_ena_first lv_lamb_ad_afs_req lv_mff_ad_cdn lam_bank_1.lam_ad.bf.lv_lam_adj_ad lam_bank_1.lam_ad.bf.lv_lam_ad_stop lam_bank_1.lam_ad.bf.lv_mff_ad_fac_h_lim lam_bank_1.lam_ad.bf.lv_mff_ad_add_lim lam_bank_1.lam_ad.bf.lv_mff_ad_fac_l_lim lam_bank_1.lam_ad.mff_ad_add_mmv_rel lam_bank_1.lam_ad.mff_ad_add_mmv_rel_quo lam_bank_1.lam_ad.mff_ad_fac_mmv_rel lam_bank_1.lam_ad.mff_ad_add_mmv lam_bank_1.lam_ad.mff_ad_fac_mmv lam_bank_1.lam_ad.lam_adj_ad lam_bank_1.lam_ad.mff_ad_add_mmv_delta lam_bank_1.lam_ad.mff_ad_add_mmv_delta_h_res lam_bank_1.lam_ad.mff_ad_fac_mmv_delta_l lam_bank_1.lam_ad.mff_sae_ad_mmv_rel lam_bank_1.lam_ad.lam_ad_sum_p lam_bank_1.lam_ad.state_mff_ad lam_bank_1.lam_ad.t_mff_ad_fac lam_bank_1.lam_ad.t_mff_ad_add lam_bank_1.lam_ad.mff_ad_fac_mmv_delta_h lam_bank_1.lam_ad.mff_ad_fac_mmv_l lam_bank_1.lam_ad.mff_ad_fac_mmv_h lam_bank_2.lam_ad.bf.lv_lam_adj_ad lam_bank_2.lam_ad.bf.lv_lam_ad_stop lam_bank_2.lam_ad.bf.lv_mff_ad_fac_h_lim lam_bank_2.lam_ad.bf.lv_mff_ad_add_lim lam_bank_2.lam_ad.bf.lv_mff_ad_fac_l_lim lam_bank_2.lam_ad.mff_ad_add_mmv_rel lam_bank_2.lam_ad.mff_ad_add_mmv_rel_quo lam_bank_2.lam_ad.mff_ad_fac_mmv_rel lam_bank_2.lam_ad.mff_ad_add_mmv lam_bank_2.lam_ad.mff_ad_fac_mmv lam_bank_2.lam_ad.lam_adj_ad lam_bank_2.lam_ad.mff_ad_add_mmv_delta lam_bank_2.lam_ad.mff_ad_add_mmv_delta_h_res lam_bank_2.lam_ad.mff_ad_fac_mmv_delta_l lam_bank_2.lam_ad.mff_sae_ad_mmv_rel lam_bank_2.lam_ad.lam_ad_sum_p lam_bank_2.lam_ad.state_mff_ad lam_bank_2.lam_ad.t_mff_ad_fac lam_bank_2.lam_ad.t_mff_ad_add lam_bank_2.lam_ad.mff_ad_fac_mmv_delta_h lam_bank_2.lam_ad.mff_ad_fac_mmv_l lam_bank_2.lam_ad.mff_ad_fac_mmv_h lv_mff_ad_act_1 lv_mff_ad_act_2 /end OUT_MEASUREMENT
/end FUNCTION
/begin FUNCTION INJ_WRAF_Sensor_Gain_Adaptation_ "_WRAF Sensor Gain Adaptation at Fuel Cut Off"
 /begin DEF_CHARACTERISTIC c_tco_min_lsl_gain_ad c_amp_min_lsl_gain_ad c_ttip_min_lsl_gain_ad c_ttip_max_lsl_gain_ad c_n_32_max_lsl_gain_ad c_n_32_min_lsl_gain_ad c_crlc_iplsl_vld c_iplsl_cor_grd_thd_fcut c_iplsl_cor_thd_fcut c_iplsl_vari_thd_purge_max c_iplsl_vari_thd_purge_min c_t_dur_int c_crlc_iplsl_fcut c_iplsl_fcut c_fac_lsl_lim_min c_fac_lsl_lim_max lc_lsl_gain_ad_test ip_fac_iplsl_cor_amp ip_fac_iplsl_cor_maf_kgh ip_fac_iplsl_cor_ttip_ls_up_mes c_max_iplsl_vld_vari ip_fac_iplsl_cor_n_32 ip_fac_iplsl_cor_iplsl_cor_chg lc_fac_min_max_ini_lsl_cor_ad_1 lc_lsl_ena_ad lc_fac_min_max_ini_lsl_cor_ad_2 /end DEF_CHARACTERISTIC
 /begin OUT_MEASUREMENT lam_bank_1.lsl_ad.bf.lv_lsl_gain_ad_req lam_bank_1.lsl_ad.bf.lv_iplsl_vld_fcut lam_bank_1.lsl_ad.bf.lv_lsl_fcut_mes lam_bank_1.lsl_ad.bf.lv_lsl_fcut_mes_not lam_bank_1.lsl_ad.bf.lv_lsl_fcut_ad_not lam_bank_1.lsl_ad.bf.lv_lsl_gain_ad_req_vld lam_bank_1.lsl_ad.iplsl_cor_mmv_fcut lam_bank_1.lsl_ad.iplsl_purge lam_bank_1.lsl_ad.iplsl_mv_purge lam_bank_1.lsl_ad.iplsl_cor_beg_purge lam_bank_1.lsl_ad.iplsl_cor_chg_purge lam_bank_1.lsl_ad.iplsl_vari_purge lam_bank_1.lsl_ad.iplsl_vld_mmv_fcut lam_bank_1.lsl_ad.iplsl_vld_vari_fcut lam_bank_1.lsl_ad.t_dur_int lam_bank_1.lsl_ad.state_lsl_fcut lam_bank_1.lsl_ad.state_lsl_gain_ad lam_bank_1.lsl_ad.fac_lsl_cor_ad lam_bank_1.lsl_ad.iplsl_max_vld_mmv_fcut lam_bank_1.lsl_ad.iplsl_min_vld_mmv_fcut lam_bank_1.lsl_ad.iplsl_max_vld_vari_fcut lam_bank_1.lsl_ad.iplsl_min_vld_vari_fcut lam_bank_1.lsl_ad.ctr_fac_lsl_cor_ad lam_bank_1.lsl_ad.fac_min_lsl_cor_ad lam_bank_1.lsl_ad.fac_max_lsl_cor_ad lam_bank_1.lsl_ad.fac_min_lsl_cor_ad_amp lam_bank_1.lsl_ad.fac_max_lsl_cor_ad_amp lam_bank_1.lsl_ad.fac_min_lsl_cor_ad_tia lam_bank_1.lsl_ad.fac_max_lsl_cor_ad_tia lam_bank_1.lsl_ad.fac_min_lsl_cor_ad_map lam_bank_1.lsl_ad.fac_max_lsl_cor_ad_map lam_bank_1.lsl_ad.fac_max_lsl_cor_ad_tam lam_bank_1.lsl_ad.fac_min_lsl_cor_ad_tam lam_bank_1.lsl_ad.fac_min_lsl_cor_ad_n_32 lam_bank_1.lsl_ad.fac_max_lsl_cor_ad_n_32 lam_bank_1.lsl_ad.fac_max_lsl_cor_ad_maf_kgh lam_bank_1.lsl_ad.fac_min_lsl_cor_ad_maf_kgh lam_bank_1.lsl_ad.fac_min_lsl_cor_ad_ttip lam_bank_1.lsl_ad.fac_max_lsl_cor_ad_ttip lam_bank_1.lsl_ad.fac_min_lsl_cor_ad_teg_dyn lam_bank_1.lsl_ad.fac_max_lsl_cor_ad_teg_dyn lam_bank_2.lsl_ad.bf.lv_lsl_gain_ad_req lam_bank_2.lsl_ad.bf.lv_iplsl_vld_fcut lam_bank_2.lsl_ad.bf.lv_lsl_fcut_mes lam_bank_2.lsl_ad.bf.lv_lsl_fcut_mes_not lam_bank_2.lsl_ad.bf.lv_lsl_fcut_ad_not lam_bank_2.lsl_ad.bf.lv_lsl_gain_ad_req_vld lam_bank_2.lsl_ad.iplsl_cor_mmv_fcut lam_bank_2.lsl_ad.iplsl_purge lam_bank_2.lsl_ad.iplsl_mv_purge lam_bank_2.lsl_ad.iplsl_cor_beg_purge lam_bank_2.lsl_ad.iplsl_cor_chg_purge lam_bank_2.lsl_ad.iplsl_vari_purge lam_bank_2.lsl_ad.iplsl_vld_mmv_fcut lam_bank_2.lsl_ad.iplsl_vld_vari_fcut lam_bank_2.lsl_ad.t_dur_int lam_bank_2.lsl_ad.state_lsl_fcut lam_bank_2.lsl_ad.state_lsl_gain_ad lam_bank_2.lsl_ad.fac_lsl_cor_ad lam_bank_2.lsl_ad.iplsl_max_vld_mmv_fcut lam_bank_2.lsl_ad.iplsl_min_vld_mmv_fcut lam_bank_2.lsl_ad.iplsl_max_vld_vari_fcut lam_bank_2.lsl_ad.iplsl_min_vld_vari_fcut lam_bank_2.lsl_ad.ctr_fac_lsl_cor_ad lam_bank_2.lsl_ad.fac_min_lsl_cor_ad lam_bank_2.lsl_ad.fac_max_lsl_cor_ad lam_bank_2.lsl_ad.fac_min_lsl_cor_ad_amp lam_bank_2.lsl_ad.fac_max_lsl_cor_ad_amp lam_bank_2.lsl_ad.fac_min_lsl_cor_ad_tia lam_bank_2.lsl_ad.fac_max_lsl_cor_ad_tia lam_bank_2.lsl_ad.fac_min_lsl_cor_ad_map lam_bank_2.lsl_ad.fac_max_lsl_cor_ad_map lam_bank_2.lsl_ad.fac_max_lsl_cor_ad_tam lam_bank_2.lsl_ad.fac_min_lsl_cor_ad_tam lam_bank_2.lsl_ad.fac_min_lsl_cor_ad_n_32 lam_bank_2.lsl_ad.fac_max_lsl_cor_ad_n_32 lam_bank_2.lsl_ad.fac_max_lsl_cor_ad_maf_kgh lam_bank_2.lsl_ad.fac_min_lsl_cor_ad_maf_kgh lam_bank_2.lsl_ad.fac_min_lsl_cor_ad_ttip lam_bank_2.lsl_ad.fac_max_lsl_cor_ad_ttip lam_bank_2.lsl_ad.fac_min_lsl_cor_ad_teg_dyn lam_bank_2.lsl_ad.fac_max_lsl_cor_ad_teg_dyn /end OUT_MEASUREMENT
/end FUNCTION
/begin FUNCTION INJ_Lambda_stimulation_for_a_lam "_Lambda stimulation for a lambda-controller with an UEGO-sensor" /end FUNCTION
/begin FUNCTION INJ_Calculation_of_limited_dynam "_Calculation of limited dynamics of N, MAF and controller output" /begin DEF_CHARACTERISTIC c_lam_mv_dyw c_n_dyw c_maf_dyw /end DEF_CHARACTERISTIC
 /begin OUT_MEASUREMENT lam_bank_1.lam_dyw.lam_mv_dyw lam_bank_1.lam_dyw.bf.lv_lam_dyw lam_bank_2.lam_dyw.lam_mv_dyw lam_bank_2.lam_dyw.bf.lv_lam_dyw lv_n_maf_dyw maf_dyw n_dyw /end OUT_MEASUREMENT
/end FUNCTION
/begin FUNCTION INJ_Operability_detection_for_th "_Operability detection for the linear lambda sensor"
 /begin DEF_CHARACTERISTIC c_lamb_crlc_ready c_t_lamb_de_clr c_lamb_thd_min c_lamb_thd_max c_lamb_de_ready c_maf_int_puc_max_up_ls_ready c_ttip_ls_up_ready id_t_dly_ls_ready__tco_st id_t_deac_ls_ready__tco_st /end DEF_CHARACTERISTIC
 /begin OUT_MEASUREMENT lam_bank_1.ls_ready.bf.lv_up_ls lam_bank_1.ls_ready.bf.lv_up_ls_raw lam_bank_1.ls_ready.bf.lv_up_ls_cdn lam_bank_1.ls_ready.lamb_mmv_ready lam_bank_1.ls_ready.lamb_de_int lam_bank_1.ls_ready.t_deac_ls_ready lam_bank_1.ls_ready.t_dly_ls_ready lam_bank_1.ls_ready.t_lamb_de_clr lam_bank_2.ls_ready.bf.lv_up_ls lam_bank_2.ls_ready.bf.lv_up_ls_raw lam_bank_2.ls_ready.bf.lv_up_ls_cdn lam_bank_2.ls_ready.lamb_mmv_ready lam_bank_2.ls_ready.lamb_de_int lam_bank_2.ls_ready.t_deac_ls_ready lam_bank_2.ls_ready.t_dly_ls_ready lam_bank_2.ls_ready.t_lamb_de_clr /end OUT_MEASUREMENT
/end FUNCTION
/begin FUNCTION INJ_Signal_acquisition_and_compe "_Signal acquisition and compensation of WRAF oxygen sensor"
 /begin DEF_CHARACTERISTIC lc_lsl_ofs_is c_lamb_av_ofs_min c_lamb_av_ofs_max c_vls_lsl_ofs_sp c_vls_lsl_ofs_lim c_t_lamb_ofs_stop c_vls_lsl_ofs_dif c_t_dly_lsl_ofs c_t_dly_lsl_puls c_iplsl_gain ip_fac_iplsl_pres_ex ip_lamb /end DEF_CHARACTERISTIC
 /begin OUT_MEASUREMENT lam_bank_1.ls_up.bf.lv_lsl_ofs lam_bank_1.ls_up.bf.lv_lsl_out lam_bank_1.ls_up.bf.lv_lsl_ofs_puls lam_bank_1.ls_up.bf.lv_vls_lsl_ofs_lim lam_bank_1.ls_up.vls_lsl_cor lam_bank_1.ls_up.vls_lsl_ofs lam_bank_1.ls_up.iplsl_cor lam_bank_2.ls_up.bf.lv_lsl_ofs lam_bank_2.ls_up.bf.lv_lsl_out lam_bank_2.ls_up.bf.lv_lsl_ofs_puls lam_bank_2.ls_up.bf.lv_vls_lsl_ofs_lim lam_bank_2.ls_up.vls_lsl_cor lam_bank_2.ls_up.vls_lsl_ofs lam_bank_2.ls_up.iplsl_cor /end OUT_MEASUREMENT
/end FUNCTION
/begin FUNCTION INJ_Linear_lambda_control "_Linear lambda control"
 /begin DEF_CHARACTERISTIC c_maf_int_lamb_stop_min lc_hom_act_comp lc_lam_off_sawup ip_ti_wf_max_lam__tco ip_t_lam_stop__tco c_t_dly_lamb_stop lc_ctl_gain_swi c_lamb_sp_afr_thd c_lamb_sp_afr_thd_hys /end DEF_CHARACTERISTIC
 /begin OUT_MEASUREMENT lam_bank_1.lam_inci.bf.lv_inh_lscl lam_bank_1.lam_inci.bf.lv_lam_stop lam_bank_1.lam_inci.bf.lv_lam_once_act lam_bank_1.lam_inci.bf.lv_lscl_inh_err lam_bank_1.lam_inci.soi_dly lam_bank_1.lam_inci.delta_lamb_sp lam_bank_1.lam_inci.delta_lamb_av_cor lam_bank_2.lam_inci.bf.lv_inh_lscl lam_bank_2.lam_inci.bf.lv_lam_stop lam_bank_2.lam_inci.bf.lv_lam_once_act lam_bank_2.lam_inci.bf.lv_lscl_inh_err lam_bank_2.lam_inci.soi_dly lam_bank_2.lam_inci.delta_lamb_sp lam_bank_2.lam_inci.delta_lamb_av_cor lv_ctl_gain_swi lv_lam_stop_intr /end OUT_MEASUREMENT
/end FUNCTION
/begin FUNCTION INJ_Forced_stimulation_for_a_lam "_Forced stimulation for a lambda-controller with an UEGO-sensor"
 /begin DEF_CHARACTERISTIC c_t_per_lamb_de_is c_ramp_lamb_de_is c_t_per_lamb_de_ls_diag c_sp_lamb_de_ls_diag c_ramp_lamb_de_ls_diag c_maf_int_lamb_puls_min c_temp_cat_lamb_puls_min c_delta_lamb_thd_puls_on c_delta_lamb_thd_puls_off ip_sp_lamb_de ip_ramp_lamb_de ip_t_per_lamb_de_cat_diag ip_sp_lamb_de_cat_diag ip_ramp_lamb_de_cat_diag c_delta_lamb_sp c_sp_lamb_de_is c_sp_lamb_de_dyn_diag ip_t_per_lamb_de c_lamb_sp c_lamb_dif_thd_afl_off c_lamb_dif_thd_afl_on c_lamb_dif_thd_afr_on c_lamb_dif_thd_afr_off lc_lamb_puls_cor_is ip_fac_2_sp_lamb_de ip_fac_1_sp_lamb_de ip_t_per_lamb_de_dyn_diag c_maf_lam_hys_cat /end DEF_CHARACTERISTIC
 /begin OUT_MEASUREMENT lam_bank_1.lam_sti.bf.lv_lamb_puls_on lam_bank_1.lam_sti.bf.lv_lamb_puls_on_ls_diag lam_bank_1.lam_sti.bf.lv_delta_lamb_puls_on lam_bank_1.lam_sti.bf.lv_lamb_puls_mst_cbk lam_bank_1.lam_sti.bf.lv_lamb_puls_syn_cbk_old lam_bank_1.lam_sti.lamb_puls_osc lam_bank_1.lam_sti.maf_int_lamb_puls lam_bank_1.lam_stic.lamb_puls lam_bank_2.lam_sti.bf.lv_lamb_puls_on lam_bank_2.lam_sti.bf.lv_lamb_puls_on_ls_diag lam_bank_2.lam_sti.bf.lv_delta_lamb_puls_on lam_bank_2.lam_sti.bf.lv_lamb_puls_mst_cbk lam_bank_2.lam_sti.bf.lv_lamb_puls_syn_cbk_old lam_bank_2.lam_sti.lamb_puls_osc lam_bank_2.lam_sti.maf_int_lamb_puls lam_bank_2.lam_stic.lamb_puls ramp_lamb_de t_per_lamb_de lv_lamb_puls_ls_diag sp_lamb_de lv_lamb_puls_cor lv_lamb_puls_syn_cbk delta_lamb_puls delta_sp_lamb_de delta_t_per_lamb_de maf_int_sp_o2l /end OUT_MEASUREMENT
/end FUNCTION
/begin FUNCTION INJ_Upstream_oxygen_sensor_heate "_Upstream oxygen sensor heater managment LSH"
 /begin DEF_CHARACTERISTIC ip_t_lsh_temp_thd ip_fac_neg_p_lsh_up_ctl ip_fac_pos_p_lsh_up_ctl ip_fac_neg_i_lsh_up_ctl ip_fac_pos_i_lsh_up_ctl ip_fac_v_efc_teg c_v_efc_lsh_up_tol c_v_efc_red c_v_efc_lsh_up_prot c_t_lsh_up_tol c_v_efc_lsh_up_lim c_vb_prot_max c_t_lsh_rise c_inc_v_efc c_fac_v_efc_lsh_up_as c_dec_v_efc ip_v_efc_lsh_up_ini c_v_efc_lsh_up_step c_v_efc_lsh_up_as c_t_lsh_up_lim c_t_lsh_up_max_step c_v_efc_lsh_up_max c_v_efc_lsh_up_max_st c_ttip_ls_up_set_1 c_ttip_ls_up_set_2 c_ttip_ls_up_dif_min_p_add c_fac_p_lsh_up_ctl c_fac_i_lsh_up_ctl c_teg_cat_up_mdl_max_lsh_up lc_inh_lsh_up_cll_ctl_1 lc_inh_lsh_up_cll_ctl_2 ip_v_efc_lsh_up_ctl /end DEF_CHARACTERISTIC
 /begin OUT_MEASUREMENT lam_bank_1.lsh_up.bf.lv_lsh_up_cll_ctl lam_bank_1.lsh_up.bf.lv_v_efc_lsh_up_lim_bol lam_bank_1.lsh_up.bf.lv_v_efc_lsh_up_lim_tol lam_bank_1.lsh_up.bf.lv_v_efc_lsh_up_lim_max lam_bank_1.lsh_up.bf.lv_pow_ctl_act lam_bank_1.lsh_up.t_lsh_up lam_bank_1.lsh_up.lshpwm_up lam_bank_1.lsh_up.v_efc_lsh_up lam_bank_1.lsh_up.t_lsh_up_tol lam_bank_1.lsh_up.t_lsh_up_lim lam_bank_1.lsh_up.state_lsh_up lam_bank_1.lsh_up.v_efc_lsh_up_clc lam_bank_1.lsh_up.v_efc_lsh_up_ctl_add lam_bank_1.lsh_up.v_efc_lsh_up_ctl_p_add lam_bank_1.lsh_up.v_efc_lsh_up_ctl_i_add lam_bank_1.lsh_up.ttip_ls_up_dif_set_mes lam_bank_2.lsh_up.bf.lv_lsh_up_cll_ctl lam_bank_2.lsh_up.bf.lv_v_efc_lsh_up_lim_bol lam_bank_2.lsh_up.bf.lv_v_efc_lsh_up_lim_tol lam_bank_2.lsh_up.bf.lv_v_efc_lsh_up_lim_max lam_bank_2.lsh_up.bf.lv_pow_ctl_act lam_bank_2.lsh_up.t_lsh_up lam_bank_2.lsh_up.lshpwm_up lam_bank_2.lsh_up.v_efc_lsh_up lam_bank_2.lsh_up.t_lsh_up_tol lam_bank_2.lsh_up.t_lsh_up_lim lam_bank_2.lsh_up.state_lsh_up lam_bank_2.lsh_up.v_efc_lsh_up_clc lam_bank_2.lsh_up.v_efc_lsh_up_ctl_add lam_bank_2.lsh_up.v_efc_lsh_up_ctl_p_add lam_bank_2.lsh_up.v_efc_lsh_up_ctl_i_add lam_bank_2.lsh_up.ttip_ls_up_dif_set_mes lv_v_efc_lsh_up_prot /end OUT_MEASUREMENT
/end FUNCTION
/begin FUNCTION INJ_Downstream_fuel_trim_regulat "_Downstream fuel trim regulation by LAM - P - Jump delay time"
 /begin DEF_CHARACTERISTIC c_lam_temp_min_cat_dly c_delta_lamb_i_min c_maf_delta_lamb_p_min c_n_delta_lamb_p_max c_n_delta_lamb_p_min c_maf_delta_lamb_p_max c_cat_diag_max_delta_lamb c_crlc_lam_down_ad ip_delta_lamb_p__vls_dif_dly ip_maf_delta_lamb_i_min__n_32 ip_maf_delta_lamb_i_max__n_32 c_maf_int_min_dly ip_delta_lamb_i__vls_dif_dly c_delta_lamb_i_ad_ext_adj ip_vls_sp_dly_2__maf__n_32 ip_fac_cat_eff_delta_lamb lc_delta_lamb_p_cat_diag ip_crlc_delta_lamb_i ip_crlc_delta_lamb_p ip_vls_sp_dly_1__maf__n_32 ip_delta_vls_down_cat_diag ip_delta_lamb_i_cat_diag c_crlc_dly_i_mv c_maf_int_min_dly_i_act_puc c_maf_int_min_dly_p_act_puc c_delta_lamb_i_max c_lamb_sp_min_lam_dly c_lamb_sp_max_lam_dly /end DEF_CHARACTERISTIC
 /begin OUT_MEASUREMENT lam_bank_1.lam_dly.bf.lv_delta_lamb lam_bank_1.lam_dly.bf.lv_lam_dly_i_act lam_bank_1.lam_dly.bf.lv_lam_dly_p_act lam_bank_1.lam_dly.delta_lamb_p lam_bank_1.lam_dly.delta_lamb_i_ad_h_res lam_bank_1.lam_dly.delta_lamb lam_bank_1.lam_dly.maf_int_dly lam_bank_1.lam_dly.vls_dif_dly lam_bank_1.lam_dly.delta_lamb_i lam_bank_1.lam_dly.delta_lamb_p_h_res lam_bank_1.lam_dly.delta_lamb_i_h_res lam_bank_1.lam_dly.delta_lamb_h_res lam_bank_1.lam_dly.delta_lamb_i_h_res_save lam_bank_1.lam_dly.delta_lamb_i_mmv lam_bank_2.lam_dly.bf.lv_delta_lamb lam_bank_2.lam_dly.bf.lv_lam_dly_i_act lam_bank_2.lam_dly.bf.lv_lam_dly_p_act lam_bank_2.lam_dly.delta_lamb_p lam_bank_2.lam_dly.delta_lamb_i_ad_h_res lam_bank_2.lam_dly.delta_lamb lam_bank_2.lam_dly.maf_int_dly lam_bank_2.lam_dly.vls_dif_dly lam_bank_2.lam_dly.delta_lamb_i lam_bank_2.lam_dly.delta_lamb_p_h_res lam_bank_2.lam_dly.delta_lamb_i_h_res lam_bank_2.lam_dly.delta_lamb_h_res lam_bank_2.lam_dly.delta_lamb_i_h_res_save lam_bank_2.lam_dly.delta_lamb_i_mmv /end OUT_MEASUREMENT
/end FUNCTION
/end MODULE
/end PROJECT
