ASAP2_VERSION 1 3
/begin PROJECT P390 "BMW DDE6.2 6-Zylinder VR0.1 15.03.2004 CAN11/12H"
/begin HEADER "" VERSION "VR0.1_6Z_CAN11/12H" PROJECT_NO P390 /end HEADER
/begin MODULE DIM ""
/begin MOD_COMMON "" BYTE_ORDER MSB_FIRST ALIGNMENT_BYTE 1 ALIGNMENT_WORD 2 ALIGNMENT_LONG 4 ALIGNMENT_FLOAT32_IEEE 4 /end MOD_COMMON
/begin CHARACTERISTIC K2REI_dCodInd_C "Kennwert Codier Index" VALUE 0xC045A Kw_Wu8 255.0 OneToOne 0.00 255.0 FORMAT "%3.0" /end CHARACTERISTIC
/begin CHARACTERISTIC K2REI_dDiaInd_C "Kennwerteblock Diagnose Index" VAL_BLK 0xC045B Kwb_Wu8 255.0 OneToOne 0.00 255.0 FORMAT "%3.0" NUMBER 2 /end CHARACTERISTIC
/begin CHARACTERISTIC K2REI_dSGFam_C "Kennwerteblock Steuergeraetefamilie/Motortype" VAL_BLK 0xC0458 Kwb_Wu8 255.0 OneToOne 0.00 255.0 FORMAT "%3.0" NUMBER 2 /end CHARACTERISTIC
/begin CHARACTERISTIC Chiste_stEnaTst_C "#SSD Schalter zum Testen des Befehlstests" VALUE 0xEFC50 Kw_Wu8 255.0 OneToOne 0.00 255.0 FORMAT "%5.1" /end CHARACTERISTIC
/begin CHARACTERISTIC K_IABGLMOT "Konstante Abgleichstrom Motor" VALUE 0x000C0AE4 TKW_VV_VV_SW 100.0 Def_i_sw_q0p001 -32.7680 32.7670 /begin FUNCTION_LIST BGCRENG /end FUNCTION_LIST FORMAT "%6.3" /end CHARACTERISTIC
/begin CHARACTERISTIC K_IABGLNL "Konstante Abgleichstrom Kl. 15" VALUE 0x000C0AE6 TKW_VV_VV_SW 100.0 Def_i_sw_q0p001 -32.7680 32.7670 /begin FUNCTION_LIST BGCRENG /end FUNCTION_LIST FORMAT "%6.3" /end CHARACTERISTIC
/begin CHARACTERISTIC K_IABGLST "Konstante Abgleichstrom Start" VALUE 0x000C0AE8 TKW_VV_VV_SW 100.0 Def_i_sw_q0p001 -32.7680 32.7670 /begin FUNCTION_LIST BGCRENG /end FUNCTION_LIST FORMAT "%6.3" /end CHARACTERISTIC
/begin CHARACTERISTIC K_IKEINESA "Konstante Strom wenn keine SA" VALUE 0x000C0AEA TKW_VV_VV_SW 100.0 Def_i_sw_q0p001 -32.7680 32.7670 /begin FUNCTION_LIST BGCRENG /end FUNCTION_LIST FORMAT "%6.3" /end CHARACTERISTIC
/begin CHARACTERISTIC K_CRENGOF "" VALUE 0x000C0AEC TKW_VV_VV_UW 100.0 Def_i_uw_q0p0635 0.0 4095.9375 /begin FUNCTION_LIST BGCRENG /end FUNCTION_LIST FORMAT "%6.3" /end CHARACTERISTIC
/begin CHARACTERISTIC K_CRVVTNOT "Wert vvt_iges bei vvt_es Fehlersignal" VALUE 0x000C0AEE TKW_VV_VV_UW 100.0 Def_i_uw_q0p0635 0.0 4095.9375 /begin FUNCTION_LIST BGCRENG /end FUNCTION_LIST FORMAT "%6.3" /end CHARACTERISTIC
/begin CHARACTERISTIC K_CRVVTOF "" VALUE 0x000C0AF0 TKW_VV_VV_UW 100.0 Def_i_uw_q0p0635 0.0 4095.9375 /begin FUNCTION_LIST BGCRENG /end FUNCTION_LIST FORMAT "%6.3" /end CHARACTERISTIC
/begin CHARACTERISTIC KL_ELTEMP39 "Temperaturfaktor Elüfter" CURVE 0x000C0AF2 TKL_SW_VV_UW 100.0 Def_f_uw_b512 0.0 511.9921 /begin FUNCTION_LIST BGCRENG /end FUNCTION_LIST
 /begin AXIS_DESCR STD_AXIS Tans Def_t_sw_q0p1 6 -3276.8000 3276.7000 FORMAT "%4.1" /end AXIS_DESCR
 FORMAT "%6.3" /end CHARACTERISTIC
/begin CHARACTERISTIC KL_ELUB60 "" CURVE 0x000C0B0C TKL_UW_VV_UW 100.0 Def_f_uw_b512 0.0 511.9921 /begin FUNCTION_LIST BGCRENG /end FUNCTION_LIST /begin AXIS_DESCR STD_AXIS Ub Def_u_uw_q0p0942 5 0.0 6173.3970 FORMAT "%4.1" /end AXIS_DESCR FORMAT "%6.3" /end CHARACTERISTIC
/begin CHARACTERISTIC KL_IABGLST "Abgleichstrom Start" CURVE 0x000C0B22 TKL_UW_VV_UB 100.0 Def_f_ub_b8 0.0 7.9687 /begin FUNCTION_LIST BGCRENG /end FUNCTION_LIST /begin AXIS_DESCR STD_AXIS Ub Def_u_uw_q0p0942 5 0.0 6173.3970 FORMAT "%4.1" /end AXIS_DESCR /end CHARACTERISTIC
/begin CHARACTERISTIC KL_IABGLMOT "Abgleichstrom Motor" CURVE 0x000C0B34 TKL_UW_VV_UB 100.0 Def_f_ub_b8 0.0 7.9687 /begin FUNCTION_LIST BGCRENG /end FUNCTION_LIST /begin AXIS_DESCR STD_AXIS Ub Def_u_uw_q0p0942 5 0.0 6173.3970 FORMAT "%4.1" /end AXIS_DESCR /end CHARACTERISTIC
/begin CHARACTERISTIC KL_ELUB39 "" CURVE 0x000C0B46 TKL_UW_VV_UW 100.0 Def_f_uw_b512 0.0 511.9921 /begin FUNCTION_LIST BGCRENG /end FUNCTION_LIST /begin AXIS_DESCR STD_AXIS Ub Def_u_uw_q0p0942 5 0.0 6173.3970 FORMAT "%4.1" /end AXIS_DESCR FORMAT "%6.3" /end CHARACTERISTIC
/begin CHARACTERISTIC KL_ELTEMP60 "Temperaturfaktor Elüfter" CURVE 0x000C0B5C TKL_SW_VV_UW 100.0 Def_f_uw_b512 0.0 511.9921 /begin FUNCTION_LIST BGCRENG /end FUNCTION_LIST
 /begin AXIS_DESCR STD_AXIS Tans Def_t_sw_q0p1 6 -3276.8000 3276.7000 FORMAT "%4.1" /end AXIS_DESCR
 FORMAT "%6.3" /end CHARACTERISTIC
/begin CHARACTERISTIC KL_ELSLS "Kennlinie E-Lüfter Strom" CURVE 0x000C0B76 TKL_UW_VV_UW 100.0 Def_i_uw_q0p0635 0.0 255.0000 /begin FUNCTION_LIST BGCRENG /end FUNCTION_LIST /begin AXIS_DESCR STD_AXIS Ub Def_u_uw_q0p0942 3 0.0 6173.3970 FORMAT "%4.1" /end AXIS_DESCR FORMAT "%6.3" /end CHARACTERISTIC
/begin CHARACTERISTIC KL_IABGLNL "Abgleichstrom Kl. 15" CURVE 0x000C0B84 TKL_UW_VV_UB 100.0 Def_f_ub_b8 0.0 7.9687 /begin FUNCTION_LIST BGCRENG /end FUNCTION_LIST /begin AXIS_DESCR STD_AXIS Ub Def_u_uw_q0p0942 5 0.0 6173.3970 FORMAT "%4.1" /end AXIS_DESCR /end CHARACTERISTIC
/begin CHARACTERISTIC KF_ELUPWM60 "Strom E-Lüfter über pwm und ub" MAP 0x000C0B96 TKF_UW_UB_UW 100.0 Def_i_uw_q0p0635 0.0 64.0000 /begin FUNCTION_LIST BGCRENG /end FUNCTION_LIST /begin AXIS_DESCR STD_AXIS L_pwmout Def_tv_ub_q0p390625 8 0.0 99.6093 /end AXIS_DESCR /begin AXIS_DESCR STD_AXIS V Def_v_uw_q1p0 8 0.0 360.0000 /end AXIS_DESCR FORMAT "%6.3" /end CHARACTERISTIC
/begin CHARACTERISTIC KF_ELUPWM39 "Strom E-Lüfter über pwm und ub" MAP 0x000C0C30 TKF_UW_UB_UW 100.0 Def_i_uw_q0p0635 0.0 64.0000 /begin FUNCTION_LIST BGCRENG /end FUNCTION_LIST /begin AXIS_DESCR STD_AXIS L_pwmout Def_tv_ub_q0p390625 8 0.0 99.6093 /end AXIS_DESCR /begin AXIS_DESCR STD_AXIS V Def_v_uw_q1p0 8 0.0 360.0000 /end AXIS_DESCR FORMAT "%6.3" /end CHARACTERISTIC
/begin CHARACTERISTIC K_DFRUTYP "DF-Rückschaltungstyp für LLR-Anhebung" VALUE 0x000C0CCA TKW_VV_VV_UB 100.0 Def_st_ub_q1 0.0 255.0000 /begin FUNCTION_LIST BGLLGEN_1PR /end FUNCTION_LIST /end CHARACTERISTIC
/begin CHARACTERISTIC K_IGENLLRANH "Generatorstromabstand für LL-Anhebung" VALUE 0x000C0CCB TKW_VV_VV_UB 100.0 Def_i_ub_q1 0.0 254.0000 /begin FUNCTION_LIST BGLLGEN_1PR /end FUNCTION_LIST /end CHARACTERISTIC
/begin CHARACTERISTIC K_LLRABS_DF "DF-Schwelle für LL-Absenkung" VALUE 0x000C0CCC TKW_VV_VV_UB 100.0 Def_f_ub_b100 0.0 99.6093 /begin FUNCTION_LIST BGLLGEN_1PR /end FUNCTION_LIST /end CHARACTERISTIC
/begin CHARACTERISTIC K_LLRANH_DF "DF-Schwelle für LL-Anhebung" VALUE 0x000C0CCD TKW_VV_VV_UB 100.0 Def_f_ub_b100 0.0 99.6093 /begin FUNCTION_LIST BGLLGEN_1PR /end FUNCTION_LIST /end CHARACTERISTIC
/begin CHARACTERISTIC K_NTWBGLLGEN "Notlaufwert Leerlaufanhebung bei Generatorfehler" VALUE 0x000C0CCE TKW_VV_VV_UB 100.0 Def_st_ub_q1 0.0 1.0000 /begin FUNCTION_LIST BGLLGEN_1PR /end FUNCTION_LIST /end CHARACTERISTIC
/begin CHARACTERISTIC K_PRELLDFAH "Prellzeit für LLR-Anhebung" VALUE 0x000C0CCF TKW_VV_VV_UB 100.0 Def_td_ub_q0p1 0.0 25.5000 /begin FUNCTION_LIST BGLLGEN_1PR /end FUNCTION_LIST /end CHARACTERISTIC
/begin CHARACTERISTIC K_PRELLDFRF "Prellzeit für LLR-Absenkung" VALUE 0x000C0CD0 TKW_VV_VV_UB 100.0 Def_td_ub_q0p1 0.0 25.5000 /begin FUNCTION_LIST BGLLGEN_1PR /end FUNCTION_LIST /end CHARACTERISTIC
/begin CHARACTERISTIC KF_DFIGEN2 "inv. Generator-DF-Ausgang" MAP 0x000C0CD1 TKF_UB_UB_UB 100.0 Def_f_ub_b100 0.0 99.6093 /begin FUNCTION_LIST BGLLGEN_1PR /end FUNCTION_LIST /begin AXIS_DESCR STD_AXIS NO_INPUT_QUANTITY Def_i_ub_q1 8 0.0 255.0000 /end AXIS_DESCR /begin AXIS_DESCR STD_AXIS NO_INPUT_QUANTITY Def_i_ub_q1 8 0.0 255.0000 /end AXIS_DESCR /end CHARACTERISTIC
/begin CHARACTERISTIC KF_DFIGEN1 "inv. Generator-DF-Ausgang" MAP 0x000C0D23 TKF_UB_UB_UB 100.0 Def_f_ub_b100 0.0 99.6093 /begin FUNCTION_LIST BGLLGEN_1PR /end FUNCTION_LIST /begin AXIS_DESCR STD_AXIS NO_INPUT_QUANTITY Def_i_ub_q1 8 0.0 255.0000 /end AXIS_DESCR /begin AXIS_DESCR STD_AXIS NO_INPUT_QUANTITY Def_i_ub_q1 8 0.0 255.0000 /end AXIS_DESCR /end CHARACTERISTIC
/begin CHARACTERISTIC KF_DFIGEN4 "inv. Generator-DF-Ausgang" MAP 0x000C0D75 TKF_UB_UB_UB 100.0 Def_f_ub_b100 0.0 99.6093 /begin FUNCTION_LIST BGLLGEN_1PR /end FUNCTION_LIST /begin AXIS_DESCR STD_AXIS NO_INPUT_QUANTITY Def_i_ub_q1 8 0.0 255.0000 /end AXIS_DESCR /begin AXIS_DESCR STD_AXIS NO_INPUT_QUANTITY Def_i_ub_q1 8 0.0 255.0000 /end AXIS_DESCR /end CHARACTERISTIC
/begin CHARACTERISTIC KF_DFIGEN3 "inv. Generator-DF-Ausgang" MAP 0x000C0DC7 TKF_UB_UB_UB 100.0 Def_f_ub_b100 0.0 99.6093 /begin FUNCTION_LIST BGLLGEN_1PR /end FUNCTION_LIST /begin AXIS_DESCR STD_AXIS NO_INPUT_QUANTITY Def_i_ub_q1 8 0.0 255.0000 /end AXIS_DESCR /begin AXIS_DESCR STD_AXIS NO_INPUT_QUANTITY Def_i_ub_q1 8 0.0 255.0000 /end AXIS_DESCR /end CHARACTERISTIC
/begin CHARACTERISTIC K_GEN_DNMIN "Motordrehzahlschwelle  für Auswertung der Generatorfehler" VALUE 0x000C0E1A TKW_VV_VV_SW 100.0 Def_n_sw_q1p0 -32768.0000 32767.0000 /begin FUNCTION_LIST DGEN /end FUNCTION_LIST /end CHARACTERISTIC
/begin CHARACTERISTIC K_SNMBSDKL61 "" VALUE 0x000C0E1C TKW_VV_VV_SW 100.0 Def_n_sw_q1p0 -32768.0000 32767.0000 /begin FUNCTION_LIST DGEN /end FUNCTION_LIST /end CHARACTERISTIC
/begin CHARACTERISTIC K_GENPDTIME "Predrivetime für Ladekontrollampe KL61" VALUE 0x000C0E1E TKW_VV_VV_UB 100.0 Def_td_ub_q0p1 0.0 25.5000 /begin FUNCTION_LIST DGEN /end FUNCTION_LIST /end CHARACTERISTIC
/begin CHARACTERISTIC K_MSKGENDFP "Bitmaske Generator Fehler-> DFP" VALUE 0x000C0E1F TKW_VV_VV_UB 100.0 Def_st_ub_q1 0.0 255.0000 /begin FUNCTION_LIST DGEN /end FUNCTION_LIST /end CHARACTERISTIC
/begin CHARACTERISTIC K_MSKGENKL61 "Bitmaske fuer Generatorfehler -> Ladekontrolle" VALUE 0x000C0E20 TKW_VV_VV_UB 100.0 Def_st_ub_q1 0.0 255.0000 /begin FUNCTION_LIST DGEN /end FUNCTION_LIST /end CHARACTERISTIC
/begin CHARACTERISTIC S_BSDKOORD "" VALUE 0x000C0E21 TKW_VV_VV_UB 100.0 Identity 0.0 1.0000 /begin FUNCTION_LIST DIBS /end FUNCTION_LIST /end CHARACTERISTIC
/begin CHARACTERISTIC K_MSKIBSDFP "Bitmaske Generator Fehler-> DFP" VALUE 0x000C0E22 TKW_VV_VV_UB 100.0 Def_st_ub_q1 0.0 255.0000 /begin FUNCTION_LIST DIBS /end FUNCTION_LIST /end CHARACTERISTIC
/begin CHARACTERISTIC K_MSKIBSDFP2 "" VALUE 0x000C0E23 TKW_VV_VV_UB 100.0 Def_st_ub_q1 0.0 255.0000 /begin FUNCTION_LIST DIBS /end FUNCTION_LIST /end CHARACTERISTIC
/begin CHARACTERISTIC K_MSKIBSDIAG "Test AK disable Diagnose" VALUE 0x000C0E24 TKW_VV_VV_UB 100.0 Def_st_ub_q1 0.0 255.0000 /begin FUNCTION_LIST DIBS /end FUNCTION_LIST /end CHARACTERISTIC
/begin CHARACTERISTIC K_MSKIBSERR "" VALUE 0x000C0E25 TKW_VV_VV_UB 100.0 ident 0.0 255.0000 /begin FUNCTION_LIST DIBS /end FUNCTION_LIST /end CHARACTERISTIC
/begin CHARACTERISTIC K_MSKIBSERR2 "" VALUE 0x000C0E26 TKW_VV_VV_UB 100.0 ident 0.0 255.0000 /begin FUNCTION_LIST DIBS /end FUNCTION_LIST /end CHARACTERISTIC
/begin CHARACTERISTIC K_TOGMAXUNPL "" VALUE 0x000C0E28 TKW_VV_VV_UL 100.0 Def_dez_ul_q1 0.0 2147483647.0000 /begin FUNCTION_LIST DQLT /end FUNCTION_LIST /end CHARACTERISTIC
/begin CHARACTERISTIC K_TOG_CNTMAX "" VALUE 0x000C0E2C TKW_VV_VV_UL 100.0 Def_dez_ul_q1 0.0 4294967295.0000 /begin FUNCTION_LIST DQLT /end FUNCTION_LIST /end CHARACTERISTIC
/begin CHARACTERISTIC K_OZDIAGNMOT "Mindestdrehzahl zur QLT-Diagnose" VALUE 0x000C0E30 TKW_VV_VV_SW 100.0 Def_n_sw_q1p0 -32768.0000 32767.0000 /begin FUNCTION_LIST DQLT /end FUNCTION_LIST /end CHARACTERISTIC
/begin CHARACTERISTIC K_OZDIAGNMOT2 "Max Drehzahl zur QLT-Diagnose" VALUE 0x000C0E32 TKW_VV_VV_SW 100.0 Def_n_sw_q1p0 -32768.0000 32767.0000 /begin FUNCTION_LIST DQLT /end FUNCTION_LIST /end CHARACTERISTIC
/begin CHARACTERISTIC K_OZTEMPQERR "Temperaturschwelle für den Permittivitätsfehler" VALUE 0x000C0E34 TKW_VV_VV_SW 100.0 Def_t_sw_q0p1 -3276.8000 3276.7000 /begin FUNCTION_LIST DQLT /end FUNCTION_LIST FORMAT "%4.1" /end CHARACTERISTIC
/begin CHARACTERISTIC K_DTOG_UBMIN "" VALUE 0x000C0E36 TKW_VV_VV_UW 100.0 Def_u_uw_q0p0942 0.0 6173.3970 /begin FUNCTION_LIST DQLT /end FUNCTION_LIST FORMAT "%4.1" /end CHARACTERISTIC
/begin CHARACTERISTIC K_OZDIAGSPG "Spannung, unterhalb der die Diagnose ausgeblendet wird" VALUE 0x000C0E38 TKW_VV_VV_UW 100.0 Def_u_uw_q0p0942 0.0 6173.3970 /begin FUNCTION_LIST DQLT /end FUNCTION_LIST FORMAT "%4.1" /end CHARACTERISTIC
/begin CHARACTERISTIC K_OZERRD "Entprellzeit Sensor- und Kommunikationsfehler" VALUE 0x000C0E3A TKW_VV_VV_UW 100.0 Def_dez_uw_q1 0.0 65535.0000 /begin FUNCTION_LIST DQLT /end FUNCTION_LIST /end CHARACTERISTIC
/begin CHARACTERISTIC K_OZHEAL "Entprellzeit Fehler-Healing" VALUE 0x000C0E3C TKW_VV_VV_UW 100.0 Def_dez_uw_q1 0.0 65535.0000 /begin FUNCTION_LIST DQLT /end FUNCTION_LIST /end CHARACTERISTIC
/begin CHARACTERISTIC SigTst_ACEn_C "Stellertestüberwachung Freigabemaske für Klimaanlage Ausgang" VALUE 0xEF6A6 Kw_Wu8 7.000 OneToOne 0.00 7.000 FORMAT "%5.3" EXTENDED_LIMITS 0.00 255.0 /end CHARACTERISTIC
/begin CHARACTERISTIC SigTst_AOHtEn_C "Stellertestüberwachung Freigabemaske für Zusatzheizersteller" VALUE 0xEF6A7 Kw_Wu8 7.000 OneToOne 0.00 7.000 FORMAT "%5.3" EXTENDED_LIMITS 0.00 255.0 /end CHARACTERISTIC
/begin CHARACTERISTIC SigTst_BPAEn_C "Stellertestüberwachung Freigabemaske für Ladedrucksteller" VALUE 0xEF6A8 Kw_Wu8 7.000 OneToOne 0.00 7.000 FORMAT "%5.3" EXTENDED_LIMITS 0.00 255.0 /end CHARACTERISTIC
/begin CHARACTERISTIC SigTst_CpBVlvEn_C "Switch to enable tester" VALUE 0xEF6A9 Kw_Wu8 7.000 OneToOne 0.00 7.000 FORMAT "%5.3" EXTENDED_LIMITS 0.00 255.0 /end CHARACTERISTIC
/begin CHARACTERISTIC SigTst_EBAFEn_C "Stellertestüberwachung Freigabemaske für EBAfCD" VALUE 0xEF6AA Kw_Wu8 7.000 OneToOne 0.00 7.000 FORMAT "%5.3" EXTENDED_LIMITS 0.00 255.0 /end CHARACTERISTIC
/begin CHARACTERISTIC SigTst_EBFEn_C "Freigabemaske für Stellertestüberwachung für E-Box Lüfter" VALUE 0xEF6AB Kw_Wu8 7.000 OneToOne 0.00 7.000 FORMAT "%5.3" EXTENDED_LIMITS 0.00 255.0 /end CHARACTERISTIC
/begin CHARACTERISTIC SigTst_EGPpEn_C "Tester demand monitoring enable mask for EGPp" VALUE 0xEF6AC Kw_Wu8 7.000 OneToOne 0.00 7.000 FORMAT "%5.3" EXTENDED_LIMITS 0.00 255.0 /end CHARACTERISTIC
/begin CHARACTERISTIC SigTst_EGREn_C "Stellertestüberwachung Freigabemaske für Abgasrückführpositionssteller" VALUE 0xEF6AD Kw_Wu8 7.000 OneToOne 0.00 7.000 FORMAT "%5.3" EXTENDED_LIMITS 0.00 255.0 /end CHARACTERISTIC
/begin CHARACTERISTIC SigTst_ETClbCorOffEn_C "Tester Anforderung Überwachungsfreigabemaske für die Ansteuerdauerkorrektur der Nullmengenkalibrierung" VALUE 0xEF6AE Kw_Wu8 7.000 OneToOne 0.00 7.000 FORMAT "%5.3" EXTENDED_LIMITS 0.00 255.0 /end CHARACTERISTIC
/begin CHARACTERISTIC SigTst_FANEn_C "Stellertest für Kühlerlüfter" VALUE 0xEF6AF Kw_Wu8 7.000 OneToOne 0.00 7.000 FORMAT "%5.3" EXTENDED_LIMITS 0.00 255.0 /end CHARACTERISTIC
/begin CHARACTERISTIC SigTst_GLWRLYEn_C "Stellertestüberwachung Freigabemaske für Glüh Relay" VALUE 0xEF6B0 Kw_Wu8 7.000 OneToOne 0.00 7.000 FORMAT "%5.3" EXTENDED_LIMITS 0.00 255.0 /end CHARACTERISTIC
/begin CHARACTERISTIC SigTst_LPAEn_C "Switch to enable tester" VALUE 0xEF6B1 Kw_Wu8 7.000 OneToOne 0.00 7.000 FORMAT "%5.3" EXTENDED_LIMITS 0.00 255.0 /end CHARACTERISTIC
/begin CHARACTERISTIC SigTst_LSUCDHt0En_C "Auswahlmake für Überwachungsbedingungen des Lambda Sensor Stellertests" VALUE 0xEF6B2 Kw_Wu8 7.000 OneToOne 0.00 7.000 FORMAT "%5.3" EXTENDED_LIMITS 0.00 255.0 /end CHARACTERISTIC
/begin CHARACTERISTIC SigTst_MILLAMPEn_C "Stellertestüberwachung Freigabemaske für MIL (OBD-Lampe)" VALUE 0xEF6B3 Kw_Wu8 7.000 OneToOne 0.00 7.000 FORMAT "%5.3" EXTENDED_LIMITS 0.00 255.0 /end CHARACTERISTIC
/begin CHARACTERISTIC SigTst_MNTCTLEn_C "Tester demand monitoring enable mask for MNTCTL" VALUE 0xEF6B4 Kw_Wu8 7.000 OneToOne 0.00 7.000 FORMAT "%5.3" EXTENDED_LIMITS 0.00 255.0 /end CHARACTERISTIC
/begin CHARACTERISTIC SigTst_MeUnEn_C "Stellertestüberwachung Freigabemaske für Zumesseinheit" VALUE 0xEF6B5 Kw_Wu8 7.000 OneToOne 0.00 7.000 FORMAT "%5.3" EXTENDED_LIMITS 0.00 255.0 /end CHARACTERISTIC
/begin CHARACTERISTIC SigTst_PCVEn_C "Stellertestüberwachung Freigabemaske für Druckregelventil" VALUE 0xEF6B6 Kw_Wu8 7.000 OneToOne 0.00 7.000 FORMAT "%5.3" EXTENDED_LIMITS 0.00 255.0 /end CHARACTERISTIC
/begin CHARACTERISTIC SigTst_PSPEn_C "Stellertestüberwachung Freigabemaske für Vorförderpumpen  Ausgang" VALUE 0xEF6B7 Kw_Wu8 7.000 OneToOne 0.00 7.000 FORMAT "%5.3" EXTENDED_LIMITS 0.00 255.0 /end CHARACTERISTIC
/begin CHARACTERISTIC SigTst_PSPoverCANEn_C "Enabling the tester signal request." VALUE 0xEF6B8 Kw_Wu8 7.000 OneToOne 0.00 7.000 FORMAT "%5.3" EXTENDED_LIMITS 0.00 255.0 /end CHARACTERISTIC
/begin CHARACTERISTIC SigTst_SYSLAMPEn_C "Stellertestüberwachung Freigabemaske für Systemlampe" VALUE 0xEF6B9 Kw_Wu8 7.000 OneToOne 0.00 7.000 FORMAT "%5.3" EXTENDED_LIMITS 0.00 255.0 /end CHARACTERISTIC
/begin CHARACTERISTIC SigTst_ShuttrEn_C "Stellertestüberwachung Freigabemaske für Kühlerjalousie" VALUE 0xEF6BA Kw_Wu8 7.000 OneToOne 0.00 7.000 FORMAT "%5.3" EXTENDED_LIMITS 0.00 255.0 /end CHARACTERISTIC
/begin CHARACTERISTIC SigTst_TVAEn_C "Stellertestüberwachung Freigabemaske für Drosselklappensteller" VALUE 0xEF6BB Kw_Wu8 7.000 OneToOne 0.00 7.000 FORMAT "%5.3" EXTENDED_LIMITS 0.00 255.0 /end CHARACTERISTIC
/begin CHARACTERISTIC SigTst_VSAEn_C "Stellertestüberwachung Freigabemaske für Drallniveausteller" VALUE 0xEF6BC Kw_Wu8 7.000 OneToOne 0.00 7.000 FORMAT "%5.3" EXTENDED_LIMITS 0.00 255.0 /end CHARACTERISTIC
/begin CHARACTERISTIC SOPTst_stRcyDem_C "#SSD Applizierbares Label, ob Recovery bei fehlerhaftem Abschaltpfadtest ausgelöst werden soll" VALUE 0xEF6BD Kw_Wu8 1.000 OneToOne 0.00 1.000 FORMAT "%5.3" EXTENDED_LIMITS 0.00 255.0 /end CHARACTERISTIC
/begin CHARACTERISTIC SOPTst_stShOffPathActv_C "#SSD aktive Abschaltpfade während der Initialisierung" VALUE 0xEF6BE Kw_Wu8 255.0 OneToOne 0.00 255.0 FORMAT "%5.1" /end CHARACTERISTIC
/begin CHARACTERISTIC SPMon_swtRstStackMon_C "Schalter zum Rücksetzen der Überwachung des maximal benötigten Stacks (1: Stack Überwachung rückgesetzt, 0: nicht Rückgesetzt)" VALUE 0xEF6BF Kw_Wu8 1.000 OneToOne 0.00 1.000 FORMAT "%5.3" EXTENDED_LIMITS 0.00 255.0 /end CHARACTERISTIC
/begin CHARACTERISTIC SrvPmp_facSTWAV_CUR "Korrekturkennlinie (Geschwindigkeit Lenkradwinkel) für den Momentenwunsch der Servopumpe" CURVE 0xEF6C0 Kl_Xs16_Ws16 10.00000 Fact 0.00 10.00000 FORMAT "%8.5" EXTENDED_LIMITS -4.000000 3.999878
 /begin AXIS_DESCR STD_AXIS SrvPmp_dphiStrg_mp AngleGradPerSec 7 -180.0192 180.0192 FORMAT "%8.4" EXTENDED_LIMITS -1440.154 1440.110 DEPOSIT ABSOLUTE /end AXIS_DESCR
/end CHARACTERISTIC
/begin CHARACTERISTIC SrvPmp_facVS_CUR "Korrekturkennlinie (Geschwindigkeit) für den Momentenwunsch der Servopumpe" CURVE 0xEF6DE Kl_Xs16_Ws16 10.00000 Fact 0.00 10.00000 FORMAT "%8.5" EXTENDED_LIMITS -4.000000 3.999878
 /begin AXIS_DESCR STD_AXIS VSSCD_v Vel 7 0.00 300.0000 FORMAT "%8.4" EXTENDED_LIMITS -327.6800 327.6700 DEPOSIT ABSOLUTE /end AXIS_DESCR
/end CHARACTERISTIC
/begin CHARACTERISTIC SrvPmp_rTrans_C "Transmission ratio of SrvPmp" VALUE 0xEF6FC Kw_Ws16 200.0000 TransR 0.00 200.0000 FORMAT "%8.4" EXTENDED_LIMITS -327.6800 327.6700 /end CHARACTERISTIC
/begin CHARACTERISTIC SrvPmp_trqSTWABase_CUR "Basiskennlinie für dem Momentenwunsch der Servopumpe" CURVE 0xEF6FE Kl_Xs16_Ws16 1500.000 Trq -500.0000 1000.000 FORMAT "%8.3" EXTENDED_LIMITS -3276.800 3276.700
 /begin AXIS_DESCR STD_AXIS FrmMng_phiStrg AngleGrad 7 -180.0192 180.0192 FORMAT "%8.4" EXTENDED_LIMITS -1440.154 1440.110 DEPOSIT ABSOLUTE /end AXIS_DESCR
/end CHARACTERISTIC
/begin CHARACTERISTIC SSpMon_DebSRCHighSplyVltgDef1_C "#SSD Fehlerentprellung SRC High für Sensorversorgungsspannung 1" VALUE 0xEF71C Kw_Wu16 655350.0 Time_ms 0.00 655350.0 FORMAT "%8.1" /end CHARACTERISTIC
/begin CHARACTERISTIC SSpMon_DebSRCHighSplyVltgOk1_C "#SSD Heilungsentprellung SRC High für Sensorversorgungsspannung 1" VALUE 0xEF71E Kw_Wu16 655350.0 Time_ms 0.00 655350.0 FORMAT "%8.1" /end CHARACTERISTIC
/begin CHARACTERISTIC SSpMon_DebSRCHighSplyVltgDef2_C "#SSD Fehlerentprellung SRC High für Sensorversorgungsspannung 2" VALUE 0xEF720 Kw_Wu16 655350.0 Time_ms 0.00 655350.0 FORMAT "%8.1" /end CHARACTERISTIC
/begin CHARACTERISTIC SSpMon_DebSRCHighSplyVltgOk2_C "#SSD Heilungsentprellung SRC High für Sensorversorgungsspannung 2" VALUE 0xEF722 Kw_Wu16 655350.0 Time_ms 0.00 655350.0 FORMAT "%8.1" /end CHARACTERISTIC
/begin CHARACTERISTIC SSpMon_DebSRCHighSplyVltgDef3_C "#SSD Fehlerentprellung SRC High für Sensorversorgungsspannung 3" VALUE 0xEF724 Kw_Wu16 655350.0 Time_ms 0.00 655350.0 FORMAT "%8.1" /end CHARACTERISTIC
/begin CHARACTERISTIC SSpMon_DebSRCHighSplyVltgOk3_C "#SSD Heilungsentprellung SRC High für Sensorversorgungsspannung 3" VALUE 0xEF726 Kw_Wu16 655350.0 Time_ms 0.00 655350.0 FORMAT "%8.1" /end CHARACTERISTIC
/begin CHARACTERISTIC SSpMon_DebSRCLowSplyVltgDef1_C "#SSD Defektentprellung SRC Low für Sensorversorgungsspannung 1" VALUE 0xEF728 Kw_Wu16 655350.0 Time_ms 0.00 655350.0 FORMAT "%8.1" /end CHARACTERISTIC
/begin CHARACTERISTIC SSpMon_DebSRCLowSplyVltgOk1_C "#SSD Heilungsentprellung SRC Low für Sensorversorgungsspannung 1" VALUE 0xEF72A Kw_Wu16 655350.0 Time_ms 0.00 655350.0 FORMAT "%8.1" /end CHARACTERISTIC
/begin CHARACTERISTIC SSpMon_DebSRCLowSplyVltgDef2_C "#SSD Defektentprellung SRC Low für Sensorversorgungsspannung 2" VALUE 0xEF72C Kw_Wu16 655350.0 Time_ms 0.00 655350.0 FORMAT "%8.1" /end CHARACTERISTIC
/begin CHARACTERISTIC SSpMon_DebSRCLowSplyVltgOk2_C "#SSD Heilungsentprellung SRC Low für Sensorversorgungsspannung 2" VALUE 0xEF72E Kw_Wu16 655350.0 Time_ms 0.00 655350.0 FORMAT "%8.1" /end CHARACTERISTIC
/begin CHARACTERISTIC SSpMon_DebSRCLowSplyVltgDef3_C "#SSD Defektentprellung SRC Low für Sensorversorgungsspannung 3" VALUE 0xEF730 Kw_Wu16 655350.0 Time_ms 0.00 655350.0 FORMAT "%8.1" /end CHARACTERISTIC
/begin CHARACTERISTIC SSpMon_DebSRCLowSplyVltgOk3_C "#SSD Heilungsentprellung SRC Low für Sensorversorgungsspannung 3" VALUE 0xEF732 Kw_Wu16 655350.0 Time_ms 0.00 655350.0 FORMAT "%8.1" /end CHARACTERISTIC
/begin CHARACTERISTIC SSpMon_numDiaVltg1_C "#SSD Applikationsparameter für diagnose Signal von Sensorversorgungsspannung 1" VALUE 0xEF734 Kw_Wu8 35.0000000000 NumPinDia 0.00 35.0000000000 FORMAT "%13.10" /end CHARACTERISTIC
/begin CHARACTERISTIC SSpMon_numDiaVltg2_C "#SSD Applikationsparameter für diagnose Signal von Sensorversorgungsspannung 2" VALUE 0xEF735 Kw_Wu8 35.0000000000 NumPinDia 0.00 35.0000000000 FORMAT "%13.10" /end CHARACTERISTIC
/begin CHARACTERISTIC SSpMon_numDiaVltg3_C "#SSD Applikationsparameter für diagnose Signal von Sensorversorgungsspannung 3" VALUE 0xEF736 Kw_Wu8 35.0000000000 NumPinDia 0.00 35.0000000000 FORMAT "%13.10" /end CHARACTERISTIC
/begin CHARACTERISTIC StrtCD_ActrDebExcTempDef_C "Fehlerentprellzeit für Übertemperatur" VALUE 0xEF738 Kw_Wu16 655350.0 Time_ms 0.00 655350.0 FORMAT "%8.1" /end CHARACTERISTIC
/begin CHARACTERISTIC StrtCD_ActrDebExcTempOk_C "Fehlerheilzeit für Übertemperatur" VALUE 0xEF73A Kw_Wu16 655350.0 Time_ms 0.00 655350.0 FORMAT "%8.1" /end CHARACTERISTIC
/begin CHARACTERISTIC StrtCD_ActrDebNoLoadDef_C "Fehlerentprellzeit für Drahtbruch" VALUE 0xEF73C Kw_Wu16 655350.0 Time_ms 0.00 655350.0 FORMAT "%8.1" /end CHARACTERISTIC
/begin CHARACTERISTIC StrtCD_ActrDebNoLoadOk_C "Fehlerheilzeit für Drahtbruch" VALUE 0xEF73E Kw_Wu16 655350.0 Time_ms 0.00 655350.0 FORMAT "%8.1" /end CHARACTERISTIC
/begin CHARACTERISTIC StrtCD_ActrDebShrtCBatDef_C "Fehlerentprellzeit KS nach U_Batt" VALUE 0xEF740 Kw_Wu16 655350.0 Time_ms 0.00 655350.0 FORMAT "%8.1" /end CHARACTERISTIC
/begin CHARACTERISTIC StrtCD_ActrDebShrtCBatOk_C "Fehlerheilzeit KS nach U_Batt" VALUE 0xEF742 Kw_Wu16 655350.0 Time_ms 0.00 655350.0 FORMAT "%8.1" /end CHARACTERISTIC
/begin CHARACTERISTIC StrtCD_ActrDebShrtCGndDef_C "Fehlerentprellzeit KS nach Gnd" VALUE 0xEF744 Kw_Wu16 655350.0 Time_ms 0.00 655350.0 FORMAT "%8.1" /end CHARACTERISTIC
/begin CHARACTERISTIC StrtCD_ActrDebShrtCGndOk_C "Fehlerheilzeit KS nach Gnd" VALUE 0xEF746 Kw_Wu16 655350.0 Time_ms 0.00 655350.0 FORMAT "%8.1" /end CHARACTERISTIC
/begin CHARACTERISTIC StrtCD_ctPwrStgOnMax_C "Maximaler Zähler für Powerstage On im Fehlerfall" VALUE 0xEF748 Kw_Wu16 65535.00 OneToOne 0.00 65535.00 FORMAT "%8.2" /end CHARACTERISTIC
/begin CHARACTERISTIC StrtCD_numDia_C "#SSD Auswahl des Diagnosesignals der Startrelayendstufe" VALUE 0xEF74A Kw_Wu8 35.0000000000 NumPinDia 0.00 35.0000000000 FORMAT "%13.10" /end CHARACTERISTIC
/begin CHARACTERISTIC StrtCD_numDioOut_C "#SSD Auswahl des Digitalausgangspins für Starterrelay" VALUE 0xEF74B Kw_Wu8 11.0000000000 NumPinDioOut 0.00 11.0000000000 FORMAT "%13.10" /end CHARACTERISTIC
/begin CHARACTERISTIC StrtCD_stActrInvOut_C "invertiere Starter Relais Steller Ausgang" VALUE 0xEF74C Kw_Wu8 1.000 OneToOne 0.00 1.000 FORMAT "%5.3" EXTENDED_LIMITS 0.00 255.0 /end CHARACTERISTIC
/begin CHARACTERISTIC StrtCD_stPwrStgActrActv_C "Statuswort für Endstufenabschaltung durch den Motorkoordinator" VALUE 0xEF74D Kw_Wu8 255.0 OneToOne 0.00 255.0 FORMAT "%5.1" /end CHARACTERISTIC
/begin CHARACTERISTIC StrtCD_stPwrStgActrDia_C "Statuswort für Endstufendiagnoseabschaltung durch den Motorkoordinator" VALUE 0xEF74E Kw_Wu8 254.0 OneToOne 1.000 255.0 FORMAT "%5.1" EXTENDED_LIMITS 0.00 255.0 /end CHARACTERISTIC
/begin CHARACTERISTIC StrtCD_stSPICtl_C "Schalter ob Endstufe SPI kontrollierbar = 1 oder nicht SPI kontrollierbar = 0" VALUE 0xEF74F Kw_Wu8 1.000 OneToOne 0.00 1.000 FORMAT "%5.3" EXTENDED_LIMITS 0.00 255.0 /end CHARACTERISTIC
/begin CHARACTERISTIC StrtCD_tiBtwTst_C "Zeitabstand, in dem die Endstufe im Fehlerfall getestet wird" VALUE 0xEF750 Kw_Wu16 29980.00 Time_ms 20.00000 30000.00 FORMAT "%8.2" EXTENDED_LIMITS 0.00 655350.0 /end CHARACTERISTIC
/begin CHARACTERISTIC StrtCD_tiPwrStgOn_C "Zeit für welche die Endstufe im Fehlerfall eingeschalten wird (nur nicht SPI kontrolliert)" VALUE 0xEF752 Kw_Wu16 655140.0 Time_ms 0.00 655140.0 FORMAT "%8.1" EXTENDED_LIMITS 0.00 655350.0 /end CHARACTERISTIC
/begin CHARACTERISTIC StSys_DebTrqShutOffDef_C "Fehlerentprellzeit T50shutoff" VALUE 0xEFA74 Kw_Wu16 655350.0 Time_ms 0.00 655350.0 FORMAT "%8.1" /end CHARACTERISTIC
/begin CHARACTERISTIC StSys_DebTrqShutOffOk_C "Heilungsentprellzeit T50shutoff" VALUE 0xEFA76 Kw_Wu16 655350.0 Time_ms 0.00 655350.0 FORMAT "%8.1" /end CHARACTERISTIC
/begin CHARACTERISTIC StSys_facAPSCor_CUR "atmospheric pressure correction factor" CURVE 0xEF758 Kl_Xs16_Ws16 4.000000 Fact 0.00 4.000000 FORMAT "%8.6" EXTENDED_LIMITS -4.000000 3.999878
 /begin AXIS_DESCR STD_AXIS APSCD_pVal Pres_hPa 8 0.00 4000.000 FORMAT "%8.3" EXTENDED_LIMITS -32768.00 32767.00 DEPOSIT ABSOLUTE /end AXIS_DESCR
/end CHARACTERISTIC
/begin CHARACTERISTIC StSys_n2MsWhlLoLim_C "untere kritische Drehzahlgrenze (ZMS-Resonanz)" VALUE 0xEFA80 Kw_Ws16 1000.000 EngN 0.00 1000.000 FORMAT "%8.3" EXTENDED_LIMITS -32768.00 32767.00 /end CHARACTERISTIC
/begin CHARACTERISTIC StSys_n2MsWhlUpOfs_C "Offset for starting trq shutoff" VALUE 0xEFA82 Kw_Ws16 1000.000 EngN 0.00 1000.000 FORMAT "%8.3" EXTENDED_LIMITS -32768.00 32767.00 /end CHARACTERISTIC
/begin CHARACTERISTIC StSys_nAdjMax_C "#SSD Abgleichende-Drehzahl" VALUE 0xEF8C8 Kw_Ws16 65535.00 EngN -32768.00 32767.00 FORMAT "%8.2" /end CHARACTERISTIC
/begin CHARACTERISTIC StSys_nDiseng_C "Anlasserabwurfdrehzahlschwelle" VALUE 0xEF996 Kw_Ws16 6000.000 EngN 0.00 6000.000 FORMAT "%8.3" EXTENDED_LIMITS -32768.00 32767.00 /end CHARACTERISTIC
/begin CHARACTERISTIC StSys_nEngage_C "Anlassereinspurdrehzahlschwelle" VALUE 0xEF998 Kw_Ws16 0.00 EngN 0.00 0.00 FORMAT "%8.2" EXTENDED_LIMITS -32768.00 32767.00 /end CHARACTERISTIC
/begin CHARACTERISTIC StSys_tinFltPT1_C "time constant for the engine speed low pass filter" VALUE 0xEFA84 Kw_Wu32 4294.9673 TimeDelay_s 0.0000010000000 4294.9673 FORMAT "%9.4" /end CHARACTERISTIC
/begin CHARACTERISTIC StSys_nFreezeTrqRmp_C "Rampenbegrenzungsdrehzahl" VALUE 0xEF9A0 Kw_Ws16 65535.00 EngN -32768.00 32767.00 FORMAT "%8.2" /end CHARACTERISTIC
/begin CHARACTERISTIC StSys_nReleaseTrqRmp_C "Rampenfreigabedrehzahl" VALUE 0xEF9A2 Kw_Ws16 65535.00 EngN -32768.00 32767.00 FORMAT "%8.2" /end CHARACTERISTIC
/begin CHARACTERISTIC StSys_nStarter_C "maximale Drehzahl für Start ohne Kl50" VALUE 0xEFA78 Kw_Ws16 6000.000 EngN 0.00 6000.000 FORMAT "%8.3" EXTENDED_LIMITS -32768.00 32767.00 /end CHARACTERISTIC
/begin CHARACTERISTIC StSys_nStrtCutOut_MAP "Kennfeld zur Bestimmung der Startabwurf-Drehzahl" MAP 0xEF820 Kf_Xs16_Ys16_Ws16 6000.000 EngN 0.00 6000.000 FORMAT "%8.3" EXTENDED_LIMITS -32768.00 32767.00
 /begin AXIS_DESCR STD_AXIS StSys_tStrt_mp Temp_Cels 8 -50.14000 899.8600 FORMAT "%8.4" EXTENDED_LIMITS -3549.940 3003.560 DEPOSIT ABSOLUTE /end AXIS_DESCR
 /begin AXIS_DESCR STD_AXIS APSCD_pVal Pres_hPa 8 0.00 3500.000 FORMAT "%8.3" EXTENDED_LIMITS -32768.00 32767.00 DEPOSIT ABSOLUTE /end AXIS_DESCR
/end CHARACTERISTIC
/begin CHARACTERISTIC StSys_nStrtTipMax_MAP "Kennfeld zur bestimmung der Maximalen Startabwurfsdrehzahl - abhängig von der Kühlmitteltemperatur und dem Luftdruck" MAP 0xEF9C4 Kf_Xs16_Ys16_Ws16 6000.000 EngN 0.00 6000.000 FORMAT "%8.3" EXTENDED_LIMITS -32768.00 32767.00
 /begin AXIS_DESCR STD_AXIS Eng_tEng Temp_Cels 8 -50.1400 899.8600 FORMAT "%8.4" EXTENDED_LIMITS -3549.940 3003.560 DEPOSIT ABSOLUTE /end AXIS_DESCR
 /begin AXIS_DESCR STD_AXIS APSCD_pVal Pres_hPa 8 0.00 3500.000 FORMAT "%8.3" EXTENDED_LIMITS -32768.00 32767.00 DEPOSIT ABSOLUTE /end AXIS_DESCR
/end CHARACTERISTIC
/begin CHARACTERISTIC StSys_nStrtTipProtCaS_C "Schwellenwert für Nockenwellensignal für Aktivierung des Blockierschutzes" VALUE 0xEFA68 Kw_Ws16 6000.000 EngN 0.00 6000.000 FORMAT "%8.3" EXTENDED_LIMITS -32768.00 32767.00 /end CHARACTERISTIC
/begin CHARACTERISTIC StSys_nStrtTipProt_C "Drehzahlschwelle für Blockierschutz" VALUE 0xEFA6A Kw_Ws16 6000.000 EngN 0.00 6000.000 FORMAT "%8.3" EXTENDED_LIMITS -32768.00 32767.00 /end CHARACTERISTIC
/begin CHARACTERISTIC StSys_numStrtAddCor_C "Selection of used engine temperature (e.g. CTSCD_tClnt, etc.)" VALUE 0xEF77A Kw_Wu8 2.00000000000 EngTempFldSel 0.00 2.00000000000 FORMAT "%13.11" /end CHARACTERISTIC
/begin CHARACTERISTIC StSys_numStrtRmp_C "Parameter um die gewünschte Motortemperatur aus dem Motortemperatur-Feld Eng_tFld  zu selektieren" VALUE 0xEF9A4 Kw_Wu8 2.00000000000 EngTempFldSel 0.00 2.00000000000 FORMAT "%13.11" /end CHARACTERISTIC
/begin CHARACTERISTIC StSys_numStrt_C "Parameter um die Motortemperatur für den Startabwurf aus dem Motortemperatur-Feld Eng_tFld  zu selektieren" VALUE 0xEF8C4 Kw_Wu8 2.00000000000 EngTempFldSel 0.00 2.00000000000 FORMAT "%13.11" /end CHARACTERISTIC
/begin CHARACTERISTIC Stsys_swtGlwLamp_C "Schalter für Anlasserfreigabe T50 mit Status Glühanzeige (1...glow controll berücksichtigt, 0...Freigabe nur von T50 abhängig)" VALUE 0xEF99A Kw_Wu8 1.000 OneToOne 0.00 1.000 FORMAT "%5.3" EXTENDED_LIMITS 0.00 255.0 /end CHARACTERISTIC
/begin CHARACTERISTIC StSys_swtShOffGearbxRec_C "Schalter für Aktivierung und Deaktivierung der P/N Erkennung (1: keine Erkennung --> Freigabe, 0: Erkennung)" VALUE 0xEFA6C Kw_Wu8 1.000 OneToOne 0.00 1.000 FORMAT "%5.3" EXTENDED_LIMITS 0.00 255.0 /end CHARACTERISTIC
/begin CHARACTERISTIC StSys_swtShutOff_C "Label zum Aktivieren des Tipstart-Pfades (1: aktiviert, 0: deaktiviert)" VALUE 0xEFA88 Kw_Wu8 1.000 OneToOne 0.00 1.000 FORMAT "%5.3" EXTENDED_LIMITS 0.00 255.0 /end CHARACTERISTIC
/begin CHARACTERISTIC StSys_swtStrtTipActv_C "Schalter für Tip-Start Funktion aktiviert (1...aktiviert, 0...deaktiviert)" VALUE 0xEFA6D Kw_Wu8 1.000 OneToOne 0.00 1.000 FORMAT "%5.3" EXTENDED_LIMITS 0.00 255.0 /end CHARACTERISTIC
/begin CHARACTERISTIC StSys_tClntHi_C "Temperaturschwelle Motor warm -> heiß" VALUE 0xEF9A6 Kw_Ws16 950.000 Temp_Cels -50.14000 899.860 FORMAT "%8.3" EXTENDED_LIMITS -3549.940 3003.560 /end CHARACTERISTIC
/begin CHARACTERISTIC StSys_tClntLo_C "Temperaturschwelle Motor kalt -> warm" VALUE 0xEF9A8 Kw_Ws16 950.000 Temp_Cels -50.14000 899.860 FORMAT "%8.3" EXTENDED_LIMITS -3549.940 3003.560 /end CHARACTERISTIC
/begin CHARACTERISTIC StSys_ti2MsWhlPrt_C "Verzögerungszeit Startmomentenabschaltung" VALUE 0xEFA8A Kw_Wu16 655350.0 Time_ms 0.00 655350.0 FORMAT "%8.1" /end CHARACTERISTIC
/begin CHARACTERISTIC StSys_tiEngageCutOut_C "Ausblendzeit nEng-ueberwachung bei Start" VALUE 0xEFA7A Kw_Wu16 655350.0 Time_ms 0.00 655350.0 FORMAT "%8.1" /end CHARACTERISTIC
/begin CHARACTERISTIC StSys_tiEngTempValid_C "Verzögerungszeit bis Motortemperatur gueltig" VALUE 0xEF9AA Kw_Wu16 655350.0 Time_ms 0.00 655350.0 FORMAT "%8.1" /end CHARACTERISTIC
/begin CHARACTERISTIC StSys_tiLckCutOut_C "ausblendzeit nEng ueberwachung bei start" VALUE 0xEF99C Kw_Wu16 655350.0 Time_ms 0.00 655350.0 FORMAT "%8.1" /end CHARACTERISTIC
/begin CHARACTERISTIC StSys_tiStartOszilDef_C "Defect time for pulsation error" VALUE 0xEFA8C Kw_Wu16 655350.0 Time_ms 0.00 655350.0 FORMAT "%8.1" /end CHARACTERISTIC
/begin CHARACTERISTIC StSys_tiStartOszilOk_C "Healing time for pulsation error" VALUE 0xEFA8E Kw_Wu16 655350.0 Time_ms 0.00 655350.0 FORMAT "%8.1" /end CHARACTERISTIC
/begin CHARACTERISTIC StSys_tiStrtCutOut_C "Startabwurf-Sperrzeit" VALUE 0xEF8C6 Kw_Wu16 655350.0 Time_ms 0.00 655350.0 FORMAT "%8.1" /end CHARACTERISTIC
/begin CHARACTERISTIC StSys_tiStrtLck_C "Anlassersperrzeit nach startabbruch" VALUE 0xEF754 Kw_Wu16 655350.0 Time_ms 0.00 655350.0 FORMAT "%8.1" /end CHARACTERISTIC
/begin CHARACTERISTIC StSys_tiStrtMax_C "max. Starterbetaetigungszeit" VALUE 0xEF756 Kw_Wu16 655350.0 Time_ms 0.00 655350.0 FORMAT "%8.1" /end CHARACTERISTIC
/begin CHARACTERISTIC StSys_tiStrtTipMin_C "min. Zeit für gedrueckten Startknopf" VALUE 0xEFA6E Kw_Wu16 655350.0 Time_ms 0.00 655350.0 FORMAT "%8.1" /end CHARACTERISTIC
/begin CHARACTERISTIC StSys_tiStrtTipNoMonitor_C "Zeitschwelle für nicht überwachte Drehzahl" VALUE 0xEFA70 Kw_Wu16 655350.0 Time_ms 0.00 655350.0 FORMAT "%8.1" /end CHARACTERISTIC
/begin CHARACTERISTIC StSys_tiStrtTipProt_C "Zeitschwelle für Drehzahl-Blockierschutz" VALUE 0xEFA72 Kw_Wu16 655350.0 Time_ms 0.00 655350.0 FORMAT "%8.1" /end CHARACTERISTIC
/begin CHARACTERISTIC StSys_trqAdjMax_C "maximales Moment fuer den Startabgleich" VALUE 0xEF8CA Kw_Ws16 6553.500 Trq -3276.800 3276.700 FORMAT "%8.3" /end CHARACTERISTIC
/begin CHARACTERISTIC StSys_trqAdjVal_C "Abgleichwert fuer das Startmoment" VALUE 0xEF8CC Kw_Ws16 6553.500 Trq -3276.800 3276.700 FORMAT "%8.3" /end CHARACTERISTIC
/begin CHARACTERISTIC StSys_dtrqColdInc_C "Momentinkrement fuer kalten Motor" VALUE 0xEF9AC Kw_Wu32 6553599.99847 RmpTrq 0.00 6553599.99847 FORMAT "%13.5" /end CHARACTERISTIC
/begin CHARACTERISTIC StSys_tiColdRmpLck_C "Rampensperrzeit fur kalten Motor" VALUE 0xEF9B0 Kw_Wu16 655350.0 Time_ms 0.00 655350.0 FORMAT "%8.1" /end CHARACTERISTIC
/begin CHARACTERISTIC StSys_trqColdLim_C "Grenzmoment fuer kalten Motor" VALUE 0xEF9B2 Kw_Ws16 3276.700 Trq 0.00 3276.700 FORMAT "%8.3" EXTENDED_LIMITS -3276.800 3276.700 /end CHARACTERISTIC
/begin CHARACTERISTIC StSys_dtrqHotInc_C "Momentinkrement fuer heißen Motor" VALUE 0xEF9B4 Kw_Wu32 6553599.99847 RmpTrq 0.00 6553599.99847 FORMAT "%13.5" /end CHARACTERISTIC
/begin CHARACTERISTIC StSys_tiHotRmpLck_C "Rampensperrzeit fur heißen Motor" VALUE 0xEF9B8 Kw_Wu16 655350.0 Time_ms 0.00 655350.0 FORMAT "%8.1" /end CHARACTERISTIC
/begin CHARACTERISTIC StSys_trqHotLim_C "Grenzmoment fuer heißen Motor" VALUE 0xEF9BA Kw_Ws16 3276.700 Trq 0.00 3276.700 FORMAT "%8.3" EXTENDED_LIMITS -3276.800 3276.700 /end CHARACTERISTIC
/begin CHARACTERISTIC StSys_trqStrtAPSCor_MAP " Base map for correction for starting torque" MAP 0xEF77C Kf_Xs16_Ys16_Ws16 240.0000 Trq -40.10000 199.9000 FORMAT "%8.4" EXTENDED_LIMITS -3276.800 3276.700
 /begin AXIS_DESCR STD_AXIS Eng_nAvrg EngN 8 0.00 6000.000 FORMAT "%8.3" EXTENDED_LIMITS -32768.00 32767.00 DEPOSIT ABSOLUTE /end AXIS_DESCR
 /begin AXIS_DESCR STD_AXIS StSys_tStrtBas_mp Temp_Cels 8 -50.140 899.860 FORMAT "%8.3" EXTENDED_LIMITS -3549.940 3003.560 DEPOSIT ABSOLUTE /end AXIS_DESCR
/end CHARACTERISTIC
/begin CHARACTERISTIC StSys_trqStrtBas_MAP "Basismoment fuer den Start" MAP 0xEF8CE Kf_Xs16_Ys16_Ws16 3276.700 Trq 0.00 3276.700 FORMAT "%8.3" EXTENDED_LIMITS -3276.800 3276.700
 /begin AXIS_DESCR STD_AXIS Eng_nAvrg EngN 8 0.00 6000.000 FORMAT "%8.3" EXTENDED_LIMITS -32768.00 32767.00 DEPOSIT ABSOLUTE /end AXIS_DESCR
 /begin AXIS_DESCR STD_AXIS StSys_tStrtBas_mp Temp_Cels 10 -50.14000 199.8600 FORMAT "%8.4" EXTENDED_LIMITS -3549.940 3003.560 DEPOSIT ABSOLUTE /end AXIS_DESCR
/end CHARACTERISTIC
/begin CHARACTERISTIC StSys_dtrqWarmInc_C "Momentinkrement fuer warmen Motor" VALUE 0xEF9BC Kw_Wu32 6553599.99847 RmpTrq 0.00 6553599.99847 FORMAT "%13.5" /end CHARACTERISTIC
/begin CHARACTERISTIC StSys_tiWarmRmpLck_C "Rampensperrzeit fur warmen Motor" VALUE 0xEF9C0 Kw_Wu16 655350.0 Time_ms 0.00 655350.0 FORMAT "%8.1" /end CHARACTERISTIC
/begin CHARACTERISTIC StSys_trqWarmLim_C "Grenzmoment fuer warmen Motor" VALUE 0xEF9C2 Kw_Ws16 3276.700 Trq 0.00 3276.700 FORMAT "%8.3" EXTENDED_LIMITS -3276.800 3276.700 /end CHARACTERISTIC
/begin CHARACTERISTIC StSys_vThres_C "Geschw.grenze Fzg. wird angeschoben" VALUE 0xEFA7C Kw_Ws16 251.0000 Vel -1.000000 250.0000 FORMAT "%8.4" EXTENDED_LIMITS -327.6800 327.6700 /end CHARACTERISTIC
/begin CHARACTERISTIC T15CD_tiDebNeg_C "#SSD Filterzeitkonstante der Klemme 15 für fallende Flanken" VALUE 0xEFA90 Kw_Wu16 655350.0 TimeDeb 0.00 655350.0 FORMAT "%8.1" /end CHARACTERISTIC
/begin CHARACTERISTIC T15CD_tiDebPos_C "#SSD Filterzeitkonstante der Klemme 15 für steigende Flanken" VALUE 0xEFA92 Kw_Wu16 655350.0 TimeDeb 0.00 655350.0 FORMAT "%8.1" /end CHARACTERISTIC
/begin CHARACTERISTIC T15CD_DebNplDef_C "Fehlerentprellzeit für Plausibilitätsfehler" VALUE 0xEFA94 Kw_Wu16 655350.0 Time_ms 0.00 655350.0 FORMAT "%8.1" /end CHARACTERISTIC
/begin CHARACTERISTIC T15CD_DebNplOk_C "Heilungsentprellzeit für Plausibilitätsfehler" VALUE 0xEFA96 Kw_Wu16 655350.0 Time_ms 0.00 655350.0 FORMAT "%8.1" /end CHARACTERISTIC
/begin CHARACTERISTIC T15CD_numDioIn_C "#SSD Applikationsparameter fuer Klemme 15" VALUE 0xEFA98 Kw_Wu8 14.0000000000 NumPinDioIn 0.00 14.0000000000 FORMAT "%13.10" /end CHARACTERISTIC
/begin CHARACTERISTIC T15CD_stInvIn_C "Invertierungsparameter für Klemme 15 Eingangssignal" VALUE 0xEFA99 Kw_Wu8 1.000 OneToOne 0.00 1.000 FORMAT "%5.3" EXTENDED_LIMITS 0.00 255.0 READ_ONLY /end CHARACTERISTIC
/begin CHARACTERISTIC T15CD_tiDebWakeUp_C "Maximale Zeitverzögerung zwischen pos.Flankedesentprellen WakeUp Signals und Klemme15 über CAN" VALUE 0xEFA9A Kw_Wu16 655350.0 Time_ms 0.00 655350.0 FORMAT "%8.1" /end CHARACTERISTIC
/begin CHARACTERISTIC T50CD_tiDebNeg_C "Entprellzeit  fallende Flanke" VALUE 0xEFA9C Kw_Wu16 655350.0 TimeDeb 0.00 655350.0 FORMAT "%8.1" /end CHARACTERISTIC
/begin CHARACTERISTIC T50CD_tiDebPos_C "entprellzeit steigende Flanke" VALUE 0xEFA9E Kw_Wu16 655350.0 TimeDeb 0.00 655350.0 FORMAT "%8.1" /end CHARACTERISTIC
/begin CHARACTERISTIC T50CD_stDflVal_C "Vorgabewert Zustand T50" VALUE 0xEFAA0 Kw_Wu8 1.000 OneToOne 0.00 1.000 FORMAT "%5.3" EXTENDED_LIMITS 0.00 255.0 /end CHARACTERISTIC
/begin CHARACTERISTIC T50CD_stInv_C "Invertierung Eingangssignal T50CD_stRawVal" VALUE 0xEFAA1 Kw_Wu8 1.000 OneToOne 0.00 1.000 FORMAT "%5.3" EXTENDED_LIMITS 0.00 255.0 /end CHARACTERISTIC
/begin CHARACTERISTIC T50CD_swtSigVal_C "Signalschalter T50 (1=CAN 0=HW)" VALUE 0xEFAA2 Kw_Wu8 1.000 OneToOne 0.00 1.000 FORMAT "%5.3" EXTENDED_LIMITS 0.00 255.0 /end CHARACTERISTIC
/begin CHARACTERISTIC ThrVlv_rTVA_Vector "#SSD Bypass-Label für ThrVlv_rTVA" VALUE 0xC3160 Kw_Wu8 255.0 OneToOne 0.00 255.0 FORMAT "%5.1" /end CHARACTERISTIC
/begin CHARACTERISTIC ThrVlv_rTVA_Channel "#SSD Bypass-Label für ThrVlv_rTVA" VALUE 0xC3161 Kw_Wu8 255.0 OneToOne 0.00 255.0 FORMAT "%5.1" /end CHARACTERISTIC
/begin CHARACTERISTIC TPUMon_ctDfctLim_C "#SSD Oberer Entprellzähler Grenzwert für Defekterkennung" VALUE 0xC33D4 Kw_Wu16 65535.00 OneToOne 0.00 65535.00 FORMAT "%8.2" /end CHARACTERISTIC
/begin CHARACTERISTIC TPUMon_ctTPU_C "Index der auf den Messpunkten dargestellten TPU" VALUE 0xC33D6 Kw_Wu8 255.0 OneToOne 0.00 255.0 FORMAT "%5.1" /end CHARACTERISTIC
/begin CHARACTERISTIC TPUMon_tiDiffMaxLimit_C "#SSD Maximal zulässige einzelne Timerdifferenz" VALUE 0xC33D8 Kw_Ws32 2147483647.00 TimeUSResolution 0.00 2147483647.00 FORMAT "%13.2" EXTENDED_LIMITS -2147483648.00 2147483647.00 /end CHARACTERISTIC
/begin CHARACTERISTIC TPUMon_tiDiffMinLimit_C "#SSD Minimal zulässige einzelne Timerdifferenz (negativer Wert)" VALUE 0xC33DC Kw_Ws32 2147483648.00 TimeUSResolution -2147483648.00 0.00 FORMAT "%13.2" EXTENDED_LIMITS -2147483648.00 2147483647.00 /end CHARACTERISTIC
/begin CHARACTERISTIC TPUMon_tiDiffSumLimit_C "#SSD Maximal zulässige Betragsumme Timerdifferenz" VALUE 0xC33E0 Kw_Ws32 2147483647.00 TimeUSResolution 0.00 2147483647.00 FORMAT "%13.2" EXTENDED_LIMITS -2147483648.00 2147483647.00 /end CHARACTERISTIC
/begin CHARACTERISTIC TVACD_ctPwrStgOnMax_C "Maximaler Zähler für Powerstage On im Fehlerfall" VALUE 0xEFAA4 Kw_Wu16 65535.00 OneToOne 0.00 65535.00 FORMAT "%8.2" /end CHARACTERISTIC
/begin CHARACTERISTIC TVACD_DebExcTempDef_C "Fehlerentprellzeit für Übertemperatur" VALUE 0xEFAA6 Kw_Wu16 655350.0 Time_ms 0.00 655350.0 FORMAT "%8.1" /end CHARACTERISTIC
/begin CHARACTERISTIC TVACD_DebExcTempOk_C "Heilungsentprellzeit für Übertemperatur" VALUE 0xEFAA8 Kw_Wu16 655350.0 Time_ms 0.00 655350.0 FORMAT "%8.1" /end CHARACTERISTIC
/begin CHARACTERISTIC TVACD_DebNoLoadDef_C "Fehlerentprellzeit für Lastabfall" VALUE 0xEFAAA Kw_Wu16 655350.0 Time_ms 0.00 655350.0 FORMAT "%8.1" /end CHARACTERISTIC
/begin CHARACTERISTIC TVACD_DebNoLoadOk_C "Heilungsentprellzeit für Lastabfall" VALUE 0xEFAAC Kw_Wu16 655350.0 Time_ms 0.00 655350.0 FORMAT "%8.1" /end CHARACTERISTIC
/begin CHARACTERISTIC TVACD_DebShortCircBatDef_C "Fehlerentprellzeit für Kurzschluß nach Batterie" VALUE 0xEFAAE Kw_Wu16 655350.0 Time_ms 0.00 655350.0 FORMAT "%8.1" /end CHARACTERISTIC
/begin CHARACTERISTIC TVACD_DebShortCircBatOk_C "Heilungsentprellzeit für Kurzschluß nach Batterie" VALUE 0xEFAB0 Kw_Wu16 655350.0 Time_ms 0.00 655350.0 FORMAT "%8.1" /end CHARACTERISTIC
/begin CHARACTERISTIC TVACD_DebShortCircGndDef_C "Fehlerentprellzeit für Kurzschluß nach Masse" VALUE 0xEFAB2 Kw_Wu16 655350.0 Time_ms 0.00 655350.0 FORMAT "%8.1" /end CHARACTERISTIC
/begin CHARACTERISTIC TVACD_DebShortCircGndOk_C "Heilungsentprellzeit für Kurzschluß nach Masse" VALUE 0xEFAB4 Kw_Wu16 655350.0 Time_ms 0.00 655350.0 FORMAT "%8.1" /end CHARACTERISTIC
/begin CHARACTERISTIC TVACD_tiDebTVADia1Def_C "Fehlerentprellzeit für Drosselklappenstellers Diagnose erstes Zeitfenster" VALUE 0xEFAB6 Kw_Wu16 655350.0 Time_ms 0.00 655350.0 FORMAT "%8.1" /end CHARACTERISTIC
/begin CHARACTERISTIC TVACD_tiDebTVADia1Ok_C "Fehlerheilzeit für Drosselklappenstellers Diagnose erstes Zeitfenster" VALUE 0xEFAB8 Kw_Wu16 655350.0 Time_ms 0.00 655350.0 FORMAT "%8.1" /end CHARACTERISTIC
/begin CHARACTERISTIC TVACD_tiDebTVADia2Def_C "Fehlerentprellzeit für Drosselklappenstellers Diagnose zweites Zeitfenster" VALUE 0xEFABA Kw_Wu16 655350.0 Time_ms 0.00 655350.0 FORMAT "%8.1" /end CHARACTERISTIC
/begin CHARACTERISTIC TVACD_tiDebTVADia2Ok_C "Fehlerheilzeit für Drosselklappenstellers Diagnose zweites Zeitfenster" VALUE 0xEFABC Kw_Wu16 655350.0 Time_ms 0.00 655350.0 FORMAT "%8.1" /end CHARACTERISTIC
/begin CHARACTERISTIC TVACD_tiDebTVADia3Def_C "Fehlerentprellzeit für Drosselklappenstellers Diagnose drittes Zeitfenster" VALUE 0xEFABE Kw_Wu16 655350.0 Time_ms 0.00 655350.0 FORMAT "%8.1" /end CHARACTERISTIC
/begin CHARACTERISTIC TVACD_tiDebTVADia3Ok_C "Fehlerheilzeit für Drosselklappenstellers Diagnose drittes Zeitfenster" VALUE 0xEFAC0 Kw_Wu16 655350.0 Time_ms 0.00 655350.0 FORMAT "%8.1" /end CHARACTERISTIC
/begin CHARACTERISTIC TVACD_tiDebTVADia4Def_C "Fehlerentprellzeit für Drosselklappensteller Diagnose viertes Zeitfenster" VALUE 0xEFAC2 Kw_Wu16 655350.0 Time_ms 0.00 655350.0 FORMAT "%8.1" /end CHARACTERISTIC
/begin CHARACTERISTIC TVACD_tiDebTVADia4Ok_C "Heilentprellzeit  für Drosselklappensteller Diagnose viertes Zeitfenster" VALUE 0xEFAC4 Kw_Wu16 655350.0 Time_ms 0.00 655350.0 FORMAT "%8.1" /end CHARACTERISTIC
/begin CHARACTERISTIC TVACD_numDia_C "#SSD Applikationsparameter fuer Diagnose-Signal von Drossel-Steller" VALUE 0xEFAC6 Kw_Wu8 35.0000000000 NumPinDia 0.00 35.0000000000 FORMAT "%13.10" /end CHARACTERISTIC
/begin CHARACTERISTIC TVACD_numPwmOut_C "#SSD Applikationsparameter fuer Drosselwert-Steller" VALUE 0xEFAC7 Kw_Wu8 13.0000000000 NumPinPwmOut 0.00 13.0000000000 FORMAT "%13.10" /end CHARACTERISTIC
/begin CHARACTERISTIC TVACD_stInvOut_C "Invertierungsparameter für das Signal der Drosselklappenstellerendstufe" VALUE 0xEFAC8 Kw_Wu8 1.000 OneToOne 0.00 1.000 FORMAT "%5.3" EXTENDED_LIMITS 0.00 255.0 /end CHARACTERISTIC
/begin CHARACTERISTIC TVACD_tiPer_C "Periodendauer Drosselklappensteller" VALUE 0xEFACA Kw_Ws16 6553.500 Period -3276.800 3276.700 FORMAT "%8.3" /end CHARACTERISTIC
/begin CHARACTERISTIC TVACD_rCnv_CUR "Kennlinie zur konvertierung von Öffnungsgrad in Tastverhältnis" CURVE 0xEFACC Kl_Xs16_Ws16 100.0000 DtyCyc 0.00 100.0000 FORMAT "%8.4" EXTENDED_LIMITS -327.6800 327.6700
 /begin AXIS_DESCR STD_AXIS ThrVlv_rTVA Prc 25 -100.0000 200.0000 FORMAT "%8.4" EXTENDED_LIMITS -400.0000 399.9878 DEPOSIT ABSOLUTE /end AXIS_DESCR
/end CHARACTERISTIC
/begin CHARACTERISTIC TVACD_rOutMax_C "Maximal auszugebendes Tastverhältnis" VALUE 0xEFB32 Kw_Ws16 655.3500 DtyCyc -327.6800 327.6700 FORMAT "%8.4" /end CHARACTERISTIC
/begin CHARACTERISTIC TVACD_rOutMin_C "Minimal auszugebendes Tastverhältnis" VALUE 0xEFB34 Kw_Ws16 655.3500 DtyCyc -327.6800 327.6700 FORMAT "%8.4" /end CHARACTERISTIC
/begin CHARACTERISTIC TVACD_rTst_C "Tastverhältnis, dass im Fehlerfall zyklisch ausgegeben wird" VALUE 0xEFB36 Kw_Ws16 100.0000 DtyCyc 0.00 100.0000 FORMAT "%8.4" EXTENDED_LIMITS -327.6800 327.6700 /end CHARACTERISTIC
/begin CHARACTERISTIC TVACD_stPwrStgActv_C "Aktivierung der Abschaltbedingungen der Endstufe" VALUE 0xEFB38 Kw_Wu8 255.0 OneToOne 0.00 255.0 FORMAT "%5.1" /end CHARACTERISTIC
/begin CHARACTERISTIC TVACD_stPwrStgDia_C "Aktivierung der Abschaltbedingungen der Endstufendiagnose" VALUE 0xEFB39 Kw_Wu8 255.0 OneToOne 0.00 255.0 FORMAT "%5.1" /end CHARACTERISTIC
/begin CHARACTERISTIC TVACD_stSPICtl_C "0 = Non SPI powerstage )" VALUE 0xEFB3A Kw_Wu8 1.000 OneToOne 0.00 1.000 FORMAT "%5.3" EXTENDED_LIMITS 0.00 255.0 /end CHARACTERISTIC
/begin CHARACTERISTIC TVACD_swt_C "Schalter Batteriespannungskorrektur (0 = AUS, 1 = EIN)" VALUE 0xEFB3B Kw_Wu8 255.0 OneToOne 0.00 255.0 FORMAT "%5.1" /end CHARACTERISTIC
/begin CHARACTERISTIC TVACD_tiBtwTst_C "Zeitabstand, in dem im Fehlerfall die Endstufe getestet wird" VALUE 0xEFB3C Kw_Wu16 29980.00 Time_ms 20.00000 30000.00 FORMAT "%8.2" EXTENDED_LIMITS 0.00 655350.0 /end CHARACTERISTIC
/begin CHARACTERISTIC TVACD_tiDiag1Max_C "Maximum des ersten Signalfensters für Fehlersignale des Drosselklappensteller" VALUE 0xEFB3E Kw_Wu16 655350.0 Time_ms 0.00 655350.0 FORMAT "%8.1" /end CHARACTERISTIC
/begin CHARACTERISTIC TVACD_tiDiag1Min_C "Minimum des ersten Signalfensters für Fehlersignale des Drosselklappensteller" VALUE 0xEFB40 Kw_Wu16 655350.0 Time_ms 0.00 655350.0 FORMAT "%8.1" /end CHARACTERISTIC
/begin CHARACTERISTIC TVACD_tiDiag2Max_C "Maximum des zweiten Signalfensters für Fehlersignale des Drosselklappensteller" VALUE 0xEFB42 Kw_Wu16 655350.0 Time_ms 0.00 655350.0 FORMAT "%8.1" /end CHARACTERISTIC
/begin CHARACTERISTIC TVACD_tiDiag2Min_C "Minimum des zweiten Signalfensters für Fehlersignale des Drosselklappensteller" VALUE 0xEFB44 Kw_Wu16 655350.0 Time_ms 0.00 655350.0 FORMAT "%8.1" /end CHARACTERISTIC
/begin CHARACTERISTIC TVACD_tiDiag3Max_C "Maximum des dritten Signalfensters für Fehlersignale des Drosselklappensteller" VALUE 0xEFB46 Kw_Wu16 655350.0 Time_ms 0.00 655350.0 FORMAT "%8.1" /end CHARACTERISTIC
/begin CHARACTERISTIC TVACD_tiDiag3Min_C "Minimum des dritten Signalfensters für Fehlersignale des Drosselklappensteller" VALUE 0xEFB48 Kw_Wu16 655350.0 Time_ms 0.00 655350.0 FORMAT "%8.1" /end CHARACTERISTIC
/begin CHARACTERISTIC TVACD_tiDiag4Max_C "Maximum des vierten Signalfensters für Fehlersignale des Drosselklappenstellers" VALUE 0xEFB4A Kw_Wu16 655350.0 Time_ms 0.00 655350.0 FORMAT "%8.1" /end CHARACTERISTIC
/begin CHARACTERISTIC TVACD_tiDiag4Min_C "Minimum des vierten Signalfensters für Fehlersignale des Drosselklappenstellers" VALUE 0xEFB4C Kw_Wu16 655350.0 Time_ms 0.00 655350.0 FORMAT "%8.1" /end CHARACTERISTIC
/begin CHARACTERISTIC TVACD_tiPwrStgOn_C "Zeit für welche die Endstufe im Fehlerfall eingeschalten wird (nur nicht SPI kontrolliert)" VALUE 0xEFB4E Kw_Wu16 655140.0 Time_ms 0.00 655140.0 FORMAT "%8.1" EXTENDED_LIMITS 0.00 655350.0 /end CHARACTERISTIC
/begin CHARACTERISTIC UAddr_stCalibration_C "#SSD ECU Applikationszugriff (0 = unterbunden, 1 = erlaubt)" VALUE 0xC0AE2 Kw_Wu8 1.000 OneToOne 0.00 1.000 FORMAT "%5.3" EXTENDED_LIMITS 0.00 255.0 /end CHARACTERISTIC
/begin CHARACTERISTIC Uaddr_stMeasurement_C "ECU Messzugriff (0 = unterbunden, 1 = erlaubt)" VALUE 0xC0AE3 Kw_Wu8 1.000 OneToOne 0.00 1.000 FORMAT "%5.3" EXTENDED_LIMITS 0.00 255.0 /end CHARACTERISTIC
/begin CHARACTERISTIC USAp_dDataVariantIdInv_C "Identifier dieser Datensatzvariante (invertiert)" VALUE 0xEFB50 Kw_Wu32 4294967295.00 OneToOne 0.00 4294967295.00 FORMAT "%13.2" /end CHARACTERISTIC
/begin CHARACTERISTIC USAp_dDataVariantId_C "Identifier dieser Datensatzvariante" VALUE 0xEFB54 Kw_Wu32 4294967295.00 OneToOne 0.00 4294967295.00 FORMAT "%13.2" /end CHARACTERISTIC
/begin CHARACTERISTIC UsrDa_swtFDC_C "Schalter zur Auswahl des FDC-Sportmoduseingriffs" VALUE 0xEFB58 Kw_Wu8 255.0 OneToOne 0.00 255.0 FORMAT "%5.1" /end CHARACTERISTIC
/begin CHARACTERISTIC VehDa_lEepUpd_C "#SSD Streckenintervall zwischen zwei EEPROM Block Updates für Vehicle Data (VehDa_lSum, VehDa_tiEngOn)" VALUE 0xEFB84 Kw_Wu32 4294957295.00 Length 10000.0000000 4294967295.00 FORMAT "%13.2" EXTENDED_LIMITS 0.00 4294967295.00 /end CHARACTERISTIC
/begin CHARACTERISTIC VehDa_nLoadActv_C "Drehzahlschwelle zur Erfassung des Fahrzeugnutzungsprofils" VALUE 0xEFB68 Kw_Ws16 6000.000 EngN 0.00 6000.000 FORMAT "%8.3" EXTENDED_LIMITS -32768.00 32767.00 /end CHARACTERISTIC
/begin CHARACTERISTIC VehDa_nLoad_C "Stützstellen der x-Achse (Drehzahl) des Fahrzeugnutzungsprofils" VAL_BLK 0xEFB6A Kwb_Ws16 6000.000 EngN 0.00 6000.000 FORMAT "%8.3" EXTENDED_LIMITS -32768.00 32767.00 NUMBER 7 /end CHARACTERISTIC
/begin CHARACTERISTIC VehDa_nMaxEepUpd_C "Maximale Motordrehzahl für Update EEPROM Block (VehDa_lSum, VehDa_tiEngOn)" VALUE 0xEFB88 Kw_Ws16 6000.000 EngN 0.00 6000.000 FORMAT "%8.3" EXTENDED_LIMITS -32768.00 32767.00 /end CHARACTERISTIC
/begin CHARACTERISTIC VehDa_nMinEepUpd_C "Minimale Motordrehzahl für Update EEPROM Block (VehDa_lSum, VehDa_tiEngOn)" VALUE 0xEFB8A Kw_Ws16 5000.000 EngN 1000.000 6000.000 FORMAT "%8.3" EXTENDED_LIMITS -32768.00 32767.00 /end CHARACTERISTIC
/begin CHARACTERISTIC VehDa_rVnMax_C "maximales v/n-Verhältnis" VALUE 0xEFB5C Kw_Ws16 0.3276700 VelToN 0.00 0.3276700 FORMAT "%9.7" EXTENDED_LIMITS -0.3276800 0.3276700 /end CHARACTERISTIC
/begin CHARACTERISTIC VehDa_swtRst_C "Schalter zum Rücksetzen von VehDa_ctLoadSecRowX_mp[X], VehDa_tiLoadSec_mp und der entsprechenden EEPROM-Werte" VALUE 0xEFB78 Kw_Wu8 1.000 OneToOne 0.00 1.000 FORMAT "%5.3" EXTENDED_LIMITS 0.00 255.0 /end CHARACTERISTIC
/begin CHARACTERISTIC VehDa_tiNPT1_C "T1 Zeitkonstante zur Vorfilterung der Motordrehzahl für v/n-Verhältnis" VALUE 0xEFB60 Kw_Wu32 4294.9673 TimeDelay_s 0.0000010000000 4294.9673 FORMAT "%9.4" /end CHARACTERISTIC
/begin CHARACTERISTIC VehDa_tiVnPT1_C "T1 Zeitkonstante zur Filterung des v/n-Verhältnisses" VALUE 0xEFB64 Kw_Wu32 4294.9673 TimeDelay_s 0.0000010000000 4294.9673 FORMAT "%9.4" /end CHARACTERISTIC
/begin CHARACTERISTIC VehDa_trqLoad_C "Stützstellen der y-Achse (Drehmoment) des Fahrzeugnutzungsprofils" VAL_BLK 0xEFB7A Kwb_Ws16 1500.000 Trq -500.0000 1000.000 FORMAT "%8.3" EXTENDED_LIMITS -3276.800 3276.700 NUMBER 5 /end CHARACTERISTIC
/begin CHARACTERISTIC VSACD_ctPwrStgOnMax_C "Maximaler Zähler für Powerstage On im Fehlerfall" VALUE 0xEFB8C Kw_Wu16 65535.00 OneToOne 0.00 65535.00 FORMAT "%8.2" /end CHARACTERISTIC
/begin CHARACTERISTIC VSACD_tiDebDioInDia1Def_C "Fehlerentprellzeit für Kurzschluss nach digital eingabe für Window1" VALUE 0xEFB8E Kw_Wu16 655350.0 Time_ms 0.00 655350.0 FORMAT "%8.1" /end CHARACTERISTIC
/begin CHARACTERISTIC VSACD_tiDebDioInDia1Ok_C "Heilungsentprellzeit für kurzschluss nach digital eingabe für window1" VALUE 0xEFB90 Kw_Wu16 655350.0 Time_ms 0.00 655350.0 FORMAT "%8.1" /end CHARACTERISTIC
/begin CHARACTERISTIC VSACD_tiDebDioInDia2Def_C "Fehlerentprellzeit für Kurzschluss nach digital eingabe für Window2" VALUE 0xEFB92 Kw_Wu16 655350.0 Time_ms 0.00 655350.0 FORMAT "%8.1" /end CHARACTERISTIC
/begin CHARACTERISTIC VSACD_tiDebDioInDia2Ok_C "Heilungsentprellzeit für kurzschluss nach digital eingabe für window2" VALUE 0xEFB94 Kw_Wu16 655350.0 Time_ms 0.00 655350.0 FORMAT "%8.1" /end CHARACTERISTIC
/begin CHARACTERISTIC VSACD_tiDebDioInDia3Def_C "Fehlerentprellzeit für Kurzschluss nach digital eingabe für Window3" VALUE 0xEFB96 Kw_Wu16 655350.0 Time_ms 0.00 655350.0 FORMAT "%8.1" /end CHARACTERISTIC
/begin CHARACTERISTIC VSACD_tiDebDioInDia3Ok_C "Heilungsentprellzeit für kurzschluss nach digital eingabe für window3" VALUE 0xEFB98 Kw_Wu16 655350.0 Time_ms 0.00 655350.0 FORMAT "%8.1" /end CHARACTERISTIC
/begin CHARACTERISTIC VSACD_tiDebDioInDia4Def_C "Fehlerentprellzeit für Kurzschluss nach digital eingabe für Window4" VALUE 0xEFB9A Kw_Wu16 655350.0 Time_ms 0.00 655350.0 FORMAT "%8.1" /end CHARACTERISTIC
/begin CHARACTERISTIC VSACD_tiDebDioInDia4Ok_C "Heilungsentprellzeit für kurzschluss nach digital eingabe für window4" VALUE 0xEFB9C Kw_Wu16 655350.0 Time_ms 0.00 655350.0 FORMAT "%8.1" /end CHARACTERISTIC
/begin CHARACTERISTIC VSACD_tiDebDioInMinDef_C "Fehlerentprellzeit für digital eingabe Min fehler" VALUE 0xEFB9E Kw_Wu16 655350.0 Time_ms 0.00 655350.0 FORMAT "%8.1" /end CHARACTERISTIC
/begin CHARACTERISTIC VSACD_tiDebDioInMinOk_C "Heilungsentprellzeit für digital eingabe Min fehler" VALUE 0xEFBA0 Kw_Wu16 655350.0 Time_ms 0.00 655350.0 FORMAT "%8.1" /end CHARACTERISTIC
/begin CHARACTERISTIC VSACD_DebExcTempDef_C "Fehlerentprellzeit für Übertemperatur" VALUE 0xEFBA2 Kw_Wu16 655350.0 Time_ms 0.00 655350.0 FORMAT "%8.1" /end CHARACTERISTIC
/begin CHARACTERISTIC VSACD_DebExcTempOk_C "Heilungsentprellzeit für Übertemperatur" VALUE 0xEFBA4 Kw_Wu16 655350.0 Time_ms 0.00 655350.0 FORMAT "%8.1" /end CHARACTERISTIC
/begin CHARACTERISTIC VSACD_DebNoLoadDef_C "Fehlerentprellzeit für Lastabfall" VALUE 0xEFBA6 Kw_Wu16 655350.0 Time_ms 0.00 655350.0 FORMAT "%8.1" /end CHARACTERISTIC
/begin CHARACTERISTIC VSACD_DebNoLoadOk_C "Heilungsentprellzeit für Lastabfall" VALUE 0xEFBA8 Kw_Wu16 655350.0 Time_ms 0.00 655350.0 FORMAT "%8.1" /end CHARACTERISTIC
/begin CHARACTERISTIC VSACD_DebShortCircBatDef_C "Fehlerentprellzeit für Kurzschluß nach Batterie" VALUE 0xEFBAA Kw_Wu16 655350.0 Time_ms 0.00 655350.0 FORMAT "%8.1" /end CHARACTERISTIC
/begin CHARACTERISTIC VSACD_DebShortCircBatOk_C "Heilungsentprellzeit für Kurzschluß nach Batterie" VALUE 0xEFBAC Kw_Wu16 655350.0 Time_ms 0.00 655350.0 FORMAT "%8.1" /end CHARACTERISTIC
/begin CHARACTERISTIC VSACD_DebShortCircGndDef_C "Fehlerentprellzeit für Kurzschluß nach Masse" VALUE 0xEFBAE Kw_Wu16 655350.0 Time_ms 0.00 655350.0 FORMAT "%8.1" /end CHARACTERISTIC
/begin CHARACTERISTIC VSACD_DebShortCircGndOk_C "Heilungsentprellzeit für Kurzschluß nach Masse" VALUE 0xEFBB0 Kw_Wu16 655350.0 Time_ms 0.00 655350.0 FORMAT "%8.1" /end CHARACTERISTIC
/begin CHARACTERISTIC VSACD_tiDebVSADia1Def_C "debounce duration for VSACD diagnosis error detection" VALUE 0xEFBB2 Kw_Wu16 655350.0 Time_ms 0.00 655350.0 FORMAT "%8.1" /end CHARACTERISTIC
/begin CHARACTERISTIC VSACD_tiDebVSADia1Ok_C "debounce duration for VSACD diagnosis error healing" VALUE 0xEFBB4 Kw_Wu16 655350.0 Time_ms 0.00 655350.0 FORMAT "%8.1" /end CHARACTERISTIC
/begin CHARACTERISTIC VSACD_tiDebVSADia2Def_C "debounce duration for VSACD diagnosis error detection" VALUE 0xEFBB6 Kw_Wu16 655350.0 Time_ms 0.00 655350.0 FORMAT "%8.1" /end CHARACTERISTIC
/begin CHARACTERISTIC VSACD_tiDebVSADia2Ok_C "debounce duration for VSACD diagnosis error healing" VALUE 0xEFBB8 Kw_Wu16 655350.0 Time_ms 0.00 655350.0 FORMAT "%8.1" /end CHARACTERISTIC
/begin CHARACTERISTIC VSACD_tiDebVSADia3Def_C "debounce duration for VSACD diagnosis error detection" VALUE 0xEFBBA Kw_Wu16 655350.0 Time_ms 0.00 655350.0 FORMAT "%8.1" /end CHARACTERISTIC
/begin CHARACTERISTIC VSACD_tiDebVSADia3Ok_C "debounce duration for VSACD diagnosis error healing" VALUE 0xEFBBC Kw_Wu16 655350.0 Time_ms 0.00 655350.0 FORMAT "%8.1" /end CHARACTERISTIC
/begin CHARACTERISTIC VSACD_tiDebVSADia4Def_C "Fehlerentprellzeit für Drallklappensteller Diagnose viertes Zeitfenster" VALUE 0xEFBBE Kw_Wu16 655350.0 Time_ms 0.00 655350.0 FORMAT "%8.1" /end CHARACTERISTIC
/begin CHARACTERISTIC VSACD_tiDebVSADia4Ok_C "Heilentprellzeit für Drallklappensteller Diagnose viertes Zeitfenster" VALUE 0xEFBC0 Kw_Wu16 655350.0 Time_ms 0.00 655350.0 FORMAT "%8.1" /end CHARACTERISTIC
/begin CHARACTERISTIC VSACD_numDia_C "#SSD Applikationsparameter fuer das Diagnose-Signal von Einlasskanal-Steller" VALUE 0xEFBC2 Kw_Wu8 35.0000000000 NumPinDia 0.00 35.0000000000 FORMAT "%13.10" /end CHARACTERISTIC
/begin CHARACTERISTIC VSACD_numDioIn_C "Digitaleingang für variable Swirl Position" VALUE 0xEFBC3 Kw_Wu8 14.0000000000 NumPinDioIn 0.00 14.0000000000 FORMAT "%13.10" /end CHARACTERISTIC
/begin CHARACTERISTIC VSACD_numPwmOut_C "#SSD Applikationsparameter fuer Einlasskanal-Steller" VALUE 0xEFBC4 Kw_Wu8 13.0000000000 NumPinPwmOut 0.00 13.0000000000 FORMAT "%13.10" /end CHARACTERISTIC
/begin CHARACTERISTIC VSACD_stInvOut_C "Invertierungsparameter für das Signal der Drallniveaustellerendstufe" VALUE 0xEFBC6 Kw_Wu8 1.000 OneToOne 0.00 1.000 FORMAT "%5.3" EXTENDED_LIMITS 0.00 255.0 /end CHARACTERISTIC
/begin CHARACTERISTIC VSACD_tiPer_C "Periodendauer des Ausgangssignal für den Drallniveausteller" VALUE 0xEFBC8 Kw_Ws16 6553.500 Period -3276.800 3276.700 FORMAT "%8.3" /end CHARACTERISTIC
/begin CHARACTERISTIC VSACD_rCnv_CUR "Kennlinie zur Konvertierung von Öffnungsgrad in Tastverhältnis" CURVE 0xEFBCA Kl_Xs16_Ws16 100.0000 DtyCyc 0.00 100.0000 FORMAT "%8.4" EXTENDED_LIMITS -327.6800 327.6700
 /begin AXIS_DESCR STD_AXIS VSA_rVSA DtyCyc 8 -100.0000 200.0000 FORMAT "%8.4" EXTENDED_LIMITS -327.6800 327.6700 DEPOSIT ABSOLUTE /end AXIS_DESCR
/end CHARACTERISTIC
/begin CHARACTERISTIC VSACD_rOutMax_C "Maximal auszugebendes Tastverhältnis" VALUE 0xEFBEC Kw_Ws16 655.3500 DtyCyc -327.6800 327.6700 FORMAT "%8.4" /end CHARACTERISTIC
/begin CHARACTERISTIC VSACD_rOutMin_C "Minimal auszugebendes Tastverhältnis" VALUE 0xEFBEE Kw_Ws16 655.3500 DtyCyc -327.6800 327.6700 FORMAT "%8.4" /end CHARACTERISTIC
/begin CHARACTERISTIC VSACD_stPwrStgActv_C "Aktivierung der Abschaltbedingungen der Endstufe" VALUE 0xEFBF0 Kw_Wu8 255.0 OneToOne 0.00 255.0 FORMAT "%5.1" /end CHARACTERISTIC
/begin CHARACTERISTIC VSACD_stPwrStgDia_C "Aktivierung der Abschaltbedingungen der Endstufendiagnose" VALUE 0xEFBF1 Kw_Wu8 255.0 OneToOne 0.00 255.0 FORMAT "%5.1" /end CHARACTERISTIC
/begin CHARACTERISTIC VSACD_stSPICtl_C "0 = Non SPI powerstage )" VALUE 0xEFBF2 Kw_Wu8 1.000 OneToOne 0.00 1.000 FORMAT "%5.3" EXTENDED_LIMITS 0.00 255.0 /end CHARACTERISTIC
/begin CHARACTERISTIC VSACD_swtExtPinEna_C "Schalter für Drallklappensteller Diagnose mit extra Pin (1...ein, 0...aus)" VALUE 0xEFBF3 Kw_Wu8 255.0 OneToOne 0.00 255.0 FORMAT "%5.1" /end CHARACTERISTIC
/begin CHARACTERISTIC VSACD_swt_C "Schalter Batteriespannungskorrektur (0 = AUS, 1 = EIN)" VALUE 0xEFBF4 Kw_Wu8 255.0 OneToOne 0.00 255.0 FORMAT "%5.1" /end CHARACTERISTIC
/begin CHARACTERISTIC VSACD_tiBtwTst_C "Zeitabstand, in dem im Fehlerfall die Endstufe getestet wird" VALUE 0xEFBF6 Kw_Wu16 29980.00 Time_ms 20.00000 30000.00 FORMAT "%8.2" EXTENDED_LIMITS 0.00 655350.0 /end CHARACTERISTIC
/begin CHARACTERISTIC VSACD_tiDiag1Max_C "window 1 max. time" VALUE 0xEFBF8 Kw_Wu16 655350.0 Time_ms 0.00 655350.0 FORMAT "%8.1" /end CHARACTERISTIC
/begin CHARACTERISTIC VSACD_tiDiag1Min_C "window 1 min. time" VALUE 0xEFBFA Kw_Wu16 655350.0 Time_ms 0.00 655350.0 FORMAT "%8.1" /end CHARACTERISTIC
/begin CHARACTERISTIC VSACD_tiDiag2Max_C "window 2 min. time" VALUE 0xEFBFC Kw_Wu16 655350.0 Time_ms 0.00 655350.0 FORMAT "%8.1" /end CHARACTERISTIC
/begin CHARACTERISTIC VSACD_tiDiag2Min_C "window 2 min. time" VALUE 0xEFBFE Kw_Wu16 655350.0 Time_ms 0.00 655350.0 FORMAT "%8.1" /end CHARACTERISTIC
/begin CHARACTERISTIC VSACD_tiDiag3Max_C "window 3 max. time" VALUE 0xEFC00 Kw_Wu16 655350.0 Time_ms 0.00 655350.0 FORMAT "%8.1" /end CHARACTERISTIC
/begin CHARACTERISTIC VSACD_tiDiag3Min_C "window 3 Min. time" VALUE 0xEFC02 Kw_Wu16 655350.0 Time_ms 0.00 655350.0 FORMAT "%8.1" /end CHARACTERISTIC
/begin CHARACTERISTIC VSACD_tiDiag4Max_C "Maximum des vierten Signalfensters für Fehlersignale des Drallklappenstellers" VALUE 0xEFC04 Kw_Wu16 655350.0 Time_ms 0.00 655350.0 FORMAT "%8.1" /end CHARACTERISTIC
/begin CHARACTERISTIC VSACD_tiDiag4Min_C "Minimum des vierten Signalfensters für Fehlersignale des Drallklappenstellers" VALUE 0xEFC06 Kw_Wu16 655350.0 Time_ms 0.00 655350.0 FORMAT "%8.1" /end CHARACTERISTIC
/begin CHARACTERISTIC VSACD_tiDioInDia1Max_C "Maximum des ersten Signalfensters für Fehlersignale des Drallklappenstellers" VALUE 0xEFC08 Kw_Wu16 655350.0 Time_ms 0.00 655350.0 FORMAT "%8.1" /end CHARACTERISTIC
/begin CHARACTERISTIC VSACD_tiDioInDia1Min_C "Minimum des ersten Signalfensters für Fehlersignale des Drallklappenstellers" VALUE 0xEFC0A Kw_Wu16 655350.0 Time_ms 0.00 655350.0 FORMAT "%8.1" /end CHARACTERISTIC
/begin CHARACTERISTIC VSACD_tiDioInDia2Max_C "Maximum des zweiten Signalfensters für Fehlersignale des Drallklappenstellers" VALUE 0xEFC0C Kw_Wu16 655350.0 Time_ms 0.00 655350.0 FORMAT "%8.1" /end CHARACTERISTIC
/begin CHARACTERISTIC VSACD_tiDioInDia2Min_C "Minimum des zweiten Signalfensters für Fehlersignale des Drallklappenstellers" VALUE 0xEFC0E Kw_Wu16 655350.0 Time_ms 0.00 655350.0 FORMAT "%8.1" /end CHARACTERISTIC
/begin CHARACTERISTIC VSACD_tiDioInDia3Max_C "Maximum des dritten Signalfensters für Fehlersignale des Drallklappenstellers" VALUE 0xEFC10 Kw_Wu16 655350.0 Time_ms 0.00 655350.0 FORMAT "%8.1" /end CHARACTERISTIC
/begin CHARACTERISTIC VSACD_tiDioInDia3Min_C "Minimum des dritten Signalfensters für Fehlersignale des Drallklappenstellers" VALUE 0xEFC12 Kw_Wu16 655350.0 Time_ms 0.00 655350.0 FORMAT "%8.1" /end CHARACTERISTIC
/begin CHARACTERISTIC VSACD_tiDioInDia4Max_C "Maximum des vierten Signalfensters für Fehlersignale des Drallklappenstellers" VALUE 0xEFC14 Kw_Wu16 655350.0 Time_ms 0.00 655350.0 FORMAT "%8.1" /end CHARACTERISTIC
/begin CHARACTERISTIC VSACD_tiDioInDia4Min_C "Minimum des vierten Signalfensters für Fehlersignale des Drallklappenstellers" VALUE 0xEFC16 Kw_Wu16 655350.0 Time_ms 0.00 655350.0 FORMAT "%8.1" /end CHARACTERISTIC
/begin CHARACTERISTIC VSACD_tiPwrStgOn_C "Zeit für welche die Endstufe im Fehlerfall eingeschalten wird (nur nicht SPI kontrolliert)" VALUE 0xEFC18 Kw_Wu16 655140.0 Time_ms 0.00 655140.0 FORMAT "%8.1" EXTENDED_LIMITS 0.00 655350.0 /end CHARACTERISTIC
/begin CHARACTERISTIC VSA_rVSA_Vector "#SSD Bypass-Label für VSA_rVSA" VALUE 0xC3162 Kw_Wu8 255.0 OneToOne 0.00 255.0 FORMAT "%5.1" /end CHARACTERISTIC
/begin CHARACTERISTIC VSA_rVSA_Channel "#SSD Bypass-Label für VSA_rVSA" VALUE 0xC3163 Kw_Wu8 255.0 OneToOne 0.00 255.0 FORMAT "%5.1" /end CHARACTERISTIC
/begin CHARACTERISTIC VSSCD_DebCanSigDef_C "#SSD Entprellzeit CAN Signal für Fahrgeschwindigkeit defekt" VALUE 0xEFC1C Kw_Wu16 655350.0 Time_ms 0.00 655350.0 FORMAT "%8.1" /end CHARACTERISTIC
/begin CHARACTERISTIC VSSCD_DebCanSigOk_C "Entprellzeit Heilung CAN-Signal für Fahrgeschwindigkeit" VALUE 0xEFC1E Kw_Wu16 655350.0 Time_ms 0.00 655350.0 FORMAT "%8.1" /end CHARACTERISTIC
/begin CHARACTERISTIC VSSCD_DebMaxDef_C "Entprellzeit für Defekterkennung bei Maximumtest der Fahrgeschwindigkeit" VALUE 0xEFC20 Kw_Wu16 655350.0 Time_ms 0.00 655350.0 FORMAT "%8.1" /end CHARACTERISTIC
/begin CHARACTERISTIC VSSCD_DebMaxOk_C "Entprellzeit für Heilung bei Maximumtest der Fahrgeschwindigkeit" VALUE 0xEFC22 Kw_Wu16 655350.0 Time_ms 0.00 655350.0 FORMAT "%8.1" /end CHARACTERISTIC
/begin CHARACTERISTIC VSSCD_DebNegPlaMonCond_C "Vorhaltlabel, nicht applizieren" VALUE 0xEFC24 Kw_Wu16 655350.0 Time_ms 0.00 655350.0 FORMAT "%8.1" READ_ONLY /end CHARACTERISTIC
/begin CHARACTERISTIC VSSCD_DebPlaMonCond_C "Entprellzeit Überwachungsbedingungen für Plausibilitätstest der Fahrgeschwindigkeit" VALUE 0xEFC26 Kw_Wu16 655350.0 Time_ms 0.00 655350.0 FORMAT "%8.1" /end CHARACTERISTIC
/begin CHARACTERISTIC VSSCD_DebPlaDef_C "Entprellzeit für Defekterkennung bei Plausibilitätstest der Fahrgeschwindigkeit" VALUE 0xEFC28 Kw_Wu16 655350.0 Time_ms 0.00 655350.0 FORMAT "%8.1" /end CHARACTERISTIC
/begin CHARACTERISTIC VSSCD_DebPlaOk_C "Entprellzeit für Heilung bei Plausibilitätstest der Fahrgeschwindigkeit" VALUE 0xEFC2A Kw_Wu16 655350.0 Time_ms 0.00 655350.0 FORMAT "%8.1" /end CHARACTERISTIC
/begin CHARACTERISTIC VSSCD_DebSigDef_C "Entprellzeit defekt für ungültiges Eingangssignal Fahrgeschwindigkeit" VALUE 0xEFC2C Kw_Wu16 655350.0 Time_ms 0.00 655350.0 FORMAT "%8.1" /end CHARACTERISTIC
/begin CHARACTERISTIC VSSCD_DebSigOk_C "Entprellzeit für Heilung ungültiges Eingangssignal der Fahrgeschwindigkeit" VALUE 0xEFC2E Kw_Wu16 655350.0 Time_ms 0.00 655350.0 FORMAT "%8.1" /end CHARACTERISTIC
/begin CHARACTERISTIC VSSCD_ImpPerDist_C "Streckenfaktor: FGG-Impulse pro Strecke" VALUE 0xEFC4C Kw_Wu32 17.500000000000000 VSS_DistFac 2.5000000000000000 20.000000000000000 FORMAT "%20.17" EXTENDED_LIMITS 0.83819031734908711 3600000000.0000000 /end CHARACTERISTIC
/begin CHARACTERISTIC VSSCD_nThresPla_C "Drehzahschwelle für NPL-Test der Fahrgeschwindigkeit" VALUE 0xEFC30 Kw_Ws16 32767.00 EngN 0.00 32767.00 FORMAT "%8.2" EXTENDED_LIMITS -32768.00 32767.00 /end CHARACTERISTIC
/begin CHARACTERISTIC VSSCD_qThresPla_C "Einspritzschwelle für NPL-Test der Fahrgeschwindigkeit" VALUE 0xEFC32 Kw_Ws16 327.6700 InjMass 0.00 327.6700 FORMAT "%8.4" EXTENDED_LIMITS -327.6800 327.6700 /end CHARACTERISTIC
/begin CHARACTERISTIC VSSCD_swtSigVal_C "#SSD Signalquelle Fahrgeschwindigkeit, Datensatzwert für SW-Schalter VSSCD_swtSig (0: HW FGG, 1: CAN)" VALUE 0xEFC34 Kw_Wu8 1.000 OneToOne 0.00 1.000 FORMAT "%5.3" EXTENDED_LIMITS 0.00 255.0 /end CHARACTERISTIC
/begin CHARACTERISTIC VSSCD_swtSigType_C "#SSD Einlesen SW-Schalter VSSCD_swtSig aus E2PROM (1) oder VSSCD_swtSigVal_C (2) bei Ini." VALUE 0xEFC35 Kw_Wu8 1.000 OneToOne 1.000 2.000 FORMAT "%5.3" EXTENDED_LIMITS 0.00 255.0 /end CHARACTERISTIC
/begin CHARACTERISTIC VSSCD_tiAPT1_C "Zeitkonstante Filterung Fahrbeschleunigung" VALUE 0xEFC38 Kw_Wu32 4294.9673 TimeDelay_s 0.0000010000000 4294.9673 FORMAT "%9.4" /end CHARACTERISTIC
/begin CHARACTERISTIC VSSCD_tiPerMax_C "Maximale Periodendauer zwischen zwei FGG-Impulsen (VSSCD_vRaw = 0  wenn VSSCD_tiPerArvg > VSSCD_tiPerMax)" VALUE 0xEFC3C Kw_Ws32 9586980.60000 Time_PwmHigh 0.00 9586980.60000 FORMAT "%13.5" EXTENDED_LIMITS -214748364.800 214748364.700 /end CHARACTERISTIC
/begin CHARACTERISTIC VSSCD_tiVPT1_C "Zeitkonstante Filterung Fahrgeschwindigkeit" VALUE 0xEFC40 Kw_Wu32 4294.9673 TimeDelay_s 0.0000010000000 4294.9673 FORMAT "%9.4" /end CHARACTERISTIC
/begin CHARACTERISTIC VSSCD_vDfl_C "Vorgabewert Fahrgeschwindigkeit" VALUE 0xEFC44 Kw_Ws16 327.6700 Vel 0.00 327.6700 FORMAT "%8.4" EXTENDED_LIMITS -327.6800 327.6700 /end CHARACTERISTIC
/begin CHARACTERISTIC VSSCD_vMax_C "v-Schwelle für Max-Test der Fahrgeschwindigkeit" VALUE 0xEFC46 Kw_Ws16 327.6700 Vel 0.00 327.6700 FORMAT "%8.4" EXTENDED_LIMITS -327.6800 327.6700 /end CHARACTERISTIC
/begin CHARACTERISTIC VSSCD_vMin_C "Minimum-Schwelle für v=0 Erkennung" VALUE 0xEFC48 Kw_Ws16 20.00000 Vel 0.00 20.00000 FORMAT "%8.5" EXTENDED_LIMITS -327.6800 327.6700 /end CHARACTERISTIC
/begin CHARACTERISTIC VSSCD_vThresPla_C "v-Schwelle für NPL-Test der Fahrgeschwindigkeit" VALUE 0xEFC4A Kw_Ws16 327.6700 Vel 0.00 327.6700 FORMAT "%8.4" EXTENDED_LIMITS -327.6800 327.6700 /end CHARACTERISTIC
/begin CHARACTERISTIC ZFC_dBPFacNumFBCG3_CA "Bandpassverstärkungen für Schubbetrieb im 3. Gang" VAL_BLK 0xEFC88 Kwb_Wr32 30.0000000 OneToOne -15.0000000 15.0000000 FORMAT "%10.7" EXTENDED_LIMITS -1.00000000E+37 1.00000000E+37 NUMBER 3 /end CHARACTERISTIC
/begin CHARACTERISTIC ZFC_dBPFacNumFBCG4_CA "Bandpassverstärkungen für Schubbetrieb im 4. Gang" VAL_BLK 0xEFC94 Kwb_Wr32 30.0000000 OneToOne -15.0000000 15.0000000 FORMAT "%10.7" EXTENDED_LIMITS -1.00000000E+37 1.00000000E+37 NUMBER 3 /end CHARACTERISTIC
/begin CHARACTERISTIC ZFC_dBPFacNumFBCG5_CA "Bandpassverstärkungen für Schubbetrieb im 5. Gang" VAL_BLK 0xEFCA0 Kwb_Wr32 30.0000000 OneToOne -15.0000000 15.0000000 FORMAT "%10.7" EXTENDED_LIMITS -1.00000000E+37 1.00000000E+37 NUMBER 3 /end CHARACTERISTIC
/begin CHARACTERISTIC ZFC_dBPFacNumFBCG6_CA "Bandpassverstärkungen für Schubbetrieb im 6. Gang" VAL_BLK 0xEFCAC Kwb_Wr32 30.0000000 OneToOne -15.0000000 15.0000000 FORMAT "%10.7" EXTENDED_LIMITS -1.00000000E+37 1.00000000E+37 NUMBER 3 /end CHARACTERISTIC
/begin CHARACTERISTIC ZFC_dSegFBCCaS_CA "Segmentwahl im Schubbetrieb" VAL_BLK 0xEFCB8 Kwb_Wu16 255.9961 Per_Ratio 0.00 255.9961 FORMAT "%8.4" NUMBER 3 /end CHARACTERISTIC
/begin CHARACTERISTIC ZFC_nAvrgMax_C "#SSD Maximale Drehzahl für die Nullmengenkalibrierung" VALUE 0xEFCBE Kw_Ws16 5960.000 EngN 40.00000 6000.000 FORMAT "%8.3" EXTENDED_LIMITS -32768.00 32767.00 /end CHARACTERISTIC
/begin CHARACTERISTIC ZFC_nAvrgMin_C "#SSD Minimale Drehzahl für die Nullmengenkalibrierung" VALUE 0xEFCC0 Kw_Ws16 5960.000 EngN 40.00000 6000.000 FORMAT "%8.3" EXTENDED_LIMITS -32768.00 32767.00 /end CHARACTERISTIC
/begin CHARACTERISTIC ZFC_nChngPRailMax_C "#SSD Maximale Drehzahl für die eine Raildruckanforderung der Nullmengenkalibrierung erfolgt" VALUE 0xEFCC2 Kw_Ws16 5960.000 EngN 40.00000 6000.000 FORMAT "%8.3" EXTENDED_LIMITS -32768.00 32767.00 /end CHARACTERISTIC
/begin CHARACTERISTIC ZFC_nFBCThresMax_C "#SSD Obere Drehzahlschwelle für Berechnung der FBC-Bandpässe im Schubbetrieb" VALUE 0xEFCC4 Kw_Ws16 5960.000 EngN 40.00000 6000.000 FORMAT "%8.3" EXTENDED_LIMITS -32768.00 32767.00 /end CHARACTERISTIC
/begin CHARACTERISTIC ZFC_nHyst_C "Hysteresewert Drehzahl für die Nullmengenkalibrierung" VALUE 0xEFCC6 Kw_Ws16 5960.000 EngN 40.00000 6000.000 FORMAT "%8.3" EXTENDED_LIMITS -32768.00 32767.00 /end CHARACTERISTIC
/begin CHARACTERISTIC ZFC_numRatETClb_C "#SSD Anzahl der Ansteuerdauer-Kalibrierungen hintereinander" VALUE 0xEFCC8 Kw_Wu8 255.0 OneToOne 0.00 255.0 FORMAT "%5.1" /end CHARACTERISTIC
/begin CHARACTERISTIC ZFC_numRatNVClb_C "#SSD Anzahl der Ansteuerspannungs-Kalibrierungen hintereinander" VALUE 0xEFCC9 Kw_Wu8 255.0 OneToOne 0.00 255.0 FORMAT "%5.1" /end CHARACTERISTIC
/begin CHARACTERISTIC ZFC_phiSet_CUR "Ansteuerbeginn für Einspritzung der Nullmengenkalibrierung" CURVE 0xEFCE4 Kl_Xs16_Ws16 1440.000 AngleCrS -720.0000 720.0000 FORMAT "%8.4" EXTENDED_LIMITS -768.0000 767.9766
 /begin AXIS_DESCR STD_AXIS Eng_nAvrg EngN 16 40.00000 6000.000 FORMAT "%8.3" EXTENDED_LIMITS -32768.00 32767.00 DEPOSIT ABSOLUTE /end AXIS_DESCR
/end CHARACTERISTIC
/begin CHARACTERISTIC ZFC_stClthSel_C "Bitmaske zur Freigabe des Kupplungssignals für die Kalibrierung" VALUE 0xEFCCA Kw_Wu8 255.0 OneToOne 0.00 255.0 FORMAT "%5.1" /end CHARACTERISTIC
/begin CHARACTERISTIC ZFC_stGearRls_CA "Gangabhängige freigabe der ZFC Kalibrierung" VAL_BLK 0xEFCCB Kwb_Wu8 1.000 OneToOne 0.00 1.000 FORMAT "%5.3" EXTENDED_LIMITS 0.00 255.0 NUMBER 7 /end CHARACTERISTIC
/begin CHARACTERISTIC ZFC_swtClbActvVal_C "Applikationswert für SW-Schalter der ZFC Kalibrierung (1: Kalibrierung aktiev, 0: inaktiev)" VALUE 0xEFCD2 Kw_Wu8 1.000 OneToOne 0.00 1.000 FORMAT "%5.3" EXTENDED_LIMITS 0.00 255.0 /end CHARACTERISTIC
/begin CHARACTERISTIC ZFC_swtClbActvType_C "Typ des Softwareschalters für die ZFC Kalibrierung" VALUE 0xEFCD3 Kw_Wu8 2.000 OneToOne 0.00 2.000 FORMAT "%5.3" EXTENDED_LIMITS 0.00 255.0 /end CHARACTERISTIC
/begin CHARACTERISTIC ZFC_tAirThres_C "Minimale Ansauglufttemperatur für die Nullmengenkalibrierung" VALUE 0xEFCD4 Kw_Ws16 250.0000 Temp_Cels -50.14000 199.8600 FORMAT "%8.4" EXTENDED_LIMITS -3549.940 3003.560 /end CHARACTERISTIC
/begin CHARACTERISTIC ZFC_tEngThres_C "Minimale Motortemperatur für die Nullmengenkalibrierung" VALUE 0xEFCD6 Kw_Ws16 250.0000 Temp_Cels -50.14000 199.8600 FORMAT "%8.4" EXTENDED_LIMITS -3549.940 3003.560 /end CHARACTERISTIC
/begin CHARACTERISTIC ZFC_tFuelThresMax_C "Maximale Kraftstofftemperatur für die Nullmengenkalibrierung" VALUE 0xEFCD8 Kw_Ws16 250.0000 Temp_Cels -50.14000 199.8600 FORMAT "%8.4" EXTENDED_LIMITS -3549.940 3003.560 /end CHARACTERISTIC
/begin CHARACTERISTIC ZFC_tFuelThresMin_C "Minimale Kraftstofftemperatur für die Nullmengenkalibrierung" VALUE 0xEFCDA Kw_Ws16 250.0000 Temp_Cels -50.14000 199.8600 FORMAT "%8.4" EXTENDED_LIMITS -3549.940 3003.560 /end CHARACTERISTIC
/begin CHARACTERISTIC ZFC_tiCldCham_CUR "Zeit bis der Brennraum für die Nullmengenkalibrierung zu stark abgekühlt ist" CURVE 0xEFC52 Kl_Xs16_Ws16 655140.0 Time_ms 0.00 655140.0 FORMAT "%8.1" EXTENDED_LIMITS -327680.0 327670.0
 /begin AXIS_DESCR STD_AXIS IATSCD_tAir Temp_Cels 12 -50.14000 199.8600 FORMAT "%8.4" EXTENDED_LIMITS -3549.940 3003.560 DEPOSIT ABSOLUTE /end AXIS_DESCR
/end CHARACTERISTIC
/begin CHARACTERISTIC ZFC_tiDelOvrRun_C "Verzögerung nach dem Einsetzen der Schubphase für die Nullmengenkalibrierung" VALUE 0xEFCDC Kw_Ws16 655140.0 Time_ms 0.00 655140.0 FORMAT "%8.1" EXTENDED_LIMITS -327680.0 327670.0 /end CHARACTERISTIC
/begin CHARACTERISTIC ZFC_tiDelpRailLim_C "Verzögerung zum Einschwingen des Raildrucks für die Nullmengenkalibrierung" VALUE 0xEFCDE Kw_Ws16 655140.0 Time_ms 0.00 655140.0 FORMAT "%8.1" EXTENDED_LIMITS -327680.0 327670.0 /end CHARACTERISTIC
/begin CHARACTERISTIC ZFC_tiHotCham_C "Zeit bis der Brennraum warm genug für die Nullmengenkalibrierung ist" VALUE 0xEFC84 Kw_Ws16 655140.0 Time_ms 0.00 655140.0 FORMAT "%8.1" EXTENDED_LIMITS -327680.0 327670.0 /end CHARACTERISTIC
/begin CHARACTERISTIC ZFC_uBattMin_C "Minimale Batteriespannung für die Nullmengenkalibrierung" VALUE 0xEFCE0 Kw_Ws16 640606.1 Volt_Batt 0.00 640606.1 FORMAT "%8.1" EXTENDED_LIMITS -640625.6 640606.1 /end CHARACTERISTIC
/begin MEASUREMENT SOPTst_stCyl "Endstufen die sich trotz redundanter Abschaltung aktivieren ließen" UBYTE OneToOne 1 100 0.00 255.0 FORMAT "%5.1" ECU_ADDRESS 0x7F89CC /end MEASUREMENT
/begin MEASUREMENT SPMon_numFreeErcosekStack_mp "Freier Ercosek Stack (Schleppzeiger im eeprom)" UWORD OneToOne 1 100 0.00 65535.00 FORMAT "%8.2" ECU_ADDRESS 0x6F82AE /end MEASUREMENT
/begin MEASUREMENT SPMon_numFreeUserStack_mp "Meßpunkt für freien Userstackbereich" UWORD OneToOne 1 100 0.00 65535.00 FORMAT "%8.2" ECU_ADDRESS 0x6F82B0 /end MEASUREMENT
/begin MEASUREMENT SrvPmp_dphiStrg_mp "Streeing Angle derivative" SWORD AngleGradPerSec 1 100 -1440.154 1440.110 FORMAT "%8.3" ECU_ADDRESS 0x8FFE12 /end MEASUREMENT
/begin MEASUREMENT SrvPmp_pwrDes "Leistungsbedarf der Servopumpe" SWORD Pwr 1 100 -308831.1 308821.7 FORMAT "%8.1" ECU_ADDRESS 0x7F90FA /end MEASUREMENT
/begin MEASUREMENT SrvPmp_pwrLead "Leistungsvorhalt der Servopumpe" SWORD Pwr 1 100 -308831.1 308821.7 FORMAT "%8.1" ECU_ADDRESS 0x7F90FC /end MEASUREMENT
/begin MEASUREMENT SrvPmp_trqDes_mp "Momentenbedarf der Servopumpe" SWORD Trq 1 100 -3276.800 3276.700 FORMAT "%8.3" ECU_ADDRESS 0x8FFE14 /end MEASUREMENT
/begin MEASUREMENT SSpMon_stRaw_1_mp "Rohwert der Defekterkennung der Sensorversorgungsspannung 1" SWORD OneToOne 1 100 -32768.00 32767.00 FORMAT "%8.2" ECU_ADDRESS 0x8FFE16 /end MEASUREMENT
/begin MEASUREMENT SSpMon_stRaw_2_mp "Rohwert der Defekterkennung der Sensorversorgungsspannung 2" SWORD OneToOne 1 100 -32768.00 32767.00 FORMAT "%8.2" ECU_ADDRESS 0x8FFE18 /end MEASUREMENT
/begin MEASUREMENT SSpMon_stRaw_3_mp "Rohwert der Defekterkennung der Sensorversorgungsspannung 3" SWORD OneToOne 1 100 -32768.00 32767.00 FORMAT "%8.2" ECU_ADDRESS 0x8FFE1A /end MEASUREMENT
/begin MEASUREMENT SSpMon_stSSpErr "Fehlerstatus der Sensorversorgungsspannungen" UWORD OneToOne 1 100 0.00 65535.00 FORMAT "%8.2" ECU_ADDRESS 0x7F90F6 /end MEASUREMENT
/begin MEASUREMENT StrtCD_stHWE_mp "zu stellender Zustand an der Digitalendstufe nach der Fehlerbehandlung" UBYTE OneToOne 1 100 0.00 255.0 FORMAT "%5.1" ECU_ADDRESS 0x8FFE1C /end MEASUREMENT
/begin MEASUREMENT StSys_facAPSCor_mp "factor for starting torque correction value" SWORD Fact 1 100 -4.000000 3.999878 FORMAT "%8.6" ECU_ADDRESS 0x8FFE1E /end MEASUREMENT
/begin MEASUREMENT StSys_nAvrgFlt_mp "engine speed after PT1 filter" SWORD EngN 1 100 -32768.00 32767.00 FORMAT "%8.2" ECU_ADDRESS 0x8FFE38 /end MEASUREMENT
/begin MEASUREMENT StSys_nThresStrtCutOut_mp "Startabwurfdrehzahl" SWORD EngN 1 100 -32768.00 32767.00 FORMAT "%8.2" ECU_ADDRESS 0x8FFE26 /end MEASUREMENT
/begin MEASUREMENT StSys_stActrLck_mp "Statusregister Ausspurbedingungen" UWORD OneToOne 1 100 0.00 65535.00 FORMAT "%8.2" ECU_ADDRESS 0x8FFE30 /end MEASUREMENT
/begin MEASUREMENT StSys_stActrOut "Anlasserzustand" UBYTE OneToOne 1 100 0.00 255.0 FORMAT "%5.1" ECU_ADDRESS 0x7F89CF /end MEASUREMENT
/begin MEASUREMENT StSys_stActrRls_mp "Statusregister Einspurbedingungen" UBYTE OneToOne 1 100 0.00 255.0 FORMAT "%5.1" ECU_ADDRESS 0x8FFE32 /end MEASUREMENT
/begin MEASUREMENT StSys_stNewStrt "Statusanzeige bei Neustart während eines aktiven Fahrzyklus" UBYTE OneToOne 1 100 0.00 255.0 FORMAT "%5.1" ECU_ADDRESS 0x7F89D0 /end MEASUREMENT
/begin MEASUREMENT StSys_stRmpMon "Zustand der Startmomenterhoehung" UBYTE OneToOne 1 100 0.00 255.0 FORMAT "%5.1" ECU_ADDRESS 0x7F89D1 /end MEASUREMENT
/begin MEASUREMENT StSys_stStrt "Startzustand" UBYTE OneToOne 1 100 0.00 255.0 FORMAT "%5.1" ECU_ADDRESS 0x7F89D2 /end MEASUREMENT
/begin MEASUREMENT StSys_stStrtCutOutMon "Zustand des Startabwurfs" UBYTE OneToOne 1 100 0.00 255.0 FORMAT "%5.1" ECU_ADDRESS 0x7F89D3 /end MEASUREMENT
/begin MEASUREMENT StSys_stStrtTip "Zustände der Tip-Start Funktion" UWORD OneToOne 1 100 0.00 65535.00 FORMAT "%8.2" ECU_ADDRESS 0x7F9100 /end MEASUREMENT
/begin MEASUREMENT StSys_stStrtTipOFF "Zustände der Tip-Start Abschaltung" UBYTE OneToOne 1 100 0.00 255.0 FORMAT "%5.1" ECU_ADDRESS 0x7F89D4 /end MEASUREMENT
/begin MEASUREMENT StSys_stStrtTipON "Zustände der Tip-Start Einschaltung" UBYTE OneToOne 1 100 0.00 255.0 FORMAT "%5.1" ECU_ADDRESS 0x7F89D5 /end MEASUREMENT
/begin MEASUREMENT StSys_stTrqShutOff "globales Interface fuer die Startmomentabschaltung" UBYTE OneToOne 1 100 0.00 255.0 FORMAT "%5.1" ECU_ADDRESS 0x7F89D6 /end MEASUREMENT
/begin MEASUREMENT StSys_stTrqShutOffCond_mp "bitcodierter Zustand der Abschaltbedingungen der Startmomentenabschaltung" UWORD OneToOne 1 100 0.00 65535.00 FORMAT "%8.2" ECU_ADDRESS 0x8FFE3A /end MEASUREMENT
/begin MEASUREMENT StSys_stTrqShutOffErr_mp "status Fehlerursachen Start o. Kl.50" UWORD OneToOne 1 100 0.00 65535.00 FORMAT "%8.2" ECU_ADDRESS 0x8FFE36 /end MEASUREMENT
/begin MEASUREMENT StSys_trqAddCor "zusaetzliches Korrekturmoment f. Startmoment" SWORD Trq 1 100 -3276.800 3276.700 FORMAT "%8.3" ECU_ADDRESS 0x7F9102 /end MEASUREMENT
/begin MEASUREMENT StSys_trqAdj_mp "Startmomentkorrektur" SWORD Trq 1 100 -3276.800 3276.700 FORMAT "%8.3" ECU_ADDRESS 0x8FFE2A /end MEASUREMENT
/begin MEASUREMENT StSys_trqBas "Startbasismoment" SWORD Trq 1 100 -3276.800 3276.700 FORMAT "%8.3" ECU_ADDRESS 0x7F9104 /end MEASUREMENT
/begin MEASUREMENT StSys_trqRmpState "Moment der Startrampe" SWORD Trq 1 100 -3276.800 3276.700 FORMAT "%8.3" ECU_ADDRESS 0x7F9106 /end MEASUREMENT
/begin MEASUREMENT StSys_trqSetAdjVal_mp "EEPROM Abgleichwert Startmoment-Korrektur" SWORD Trq 1 100 -3276.800 3276.700 FORMAT "%8.3" ECU_ADDRESS 0x8FFE2C /end MEASUREMENT
/begin MEASUREMENT StSys_trqStrt "inneres Moment Startwert" SWORD Trq 1 100 -3276.800 3276.700 FORMAT "%8.3" ECU_ADDRESS 0x7F9108 /end MEASUREMENT
/begin MEASUREMENT StSys_trqStrtAPSCor_mp " starting torque correction" SWORD Trq 1 100 -3276.800 3276.700 FORMAT "%8.3" ECU_ADDRESS 0x8FFE20 /end MEASUREMENT
/begin MEASUREMENT StSys_trqStrtAPS_mp "starting torque correction" SWORD Trq 1 100 -3276.800 3276.700 FORMAT "%8.3" ECU_ADDRESS 0x8FFE22 /end MEASUREMENT
/begin MEASUREMENT StSys_trqStrtBas_mp "Basismoment fuer Start" SWORD Trq 1 100 -3276.800 3276.700 FORMAT "%8.3" ECU_ADDRESS 0x8FFE2E /end MEASUREMENT
/begin MEASUREMENT StSys_tStrtBas_mp "Aus dem Motortemperaturfeld Eng_tFld ausgewählte Temperatur" SWORD Temp_Cels 1 100 -50.140 899.860 FORMAT "%8.3" ECU_ADDRESS 0x8FFE24 /end MEASUREMENT
/begin MEASUREMENT StSys_tStrtRmp_mp "Aus dem Motortemperaturfeld Eng_tFld ausgewählte Temperatur" SWORD Temp_Cels 1 100 -50.140 899.860 FORMAT "%8.3" ECU_ADDRESS 0x8FFE34 /end MEASUREMENT
/begin MEASUREMENT StSys_tStrt_mp "Aus dem Motortemperaturfeld Eng_tFld ausgewählte Temperatur für den Startabwurf" SWORD Temp_Cels 1 100 -50.140 899.860 FORMAT "%8.3" ECU_ADDRESS 0x8FFE28 /end MEASUREMENT
/begin MEASUREMENT SWTmr_tiTmr16 "16-Bit Referenzzeit für Timer" UWORD Time_ms 1 100 0.00 655350.0 FORMAT "%8.1" ECU_ADDRESS 0x7F879A /end MEASUREMENT
/begin MEASUREMENT SWTmr_tiTmr32 "32-Bit Referenzzeit für Timer" ULONG Time_ms 1 100 0.00 42949672950.0 FORMAT "%13.1" ECU_ADDRESS 0x7F879C /end MEASUREMENT
/begin MEASUREMENT T15CD_stCondDebVal_mp "Bedingungen (Bitleiste) für Auswertung T15CD_ stDebVal" UBYTE OneToOne 1 100 0.00 255.0 FORMAT "%5.1" ECU_ADDRESS 0x8FFE3C /end MEASUREMENT
/begin MEASUREMENT T15CD_stDebVal "entprellter Wert der Klemme 15" UBYTE OneToOne 1 100 0.00 255.0 FORMAT "%5.1" ECU_ADDRESS 0x7F89D7 /end MEASUREMENT
/begin MEASUREMENT T15CD_stDebWakeUpVal "entprellter Wake Up Signaleingang" UBYTE OneToOne 1 100 0.00 255.0 FORMAT "%5.1" ECU_ADDRESS 0x7F89D8 /end MEASUREMENT
/begin MEASUREMENT T15CD_stLogicT15_mp "Staatsmaschine für T15 in der neu ""Anpassung wakeup Konzept""" UBYTE OneToOne 1 100 0.00 255.0 FORMAT "%5.1" ECU_ADDRESS 0x8FFE3D /end MEASUREMENT
/begin MEASUREMENT T15CD_stWakeUp "Wake Up Zustand" UBYTE OneToOne 1 100 0.00 255.0 FORMAT "%5.1" ECU_ADDRESS 0x7F89D9 /end MEASUREMENT
/begin MEASUREMENT T15CD_stWakeUpRawVal_mp "Rohwert des Wake Up Signals aus der HWE" UBYTE OneToOne 1 100 0.00 255.0 FORMAT "%5.1" ECU_ADDRESS 0x6F82B2 /end MEASUREMENT
/begin MEASUREMENT T50CD_stDebVal "entprellter Statuswert der Klemme 50" UBYTE OneToOne 1 100 0.00 255.0 FORMAT "%5.1" ECU_ADDRESS 0x7F89DA /end MEASUREMENT
/begin MEASUREMENT T50CD_stRawVal "unentprellter Wert des Eingangssignals für Klemme 50" UBYTE OneToOne 1 100 0.00 255.0 FORMAT "%5.1" ECU_ADDRESS 0x7F89DB /end MEASUREMENT
/begin MEASUREMENT T50CD_swtSig "T50 von Hardware oder CAN" UBYTE OneToOne 1 100 0.00 255.0 FORMAT "%5.1" ECU_ADDRESS 0x7F89DC /end MEASUREMENT
/begin MEASUREMENT ThrVlv_rTVA "Stellgröße für Regelklappe (Stellerkoordinatorausgang)" SWORD Prc 1 100 -400.0000 399.9878 FORMAT "%8.4" ECU_ADDRESS 0x7F910C /end MEASUREMENT
/begin MEASUREMENT ThrVlv_rTVAByp_mp "Bypass-Label, Kopie von ThrVlv_rTVA" SWORD Prc 1 100 -400.0000 399.9878 FORMAT "%8.4" ECU_ADDRESS 0x8FFE3E /end MEASUREMENT
/begin MEASUREMENT TPUMon_ctUpDwnDeb_mp "Meßpunkt für den Entprellungszähler der TPUMon Zeitabweichung" UWORD OneToOne 1 100 0.00 65535.00 FORMAT "%8.2" ECU_ADDRESS 0x8FFE40 /end MEASUREMENT
/begin MEASUREMENT TPUMon_tiDiffMax_mp "Meßpunkt der maximalen Differenzen aus Timervergleich in den letzten 100 ms" SLONG TimeUSResolution 1 100 -2147483648.00 2147483647.00 FORMAT "%13.2" ECU_ADDRESS 0x8FFE44 /end MEASUREMENT
/begin MEASUREMENT TPUMon_tiDiffMin_mp "Meßpunkt der minimalen (negativer Wert) Differenzen aus Timervergleich in den letzten 100 ms" SLONG TimeUSResolution 1 100 -2147483648.00 2147483647.00 FORMAT "%13.2" ECU_ADDRESS 0x8FFE48 /end MEASUREMENT
/begin MEASUREMENT TPUMon_tiDiffSum_mp "Meßpunkt der Summe aller Differenzen aus Timervergleich in den letzten 100 ms" SLONG TimeUSResolution 1 100 -2147483648.00 2147483647.00 FORMAT "%13.2" ECU_ADDRESS 0x8FFE4C /end MEASUREMENT
/begin MEASUREMENT TVACD_rCnv_mp "Tastverhältnis basierend aus dem Ausgang des Abgasrückführreglers" SWORD DtyCyc 1 100 -327.6800 327.6700 FORMAT "%8.4" ECU_ADDRESS 0x8FFE50 /end MEASUREMENT
/begin MEASUREMENT TVACD_rOut "Tastverhältnis zür Endstufenansteuerung" SWORD DtyCyc 1 100 -327.6800 327.6700 FORMAT "%8.4" ECU_ADDRESS 0x7F910A /end MEASUREMENT
/begin MEASUREMENT TVACD_stErr_mp "Measurementpoint of actual error state of TVA H-Bridge" UBYTE OneToOne 1 100 0.00 255.0 FORMAT "%5.1" ECU_ADDRESS 0x8FFE52 /end MEASUREMENT
/begin MEASUREMENT USAp_dDataVariant_u8 "Nummer der aktiven Datensatzvariante" UBYTE OneToOne 1 100 0.00 255.0 FORMAT "%5.1" ECU_ADDRESS 0x802262 /end MEASUREMENT
/begin MEASUREMENT USAp_stDataVariant_u8 "Statusflags der aktiven Datensatzvariante" UBYTE OneToOne 1 100 0.00 255.0 FORMAT "%5.1" ECU_ADDRESS 0x802263 /end MEASUREMENT
/begin MEASUREMENT UsrDa_stFDC "Status von FDC" UBYTE OneToOne 1 100 0.00 255.0 FORMAT "%5.1" ECU_ADDRESS 0x7F89DE /end MEASUREMENT
/begin MEASUREMENT UsrDa_stRecFDC "FDC im Fahrzeug vorhanden / nicht vorhanden" UBYTE OneToOne 1 100 0.00 255.0 FORMAT "%5.1" ECU_ADDRESS 0x7F89DF /end MEASUREMENT
/begin MEASUREMENT VehDa_ctLoadPrimRow0_mp "Primärkennfeld Fahrzeugnutzungsprofil" UWORD OneToOne 1 100 0.00 65535.00 FORMAT "%8.2" ARRAY_SIZE 8 ECU_ADDRESS 0x6F82B4 /end MEASUREMENT
/begin MEASUREMENT VehDa_ctLoadPrimRow1_mp "Primärkennfeld Fahrzeugnutzungsprofil" UWORD OneToOne 1 100 0.00 65535.00 FORMAT "%8.2" ARRAY_SIZE 8 ECU_ADDRESS 0x6F82C4 /end MEASUREMENT
/begin MEASUREMENT VehDa_ctLoadPrimRow2_mp "Primärkennfeld Fahrzeugnutzungsprofil" UWORD OneToOne 1 100 0.00 65535.00 FORMAT "%8.2" ARRAY_SIZE 8 ECU_ADDRESS 0x6F82D4 /end MEASUREMENT
/begin MEASUREMENT VehDa_ctLoadPrimRow3_mp "Primärkennfeld Fahrzeugnutzungsprofil" UWORD OneToOne 1 100 0.00 65535.00 FORMAT "%8.2" ARRAY_SIZE 8 ECU_ADDRESS 0x6F82E4 /end MEASUREMENT
/begin MEASUREMENT VehDa_ctLoadPrimRow4_mp "Primärkennfeld Fahrzeugnutzungsprofil" UWORD OneToOne 1 100 0.00 65535.00 FORMAT "%8.2" ARRAY_SIZE 8 ECU_ADDRESS 0x6F82F4 /end MEASUREMENT
/begin MEASUREMENT VehDa_ctLoadPrimRow5_mp "Primärkennfeld Fahrzeugnutzungsprofil" UWORD OneToOne 1 100 0.00 65535.00 FORMAT "%8.2" ARRAY_SIZE 8 ECU_ADDRESS 0x6F8304 /end MEASUREMENT
/begin MEASUREMENT VehDa_ctLoadSecRow0_mp "Sekundärkennfeld Fahrzeugnutzungsprofil" UBYTE OneToOne 1 100 0.00 255.0 FORMAT "%5.1" ARRAY_SIZE 8 ECU_ADDRESS 0x6F8314 /end MEASUREMENT
/begin MEASUREMENT VehDa_ctLoadSecRow1_mp "Sekundärkennfeld Fahrzeugnutzungsprofil" UBYTE OneToOne 1 100 0.00 255.0 FORMAT "%5.1" ARRAY_SIZE 8 ECU_ADDRESS 0x6F831C /end MEASUREMENT
/begin MEASUREMENT VehDa_ctLoadSecRow2_mp "Sekundärkennfeld Fahrzeugnutzungsprofil" UBYTE OneToOne 1 100 0.00 255.0 FORMAT "%5.1" ARRAY_SIZE 8 ECU_ADDRESS 0x6F8324 /end MEASUREMENT
/begin MEASUREMENT VehDa_ctLoadSecRow3_mp "Sekundärkennfeld Fahrzeugnutzungsprofil" UBYTE OneToOne 1 100 0.00 255.0 FORMAT "%5.1" ARRAY_SIZE 8 ECU_ADDRESS 0x6F832C /end MEASUREMENT
/begin MEASUREMENT VehDa_ctLoadSecRow4_mp "Sekundärkennfeld Fahrzeugnutzungsprofil" UBYTE OneToOne 1 100 0.00 255.0 FORMAT "%5.1" ARRAY_SIZE 8 ECU_ADDRESS 0x6F8334 /end MEASUREMENT
/begin MEASUREMENT VehDa_ctLoadSecRow5_mp "Sekundärkennfeld Fahrzeugnutzungsprofil" UBYTE OneToOne 1 100 0.00 255.0 FORMAT "%5.1" ARRAY_SIZE 8 ECU_ADDRESS 0x6F833C /end MEASUREMENT
/begin MEASUREMENT VehDa_lInt_mp "Hilfszähler für Kilometerzähler VehDa_lSum über Integration Fahrgeschwindigkeit VSSCD_vRaw" SLONG Dist_20ms 1 100 -119304.647111 119304.647056 FORMAT "%13.6" ECU_ADDRESS 0x8FFE54 /end MEASUREMENT
/begin MEASUREMENT VehDa_lSum "Erfassung gefahrene Strecke" ULONG Length 1 100 0.00 4294967295.00 FORMAT "%13.2" ECU_ADDRESS 0x7F9298 /end MEASUREMENT
/begin MEASUREMENT VehDa_nEngFilt_mp "vorgefilterte Motordrehzahl für v/n Verhältnis" SWORD EngN 1 100 -32768.00 32767.00 FORMAT "%8.2" ECU_ADDRESS 0x8FFE58 /end MEASUREMENT
/begin MEASUREMENT VehDa_rVn "Verhältnis von Fahrgeschwindigkeit zur Motordrehzahl" SWORD VelToN 1 100 0.00 0.1000000 FORMAT "%9.7" ECU_ADDRESS 0x7F9120 /end MEASUREMENT
/begin MEASUREMENT VehDa_stTrqDem "Status der aktuellen Momentenanforderungen" UWORD OneToOne 1 100 0.00 65535.00 FORMAT "%8.2" ECU_ADDRESS 0x7F9122 /end MEASUREMENT
/begin MEASUREMENT VehDa_tiEngOn "Erfassung der aktuellen Betriebszeit" ULONG TimeEngOn 1 100 0.00 4294967295.00 FORMAT "%13.2" ECU_ADDRESS 0x7F929C /end MEASUREMENT
/begin MEASUREMENT VehDa_tiLoadPrim_mp "Fahrzeugnutzungsprofil-Betriebsstundenzähler" UWORD OneToOne 1 100 0.00 65535.00 FORMAT "%8.2" ECU_ADDRESS 0x6F8344 /end MEASUREMENT
/begin MEASUREMENT VehDa_tiLoadSec_mp "Fahrzeugnutzungsprofil-Betriebsstundenzähler" ULONG OneToOne 1 100 0.00 4294967295.00 FORMAT "%13.2" ECU_ADDRESS 0x6F8348 /end MEASUREMENT
/begin MEASUREMENT VehMot_nMax "Grenzdrehzahl für Fahrzeugbewegung" SWORD EngN 1 100 -32768.00 32767.00 FORMAT "%8.2" ECU_ADDRESS 0x7F9124 /end MEASUREMENT
/begin MEASUREMENT VehMot_nMin "Leerlaufdrehzahl für Fahrzeugbewegung" SWORD EngN 1 100 -32768.00 32767.00 FORMAT "%8.2" ECU_ADDRESS 0x7F9126 /end MEASUREMENT
/begin MEASUREMENT VehMot_pwrAcsDes "Gesamtbedarf Leistung der Nebenaggregate in der Fahrzeugbewegung" SWORD Pwr 1 100 -308831.1 308821.7 FORMAT "%8.1" ECU_ADDRESS 0x7F9128 /end MEASUREMENT
/begin MEASUREMENT VehMot_pwrAcsLead "Leistungsvorhalt der Nebenaggregate in der Fahrzeugbewegung" SWORD Pwr 1 100 -308831.1 308821.7 FORMAT "%8.1" ECU_ADDRESS 0x7F912A /end MEASUREMENT
/begin MEASUREMENT VESGov_trq "Momentenanforderung Arbeitsdrehzahlregler" SWORD Trq 1 100 -3276.800 3276.700 FORMAT "%8.3" ECU_ADDRESS 0x7F910E /end MEASUREMENT
/begin MEASUREMENT VSACD_rCnv_mp "Tastverhältnis basierend aus dem Ausgang der Drallniveausteuerung" SWORD DtyCyc 1 100 -327.6800 327.6700 FORMAT "%8.4" ECU_ADDRESS 0x8FFE5C /end MEASUREMENT
/begin MEASUREMENT VSACD_rOut "Tastverhältnis zür Endstufenansteuerung" SWORD DtyCyc 1 100 -327.6800 327.6700 FORMAT "%8.4" ECU_ADDRESS 0x7F9110 /end MEASUREMENT
/begin MEASUREMENT VSACD_stErr_mp "Status des PWM-einganges der Drallklappe" UBYTE OneToOne 1 100 0.00 255.0 FORMAT "%5.1" ECU_ADDRESS 0x8FFE5E /end MEASUREMENT
/begin MEASUREMENT VSA_rVSA "Stellgröße für Einlaßkanalabschaltung (Stellerkoordinatorausgang)" SWORD DtyCyc 1 100 -327.6800 327.6700 FORMAT "%8.4" ECU_ADDRESS 0x7F9112 /end MEASUREMENT
/begin MEASUREMENT VSA_rVSAByp_mp "Bypass-Label, copie of VSA_rVSA" SWORD Prc 1 100 -400.0000 399.9878 FORMAT "%8.4" ECU_ADDRESS 0x8FFE5A /end MEASUREMENT
/begin MEASUREMENT VSSCD_a "Fahrbeschleunigung" SWORD Acc 1 100 -32.76800 32.76700 FORMAT "%8.5" ECU_ADDRESS 0x7F9114 /end MEASUREMENT
/begin MEASUREMENT VSSCD_aRaw "Rohwert Fahrbeschleunigung" SWORD Acc 1 100 -32.76800 32.76700 FORMAT "%8.5" ECU_ADDRESS 0x7F9116 /end MEASUREMENT
/begin MEASUREMENT VSSCD_ctImp "Impulszähler Fahrgeschwindigkeit Impulssignal" UWORD OneToOne 1 100 0.00 65535.00 FORMAT "%8.2" ECU_ADDRESS 0x7F9118 /end MEASUREMENT
/begin MEASUREMENT VSSCD_rImp_mp "Tastverhältnis Eingangssignal Fahrgeschwindigkeit (FGG)" SWORD DtyCyc 1 100 -327.6800 327.6700 FORMAT "%8.4" ECU_ADDRESS 0x8FFE60 /end MEASUREMENT
/begin MEASUREMENT VSSCD_stInHW_mp "Statusflags Eingangssignal Fahrgeschwindigkeit (FGG)" UBYTE OneToOne 1 100 0.00 255.0 FORMAT "%5.1" ECU_ADDRESS 0x8FFE62 /end MEASUREMENT
/begin MEASUREMENT VSSCD_swtSig "Signaleingangsschalter Fahrgeschwindigkeit" UBYTE OneToOne 1 100 0.00 255.0 FORMAT "%5.1" ECU_ADDRESS 0x7F89E0 /end MEASUREMENT
/begin MEASUREMENT VSSCD_tiPerAvrg "Mittlere Periodendauer zwischen zwei FGG-Impulsen" SLONG Time_PwmHigh 1 100 -214748364.800 214748364.700 FORMAT "%13.3" ECU_ADDRESS 0x7F9294 /end MEASUREMENT
/begin MEASUREMENT VSSCD_v "Fahrzeuggeschwindigkeit" SWORD Vel 1 100 -327.6800 327.6700 FORMAT "%8.4" ECU_ADDRESS 0x7F911A /end MEASUREMENT
/begin MEASUREMENT VSSCD_vRaw "Rohwert Fahrgeschwindigkeit" SWORD Vel 1 100 -327.6800 327.6700 FORMAT "%8.4" ECU_ADDRESS 0x7F911C /end MEASUREMENT
/begin MEASUREMENT VSSCD_vSensVal "Vehicle speed sensed value" SWORD Vel 1 100 -327.6800 327.6700 FORMAT "%8.4" ECU_ADDRESS 0x7F911E /end MEASUREMENT
/begin MEASUREMENT WDCom_dChisteResponse_u32 "Antwortbeitrag des Befehlstests" UWORD OneToOne 1 100 0.00 65535.00 FORMAT "%8.2" ECU_ADDRESS 0x7FD704 /end MEASUREMENT
/begin MEASUREMENT WDCom_dErrorCountForCntler_u8 "Kopie des überwachungsmodul-internen Fehlerzählers für den Funktionsrechner" UBYTE OneToOne 1 100 0.00 255.0 FORMAT "%5.1" ECU_ADDRESS 0x7FD746 /end MEASUREMENT
/begin MEASUREMENT WDCom_dErrorCountForSpi_u8 "Fehlerzähler für die Kommunikation zwischen Funktionsrechner und Überwachungsmodul" UBYTE OneToOne 1 100 0.00 255.0 FORMAT "%5.1" ECU_ADDRESS 0x7FD745 /end MEASUREMENT
/begin MEASUREMENT WDCom_dErrorCountForWD_u8 "Fehlerzähler für das Überwachungsmodul" UBYTE OneToOne 1 100 0.00 255.0 FORMAT "%5.1" ECU_ADDRESS 0x7F9D2F /end MEASUREMENT
/begin MEASUREMENT WDCom_dRequest_u32 "Aktuelle Frage des Überwachungsmoduls" UWORD OneToOne 1 100 0.00 65535.00 FORMAT "%8.2" ECU_ADDRESS 0x7FD70C /end MEASUREMENT
/begin MEASUREMENT ZFC_dpRailLim_mp "Aktuelle max Raildruckabweichung für die Nullmengenkalibrierung" SWORD Pres_Rail 1 100 -3276.800 3276.700 FORMAT "%5.3" ECU_ADDRESS 0x8FFE64 /end MEASUREMENT
/begin MEASUREMENT ZFC_dpRail_mp "Raildruckabweichung zum Raildruck Kalibrierungspunkt" SWORD Pres_Rail 1 100 -3276.800 3276.700 FORMAT "%5.3" ECU_ADDRESS 0x6F834C /end MEASUREMENT
/begin MEASUREMENT ZFC_numCylInj_mp "Aktuelle Zylindernummer für die Einspritzung der Nullmengenkalibrierung" UBYTE OneToOne 1 100 0.00 255.0 FORMAT "%5.1" ECU_ADDRESS 0x6F8369 /end MEASUREMENT
/begin MEASUREMENT ZFC_phiInj_mp "Ansteuerbeginng der Einspritzung für die Nullmengenkalibrierung" SWORD AngleCrS 1 100 -768.0000 767.9766 FORMAT "%8.4" ECU_ADDRESS 0x8FFE6E /end MEASUREMENT
/begin MEASUREMENT ZFC_pRailSetPoint_mp "Angeforderter Raildrucksollwert der Nullmengenkalibrierung" SWORD Pres_Rail 1 100 -3276.800 3276.700 FORMAT "%5.3" ECU_ADDRESS 0x8FFE66 /end MEASUREMENT
/begin MEASUREMENT ZFC_SigThres_mp "Aktuelle Signalschwelle für die Nullmengenkalibrierung" SWORD OneToOne 1 100 -32768.00 32767.00 FORMAT "%8.2" ECU_ADDRESS 0x8FFE6C /end MEASUREMENT
/begin MEASUREMENT ZFC_Sig_mp "Messwert der Kalibrierung" SLONG OneToOne 1 100 -2147483648.00 2147483647.00 FORMAT "%13.2" ARRAY_SIZE 6 ECU_ADDRESS 0x6F8350 /end MEASUREMENT
/begin MEASUREMENT ZFC_stCldCham "Zustand des Brennraums für die Nullmengenkalibrierung" UBYTE OneToOne 1 100 0.00 255.0 FORMAT "%5.1" ECU_ADDRESS 0x7F89E1 /end MEASUREMENT
/begin MEASUREMENT ZFC_stCmbCham_mp "Zustand der Erkennung kalter Brennraum für die Nullmengenkalibrierung" UBYTE OneToOne 1 100 0.00 255.0 FORMAT "%5.1" ECU_ADDRESS 0x8FFE63 /end MEASUREMENT
/begin MEASUREMENT ZFC_stDem_mp "Anforderungen der Nullmengenkalibrierung" UBYTE OneToOne 1 100 0.00 255.0 FORMAT "%5.1" ECU_ADDRESS 0x8FFE68 /end MEASUREMENT
/begin MEASUREMENT ZFC_stEvalSig_mp "Status der Auswertung des Signals der Nullmengenkalibrierung" UBYTE ZFC_EvalEngSpd_Rslt 1 100 0.00 2.00000000000 FORMAT "%13.11" ECU_ADDRESS 0x6F8368 /end MEASUREMENT
/begin MEASUREMENT ZFC_stInj_mp "Status der Einspritzprogrammierung der Nullmengenkalibrierung" UBYTE ZFC_Inj_State 1 100 0.00 64.0000000000 FORMAT "%13.10" ECU_ADDRESS 0x6F836A /end MEASUREMENT
/begin MEASUREMENT ZFC_st_mp "Status der Nullmengenkalibrierung" UBYTE ZFC_State 1 100 1.00000000000 16.0000000000 FORMAT "%13.10" ECU_ADDRESS 0x6F834E /end MEASUREMENT
/begin MEASUREMENT ZFC_swtClbActv "SW-Schalter für die Aktivierung der ZFC Kalibrierung" UBYTE OneToOne 1 100 0.00 255.0 FORMAT "%5.1" ECU_ADDRESS 0x7F89E2 /end MEASUREMENT
/begin MEASUREMENT ZFC_tiET_mp "Ansteuerdauer für die Einspritzung der Nullmengenkalibrierung" SWORD InjTime_us 1 100 -32768.00 32767.00 FORMAT "%8.2" ECU_ADDRESS 0x6F836C /end MEASUREMENT
/begin MEASUREMENT ZFC_vStopClb_mp "Minimale Fahrzeuggeschwindigkeit der aktuellen Ansteuerdauerkalibrierung" SWORD Vel 1 100 -327.6800 327.6700 FORMAT "%8.4" ECU_ADDRESS 0x8FFE6A /end MEASUREMENT
/begin MEASUREMENT I_craweng "Strombedarf Motor" SWORD Def_i_sw_q1 0 0 -10.0000 254.0000 ECU_ADDRESS 0x007FF458 /begin FUNCTION_LIST BGCRENG /end FUNCTION_LIST /end MEASUREMENT
/begin MEASUREMENT Fak_ttansel "Ansaugluftfaktor E-Lüfterstrom" UWORD Def_f_uw_b512 0 0 0.0 511.9921 ECU_ADDRESS 0x007FF45A /begin FUNCTION_LIST BGCRENG /end FUNCTION_LIST /end MEASUREMENT
/begin MEASUREMENT Fak_tubel "Faktor Lüfterstrom aus Geschwindigkeit" UWORD Def_f_uw_b512 0 0 0.0 511.9921 ECU_ADDRESS 0x007FF45C /begin FUNCTION_LIST BGCRENG /end FUNCTION_LIST /end MEASUREMENT
/begin MEASUREMENT I_elu_vvt "Strom E-Lüfter und VVT-System" UWORD Def_i_uw_q0p0635 0 0 0.0 4095.9375 ECU_ADDRESS 0x007FF45E /begin FUNCTION_LIST BGCRENG /end FUNCTION_LIST /end MEASUREMENT
/begin MEASUREMENT I_eluefter "E-Lüfter Stromaufnahme" UWORD Def_i_uw_q0p0635 0 0 0.0 4095.9375 ECU_ADDRESS 0x007FF460 /begin FUNCTION_LIST BGCRENG /end FUNCTION_LIST /end MEASUREMENT
/begin MEASUREMENT I_elupwm "Lüfterstrom ohne Temperatur- und Geschwindigkeitseinfluss" UWORD Def_i_uw_q0p0635 0 0 0.0 64.0000 ECU_ADDRESS 0x007FF462 /begin FUNCTION_LIST BGCRENG /end FUNCTION_LIST /end MEASUREMENT
/begin MEASUREMENT I_eluvfzg "Lüfterstrom ohne Geschwindigkeitseinfluss" UWORD Def_i_uw_q0p0635 0 0 0.0 128.0000 ECU_ADDRESS 0x007FF464 /begin FUNCTION_LIST BGCRENG /end FUNCTION_LIST /end MEASUREMENT
/begin MEASUREMENT I_gle "Glühstrom" UWORD Def_i_uw_q0p0635 0 0 0.0 4095.9375 ECU_ADDRESS 0x007FF466 /begin FUNCTION_LIST BGCRENG /end FUNCTION_LIST /end MEASUREMENT
/begin MEASUREMENT I_sls "berechnete Groesse Strombedarf Sekundärluftpumpe" UWORD Def_i_uw_q0p0635 0 0 0.0 255.0000 ECU_ADDRESS 0x007FF468 /begin FUNCTION_LIST BGCRENG /end FUNCTION_LIST /end MEASUREMENT
/begin MEASUREMENT Vvt_ib1_2 "Gesamtstrom VVT Bank1 bzw 4Zyl. und Bank2" UWORD Def_i_uw_q0p0635 0 0 0.0 4095.9375 ECU_ADDRESS 0x007FF46A /begin FUNCTION_LIST BGCRENG /end FUNCTION_LIST /end MEASUREMENT
/begin MEASUREMENT Vvt_iges "Strombedarf des gesamten VVT-Systems" UWORD Def_i_uw_q0p0635 0 0 0.0 192.0000 ECU_ADDRESS 0x007FF46C /begin FUNCTION_LIST BGCRENG /end FUNCTION_LIST /end MEASUREMENT
/begin MEASUREMENT St_bgllgen0.B_hysllrah "" UBYTE Def_bit_ub_0 0 0 0.0 255.0 ECU_ADDRESS 0x007FF470 /begin FUNCTION_LIST BGLLGEN_1PR /end FUNCTION_LIST BIT_MASK 0x1 /end MEASUREMENT
/begin MEASUREMENT St_bgllgen0 "Statuswort" UBYTE Def_st_ub_q1 0 0 0.0 255.0000 ECU_ADDRESS 0x007FF470 /begin FUNCTION_LIST BGLLGEN_1PR /end FUNCTION_LIST /end MEASUREMENT
/begin MEASUREMENT N_idlgspec "Anforderung LL-Anhebung" UBYTE Def_st_ub_q1 0 0 0.0 255.0000 ECU_ADDRESS 0x007FF471 /begin FUNCTION_LIST BGLLGEN_1PR /end FUNCTION_LIST /end MEASUREMENT
/begin MEASUREMENT N_gsllm "" SWORD Def_n_sw_q1p0 0 0 0.0 32767.0000 ECU_ADDRESS 0x007FF46E /begin FUNCTION_LIST BGLLGEN_1PR /end FUNCTION_LIST /end MEASUREMENT
/begin MEASUREMENT Gen_dfvorhs "DF-Signal Vorhersage" UBYTE Def_f_ub_b100 0 0 0.0 99.6093 ECU_ADDRESS 0x007FF472 /begin FUNCTION_LIST BGLLGEN_1PR /end FUNCTION_LIST /end MEASUREMENT
/begin MEASUREMENT St_dgen0.B_1stbsder "" UBYTE Def_bit_ub_0 0 0 0.0 255.0 ECU_ADDRESS 0x007FFB51 /begin FUNCTION_LIST DGEN /end FUNCTION_LIST BIT_MASK 0x1 /end MEASUREMENT
/begin MEASUREMENT St_dgen0.B_kl61 "Bedingung Ladekontroll Laempchen an" UBYTE Def_bit_ub_1 0 0 0.0 255.0 ECU_ADDRESS 0x007FFB51 /begin FUNCTION_LIST DGEN /end FUNCTION_LIST BIT_MASK 0x2 /end MEASUREMENT
/begin MEASUREMENT St_dgen0.B_genfprl "Bedingung Generatorfehler entprellt" UBYTE Def_bit_ub_2 0 0 0.0 255.0 ECU_ADDRESS 0x007FFB51 /begin FUNCTION_LIST DGEN /end FUNCTION_LIST BIT_MASK 0x4 /end MEASUREMENT
/begin MEASUREMENT St_dgen0.B_gfbsupak "Generator Typ unplausibel^aus Fehlerspeicher" UBYTE Def_bit_ub_3 0 0 0.0 255.0 ECU_ADDRESS 0x007FFB51 /begin FUNCTION_LIST DGEN /end FUNCTION_LIST BIT_MASK 0x8 /end MEASUREMENT
/begin MEASUREMENT St_dgen0.B_gfelak "Generatorfehler elektrisch aus Fehlerspeicher" UBYTE Def_bit_ub_4 0 0 0.0 255.0 ECU_ADDRESS 0x007FFB51 /begin FUNCTION_LIST DGEN /end FUNCTION_LIST BIT_MASK 0x10 /end MEASUREMENT
/begin MEASUREMENT St_dgen0.B_gfhtak "Generatorfehler Uebertemperatur aus Fehlerspeicher" UBYTE Def_bit_ub_5 0 0 0.0 255.0 ECU_ADDRESS 0x007FFB51 /begin FUNCTION_LIST DGEN /end FUNCTION_LIST BIT_MASK 0x20 /end MEASUREMENT
/begin MEASUREMENT St_dgen0.B_gfmeak "Generatorfehler mechanisch aus Fehlerspeicher" UBYTE Def_bit_ub_6 0 0 0.0 255.0 ECU_ADDRESS 0x007FFB51 /begin FUNCTION_LIST DGEN /end FUNCTION_LIST BIT_MASK 0x40 /end MEASUREMENT
/begin MEASUREMENT St_dgen0.B_gfnobsak "Generator BSD Kommunikationsverlust aus Fehlerspeicher" UBYTE Def_bit_ub_7 0 0 0.0 255.0 ECU_ADDRESS 0x007FFB51 /begin FUNCTION_LIST DGEN /end FUNCTION_LIST BIT_MASK 0x80 /end MEASUREMENT
/begin MEASUREMENT St_dgen0 "Statuswort" UBYTE Def_st_ub_q1 0 0 0.0 255.0000 ECU_ADDRESS 0x007FFB51 /begin FUNCTION_LIST DGEN /end FUNCTION_LIST /end MEASUREMENT
/begin MEASUREMENT St_gen "Generatorstatus" UBYTE Def_st_ub_q1 0 0 0.0 255.0000 ECU_ADDRESS 0x008003B0 /begin FUNCTION_LIST DGEN /end FUNCTION_LIST /end MEASUREMENT
/begin MEASUREMENT St_genbsd "" UWORD Def_st_uw_q1 0 0 0.0 65535.0000 ECU_ADDRESS 0x008003AC /begin FUNCTION_LIST DGEN /end FUNCTION_LIST /end MEASUREMENT
/begin MEASUREMENT St_gengen "" UWORD Def_st_uw_q1 0 0 0.0 65535.0000 ECU_ADDRESS 0x008003AE /begin FUNCTION_LIST DGEN /end FUNCTION_LIST /end MEASUREMENT
/begin MEASUREMENT Gen_fbsak "BSD Uebertragungsfehler kodiert fuer FSPVDGEN" UBYTE Def_st_ub_q1 0 0 0.0 255.0000 ECU_ADDRESS 0x008003B1 /begin FUNCTION_LIST DGEN /end FUNCTION_LIST /end MEASUREMENT
/begin MEASUREMENT Gen_statroh "Generatorfehler kodiert fuer FSPVDGEN" UBYTE Def_st_ub_q1 0 0 0.0 255.0000 ECU_ADDRESS 0x008003B2 /begin FUNCTION_LIST DGEN /end FUNCTION_LIST /end MEASUREMENT
/begin MEASUREMENT St_dibs1.B_ifbsak "IBS Stromfehler" UBYTE Def_bit_ub_2 0 0 0.0 255.0 ECU_ADDRESS 0x007FFB52 /begin FUNCTION_LIST DIBS /end FUNCTION_LIST BIT_MASK 0x4 /end MEASUREMENT
/begin MEASUREMENT St_dibs1.B_ifebsak "" UBYTE Def_bit_ub_3 0 0 0.0 255.0 ECU_ADDRESS 0x007FFB52 /begin FUNCTION_LIST DIBS /end FUNCTION_LIST BIT_MASK 0x8 /end MEASUREMENT
/begin MEASUREMENT St_dibs1.B_ifuplak "IBS Temperaturfehler" UBYTE Def_bit_ub_4 0 0 0.0 255.0 ECU_ADDRESS 0x007FFB52 /begin FUNCTION_LIST DIBS /end FUNCTION_LIST BIT_MASK 0x10 /end MEASUREMENT
/begin MEASUREMENT St_dibs1 "Statuswort" UBYTE Def_st_ub_q1 0 0 0.0 255.0000 ECU_ADDRESS 0x007FFB52 /begin FUNCTION_LIST DIBS /end FUNCTION_LIST /end MEASUREMENT
/begin MEASUREMENT St_dibs2.B_ifisak "Fehler IBS Version unplausibel" UBYTE Def_bit_ub_0 0 0 0.0 255.0 ECU_ADDRESS 0x007FFB53 /begin FUNCTION_LIST DIBS /end FUNCTION_LIST BIT_MASK 0x1 /end MEASUREMENT
/begin MEASUREMENT St_dibs2.B_ifusak "IBS Spannungsfehler" UBYTE Def_bit_ub_1 0 0 0.0 255.0 ECU_ADDRESS 0x007FFB53 /begin FUNCTION_LIST DIBS /end FUNCTION_LIST BIT_MASK 0x2 /end MEASUREMENT
/begin MEASUREMENT St_dibs2.B_iftempak "IBS KL15 Masseschluss" UBYTE Def_bit_ub_2 0 0 0.0 255.0 ECU_ADDRESS 0x007FFB53 /begin FUNCTION_LIST DIBS /end FUNCTION_LIST BIT_MASK 0x4 /end MEASUREMENT
/begin MEASUREMENT St_dibs2.B_ifwugdak "" UBYTE Def_bit_ub_3 0 0 0.0 255.0 ECU_ADDRESS 0x007FFB53 /begin FUNCTION_LIST DIBS /end FUNCTION_LIST BIT_MASK 0x8 /end MEASUREMENT
/begin MEASUREMENT St_dibs2.B_ifwuplak "Signal nv lave loc zur Flankenerkennung" UBYTE Def_bit_ub_4 0 0 0.0 255.0 ECU_ADDRESS 0x007FFB53 /begin FUNCTION_LIST DIBS /end FUNCTION_LIST BIT_MASK 0x10 /end MEASUREMENT
/begin MEASUREMENT St_dibs2.B_ifsysak "Signal nv lave loc zur Flankenerkennung" UBYTE Def_bit_ub_5 0 0 0.0 255.0 ECU_ADDRESS 0x007FFB53 /begin FUNCTION_LIST DIBS /end FUNCTION_LIST BIT_MASK 0x20 /end MEASUREMENT
/begin MEASUREMENT St_dibs2 "Statuswort" UBYTE Def_st_ub_q1 0 0 0.0 255.0000 ECU_ADDRESS 0x007FFB53 /begin FUNCTION_LIST DIBS /end FUNCTION_LIST /end MEASUREMENT
/begin MEASUREMENT St_dibs0.B_dibloc1 "BSD Kommunikation zum IBS gestoert" UBYTE Def_bit_ub_0 0 0 0.0 255.0 ECU_ADDRESS 0x008003BE /begin FUNCTION_LIST DIBS /end FUNCTION_LIST BIT_MASK 0x1 /end MEASUREMENT
/begin MEASUREMENT St_dibs0.B_dibloc2 "Fehler erweiterte BSD Kommunikation zum IBS" UBYTE Def_bit_ub_1 0 0 0.0 255.0 ECU_ADDRESS 0x008003BE /begin FUNCTION_LIST DIBS /end FUNCTION_LIST BIT_MASK 0x2 /end MEASUREMENT
/begin MEASUREMENT St_dibs0 "Statuswort" UBYTE Def_st_ub_q1 0 0 0.0 255.0000 ECU_ADDRESS 0x008003BE /begin FUNCTION_LIST DIBS /end FUNCTION_LIST /end MEASUREMENT
/begin MEASUREMENT Ibs1_errstat "" UWORD Def_st_uw_q1 0 0 0.0 65535.0000 ECU_ADDRESS 0x008003B4 /begin FUNCTION_LIST DIBS /end FUNCTION_LIST /end MEASUREMENT
/begin MEASUREMENT Ibs2_errstat "" UWORD Def_st_uw_q1 0 0 0.0 65535.0000 ECU_ADDRESS 0x008003B6 /begin FUNCTION_LIST DIBS /end FUNCTION_LIST /end MEASUREMENT
/begin MEASUREMENT Ibs3_errstat "" UWORD Def_st_uw_q1 0 0 0.0 65535.0000 ECU_ADDRESS 0x008003B8 /begin FUNCTION_LIST DIBS /end FUNCTION_LIST /end MEASUREMENT
/begin MEASUREMENT T_count_dibs1 "" UBYTE Def_i_ub_q1 0 0 0.0 255.0000 ECU_ADDRESS 0x008003BA /begin FUNCTION_LIST DIBS /end FUNCTION_LIST /end MEASUREMENT
/begin MEASUREMENT T_count_dibs2 "" UBYTE Def_i_ub_q1 0 0 0.0 255.0000 ECU_ADDRESS 0x008003BB /begin FUNCTION_LIST DIBS /end FUNCTION_LIST /end MEASUREMENT
/begin MEASUREMENT T_count_dibs3 "" UBYTE ident 0 0 0.0 255.0000 ECU_ADDRESS 0x008003BC /begin FUNCTION_LIST DIBS /end FUNCTION_LIST /end MEASUREMENT
/begin MEASUREMENT T_count_dibs4 "" UBYTE ident 0 0 0.0 255.0000 ECU_ADDRESS 0x008003BD /begin FUNCTION_LIST DIBS /end FUNCTION_LIST /end MEASUREMENT
/begin MEASUREMENT Ibsderrs2 "Fehlerzähler IBS EBSD Kommunikation" UWORD Def_dez_uw_q1 0 0 0.0 65535.0000 ECU_ADDRESS 0x008003C0 /begin FUNCTION_LIST DIBS /end FUNCTION_LIST /end MEASUREMENT
/begin MEASUREMENT Ibsderrs1 "Fehlerzähler IBS BSD Kommunikation" UBYTE Def_dez_ub_q1 0 0 0.0 255.0000 ECU_ADDRESS 0x008003C2 /begin FUNCTION_LIST DIBS /end FUNCTION_LIST /end MEASUREMENT
/begin MEASUREMENT Ibspreco2 "Vorteiler /10 fuer Ibsderrs2" UBYTE Def_dez_ub_q1 0 0 0.0 255.0000 ECU_ADDRESS 0x008003C3 /begin FUNCTION_LIST DIBS /end FUNCTION_LIST /end MEASUREMENT
/begin MEASUREMENT St_dqlt0.B_ozlerr "Messfehler Ölniveau" UBYTE Def_bit_ub_0 0 0 0.0 255.0 ECU_ADDRESS 0x007FFC1A /begin FUNCTION_LIST DQLT /end FUNCTION_LIST BIT_MASK 0x1 /end MEASUREMENT
/begin MEASUREMENT St_dqlt0.B_ozqerr "Messfehler Ölzustand" UBYTE Def_bit_ub_1 0 0 0.0 255.0 ECU_ADDRESS 0x007FFC1A /begin FUNCTION_LIST DQLT /end FUNCTION_LIST BIT_MASK 0x2 /end MEASUREMENT
/begin MEASUREMENT St_dqlt0.B_ozterr "Messfehler Öltemperatur" UBYTE Def_bit_ub_2 0 0 0.0 255.0 ECU_ADDRESS 0x007FFC1A /begin FUNCTION_LIST DQLT /end FUNCTION_LIST BIT_MASK 0x4 /end MEASUREMENT
/begin MEASUREMENT St_dqlt0.B_td_ogerr "" UBYTE Def_bit_ub_3 0 0 0.0 255.0 ECU_ADDRESS 0x007FFC1A /begin FUNCTION_LIST DQLT /end FUNCTION_LIST BIT_MASK 0x8 /end MEASUREMENT
/begin MEASUREMENT St_dqlt0.B_td_ogupl "" UBYTE Def_bit_ub_4 0 0 0.0 255.0 ECU_ADDRESS 0x007FFC1A /begin FUNCTION_LIST DQLT /end FUNCTION_LIST BIT_MASK 0x10 /end MEASUREMENT
/begin MEASUREMENT St_dqlt0.B_ozkttoens "Töns-Sensor verbaut" UBYTE Def_bit_ub_5 0 0 0.0 255.0 ECU_ADDRESS 0x007FFC1A /begin FUNCTION_LIST DQLT /end FUNCTION_LIST BIT_MASK 0x20 /end MEASUREMENT
/begin MEASUREMENT St_dqlt0.B_ozerrbsd "BSD global Fehler" UBYTE Def_bit_ub_6 0 0 0.0 255.0 ECU_ADDRESS 0x007FFC1A /begin FUNCTION_LIST DQLT /end FUNCTION_LIST BIT_MASK 0x40 /end MEASUREMENT
/begin MEASUREMENT St_dqlt0.B_ozdiagnmotok "Motordrehzahl ok für die Diagnose" UBYTE Def_bit_ub_7 0 0 0.0 255.0 ECU_ADDRESS 0x007FFC1A /begin FUNCTION_LIST DQLT /end FUNCTION_LIST BIT_MASK 0x80 /end MEASUREMENT
/begin MEASUREMENT St_dqlt0 "Statuswort" UBYTE Def_st_ub_q1 0 0 0.0 255.0000 ECU_ADDRESS 0x007FFC1A /begin FUNCTION_LIST DQLT /end FUNCTION_LIST /end MEASUREMENT
/begin MEASUREMENT St_dqlt1.B_ozerr "Sensorfehler in FS eingetragen" UBYTE Def_bit_ub_0 0 0 0.0 255.0 ECU_ADDRESS 0x007FFC1B /begin FUNCTION_LIST DQLT /end FUNCTION_LIST BIT_MASK 0x1 /end MEASUREMENT
/begin MEASUREMENT St_dqlt1 "Statuswort" UBYTE Def_st_ub_q1 0 0 0.0 255.0000 ECU_ADDRESS 0x007FFC1B /begin FUNCTION_LIST DQLT /end FUNCTION_LIST /end MEASUREMENT
/begin MEASUREMENT St_oz_o.B_oztemic "QLT-Temic verbaut" UBYTE Def_bit_ub_0 0 0 0.0 255.0 ECU_ADDRESS 0x007FFC1C /begin FUNCTION_LIST DQLT /end FUNCTION_LIST BIT_MASK 0x1 /end MEASUREMENT
/begin MEASUREMENT St_oz_o.B_mol_sf "Sensorfehler in FS eingetragen für CC-Meldung" UBYTE Def_bit_ub_1 0 0 0.0 255.0 ECU_ADDRESS 0x007FFC1C /begin FUNCTION_LIST DQLT /end FUNCTION_LIST BIT_MASK 0x2 /end MEASUREMENT
/begin MEASUREMENT St_oz_o "Statuswort" UBYTE Def_st_ub_q1 0 0 0.0 255.0000 ECU_ADDRESS 0x007FFC1C /begin FUNCTION_LIST DQLT /end FUNCTION_LIST /end MEASUREMENT
/begin MEASUREMENT Oz_permerrz "" UBYTE Def_dez_ub_q1 0 0 0.0 255.0000 ECU_ADDRESS 0x008003D0 /begin FUNCTION_LIST DQLT /end FUNCTION_LIST /end MEASUREMENT
/begin MEASUREMENT Oz_diagtoens "Töns Diagnose Byte" UWORD Def_dez_uw_q1 0 0 0.0 65535.0000 ECU_ADDRESS 0x008003C4 /begin FUNCTION_LIST DQLT /end FUNCTION_LIST /end MEASUREMENT
/begin FUNCTION sigtst_auto ""
 /begin DEF_CHARACTERISTIC SigTst_ACEn_C SigTst_AOHtEn_C SigTst_BPAEn_C SigTst_CpBVlvEn_C SigTst_EBAFEn_C SigTst_EBFEn_C SigTst_EGPpEn_C SigTst_EGREn_C SigTst_ETClbCorOffEn_C SigTst_FANEn_C SigTst_GLWRLYEn_C SigTst_LPAEn_C SigTst_LSUCDHt0En_C SigTst_MILLAMPEn_C SigTst_MNTCTLEn_C SigTst_MeUnEn_C SigTst_PCVEn_C SigTst_PSPEn_C SigTst_PSPoverCANEn_C SigTst_SYSLAMPEn_C SigTst_ShuttrEn_C SigTst_TVAEn_C SigTst_VSAEn_C /end DEF_CHARACTERISTIC
/end FUNCTION
/begin FUNCTION soptst "Power-Up-Function test of disabling security pathes" /begin DEF_CHARACTERISTIC SOPTst_stRcyDem_C SOPTst_stShOffPathActv_C /end DEF_CHARACTERISTIC /end FUNCTION
/begin FUNCTION soptst_msg "" /begin OUT_MEASUREMENT SOPTst_stCyl /end OUT_MEASUREMENT /end FUNCTION
/begin FUNCTION spmon "Stack pointer Überwachung" /begin DEF_CHARACTERISTIC SPMon_swtRstStackMon_C /end DEF_CHARACTERISTIC /begin OUT_MEASUREMENT SPMon_numFreeErcosekStack_mp SPMon_numFreeUserStack_mp /end OUT_MEASUREMENT /end FUNCTION
/begin FUNCTION srvpmp "Servopumpe"
 /begin DEF_CHARACTERISTIC SrvPmp_facSTWAV_CUR SrvPmp_facVS_CUR SrvPmp_rTrans_C SrvPmp_trqSTWABase_CUR /end DEF_CHARACTERISTIC
 /begin IN_MEASUREMENT FrmMng_phiStrg SrvPmp_dphiStrg_mp VSSCD_v /end IN_MEASUREMENT
/end FUNCTION
/begin FUNCTION srvpmp_msg "" /begin OUT_MEASUREMENT SrvPmp_pwrDes SrvPmp_pwrLead /end OUT_MEASUREMENT /end FUNCTION
/begin FUNCTION srvpmp_uic "" /begin OUT_MEASUREMENT SrvPmp_dphiStrg_mp SrvPmp_trqDes_mp /end OUT_MEASUREMENT /end FUNCTION
/begin FUNCTION sspmon "Versorgungsspannungsüberwachung"
 /begin DEF_CHARACTERISTIC SSpMon_DebSRCHighSplyVltgDef1_C SSpMon_DebSRCHighSplyVltgOk1_C SSpMon_DebSRCHighSplyVltgDef2_C SSpMon_DebSRCHighSplyVltgOk2_C SSpMon_DebSRCHighSplyVltgDef3_C SSpMon_DebSRCHighSplyVltgOk3_C SSpMon_DebSRCLowSplyVltgDef1_C SSpMon_DebSRCLowSplyVltgOk1_C SSpMon_DebSRCLowSplyVltgDef2_C SSpMon_DebSRCLowSplyVltgOk2_C SSpMon_DebSRCLowSplyVltgDef3_C SSpMon_DebSRCLowSplyVltgOk3_C SSpMon_numDiaVltg1_C SSpMon_numDiaVltg2_C SSpMon_numDiaVltg3_C /end DEF_CHARACTERISTIC
/end FUNCTION
/begin FUNCTION sspmon_msg "" /begin OUT_MEASUREMENT SSpMon_stSSpErr /end OUT_MEASUREMENT /end FUNCTION
/begin FUNCTION sspmon_uic "" /begin OUT_MEASUREMENT SSpMon_stRaw_1_mp SSpMon_stRaw_2_mp SSpMon_stRaw_3_mp /end OUT_MEASUREMENT /end FUNCTION
/begin FUNCTION stdpwm_pwrstg "" /end FUNCTION
/begin FUNCTION strtcd_actrout "Starterrelais Steller"
 /begin DEF_CHARACTERISTIC StrtCD_ActrDebExcTempDef_C StrtCD_ActrDebExcTempOk_C StrtCD_ActrDebNoLoadDef_C StrtCD_ActrDebNoLoadOk_C StrtCD_ActrDebShrtCBatDef_C StrtCD_ActrDebShrtCBatOk_C StrtCD_ActrDebShrtCGndDef_C StrtCD_ActrDebShrtCGndOk_C StrtCD_ctPwrStgOnMax_C StrtCD_numDia_C StrtCD_numDioOut_C StrtCD_stActrInvOut_C StrtCD_stPwrStgActrActv_C StrtCD_stPwrStgActrDia_C StrtCD_stSPICtl_C StrtCD_tiBtwTst_C StrtCD_tiPwrStgOn_C /end DEF_CHARACTERISTIC
/end FUNCTION
/begin FUNCTION strtcd_actrout_uic "" /begin OUT_MEASUREMENT StrtCD_stHWE_mp /end OUT_MEASUREMENT /end FUNCTION
/begin FUNCTION stsys "Startsystem" /begin DEF_CHARACTERISTIC StSys_tiStrtLck_C StSys_tiStrtMax_C /end DEF_CHARACTERISTIC /end FUNCTION
/begin FUNCTION stsys_addcor "Startmomentenkorrektur"
 /begin DEF_CHARACTERISTIC StSys_facAPSCor_CUR StSys_numStrtAddCor_C StSys_trqStrtAPSCor_MAP /end DEF_CHARACTERISTIC
 /begin IN_MEASUREMENT APSCD_pVal Eng_nAvrg StSys_tStrtBas_mp /end IN_MEASUREMENT
/end FUNCTION
/begin FUNCTION stsys_addcor_msg "" /begin OUT_MEASUREMENT StSys_trqAddCor /end OUT_MEASUREMENT /end FUNCTION
/begin FUNCTION stsys_addcor_uic ""
 /begin OUT_MEASUREMENT StSys_facAPSCor_mp StSys_trqStrtAPSCor_mp StSys_trqStrtAPS_mp StSys_tStrtBas_mp /end OUT_MEASUREMENT
/end FUNCTION
/begin FUNCTION stsys_strt "Startabwurf" /begin DEF_CHARACTERISTIC StSys_nStrtCutOut_MAP StSys_numStrt_C StSys_tiStrtCutOut_C /end DEF_CHARACTERISTIC /begin IN_MEASUREMENT APSCD_pVal StSys_tStrt_mp /end IN_MEASUREMENT /end FUNCTION
/begin FUNCTION stsys_strtbas "Startbasismoment"
 /begin DEF_CHARACTERISTIC StSys_nAdjMax_C StSys_trqAdjMax_C StSys_trqAdjVal_C StSys_trqStrtBas_MAP /end DEF_CHARACTERISTIC
 /begin IN_MEASUREMENT Eng_nAvrg StSys_tStrtBas_mp /end IN_MEASUREMENT
/end FUNCTION
/begin FUNCTION stsys_strtbas_msg "" /begin OUT_MEASUREMENT StSys_trqBas /end OUT_MEASUREMENT /end FUNCTION
/begin FUNCTION stsys_strtbas_uic "" /begin OUT_MEASUREMENT StSys_trqAdj_mp StSys_trqSetAdjVal_mp StSys_trqStrtBas_mp /end OUT_MEASUREMENT /end FUNCTION
/begin FUNCTION stsys_strtctl "Startsystem Anlassersteuerung"
 /begin DEF_CHARACTERISTIC StSys_nDiseng_C StSys_nEngage_C Stsys_swtGlwLamp_C StSys_tiLckCutOut_C /end DEF_CHARACTERISTIC
/end FUNCTION
/begin FUNCTION stsys_strtctl_msg "" /begin OUT_MEASUREMENT StSys_stActrOut /end OUT_MEASUREMENT /end FUNCTION
/begin FUNCTION stsys_strtctl_uic "" /begin OUT_MEASUREMENT StSys_stActrLck_mp StSys_stActrRls_mp /end OUT_MEASUREMENT /end FUNCTION
/begin FUNCTION stsys_strtrmp "Startrampe"
 /begin DEF_CHARACTERISTIC StSys_nFreezeTrqRmp_C StSys_nReleaseTrqRmp_C StSys_numStrtRmp_C StSys_tClntHi_C StSys_tClntLo_C StSys_tiEngTempValid_C StSys_dtrqColdInc_C StSys_tiColdRmpLck_C StSys_trqColdLim_C StSys_dtrqHotInc_C StSys_tiHotRmpLck_C StSys_trqHotLim_C StSys_dtrqWarmInc_C StSys_tiWarmRmpLck_C StSys_trqWarmLim_C /end DEF_CHARACTERISTIC
/end FUNCTION
/begin FUNCTION stsys_strtrmp_msg "" /begin OUT_MEASUREMENT StSys_stRmpMon StSys_trqRmpState StSys_trqStrt /end OUT_MEASUREMENT /end FUNCTION
/begin FUNCTION stsys_strtrmp_uic "" /begin OUT_MEASUREMENT StSys_tStrtRmp_mp /end OUT_MEASUREMENT /end FUNCTION
/begin FUNCTION stsys_strttip "Tip Start (Automatik Start)"
 /begin DEF_CHARACTERISTIC StSys_nStrtTipMax_MAP StSys_nStrtTipProtCaS_C StSys_nStrtTipProt_C StSys_swtShOffGearbxRec_C StSys_swtStrtTipActv_C StSys_tiStrtTipMin_C StSys_tiStrtTipNoMonitor_C StSys_tiStrtTipProt_C /end DEF_CHARACTERISTIC
 /begin IN_MEASUREMENT APSCD_pVal Eng_tEng /end IN_MEASUREMENT
/end FUNCTION
/begin FUNCTION stsys_strttip_msg "" /begin OUT_MEASUREMENT StSys_stStrtTip StSys_stStrtTipOFF StSys_stStrtTipON /end OUT_MEASUREMENT /end FUNCTION
/begin FUNCTION stsys_strttip_uic "" /end FUNCTION
/begin FUNCTION stsys_strt_msg "" /begin OUT_MEASUREMENT StSys_stNewStrt StSys_stStrt StSys_stStrtCutOutMon /end OUT_MEASUREMENT /end FUNCTION
/begin FUNCTION stsys_strt_uic "" /begin OUT_MEASUREMENT StSys_nThresStrtCutOut_mp StSys_tStrt_mp /end OUT_MEASUREMENT /end FUNCTION
/begin FUNCTION stsys_t50shutoff ""
 /begin DEF_CHARACTERISTIC StSys_DebTrqShutOffDef_C StSys_DebTrqShutOffOk_C StSys_nStarter_C StSys_tiEngageCutOut_C StSys_vThres_C /end DEF_CHARACTERISTIC
/end FUNCTION
/begin FUNCTION stsys_t50shutoff_uic "" /begin OUT_MEASUREMENT StSys_stTrqShutOffErr_mp /end OUT_MEASUREMENT /end FUNCTION
/begin FUNCTION stsys_trqshutoff "Startmomentabschaltung"
 /begin DEF_CHARACTERISTIC StSys_n2MsWhlLoLim_C StSys_n2MsWhlUpOfs_C StSys_tinFltPT1_C StSys_swtShutOff_C StSys_ti2MsWhlPrt_C StSys_tiStartOszilDef_C StSys_tiStartOszilOk_C /end DEF_CHARACTERISTIC
/end FUNCTION
/begin FUNCTION stsys_trqshutoff_msg "" /begin OUT_MEASUREMENT StSys_stTrqShutOff /end OUT_MEASUREMENT /end FUNCTION
/begin FUNCTION stsys_trqshutoff_uic "" /begin OUT_MEASUREMENT StSys_nAvrgFlt_mp StSys_stTrqShutOffCond_mp /end OUT_MEASUREMENT /end FUNCTION
/begin FUNCTION switches_base "" /end FUNCTION
/begin FUNCTION switches_proj "" /end FUNCTION
/begin FUNCTION switches_sys "" /end FUNCTION
/begin FUNCTION swtmr_inc10ms "" /end FUNCTION
/begin FUNCTION swtmr_inc10ms_uic "" /end FUNCTION
/begin FUNCTION swtmr_msg "" /begin OUT_MEASUREMENT SWTmr_tiTmr16 SWTmr_tiTmr32 /end OUT_MEASUREMENT /end FUNCTION
/begin FUNCTION system_const_base "" /end FUNCTION
/begin FUNCTION system_const_conf "" /end FUNCTION
/begin FUNCTION system_const_proj "" /end FUNCTION
/begin FUNCTION system_const_sys "" /end FUNCTION
/begin FUNCTION t15cd "Klemme 15 Komponententreiber"
 /begin DEF_CHARACTERISTIC T15CD_tiDebNeg_C T15CD_tiDebPos_C T15CD_DebNplDef_C T15CD_DebNplOk_C T15CD_numDioIn_C T15CD_stInvIn_C T15CD_tiDebWakeUp_C /end DEF_CHARACTERISTIC
/end FUNCTION
/begin FUNCTION t15cd_msg "" /begin OUT_MEASUREMENT T15CD_stDebVal T15CD_stDebWakeUpVal T15CD_stWakeUp /end OUT_MEASUREMENT /end FUNCTION
/begin FUNCTION t15cd_uic ""
 /begin OUT_MEASUREMENT T15CD_stCondDebVal_mp T15CD_stLogicT15_mp T15CD_stWakeUpRawVal_mp /end OUT_MEASUREMENT
/end FUNCTION
/begin FUNCTION t50cd "Komponententreiber Klemme 50"
 /begin DEF_CHARACTERISTIC T50CD_tiDebNeg_C T50CD_tiDebPos_C T50CD_stDflVal_C T50CD_stInv_C T50CD_swtSigVal_C /end DEF_CHARACTERISTIC
/end FUNCTION
/begin FUNCTION t50cd_msg "" /begin OUT_MEASUREMENT T50CD_stDebVal T50CD_stRawVal T50CD_swtSig /end OUT_MEASUREMENT /end FUNCTION
/begin FUNCTION t50cd_uic "" /end FUNCTION
/begin FUNCTION thrvlv_co "actuator coordinator for Throttle Valve" /end FUNCTION
/begin FUNCTION thrvlv_co_msg "" /begin OUT_MEASUREMENT ThrVlv_rTVA /end OUT_MEASUREMENT /end FUNCTION
/begin FUNCTION thrvlv_co_uic "" /begin DEF_CHARACTERISTIC ThrVlv_rTVA_Vector ThrVlv_rTVA_Channel /end DEF_CHARACTERISTIC /begin OUT_MEASUREMENT ThrVlv_rTVAByp_mp /end OUT_MEASUREMENT /end FUNCTION
/begin FUNCTION tpumon "Timer Überwachung"
 /begin DEF_CHARACTERISTIC TPUMon_ctDfctLim_C TPUMon_ctTPU_C TPUMon_tiDiffMaxLimit_C TPUMon_tiDiffMinLimit_C TPUMon_tiDiffSumLimit_C /end DEF_CHARACTERISTIC
/end FUNCTION
/begin FUNCTION tpumon_uic ""
 /begin OUT_MEASUREMENT TPUMon_ctUpDwnDeb_mp TPUMon_tiDiffMax_mp TPUMon_tiDiffMin_mp TPUMon_tiDiffSum_mp /end OUT_MEASUREMENT
/end FUNCTION
/begin FUNCTION tvacd "Drosselklappensteller Komponententreiber"
 /begin DEF_CHARACTERISTIC TVACD_ctPwrStgOnMax_C TVACD_DebExcTempDef_C TVACD_DebExcTempOk_C TVACD_DebNoLoadDef_C TVACD_DebNoLoadOk_C TVACD_DebShortCircBatDef_C TVACD_DebShortCircBatOk_C TVACD_DebShortCircGndDef_C TVACD_DebShortCircGndOk_C TVACD_tiDebTVADia1Def_C TVACD_tiDebTVADia1Ok_C TVACD_tiDebTVADia2Def_C TVACD_tiDebTVADia2Ok_C TVACD_tiDebTVADia3Def_C TVACD_tiDebTVADia3Ok_C TVACD_tiDebTVADia4Def_C TVACD_tiDebTVADia4Ok_C TVACD_numDia_C TVACD_numPwmOut_C TVACD_stInvOut_C TVACD_tiPer_C TVACD_rCnv_CUR TVACD_rOutMax_C TVACD_rOutMin_C TVACD_rTst_C TVACD_stPwrStgActv_C TVACD_stPwrStgDia_C TVACD_stSPICtl_C TVACD_swt_C TVACD_tiBtwTst_C TVACD_tiDiag1Max_C TVACD_tiDiag1Min_C TVACD_tiDiag2Max_C TVACD_tiDiag2Min_C TVACD_tiDiag3Max_C TVACD_tiDiag3Min_C TVACD_tiDiag4Max_C TVACD_tiDiag4Min_C TVACD_tiPwrStgOn_C /end DEF_CHARACTERISTIC
 /begin IN_MEASUREMENT ThrVlv_rTVA /end IN_MEASUREMENT
/end FUNCTION
/begin FUNCTION tvacd_msg "" /begin OUT_MEASUREMENT TVACD_rOut /end OUT_MEASUREMENT /end FUNCTION
/begin FUNCTION tvacd_uic "" /begin OUT_MEASUREMENT TVACD_rCnv_mp TVACD_stErr_mp /end OUT_MEASUREMENT /end FUNCTION
/begin FUNCTION uaddr "" /begin DEF_CHARACTERISTIC UAddr_stCalibration_C Uaddr_stMeasurement_C /end DEF_CHARACTERISTIC /end FUNCTION
/begin FUNCTION usap "Datensatzvarianten Bezeichner" /begin DEF_CHARACTERISTIC USAp_dDataVariantIdInv_C USAp_dDataVariantId_C /end DEF_CHARACTERISTIC /begin OUT_MEASUREMENT USAp_dDataVariant_u8 USAp_stDataVariant_u8 /end OUT_MEASUREMENT /end FUNCTION
/begin FUNCTION usrda "Benutzergrößen" /begin DEF_CHARACTERISTIC UsrDa_swtFDC_C /end DEF_CHARACTERISTIC /end FUNCTION
/begin FUNCTION usrda_msg "" /begin OUT_MEASUREMENT UsrDa_stFDC UsrDa_stRecFDC /end OUT_MEASUREMENT /end FUNCTION
/begin FUNCTION usrda_uic "" /end FUNCTION
/begin FUNCTION vehda "Fahrzeuggrößen" /begin DEF_CHARACTERISTIC VehDa_rVnMax_C VehDa_tiNPT1_C VehDa_tiVnPT1_C /end DEF_CHARACTERISTIC /end FUNCTION
/begin FUNCTION vehda_loadcalc "Ermittlung des Fahrzeugnutzungsprofil"
 /begin DEF_CHARACTERISTIC VehDa_nLoadActv_C VehDa_nLoad_C VehDa_swtRst_C VehDa_trqLoad_C /end DEF_CHARACTERISTIC
 /begin OUT_MEASUREMENT VehDa_ctLoadPrimRow0_mp VehDa_ctLoadPrimRow1_mp VehDa_ctLoadPrimRow2_mp VehDa_ctLoadPrimRow3_mp VehDa_ctLoadPrimRow4_mp VehDa_ctLoadPrimRow5_mp VehDa_ctLoadSecRow0_mp VehDa_ctLoadSecRow1_mp VehDa_ctLoadSecRow2_mp VehDa_ctLoadSecRow3_mp VehDa_ctLoadSecRow4_mp VehDa_ctLoadSecRow5_mp VehDa_tiLoadPrim_mp VehDa_tiLoadSec_mp /end OUT_MEASUREMENT
/end FUNCTION
/begin FUNCTION vehda_loadcalc_uic "" /end FUNCTION
/begin FUNCTION vehda_lsum "Erfassung gefahrene Strecke" /end FUNCTION
/begin FUNCTION vehda_lsum_msg "" /begin OUT_MEASUREMENT VehDa_lSum /end OUT_MEASUREMENT /end FUNCTION
/begin FUNCTION vehda_lsum_uic "" /begin OUT_MEASUREMENT VehDa_lInt_mp /end OUT_MEASUREMENT /end FUNCTION
/begin FUNCTION vehda_msg "" /begin OUT_MEASUREMENT VehDa_rVn VehDa_stTrqDem /end OUT_MEASUREMENT /end FUNCTION
/begin FUNCTION vehda_tiengon "Erfassung der aktuellen Betriebszeit" /begin DEF_CHARACTERISTIC VehDa_lEepUpd_C VehDa_nMaxEepUpd_C VehDa_nMinEepUpd_C /end DEF_CHARACTERISTIC /end FUNCTION
/begin FUNCTION vehda_tiengon_msg "" /begin OUT_MEASUREMENT VehDa_tiEngOn /end OUT_MEASUREMENT /end FUNCTION
/begin FUNCTION vehda_tiengon_uic "" /end FUNCTION
/begin FUNCTION vehda_uic "" /begin OUT_MEASUREMENT VehDa_nEngFilt_mp /end OUT_MEASUREMENT /end FUNCTION
/begin FUNCTION vehmot "Fahrzeugbewegung" /end FUNCTION
/begin FUNCTION vehmot_msg "" /begin OUT_MEASUREMENT VehMot_nMax VehMot_nMin VehMot_pwrAcsDes VehMot_pwrAcsLead /end OUT_MEASUREMENT /end FUNCTION
/begin FUNCTION vesgov_governor "Arbeitsdrehzahlregler" /end FUNCTION
/begin FUNCTION vesgov_governor_msg "" /begin OUT_MEASUREMENT VESGov_trq /end OUT_MEASUREMENT /end FUNCTION
/begin FUNCTION vesgov_governor_uic "" /end FUNCTION
/begin FUNCTION vsacd "Drallniveausteller Komponententreiber"
 /begin DEF_CHARACTERISTIC VSACD_ctPwrStgOnMax_C VSACD_tiDebDioInDia1Def_C VSACD_tiDebDioInDia1Ok_C VSACD_tiDebDioInDia2Def_C VSACD_tiDebDioInDia2Ok_C VSACD_tiDebDioInDia3Def_C VSACD_tiDebDioInDia3Ok_C VSACD_tiDebDioInDia4Def_C VSACD_tiDebDioInDia4Ok_C VSACD_tiDebDioInMinDef_C VSACD_tiDebDioInMinOk_C VSACD_DebExcTempDef_C VSACD_DebExcTempOk_C VSACD_DebNoLoadDef_C VSACD_DebNoLoadOk_C VSACD_DebShortCircBatDef_C VSACD_DebShortCircBatOk_C VSACD_DebShortCircGndDef_C VSACD_DebShortCircGndOk_C VSACD_tiDebVSADia1Def_C VSACD_tiDebVSADia1Ok_C VSACD_tiDebVSADia2Def_C VSACD_tiDebVSADia2Ok_C VSACD_tiDebVSADia3Def_C VSACD_tiDebVSADia3Ok_C VSACD_tiDebVSADia4Def_C VSACD_tiDebVSADia4Ok_C VSACD_numDia_C VSACD_numDioIn_C VSACD_numPwmOut_C VSACD_stInvOut_C VSACD_tiPer_C VSACD_rCnv_CUR VSACD_rOutMax_C VSACD_rOutMin_C VSACD_stPwrStgActv_C VSACD_stPwrStgDia_C VSACD_stSPICtl_C VSACD_swtExtPinEna_C VSACD_swt_C VSACD_tiBtwTst_C VSACD_tiDiag1Max_C VSACD_tiDiag1Min_C VSACD_tiDiag2Max_C VSACD_tiDiag2Min_C VSACD_tiDiag3Max_C VSACD_tiDiag3Min_C VSACD_tiDiag4Max_C VSACD_tiDiag4Min_C VSACD_tiDioInDia1Max_C VSACD_tiDioInDia1Min_C VSACD_tiDioInDia2Max_C VSACD_tiDioInDia2Min_C VSACD_tiDioInDia3Max_C VSACD_tiDioInDia3Min_C VSACD_tiDioInDia4Max_C VSACD_tiDioInDia4Min_C VSACD_tiPwrStgOn_C /end DEF_CHARACTERISTIC
 /begin IN_MEASUREMENT VSA_rVSA /end IN_MEASUREMENT
/end FUNCTION
/begin FUNCTION vsacd_msg "" /begin OUT_MEASUREMENT VSACD_rOut /end OUT_MEASUREMENT /end FUNCTION
/begin FUNCTION vsacd_uic "" /begin OUT_MEASUREMENT VSACD_rCnv_mp VSACD_stErr_mp /end OUT_MEASUREMENT /end FUNCTION
/begin FUNCTION vsacd_var "" /end FUNCTION
/begin FUNCTION vsacd_var_uic "" /end FUNCTION
/begin FUNCTION vsa_co "Stellerkoordinator für Drallnivieausteller" /end FUNCTION
/begin FUNCTION vsa_co_msg "" /begin OUT_MEASUREMENT VSA_rVSA /end OUT_MEASUREMENT /end FUNCTION
/begin FUNCTION vsa_co_uic "" /begin DEF_CHARACTERISTIC VSA_rVSA_Vector VSA_rVSA_Channel /end DEF_CHARACTERISTIC /begin OUT_MEASUREMENT VSA_rVSAByp_mp /end OUT_MEASUREMENT /end FUNCTION
/begin FUNCTION vsscd_co "Fahrgeschwindigkeitsgeber Komponententreiber"
 /begin DEF_CHARACTERISTIC VSSCD_DebCanSigDef_C VSSCD_DebCanSigOk_C VSSCD_DebMaxDef_C VSSCD_DebMaxOk_C VSSCD_DebNegPlaMonCond_C VSSCD_DebPlaMonCond_C VSSCD_DebPlaDef_C VSSCD_DebPlaOk_C VSSCD_DebSigDef_C VSSCD_DebSigOk_C VSSCD_nThresPla_C VSSCD_qThresPla_C VSSCD_swtSigVal_C VSSCD_swtSigType_C VSSCD_tiAPT1_C VSSCD_tiPerMax_C VSSCD_tiVPT1_C VSSCD_vDfl_C VSSCD_vMax_C VSSCD_vMin_C VSSCD_vThresPla_C /end DEF_CHARACTERISTIC
/end FUNCTION
/begin FUNCTION vsscd_co_distfac "" /begin DEF_CHARACTERISTIC VSSCD_ImpPerDist_C /end DEF_CHARACTERISTIC /end FUNCTION
/begin FUNCTION vsscd_co_distfac_uic "" /end FUNCTION
/begin FUNCTION vsscd_co_uic "" /begin OUT_MEASUREMENT VSSCD_rImp_mp VSSCD_stInHW_mp /end OUT_MEASUREMENT /end FUNCTION
/begin FUNCTION vsscd_co_var "" /end FUNCTION
/begin FUNCTION vsscd_co_var_msg "" /begin OUT_MEASUREMENT VSSCD_ctImp VSSCD_swtSig VSSCD_tiPerAvrg /end OUT_MEASUREMENT /end FUNCTION
/begin FUNCTION vsscd_co_var_uic "" /end FUNCTION
/begin FUNCTION vsscd_msg "" /begin OUT_MEASUREMENT VSSCD_a VSSCD_aRaw VSSCD_v VSSCD_vRaw VSSCD_vSensVal /end OUT_MEASUREMENT /end FUNCTION
/begin FUNCTION wdcom "Frage-Antwort-Kommunikation mit Überwachungsmodul" /begin DEF_CHARACTERISTIC Chiste_stEnaTst_C /end DEF_CHARACTERISTIC /end FUNCTION
/begin FUNCTION wdcom_msg ""
 /begin OUT_MEASUREMENT WDCom_dChisteResponse_u32 WDCom_dErrorCountForCntler_u8 WDCom_dErrorCountForSpi_u8 WDCom_dErrorCountForWD_u8 WDCom_dRequest_u32 /end OUT_MEASUREMENT
/end FUNCTION
/begin FUNCTION zfc_cldcmbcham "" /begin DEF_CHARACTERISTIC ZFC_tiCldCham_CUR ZFC_tiHotCham_C /end DEF_CHARACTERISTIC /begin IN_MEASUREMENT IATSCD_tAir /end IN_MEASUREMENT /end FUNCTION
/begin FUNCTION zfc_cldcmbcham_msg "" /begin OUT_MEASUREMENT ZFC_stCldCham /end OUT_MEASUREMENT /end FUNCTION
/begin FUNCTION zfc_cldcmbcham_uic "" /begin OUT_MEASUREMENT ZFC_stCmbCham_mp /end OUT_MEASUREMENT /end FUNCTION
/begin FUNCTION zfc_co ""
 /begin DEF_CHARACTERISTIC ZFC_dBPFacNumFBCG3_CA ZFC_dBPFacNumFBCG4_CA ZFC_dBPFacNumFBCG5_CA ZFC_dBPFacNumFBCG6_CA ZFC_dSegFBCCaS_CA ZFC_nAvrgMax_C ZFC_nAvrgMin_C ZFC_nChngPRailMax_C ZFC_nFBCThresMax_C ZFC_nHyst_C ZFC_numRatETClb_C ZFC_numRatNVClb_C ZFC_stClthSel_C ZFC_stGearRls_CA ZFC_swtClbActvVal_C ZFC_swtClbActvType_C ZFC_tAirThres_C ZFC_tEngThres_C ZFC_tFuelThresMax_C ZFC_tFuelThresMin_C ZFC_tiDelOvrRun_C ZFC_tiDelpRailLim_C ZFC_uBattMin_C /end DEF_CHARACTERISTIC
/end FUNCTION
/begin FUNCTION zfc_co_uic ""
 /begin OUT_MEASUREMENT ZFC_dpRailLim_mp ZFC_dpRail_mp ZFC_pRailSetPoint_mp ZFC_stDem_mp ZFC_st_mp ZFC_vStopClb_mp /end OUT_MEASUREMENT
/end FUNCTION
/begin FUNCTION zfc_evalengspd "" /begin OUT_MEASUREMENT ZFC_Sig_mp /end OUT_MEASUREMENT /end FUNCTION
/begin FUNCTION zfc_evalengspd_uic "" /begin OUT_MEASUREMENT ZFC_SigThres_mp ZFC_stEvalSig_mp /end OUT_MEASUREMENT /end FUNCTION
/begin FUNCTION zfc_inj "Einspritzberechnung der Nullmengenkalibrierung" /begin DEF_CHARACTERISTIC ZFC_phiSet_CUR /end DEF_CHARACTERISTIC /begin IN_MEASUREMENT Eng_nAvrg /end IN_MEASUREMENT /end FUNCTION
/begin FUNCTION zfc_inj_uic "" /begin OUT_MEASUREMENT ZFC_numCylInj_mp ZFC_phiInj_mp ZFC_stInj_mp ZFC_tiET_mp /end OUT_MEASUREMENT /end FUNCTION
/begin FUNCTION zfc_msg "" /begin OUT_MEASUREMENT ZFC_swtClbActv /end OUT_MEASUREMENT /end FUNCTION
/begin FUNCTION _pa_branchtab "" /end FUNCTION
/begin FUNCTION _ksd "Kundenspezifische Daten (mit #KSD gekennzeichnet)" /begin REF_CHARACTERISTIC /end REF_CHARACTERISTIC /end FUNCTION
/begin FUNCTION _ssd "Systemspezifische Daten (mit #SSD gekennzeichnet)"
 /begin REF_CHARACTERISTIC ACC_DebPlausTrqDesDef_C ACC_DebPlausTrqDesOk_C ACC_DebTrqInrDef_C ACC_DebTrqInrOk_C ACC_dtrqLimBrkDwn_C ACC_dtrqLimBrkUp_C ACC_dtrqLimDwn_C ACC_dtrqLimUp_C AccPed_drAPPUnFltLim_C AccPed_drLimDwn_C AccPed_drLimUp_C AccPed_facAcsWghMax_C AccPed_facAcsWghMin_C AccPed_facLIOvrBehWgh_C AccPed_nErr_C AccPed_nErr_CUR AccPed_nLim_C AccPed_nLimNMR_C AccPed_nSecCase_C AccPed_rErrValPlaus_C AccPed_rThPlaus_C AccPed_rThresPrp_C AccPed_rThresSfty_C AccPed_rZero_C AccPed_swtPlausCheck_C AccPed_swtRstCon_C AccPed_swtVehDynReqd_C AccPed_tiChkDebNeg_C AccPed_tiChkDebPos_C AccPed_tiPlausBrkDebPos_C AccPed_trqDes_Channel AccPed_trqDes_Vector AccPed_trqLIOvrBehOfsL_C AccPed_trqNMRMax_C AccPed_vLim_C ACC_PlausTrqTmrDead_C ACC_qOvrRunZeroYHigh_C ACC_qOvrRunZeroYLow_C ACC_swtBrkPressedDel_C ACC_swtTrqDesShutOff_C ACC_tiBrkPressedDel_C ACC_tiPT1_C ACCtl_nMin_C ACC_trqRedShft_CUR ACC_trqReplVal_C ADCMon_DebQueueDef_C ADCMon_DebRefVltgSRCDef_C ADCMon_DebTstImpDef_C ADCMon_nQueueMon_C ADCMon_tiQueueMon_C ADCMon_tiSendTstImp_C ADCMon_uRefSRCMax_C ADCMon_uRefSRCMin_C ADCMon_uTstImpSRCMax_C AFSCD_swtAirSysType_C AFSCD_swtAirSysVal_C AFS_swtChkDM_ANF_AFS_C AFS_swtChkSTWA_C AFS_swtdphiStrgGenSel_C AFS_trqDesMax_C AFS_trqDesMin_C AirCtl_mDesValAdd_Channel AirCtl_mDesValAdd_Vector AirCtl_mDesVal_Channel AirCtl_mDesVal_Vector AirCtl_rEGRAdd_Channel AirCtl_rEGRAdd_Vector AirCtl_rEGR_Channel AirCtl_rEGR_Vector AirCtl_rTVAAdd_Channel AirCtl_rTVAAdd_Vector AirCtl_rTVA_Channel AirCtl_rTVA_Vector Alt_pwrDes_Channel Alt_pwrDes_Vector AOHtCD_numDia_C AOHtCD_numDioIn_C AOHtCD_numPwmOut_C AOHt_nMin_C AOHt_rHtgOut_Channel AOHt_rHtgOut_Vector APPCD_DebPlaDef_C APPCD_DebPlaOk_C APPCD_DebSRCHighDef_C APPCD_DebSRCHighOk_C APPCD_DebSRCLowDef_C APPCD_DebSRCLowOk_C APPCD_drHealRmpUp_C APPCD_numAdcAPP1_C APPCD_numAdcAPP2_C APPCD_rLinAPP1_CUR APPCD_rLinAPP2_CUR APPCD_rPlaWinLowIdleXHigh_C APPCD_rPlaWinLowIdleXLow_C APPCD_rPlaWinParLoadXHigh_C APPCD_rPlaWinParLoadXLow_C APPCD_SSpMonAPP1_C APPCD_SSpMonAPP2_C APPCD_stCfgAccPed_C APPCD_uAPP1_SRCMax_C APPCD_uAPP1_SRCMin_C APPCD_uAPP2_SRCMax_C APPCD_uAPP2_SRCMin_C APPCD_uKickDownHighAPP1_C APPCD_uKickDownHighAPP2_C APPCD_uKickDownLowAPP1_C APPCD_uKickDownLowAPP2_C APPCD_uPlaWinFull_C APPCD_uPlaWinIdle_C APPCD_uPlaWinPar_C APSCD_numAdc_C APSCD_pDfl_C APSCD_pLin_CUR APSCD_uSRCMax_C APSCD_uSRCMin_C ASDdc_trq_Channel ASDdc_trq_Vector ASDrf_trqInr_Channel ASDrf_trqInr_Vector BattCD_numAdc_C Batt_uNrm_C BPACD_DebExcTempDef_C BPACD_DebNoLoadDef_C BPACD_DebShortCircBatDef_C BPACD_DebShortCircGndDef_C BPACD_numDia_C BPACD_numPwmOut_C BPACD_stPwrStgDia_C BPACD_tiBtwTst_C BPA_rBPACD_Channel BPA_rBPACD_Vector BPSCD_DebNplDef_C BPSCD_DebSigDef_C BPSCD_DebSRCHighDef_C BPSCD_DebSRCLowDef_C BPSCD_numAdc_C BPSCD_swtSigVal_C BPSCD_uSRCMax_C BPSCD_uSRCMin_C BrkCD_DebPlaDef_C BrkCD_DebPlaOk_C BrkCD_numDioInMn_C BrkCD_numDioInRed_C BrkCD_stMnSwtInvIn_C BrkCD_stRedSwtInvIn_C BrkCD_swtRedSwtPresent_C BrkCD_tiMnSwtDebNeg_C BrkCD_tiMnSwtDebPos_C BrkCD_tiRedSwtDebNeg_C BrkCD_tiRedSwtDebPos_C BypEtk_dNsyncStimuli16_C BypEtk_dNsyncStimuli32_C BypEtk_dNsyncStimuli64_C BypEtk_dNsyncStimuli8_C BypEtk_dTsyncStimuli16_C BypEtk_dTsyncStimuli32_C BypEtk_dTsyncStimuli64_C BypEtk_dTsyncStimuli8_C BypEtk_stAscet_C BypInt_adFunc_C BypInt_stAscet_C CaSCD_ctEdgOfs_C CaSCD_ctErrSync_C CaSCD_ctShftSync_C CaSCD_dSegSeries_C CaSCD_facPlausHigh_CUR CaSCD_facPlausLow_CUR CaSCD_nMinSpeed_C CaSCD_phiSegLen_C CaSCD_phiSegLenTolc_C CaSCD_phiSegOfs_C CaSCD_phiSpeedCalcTolc_C CaSCD_phiSpeedSegLen_C CaSCD_phiSpeedSegOfs_C CaSCD_stCalc_C CaSCD_stEdgeTrig_C CaSCD_stPinState_C CaSCD_stTPO_C CaSCD_tiPeriodRev1Max_C CaSCD_tiPeriodRev2Max_C CaSCD_tiTimOutOfs_C Chiste_stEnaTst_C CoDT_swtCoTypeType_C CoDT_swtCoTypeVal_C CoDT_trqMinInit_C CoEng_dtrqLimUp_C CoEng_dtrqLimUp1_C CoEng_ExtWaitMsk_C CoEng_ExtWaitMsk2_C CoEng_facAdjMax_C CoEng_nActrRelease_C CoEng_nShOffTstMax_C CoEng_nShOffTstMin_C CoEng_rhoFuel_C CoEng_stIRevShutOff_C CoEng_stRevShutOff_C CoEng_stShOffAddReqIRev_C CoEng_stShOffAddReqRev_C CoEng_stShOffAftRun_C CoEng_stShOffAirbFrnt_C CoEng_stShOffAirbRear_C CoEng_stShOffAirbSide_C CoEng_stShOffDblCtl_C CoEng_stShOffDiaReqFI_C CoEng_stShOffExtReq_C CoEng_stShOffFWOscDet_C CoEng_stShOffInit_C CoEng_stShOffInjMon_C CoEng_stShOffInjShCir_C CoEng_stShOffIRevSys1_C CoEng_stShOffIRevSys2_C CoEng_stShOffIRevVeh_C CoEng_stShOffIrrCmb_C CoEng_stShOffOvrSpd_C CoEng_stShOffPresMin_C CoEng_stShOffRevSys1_C CoEng_stShOffRevSys2_C CoEng_stShOffRevVeh_C CoEng_stShOffRlOvrBar_C CoEng_stShOffSV_C CoEng_stShOffTstSel_C CoEng_stSoftShOffAR_C CoEng_tiActrPrt_C CoEng_tiDlyT15_C CoEng_tiMinAftRun_C CoEng_tiOvrRunCoordDebPos_C CoEng_tiPwrStgDiaRdy_C CoEng_tiSoftShOff_CUR CoEng_trqOvrRunThres_C CoEng_trqSlpLim_Channel CoEng_trqSlpLim_Vector ConvCD_numDioIn_C CoVeh_trqPrpDes_Channel CoVeh_trqPrpDes_Vector CoVeh_trqPrpLead_Channel CoVeh_trqPrpLead_Vector CoVM_amMAX_C CoVM_swtPlausChkType_C CoVM_swtPlausChkVal_C CoVM_trqDecMax_C CoVM_trqIncMin_C CrCtl_stShutOffCodeMsk_C CrCtl_trqDes_Channel CrCtl_trqDes_Vector CrCtl_trqLead_Channel CrCtl_trqLead_Vector CrCtl_vTipStep_C CrSCD_ctGapIncs_C CrSCD_ctGaps_C CrSCD_ctIncs_C CrSCD_ctThresCtlMin_C CrSCD_ctTurns_C CrSCD_facGapPlausHigh_CUR CrSCD_facGapPlausLow_CUR CrSCD_facIncPlausHigh_CUR CrSCD_facIncPlausLow_CUR CrSCD_nFast_C CrSCD_nMax_C CrSCD_nMin_C CrSCD_nSlow_C CrSCD_nSlowHigh_C CrSCD_nThresCtlHigh_C CrSCD_nThresCtlLow_C CrSCD_numFBCSeg_C CrSCD_numShftMisf_C CrSCD_numTDCSeg_C CrSCD_phiGap2Zero_C CrSCD_phiIncCor_CUR CrSCD_phiSegLength_C CrSCD_phiSegPhase_C CrSCD_tiPlausCalcOff_C CrS_ctMaxInjStrt_C CrS_facSegTime_C CrS_facSegTimeMax_C CrS_facSegTimeMin_C CrS_phiSegLengthStrtSpd_C CrS_phiSegOfsStrtSpd_C CrS_phiSegOfsStrtSpdOld_C CTSCD_DebSigDef_C CTSCD_DebSRCHighDef_C CTSCD_DebSRCLowDef_C CTSCD_numAdc_C CTSCD_stSensIDWord_C DSM_DInDfp_ADCMon_C DSM_DInDfp_EngMCaS1_C DSM_DInDfp_EngMCrS1_C DSM_DInDfp_FrmMngParkConsumer_C DSM_DInDfp_InjVlvBnk1A_C DSM_DInDfp_InjVlvBnk1B_C DSM_DInDfp_InjVlvBnk2A_C DSM_DInDfp_InjVlvBnk2B_C DSM_DInDfp_InjVlvChipA_C DSM_DInDfp_InjVlvChipB_C DSM_DInDfp_InjVlvCyl1A_C DSM_DInDfp_InjVlvCyl1B_C DSM_DInDfp_InjVlvCyl2A_C DSM_DInDfp_InjVlvCyl2B_C DSM_DInDfp_InjVlvCyl3A_C DSM_DInDfp_InjVlvCyl3B_C DSM_DInDfp_InjVlvCyl4A_C DSM_DInDfp_InjVlvCyl4B_C DSM_DInDfp_InjVlvCyl5A_C DSM_DInDfp_InjVlvCyl5B_C DSM_DInDfp_InjVlvCyl6A_C DSM_DInDfp_InjVlvCyl6B_C DSM_DInDfp_InjVlvCyl7A_C DSM_DInDfp_InjVlvCyl7B_C DSM_DInDfp_InjVlvCyl8A_C DSM_DInDfp_InjVlvCyl8B_C DSM_DInDfp_MeUnCD_ADC_C DSM_DInDfp_MeUnCDNoLoad_C DSM_DInDfp_MeUnCDSCBat_C DSM_DInDfp_MeUnCDSCGnd_C DSM_DInDfp_MeUnCD_SigTst_C DSM_DInDfp_MSidCD_Comm_C DSM_DInDfp_MSidCD_Pin_C DSM_DInDfp_MSidCD_Select_C DSM_DInDfp_MSidCD_Sel_INI_C DSM_DInDfp_PCVCD_ADC_C DSM_DInDfp_PCVCDNoLoad_C DSM_DInDfp_PCVCDSCBat_C DSM_DInDfp_PCVCDSCGnd_C DSM_DInDfp_PCVCD_SigTst_C DSM_DInDfp_RailCD_C DSM_DInDfp_RailCD_PMonStrt_C DSM_DInDfp_RailCtlModeMeUnDiag_C DSM_DInDfp_RailCtlModePCVDiag_C DSM_DInDfp_RailMeUn0_C DSM_DInDfp_RailMeUn1_C DSM_DInDfp_RailMeUn2_C DSM_DInDfp_RailMeUn3_C DSM_DInDfp_RailMeUn4_C DSM_DInDfp_RailPCV0_C DSM_DInDfp_RailPCV1_C DSM_DInDfp_RailPCV2_C DSM_DInDfp_RailPCV3_C DSM_DInDfp_RailPCV4_C DSM_DInDfp_RailPCV5_C DSM_DInDfp_RTMMon_C DSM_DInDfp_TPUMon_C DSM_InhDfp_ACC_PlausTrqDes_C DSM_InhDfp_ACTrq_C DSM_InhDfp_ADCMon_C DSM_InhDfp_AFSCD_PlSetyDrft_C DSM_InhDfp_AFSCD_SRCAirTemp_C DSM_InhDfp_AFSCD_SRCBatt_C DSM_InhDfp_AFSCD_SRCCorrAirm_C DSM_InhDfp_AFSCD_SRCRawAirm_C DSM_InhDfp_AFSCD_SRCRefSigPer_C DSM_InhDfp_AirCtl_GovNegDev_C DSM_InhDfp_AirCtl_GovNegDev2_C DSM_InhDfp_AirCtl_GovPosDev_C DSM_InhDfp_AirCtl_GovPosDev2_C DSM_InhDfp_AltCD_C DSM_InhDfp_AOHtCD_AOHtDia1_C DSM_InhDfp_AOHtCD_C DSM_InhDfp_APP1_C DSM_InhDfp_APP2_C DSM_InhDfp_APSCD_C DSM_InhDfp_ARS_C DSM_InhDfp_BPACD_Max_C DSM_InhDfp_BPACD_Min_C DSM_InhDfp_BPACD_SigNpl_C DSM_InhDfp_BPSCD_C DSM_InhDfp_BrkCD_C DSM_InhDfp_CmbChbMisfireMul_C DSM_InhDfp_CmbChbMisfire1_C DSM_InhDfp_CmbChbMisfire2_C DSM_InhDfp_CmbChbMisfire3_C DSM_InhDfp_CmbChbMisfire4_C DSM_InhDfp_CmbChbMisfire5_C DSM_InhDfp_CmbChbMisfire6_C DSM_InhDfp_ConvCD_C DSM_InhDfp_CrCCDMFL_C DSM_InhDfp_CrCtl_vCrCtl_C DSM_InhDfp_CTSCD_C DSM_InhDfp_EATSCD_C DSM_InhDfp_EBTSCD_C DSM_InhDfp_EGRCD_Max_C DSM_InhDfp_EGRCD_Min_C DSM_InhDfp_EGRCD_SigNpl_C DSM_InhDfp_EngMCaS1_C DSM_InhDfp_EngMCrS1_C DSM_InhDfp_FanCD_C DSM_InhDfp_FanCD_FanCtlr1_C DSM_InhDfp_FBCqDvt_C DSM_InhDfp_FrmMngDMANFAFS_C DSM_InhDfp_FrmMngDRMANFSSG_C DSM_InhDfp_FrmMngLENKRADWINKEL_C DSM_InhDfp_FrmMngMILEAGE_RANGE_C DSM_InhDfp_FrmMngOPCRCTLACC_C DSM_InhDfp_FrmMngParkConsumer_C DSM_InhDfp_FrmMngSTAT_ARS_C DSM_InhDfp_FrmMngSTAT_DSC_C DSM_InhDfp_FrmMngSTAT_KOMBI_C DSM_InhDfp_FrmMngStOBDGbxMilOf_C DSM_InhDfp_FrmMngStOBDGbxMilOn_C DSM_InhDfp_FrmMngTERMINAL_C DSM_InhDfp_FrmMngTORQUE_DSC_C DSM_InhDfp_FrmMngTORQUE_GEARBX_C DSM_InhDfp_FrmMngTrq_ReqACC_C DSM_InhDfp_FrmMngWHEEL_SPEED_C DSM_InhDfp_FTSCD_C DSM_InhDfp_IATSCD_CATS_C DSM_InhDfp_ImmCtlImmCD_C DSM_InhDfp_ImmCtlImmEep_C DSM_InhDfp_ImmCtlMpl_C DSM_InhDfp_IndSys1_C DSM_InhDfp_IndSys2_C DSM_InhDfp_InjVCDActrChrg_C DSM_InhDfp_InjVCDActrVolt_C DSM_InhDfp_InjVCD_CY370Ampl_C DSM_InhDfp_InjVCDMonCab_C DSM_InhDfp_InjVCDMonSwt_C DSM_InhDfp_InjVCDShOffDCDC_C DSM_InhDfp_InjVCDUBuf_C DSM_InhDfp_InjVlvBnk1A_C DSM_InhDfp_InjVlvBnk1B_C DSM_InhDfp_InjVlvBnk2A_C DSM_InhDfp_InjVlvBnk2B_C DSM_InhDfp_InjVlvChipA_C DSM_InhDfp_InjVlvChipB_C DSM_InhDfp_InjVlvCyl1A_C DSM_InhDfp_InjVlvCyl1B_C DSM_InhDfp_InjVlvCyl1C_C DSM_InhDfp_InjVlvCyl2A_C DSM_InhDfp_InjVlvCyl2B_C DSM_InhDfp_InjVlvCyl2C_C DSM_InhDfp_InjVlvCyl3A_C DSM_InhDfp_InjVlvCyl3B_C DSM_InhDfp_InjVlvCyl3C_C DSM_InhDfp_InjVlvCyl4A_C DSM_InhDfp_InjVlvCyl4B_C DSM_InhDfp_InjVlvCyl4C_C DSM_InhDfp_InjVlvCyl5A_C DSM_InhDfp_InjVlvCyl5B_C DSM_InhDfp_InjVlvCyl5C_C DSM_InhDfp_InjVlvCyl6A_C DSM_InhDfp_InjVlvCyl6B_C DSM_InhDfp_InjVlvCyl6C_C DSM_InhDfp_InjVlvCyl7A_C DSM_InhDfp_InjVlvCyl7B_C DSM_InhDfp_InjVlvCyl7C_C DSM_InhDfp_InjVlvCyl8A_C DSM_InhDfp_InjVlvCyl8B_C DSM_InhDfp_InjVlvCyl8C_C DSM_InhDfp_MeUnCD_ADC_C DSM_InhDfp_MeUnCDNoLoad_C DSM_InhDfp_MeUnCDSCBat_C DSM_InhDfp_MeUnCDSCGnd_C DSM_InhDfp_MeUnCD_SigTst_C DSM_InhDfp_Montr_C DSM_InhDfp_MSidCD_Comm_C DSM_InhDfp_MSidCD_Pin_C DSM_InhDfp_MSidCD_Select_C DSM_InhDfp_MSidCD_Sel_INI_C DSM_InhDfp_OvRMonBrk_C DSM_InhDfp_PCR_GovDevNeg_C DSM_InhDfp_PCR_GovDevPos_C DSM_InhDfp_PCVCD_ADC_C DSM_InhDfp_PCVCDNoLoad_C DSM_InhDfp_PCVCDSCBat_C DSM_InhDfp_PCVCDSCGnd_C DSM_InhDfp_PCVCD_SigTst_C DSM_InhDfp_RailCD_C DSM_InhDfp_RailCDOfsTst_C DSM_InhDfp_RailCD_PMonStrt_C DSM_InhDfp_RailCtlModeMeUnDiag_C DSM_InhDfp_RailCtlModePCVDiag_C DSM_InhDfp_RailMeUn0_C DSM_InhDfp_RailMeUn1_C DSM_InhDfp_RailMeUn2_C DSM_InhDfp_RailMeUn3_C DSM_InhDfp_RailMeUn4_C DSM_InhDfp_RailPCV0_C DSM_InhDfp_RailPCV1_C DSM_InhDfp_RailPCV2_C DSM_InhDfp_RailPCV3_C DSM_InhDfp_RailPCV4_C DSM_InhDfp_RailPCV5_C DSM_InhDfp_RTMMon_C DSM_InhDfp_SOPTst_C DSM_InhDfp_SSpMon1_C DSM_InhDfp_SSpMon2_C DSM_InhDfp_SSpMon3_C DSM_InhDfp_SysLamp_C DSM_InhDfp_TGearbx_C DSM_InhDfp_TPUMon_C DSM_InhDfp_T15CD_C DSM_InhDfp_VSACD_Max_C DSM_InhDfp_VSACD_Min_C DSM_InhDfp_VSACD_SigNpl_C DSM_InhDfp_VSSCD1_C DSM_InhDfp_VSSCD2_C DSM_SdwDfp_APP2_C DSM_SdwDfp_FrmMngDRMANFSSG_C DSM_SdwDfp_FrmMngOPCRCTLACC_C DSM_SdwDfp_FrmMngTORQUE_DSC_C DSM_SdwDfp_FrmMngTORQUE_GEARBX_C DSM_SdwDfp_FrmMngTrq_ReqACC_C EATSCD_numAdc_C EBAFCD_numDiaOut_C EBAFCD_numDioOut_C EBFCD_numDiaOut_C EBFCD_numDioOut_C EBTSCD_DebSRCHighDef_C EBTSCD_DebSRCLowDef_C EBTSCD_dtRmpSlpDwn_C EBTSCD_dtRmpSlpUp_C EBTSCD_numAdc_C EBTSCD_OvrDebSRCHighDef_C EBTSCD_stSensIDWord_C EBTSCD_tDfl_C EBTSCD_tiTECUPT1_C EBTSCD_tLin_CUR EBTSCD_tOvrTemp_C EBTSCD_uSRCMax_C EBTSCD_uSRCMin_C ECU_vPrgThres_C EGPpCD_numDia_C EGPpCD_numDioOut_C EGRCD_DebExcTempDef_C EGRCD_DebNoLoadDef_C EGRCD_DebShortCircBatDef_C EGRCD_DebShortCircGndDef_C EGRCD_numDia_C EGRCD_numPwmOut_C EGRCD_stPwrStgDia_C EGRVlv_rEGR_Channel EGRVlv_rEGR_Vector EGRVlv_rEGR2_Channel EGRVlv_rEGR2_Vector EGSys_swtPresSel_C EGT_stTSync_Channel EGT_stTSync_Vector EngM_ctOfsCaSCrS_C EngM_ctPhWhlRev_C EngM_ctPostSync_C EngM_ctReSync_C EngM_ctSpdtoZero_C EngM_ctVerSync_C EngM_DebIncCaSErrSigDef_C EngM_DebIncCaSErrSigOK_C EngM_DebIncCaSNoSigDef_C EngM_DebIncCrSErrSigDef_C EngM_DebIncCrSErrSigOK_C EngM_DebIncOfsSigCaSCrSDef_C EngM_DebPhCrSErrSigDef_C EngM_dLimitCond_ASD_CA EngM_dLimitCond_Common_CA EngM_dLimitCond_FBC_CA EngM_dLimitCond_Joint_CA EngM_dLimitCond_LiGov_CA EngM_dLimitCond_Pilot_CA EngM_nLimitInj_C EngM_nLimitThresh_CA EngM_nLimitThreshHyst_CA EngM_nMaxStrtBackUp_C EngM_nMaxStrt_C EngM_nMinDiag_C EngM_nSwtCoMa_C EngM_numDiaOut_C EngM_numDioOut_C EngM_numLimitInj_C EngM_numPin_C EngM_nWaitIncSig_C EngM_phiDelayPhNoSig_C EngM_phiDelta_C EngM_phiDeltaExtSync_C EngM_phiFrstInjInt_C EngM_phiInt_C EngM_phiMax_C EngM_phiTDC_C EngM_stBackUpVar_C EngM_stEnaBackUp_C EngM_stSyncBefGap_C EngM_swtExitOfs_C EngM_swtFirSeqFBC_C EngM_swtNumCylType_C EngM_swtNumCylVal_C EngM_swtSyncViaCAN_C EngM_tiCpuTimeOut_C EngM_tiDiffInt_C EngM_tiWaitIncSig_C EngM_trqFrc_Channel EngM_trqFrc_Vector EngPrt_nOvrSpd_C EngPrt_qPrtLim_Channel EngPrt_qPrtLim_Vector EngPrt_trqNLim_Channel EngPrt_trqNLim_Vector EngPrt_trqPrtLim_Channel EngPrt_trqPrtLim_Vector ErLpCD_numDiaErrLmp_C ErLpCD_numDiaSysLmp_C ErLpCD_numDioOutErrLmp_C ErLpCD_numDioOutSysLmp_C ESS_nBattMin_C ETClb_DebETMaxDefect_C ETClb_DebETMaxOk_C ETClb_DebETMinDefect_C ETClb_DebETMinOk_C ETClb_numCyclMeas_C ETClb_numCyclStartEnergize_C ETClb_pRailSet_CA ETClb_SigThres_CA ETClb_tiET_MAX_CA ETClb_tiET_MIN_CA ETClb_volEffectiveMin_CA ExeMon_stEnaTst_C FanCD_DebShortCircGndDef_C FanCD_numDia_C FanCD_numPwmOut_C FanCD_tiBtwTst_C FanCD_tiFanCtlr2Max_C FanCD_tiFanCtlr2Min_C FanCD_tiFanCtlr3Max_C FanCD_tiFanCtlr3Min_C FBC_lrn_Channel FBC_lrn_Vector FBC_q_Channel FBC_q_Vector FlFCD_numDioIn_C FlMng_swtFullLdRglType_C FlMng_swtFullLdRglVal_C FlSys_nDeflateMax_C FlSys_nDeflateMin_C FlSys_pDeflate_C FlSys_rhoFl_C FlSys_rhoFl_CUR FlSys_swtTempSensCfgType_C FlSys_tiDeflateDel_C FMTC_trq2qBas_MAP FMTC_trq2qRgn1_MAP FMTC_trq2qRgn2_MAP FrmMng_aSideDef_C FrmMng_cnvAccmLimTrq_Offset_C FrmMng_cnvAccmLimTrq_Slope_C FrmMng_cnvACCtrq_Offset_C FrmMng_cnvACCtrq_Slope_C FrmMng_cnvAFStrq_Offset_C FrmMng_cnvAFStrq_Slope_C FrmMng_cnvAipEng_Offset_C FrmMng_cnvAipEng_Slope_C FrmMng_cnvAngAcpd_Offset_C FrmMng_cnvAngAcpd_Slope_C FrmMng_cnvARStrq_Offset_C FrmMng_cnvARStrq_Slope_C FrmMng_cnvAVA_DSC_Offset_C FrmMng_cnvAVA_DSC_Slope_C FrmMng_cnv_BattCls_Offset_C FrmMng_cnv_BattCls_Slope_C FrmMng_cnvDSCtrq_Offset_C FrmMng_cnvDSCtrq_Slope_C FrmMng_cnvFLLV_FUTA_Offset_C FrmMng_cnvFLLV_FUTA_Slope_C FrmMng_cnv_HiLimCurr_Offset_C FrmMng_cnv_HiLimCurr_Slope_C FrmMng_cnvIjvFu_Offset_C FrmMng_cnvIjvFu_Slope_C FrmMng_cnvKOMBIv_Offset_C FrmMng_cnvKOMBIv_Slope_C FrmMng_cnv_LoLimCurr_Offset_C FrmMng_cnv_LoLimCurr_Slope_C FrmMng_cnvnSetPoint_Slope_C FrmMng_cnvRpmEng_Offset_C FrmMng_cnvRpmEng_Slope_C FrmMng_cnvRqamFu_Offset_C FrmMng_cnvRqamFu_Slope_C FrmMng_cnvTempEng_Offset_C FrmMng_cnvTempEng_Slope_C FrmMng_cnvTEMP_EX_Offset_C FrmMng_cnvTEMP_EX_Slope_C FrmMng_cnvtOil_Offset_C FrmMng_cnvtOil_Slope_C FrmMng_cnvTrqAvl_Offset_C FrmMng_cnvTrqAvl_Slope_C FrmMng_cnvTrqDvch_Offset_C FrmMng_cnvTrqDvch_Slope_C FrmMng_cnvtrq_Offset_C FrmMng_cnvtrq_Slope_C FrmMng_cnvvMrk_Offset_C FrmMng_cnvvMrk_Slope_C FrmMng_cnvvPrgNo_Offset_C FrmMng_cnvvPrgNo_Slope_C FrmMng_cnvV_VEH_Offset_C FrmMng_cnvV_VEH_Slope_C FrmMng_cnv_ZrCurrLim_Offset_C FrmMng_cnv_ZrCurrLim_Slope_C FrmMng_ctDebAlvDMANFAFSDef_C FrmMng_ctDebCsDMANFAFSDef_C FrmMng_ctDebSigDMANFAFSDef_C FrmMng_ctDebToDMANFAFSDef_C FrmMng_ctDebToWHEEL_SPEEDDef_C FrmMng_DebACTrqDef_C FrmMng_DebAlvDMOMENT_ACCDef_C FrmMng_DebAlvOPCRCTLACCDef_C FrmMng_DebAlvSTAT_ARSDef_C FrmMng_DebAlvSTAT_KOMBIDef_C FrmMng_DebAlvTORQUE_DSCDef_C FrmMng_DebAlvTORQUE_GEARBXDef_C FrmMng_DebCsDMOMENT_ACCDef_C FrmMng_DebCsOPCRCTLACCDef_C FrmMng_DebCsTORQUE_DSCDef_C FrmMng_DebCsTORQUE_GEARBXDef_C FrmMng_DebSigDMOMENT_ACCDef_C FrmMng_DebSigMILEAGE_RANGEDef_C FrmMng_DebSigOPCRCTLACCDef_C FrmMng_DebSigSTAT_ARSDef_C FrmMng_DebSigSTAT_DSCDef_C FrmMng_DebSigSTAT_KOMBIDef_C FrmMng_DebSigTORQUE_DSCDef_C FrmMng_DebSigTORQUE_GEARBXDef_C FrmMng_DebToDMOMENT_ACCDef_C FrmMng_DebToMILEAGE_RANGEDef_C FrmMng_DebToOPCRCTLACCDef_C FrmMng_DebToSTAT_ARSDef_C FrmMng_DebToSTAT_DSCDef_C FrmMng_DebToSTAT_KOMBIDef_C FrmMng_DebToTORQUE_DSCDef_C FrmMng_DebToTORQUE_GEARBXDef_C FrmMng_dstGear_C FrmMng_dtrqOvrRunRmpDwn_C FrmMng_numCCAddLevlNum_C FrmMng_numCCbtnachNum_C FrmMng_numCCbttdfkNum_C FrmMng_numCCbttkntNum_C FrmMng_numCCGenDef2Num_C FrmMng_numCCNoCrCtlNum_C FrmMng_numCCOelLevlNum_C FrmMng_numCCOelVerbNum_C FrmMng_numCCOelVerlNum_C FrmMng_numCCOilPresNum_C FrmMng_numCCOvrTempNum_C FrmMng_numCCOvrTem2Num_C FrmMng_numCCPFltDefNum_C FrmMng_numCCpmerrNum_C FrmMng_numCCPreGlowNum_C FrmMng_numCCprioNum_C FrmMng_numCCruhverNum_C FrmMng_numCCStatMilLmpTstNum_C FrmMng_numCCStatMilNum_C FrmMng_numCCSysLampNum_C FrmMng_numInqyID_C FrmMng_stClCtrDEF_C FrmMng_stConvErr_C FrmMng_stT50Def_C FrmMng_swtDMOMENT_ACC_C FrmMng_swtDRMANFSSG_C FrmMng_tiCCAddLevlCycle_C FrmMng_tiCCbtnachCycle_C FrmMng_tiCCbttdfkCycle_C FrmMng_tiCCbttkntCycle_C FrmMng_tiCCGenDef2Cycle_C FrmMng_tiCCNoCrCtlCycle_C FrmMng_tiCCOelLevlCycle_C FrmMng_tiCCOelVerbCycle_C FrmMng_tiCCOelVerlCycle_C FrmMng_tiCCOilPresCycle_C FrmMng_tiCCOvrTempCycle_C FrmMng_tiCCOvrTem2Cycle_C FrmMng_tiCCPFltDefCycle_C FrmMng_tiCCpmerrCycle_C FrmMng_tiCCPreGlowCycle_C FrmMng_tiCCprioCycle_C FrmMng_tiCCruhverCycle_C FrmMng_tiCCStatMilCycle_C FrmMng_tiCCStatMilLmpTstCycle_C FrmMng_tiCCSysLampCycle_C FrmMng_tiCCTxDeb_C FrmMng_trqGearbxMaxSubs_C FTSCD_numAdc_C Gearbx_amMax_C Gearbx_nMin_MAP Gearbx_rTransR_C Gearbx_rTrans1_C Gearbx_rTrans2_C Gearbx_rTrans3_C Gearbx_rTrans4_C Gearbx_rTrans5_C Gearbx_rTrans6_C Gearbx_swtUnplausChk_C Gearbx_trqDecMax_C Gearbx_trqDecMax_CUR Gearbx_trqIncMin_C Gearbx_trqInMax_Channel Gearbx_trqInMax_Vector GearCD_numDioIn_C HPUn_nMin_C HPUn_pRailDvtOk_C HPUn_qBalLim_CUR HPUn_qFlTempLim_MAP HWEMon_DebComDef_C HWEMon_DebComOk_C HWEMon_DebComStepDown_C HWEMon_DebComStepUp_C HWEMon_numTrigRecovery_C IATSCD_DebSigDef_C IATSCD_DebSRCHighDef_C IATSCD_DebSRCLowDef_C IATSCD_numAdc_C IATSCD_numAdcCats_C IndSys_rVSAAdd_Channel IndSys_rVSAAdd_Vector IndSys_rVSA_Channel IndSys_rVSA_Vector InjCrv_DebLimDef_C InjCrv_DebLimOk_C InjCrv_numInjMaxSys_C InjCrv_phiMI1DesAdd_Channel InjCrv_phiMI1DesAdd_Vector InjCrv_phiMI1Des_Channel InjCrv_phiMI1Des_Vector InjCrv_phiMI1Max_MAP InjCrv_phiMI1Rgn_Channel InjCrv_phiMI1Rgn_Vector InjCrv_phiPiIMax_C InjCrv_phiPiI1DesAdd_Channel InjCrv_phiPiI1DesAdd_Vector InjCrv_phiPiI1Des_Channel InjCrv_phiPiI1Des_Vector InjCrv_phiPiI1Rgn_Channel InjCrv_phiPiI1Rgn_Vector InjCrv_phiPiI2DesAdd_Channel InjCrv_phiPiI2DesAdd_Vector InjCrv_phiPiI2Des_Channel InjCrv_phiPiI2Des_Vector InjCrv_phiPiI2Rgn_Channel InjCrv_phiPiI2Rgn_Vector InjCrv_phiPiI3DesAdd_Channel InjCrv_phiPiI3DesAdd_Vector InjCrv_phiPiI3Des_Channel InjCrv_phiPiI3Des_Vector InjCrv_phiPoI1DesAdd_Channel InjCrv_phiPoI1DesAdd_Vector InjCrv_phiPoI1Des_Channel InjCrv_phiPoI1Des_Vector InjCrv_phiPoI1Max_C InjCrv_phiPoI1Rgn_Channel InjCrv_phiPoI1Rgn_Vector InjCrv_phiPoI2_Channel InjCrv_phiPoI2Min_C InjCrv_phiPoI2Rgn_Channel InjCrv_phiPoI2Rgn_Vector InjCrv_phiPoI2_Vector InjCrv_qMI1DesAdd_Channel InjCrv_qMI1DesAdd_Vector InjCrv_qMI1Des_Channel InjCrv_qMI1Des_Vector InjCrv_qMI1Rgn_Channel InjCrv_qMI1Rgn_Vector InjCrv_qPiI1DesAdd_Channel InjCrv_qPiI1DesAdd_Vector InjCrv_qPiI1Des_Channel InjCrv_qPiI1Des_Vector InjCrv_qPiI1Rgn_Channel InjCrv_qPiI1Rgn_Vector InjCrv_qPiI1SetByp_Channel InjCrv_qPiI1SetByp_Vector InjCrv_qPiI2DesAdd_Channel InjCrv_qPiI2DesAdd_Vector InjCrv_qPiI2Des_Channel InjCrv_qPiI2Des_Vector InjCrv_qPiI2Rgn_Channel InjCrv_qPiI2Rgn_Vector InjCrv_qPiI2SetByp_Channel InjCrv_qPiI2SetByp_Vector InjCrv_qPiI3DesAdd_Channel InjCrv_qPiI3DesAdd_Vector InjCrv_qPiI3Des_Channel InjCrv_qPiI3Des_Vector InjCrv_qPoI1DesAdd_Channel InjCrv_qPoI1DesAdd_Vector InjCrv_qPoI1Des_Channel InjCrv_qPoI1Des_Vector InjCrv_qPoI1Rgn_Channel InjCrv_qPoI1Rgn_Vector InjCrv_qPoI2Des_Channel InjCrv_qPoI2Des_Vector InjCrv_qPoI2Eff_Channel InjCrv_qPoI2Eff_Vector InjCrv_qPoI2Rgn_Channel InjCrv_qPoI2Rgn_Vector InjCrv_stInjCharSetVal_Channel InjCrv_stInjCharSetVal_Vector InjCrv_stPiIRlsBypass_Channel InjCrv_stPiIRlsBypass_Vector InjCrv_tiPause_C InjCrv_tiPiIMax_C InjCrv_tiPiI1DesAdd_Channel InjCrv_tiPiI1DesAdd_Vector InjCrv_tiPiI1Des_Channel InjCrv_tiPiI1Des_Vector InjCrv_tiPiI1Rgn_Channel InjCrv_tiPiI1Rgn_Vector InjCrv_tiPiI2DesAdd_Channel InjCrv_tiPiI2DesAdd_Vector InjCrv_tiPiI2Des_Channel InjCrv_tiPiI2Des_Vector InjCrv_tiPiI2Rgn_Channel InjCrv_tiPiI2Rgn_Vector InjCrv_tiPoI2_Channel InjCrv_tiPoI2Max_MAP InjCrv_tiPoI2Min_C InjCrv_tiPoI2Rgn_Channel InjCrv_tiPoI2Rgn_Vector InjCrv_tiPoI2_Vector InjCtl_qCurr_Channel InjCtl_qCurr_Vector InjCtl_qLimErr_CUR InjCtl_qLimErr_MAP InjCtl_qRaw_Channel InjCtl_qRaw_Vector InjCtl_qSet_Channel InjCtl_qSet_Vector InjUn_nInjLock_C InjUn_phiTstShOffPathSet_C InjUn_tiTstShOffPathET_C InjVCD_ctThres_C InjVCD_ctThresShOffDCDCEv_C InjVCD_DebActrEnrgDef_C InjVCD_DebActrEnrgOK_C InjVCD_DebDCDCLowDef_C InjVCD_DebDCDCStartDef_C InjVCD_DebUBufSRCHighDef_C InjVCD_DebUBufSRCHighOk_C InjVCD_DebUBufSRCLowDef_C InjVCD_DebUBufSRCLowOk_C InjVCD_duInt_C InjVCD_facMonUThresHiPl_CA InjVCD_facMonUThresLoPl_CA InjVCD_facWActrChrgCorr_C InjVCD_facWActrCorr_C InjVCD_facWActrDisChCorr_C InjVCD_facWActrDvtMax_C InjVCD_facWActrDvtMin_C InjVCD_fPolar_C InjVCD_nClsEng_C InjVCD_nEngMonShCir_C InjVCD_nETMaxLim_C InjVCD_numCollTyp_C InjVCD_numCylTestBench_C InjVCD_numFacWValidMin_C InjVCD_numPolar_C InjVCD_numWValidMin_C InjVCD_pClsRailMax_C InjVCD_pRailMonShCirMax_C InjVCD_rCapUpTolc_C InjVCD_rClsVoltMin_C InjVCD_resCalcChrgShunt_C InjVCD_rMonShCirTiChrgUpTolc_C InjVCD_rTiChrgUpTolc_C InjVCD_rZFCETDif2_GMAP InjVCD_stCY370RcyTst_C InjVCD_swtEnaAgDiff_C InjVCD_swtEnaWActrCorr_C InjVCD_swtEvMgmt_C InjVCD_swtSelTempType_C InjVCD_swtSelTempVal_C InjVCD_swtShOffDCDCTst_C InjVCD_tActr_CUR InjVCD_tActrDfl_C InjVCD_tiClsLead_C InjVCD_tiClsMeasBeg_C InjVCD_tiClsMeasEnd_C InjVCD_tiClsMeasure_C InjVCD_tiET_MAP InjVCD_tiETMax_C InjVCD_tiETMinHigh_C InjVCD_tiETMinLow_C InjVCD_tiHoldMin_C InjVCD_tiLeadJit_C InjVCD_tiLeadPost1_C InjVCD_tiLeadPost2_C InjVCD_tiLeadPost3_C InjVCD_tiLeadPost4_C InjVCD_tiLeadPre1_C InjVCD_tiLeadPre2_C InjVCD_tiLeadPre3_C InjVCD_tiLeadPre4_C InjVCD_tiMI1ET_Channel InjVCD_tiMI1ET_Vector InjVCD_tiMi1ThresLo_C InjVCD_tiMonET_C InjVCD_tiMonLead_C InjVCD_tiMonThresHiPlaus_C InjVCD_tiMonThresLoPlaus_C InjVCD_tiPiI1ET_Channel InjVCD_tiPiI1ET_Vector InjVCD_tiPiI2ET_Channel InjVCD_tiPiI2ET_Vector InjVCD_tiPoI1ET_Channel InjVCD_tiPoI1ET_Vector InjVCD_tiPoI2ET_Channel InjVCD_tiPoI2ET_Vector InjVCD_tiPolarET_C InjVCD_tiPolarLead_C InjVCD_uActrLin_CUR InjVCD_uActrThrSRCHi_C InjVCD_uActrThrSRCLo_C InjVCD_uBufCLoLim_C InjVCD_uBufLin_CUR InjVCD_uBufSRCMax_C InjVCD_uBufSRCMin_C InjVCD_uChrgLin_CUR InjVCD_uChrgThrSRCHi_C InjVCD_uChrgThrSRCLo_C InjVCD_uCY370Lin_CUR InjVCD_uCY370ThrSRCHi_C InjVCD_uCY370ThrSRCLo_C InjVCD_uShOffBufThres_C InjVCD_wActrChrgDfl_C InjVCD_wActrDiffPlausMax_C InjVCD_wActrDiffPlausMin_C InjVCD_wActrDisChDfl_C InjVCD_wActrNom_CUR InjVCD_wActrPlausMax_C InjVCD_wActrPlausMin_C InjVlv_ctMonQckThres_C InjVlv_ctMonQckThresLo_C InjVlv_DebBnkA0Def_C InjVlv_DebBnkA0Ok_C InjVlv_DebBnkA1Def_C InjVlv_DebBnkA1Ok_C InjVlv_DebBnkA2Def_C InjVlv_DebBnkA2Ok_C InjVlv_DebBnkA3Def_C InjVlv_DebBnkA3Ok_C InjVlv_DebBnkB0Def_C InjVlv_DebBnkB0Ok_C InjVlv_DebBnkB1Def_C InjVlv_DebBnkB1Ok_C InjVlv_DebBnkB2Def_C InjVlv_DebBnkB2Ok_C InjVlv_DebBnkB3Def_C InjVlv_DebBnkB3Ok_C InjVlv_DebChipA0Def_C InjVlv_DebChipA0Ok_C InjVlv_DebChipA1Def_C InjVlv_DebChipA1Ok_C InjVlv_DebChipA2Def_C InjVlv_DebChipA2Ok_C InjVlv_DebChipA3Def_C InjVlv_DebChipA3Ok_C InjVlv_DebChipB0Def_C InjVlv_DebChipB0Ok_C InjVlv_DebChipB1Def_C InjVlv_DebChipB1Ok_C InjVlv_DebChipB2Def_C InjVlv_DebChipB2Ok_C InjVlv_DebChipB3Def_C InjVlv_DebChipB3Ok_C InjVlv_DebCylA0Def_C InjVlv_DebCylA0Ok_C InjVlv_DebCylA1Def_C InjVlv_DebCylA1Ok_C InjVlv_DebCylA2Def_C InjVlv_DebCylA2Ok_C InjVlv_DebCylA3Def_C InjVlv_DebCylA3Ok_C InjVlv_DebCylB0Def_C InjVlv_DebCylB0Ok_C InjVlv_DebCylB1Def_C InjVlv_DebCylB1Ok_C InjVlv_DebCylB2Def_C InjVlv_DebCylB2Ok_C InjVlv_DebCylB3Def_C InjVlv_DebCylB3Ok_C InjVlv_DebCylC0Def_C InjVlv_DebCylC0Ok_C InjVlv_DebCylC1Def_C InjVlv_DebCylC1Ok_C InjVlv_DebCylC2Def_C InjVlv_DebCylC2Ok_C InjVlv_DebCylC3Def_C InjVlv_DebCylC3Ok_C InjVlv_facNVCInPI_C InjVlv_facNVCMax_C InjVlv_facNVCMin_C InjVlv_facPCorQ_CUR InjVlv_facPCorTi_CUR InjVlv_facVoltCorUp_MAP InjVlv_iDCDC_CUR InjVlv_iMonDisChDwn_C InjVlv_nMonQckThresLo_C InjVlv_numClsVltgAdjMax_C InjVlv_numClsVltgAdjMin_C InjVlv_numInjChrgBal_MAP InjVlv_numNoLoadCylMax_C InjVlv_NVCIKi_C InjVlv_NVCIKiNeg_C InjVlv_NVCIKiPos_C InjVlv_NVCPKp_C InjVlv_NVCPKpNeg_C InjVlv_NVCPKpPos_C InjVlv_pCorBase_CUR InjVlv_pMin_C InjVlv_pMin_CUR InjVlv_pNVCMax_C InjVlv_pNVCMin_C InjVlv_pRailDfl_C InjVlv_qWvCorMax_C InjVlv_qWvCorMin_C InjVlv_rChrgBalPwrHys_C InjVlv_rChrgBalVltgHys_C InjVlv_stBufCInjLimYHigh_C InjVlv_stBufCInjLimYLow_C InjVlv_stErrMskPattern_C InjVlv_stErrMskSelect_C InjVlv_stMonQckEna_C InjVlv_stPWvCorMsk_C InjVlv_stQntAdj_MAP InjVlv_tActrDfl_C InjVlv_tiNVCDwnThres_C InjVlv_tiNVCUpThres_C InjVlv_tNVCEngMax_C InjVlv_tNVCEngMin_C InjVlv_uBufCInjLimXHigh_C InjVlv_uBufCInjLimXLow_C InjVlv_uDiffNVCSet_CUR InjVlv_uMonBattThres_C InjVlv_uNVCIWinNeg_C InjVlv_uNVCIWinPos_C InjVlv_uNVCPWinNeg_C InjVlv_uNVCPWinPos_C InjVlv_uNVCThres_C InjVlv_uOfs_C InjVlv_uSetBott_C InjVlv_uSetUpNVCActrMax_C InjVlv_uSetUpNVCActrMin_C InjVlv_uSetUpPress0_CUR InjVlv_uSetUpPress1_CUR InjVlv_uSetUpPress10_CUR InjVlv_uSetUpPress11_CUR InjVlv_uSetUpPress12_CUR InjVlv_uSetUpPress13_CUR InjVlv_uSetUpPress14_CUR InjVlv_uSetUpPress15_CUR InjVlv_uSetUpPress2_CUR InjVlv_uSetUpPress3_CUR InjVlv_uSetUpPress4_CUR InjVlv_uSetUpPress5_CUR InjVlv_uSetUpPress6_CUR InjVlv_uSetUpPress7_CUR InjVlv_uSetUpPress8_CUR InjVlv_uSetUpPress9_CUR InjVlv_volQntAdjLim_C InjVlv_wInj_CUR IVCtl_ChrgUpIKi_C IVCtl_ChrgUpIKiNeg_C IVCtl_ChrgUpIKiPos_C IVCtl_ChrgUpPKp_C IVCtl_ChrgUpPKpNeg_C IVCtl_ChrgUpPKpPos_C IVCtl_DisChDwnIKi_C IVCtl_DisChDwnIKiNeg_C IVCtl_DisChDwnIKiPos_C IVCtl_DisChDwnPKp_C IVCtl_DisChDwnPKpNeg_C IVCtl_DisChDwnPKpPos_C IVCtl_iChrgUpCls_C IVCtl_iChrgUp_CUR IVCtl_iChrgUpGovMax_C IVCtl_iChrgUpGovMin_C IVCtl_iChrgUpInitI_C IVCtl_iChrgUpMax_C IVCtl_iChrgUpMin_C IVCtl_iDisChDwnCls_C IVCtl_iDisChDwn_CUR IVCtl_iDisChDwnGovMax_C IVCtl_iDisChDwnGovMin_C IVCtl_iDisChDwnInitI_C IVCtl_iDisChDwnMax_C IVCtl_iDisChDwnMin_C IVCtl_IKi_C IVCtl_IKiNeg_C IVCtl_IKiPos_C IVCtl_PKp_C IVCtl_PKpNeg_C IVCtl_PKpPos_C IVCtl_tiChrgSetUp_CUR IVCtl_tiChrgUpIWinNeg_C IVCtl_tiChrgUpIWinPos_C IVCtl_tiChrgUpPse_C IVCtl_tiChrgUpPWinNeg_C IVCtl_tiChrgUpPWinPos_C IVCtl_tiDisChDwnIWinNeg_C IVCtl_tiDisChDwnIWinPos_C IVCtl_tiDisChDwnPse_C IVCtl_tiDisChDwnPWinNeg_C IVCtl_tiDisChDwnPWinPos_C IVCtl_tiDisChSetDwn_CUR IVCtl_uClsActrUp_C IVCtl_uIWinNeg_C IVCtl_uIWinPos_C IVCtl_uMaxSetUp_C IVCtl_uMinSetUp_C IVCtl_uPIMax_C IVCtl_uPIMin_C IVCtl_uPWinNeg_C IVCtl_uPWinPos_C IVCtl_uSetUpPreCtl_CUR IVCtl_uUpInitI_C LIGov_nDeltaSec_C LIGov_nDiffDelta_C LIGov_nLimHigh_C LIGov_nMSDiffMax_C LIGov_nRmpBaseDwn_C LIGov_nRmpCoEngDwn_C LIGov_nRmpGearbxDwn_C LIGov_nRmpHDCDwn_C LIGov_nRmpHDCUp_C LIGov_nRmpPwrMngDwn_C LIGov_nRmpSecDelta_C LIGov_nRmpSurgeDwn_C LIGov_nSetpoint_Channel LIGov_nSetpointTrm_C LIGov_nSetpointTrmLim_C LIGov_nSetpoint_Vector LIGov_trq_Channel LIGov_trq_Vector LSUCD_facPresCompLean_CUR LSUCD_facPresCompRich_CUR LSUCD_facUToRi_C LSUCD_rO2_CUR LSUCD_stHtDis_C LSUCD_stPumpCtlDis_C LSUCD_stPwrStgDia_C LSUCD_stRefPumpDis_C LSUCD_tiHtPer_C LSUCD_tRi_CUR LSUCD_uBattMaxHigh_C LSUCD_uBattMaxLow_C LSUCD_uBattNominal_C LSUCD_uO2Ref_C LSUCD_uRiOfs_C LSUCtl_dcycHtMin_C LSUCtl_dcycRmpUp_C LSUCtl_dcycStrt_CUR LSUCtl_tRiSetPoint_C LSU_rLmbdRec_CUR MemMon_numErrChkRam_C MemMon_numErrChkRom_C MemMon_tiHealChkRam_C MemMon_tiHealChkRom_C MeUnCD_dcycMax_C MeUnCD_dcycMin_C MeUnCD_dcycSetValLin_CUR MeUnCD_dcycTst_C MeUnCD_DebExcTempDef_C MeUnCD_DebExcTempOk_C MeUnCD_DebNoLoadDef_C MeUnCD_DebNoLoadOk_C MeUnCD_DebShortCircBatDef_C MeUnCD_DebShortCircBatOk_C MeUnCD_DebShortCircGndDef_C MeUnCD_DebShortCircGndOk_C MeUnCD_DebSRCHighDef_C MeUnCD_DebSRCHighOk_C MeUnCD_DebSRCLowDef_C MeUnCD_DebSRCLowOk_C MeUnCD_facIGovInit_CUR MeUnCD_facIGovMax_C MeUnCD_facIGovMin_C MeUnCD_IGovDKd_C MeUnCD_IGovIKi_C MeUnCD_IGovIKiNeg_C MeUnCD_IGovIKiPos_C MeUnCD_iIGovIWinNeg_C MeUnCD_iIGovIWinPos_C MeUnCD_iLin_CUR MeUnCD_nDiffMax_C MeUnCD_numAdc_C MeUnCD_numDia1_C MeUnCD_numDia2_C MeUnCD_numPwmOut_C MeUnCD_resCoil_C MeUnCD_stInvOut_C MeUnCD_stPwrStgDia_C MeUnCD_swt_C MeUnCD_tiBtwTst_C MeUnCD_tiFltPT1Init_C MeUnCD_tiFlt1PT1_C MeUnCD_tiFlt2PT1_C MeUnCD_tiIGovDT1_C MeUnCD_tiIGovInit_C MeUnCD_tiPer_CUR MeUnCD_uSRCMax_C MeUnCD_uSRCMin_C MeUn_iCnvFlowRate_CUR MeUn_iSet_Channel MeUn_iSetMin_C MeUn_iSet_Vector MeUn_pActrPrt_C MeUn_pFlowOfFl_C MRlyCD_ctTooEarlyThres_C MRlyCD_numDioOutMnRly_C MRlyCD_numDioOutPSOFF_C MRlyCD_stInvOut_C MRlyCD_tiNotOpen_C MSidCD_Comm_DebNplDef_C MSidCD_numECUS_C MSidCD_Select_DebNplDef_C MSidCD_Select_DebNplOk_C MSidCD_stErrInjOFF_C MSidCD_swtCanDeb_C MSidCD_swtMAIN_C MSidCD_tiCanDeb_C NetMng_CANFadeOutMaskA_C NetMng_CANFadeOutMaskB_C NetMng_ctBusOffRetriesA_C NetMng_ctBusOffRetriesB_C NetMng_ctInitRetryCanA_C NetMng_ctInitRetryCanB_C NetMng_FadeOutMaskA_C NetMng_FadeOutMaskB_C NetMng_SplyVltgHysYHigh_C NetMng_SplyVltgHysYLow_C NetMng_swtONWM_C NetMng_tiDebNegBusMonCanA_C NetMng_tiDebNegBusMonCanB_C NetMng_tiDebNegBusOffCanA_C NetMng_tiDebNegBusOffCanB_C NetMng_tiDebNegErrCanA_C NetMng_tiDebNegErrCanB_C NetMng_tiDebNegMonCanA_C NetMng_tiDebNegMonCanB_C NetMng_tiDebPosBusMonCanA_C NetMng_tiDebPosBusMonCanB_C NetMng_tiDebPosBusOffCanA_C NetMng_tiDebPosBusOffCanB_C NetMng_tiDebPosErrCanA_C NetMng_tiDebPosErrCanB_C NetMng_tiDebPosMonCanA_C NetMng_tiDebPosMonCanB_C NetMng_tiFadeoutLowBat_C NetMng_tiRecoverA_C NetMng_tiRecoverB_C NSC_numPrio_C NSC_st_C OPSCD_DebSRCLoDef_C OPSCD_numAdc_C OPSCD_numDia_C OPSCD_numDioOut_C OPSCD_uSRCMax_C OPSCD_uSRCMin_C OTSCD_DebNplDef_C OTSCD_DebSigDef_C OTSCD_DebSRCHighDef_C OTSCD_DebSRCLowDef_C OTSCD_numAdc_C OTSCD_uSRCMax_C OTSCD_uSRCMin_C OvRMon_ctEngSpdGrad_C OvRMon_DebETDef_C OvRMon_DebSigA0Def_C OvRMon_facInjEff_MAP OvRMon_nDiffMax_C OvRMon_nLIGovLim_C OvRMon_nSegMax_C OvRMon_nSegMin_C OvRMon_nStSysLim_C OvRMon_nThresNrml2Strt_C OvRMon_numBrkDioInMn_C OvRMon_numBrkDioInRed_C OvRMon_stBrkMnSwtInvIn_C OvRMon_stBrkRedSwtInvIn_C OvRMon_stDebCnt_C OvRMon_stIntrInit_C OvRMon_swtBrkRedSwtPresent_C OvRMon_swtBrkSigVal_C OvRMon_tiAPP1Flt_C OvRMon_tiASDdc_C OvRMon_tiBrkMnSwtDebPos_C OvRMon_tiBrkRedSwtDebPos_C OvRMon_tiCompAcsTemp_C OvRMon_tiCrCtlBrkRmp_C OvRMon_tiCrCtlConvRmp_C OvRMon_tiDebBrk_C OvRMon_tiDebConv_C OvRMon_tiDebT15_C OvRMon_tiErrAPP_C OvRMon_tiErrDblStorage_C OvRMon_tiLimET_CUR OvRMon_tiSegMin_C OvRMon_uAPPFull_C OvRMon_uAPP1Lim_C OvRMon_uPlaWinFull_C OvRMon_uPlaWinIdle_C PCR_dnSurgeSlpDwn_C PCR_dnSurgeSlpUp_C PCR_nCoStart_C PCR_nCoStrtHigh_C PCR_nLIGovBase_C PCR_nSurgeMon1_C PCR_nSurgeMon2_C PCR_pBGDevMaxOffset_C PCR_pBGDevMinOffset_C PCR_pDesAdd_Channel PCR_pDesAdd_Vector PCR_pDes_Channel PCR_pDes_Vector PCR_rBPACDAdd_Channel PCR_rBPACDAdd_Vector PCR_rBPACD_Channel PCR_rBPACD_Vector PCR_rSurgeHigh_MAP PCR_swtRelAbsType_C PCR_swtRelAbsVal_C PCR_tiCoStrt_CUR PCR_tiStrtDelayInit_C PCR_tiSurgeMonLIGov_C PCR_vSurgeLIGov_C PCVCD_dcycMax_C PCVCD_dcycMin_C PCVCD_dcycTst_C PCVCD_DebExcTempDef_C PCVCD_DebExcTempOk_C PCVCD_DebNoLoadDef_C PCVCD_DebNoLoadOk_C PCVCD_DebShortCircBatDef_C PCVCD_DebShortCircBatOk_C PCVCD_DebShortCircGndDef_C PCVCD_DebShortCircGndOk_C PCVCD_DebSRCHighDef_C PCVCD_DebSRCHighOk_C PCVCD_DebSRCLowDef_C PCVCD_DebSRCLowOk_C PCVCD_facIGovInit_CUR PCVCD_facIGovMax_C PCVCD_facIGovMin_C PCVCD_IGovDKd_C PCVCD_IGovIKi_C PCVCD_IGovIKiNeg_C PCVCD_IGovIKiPos_C PCVCD_iIGovIWinNeg_C PCVCD_iIGovIWinPos_C PCVCD_iLin_CUR PCVCD_numAdc_C PCVCD_numDia1_C PCVCD_numDia2_C PCVCD_numPwmOut_C PCVCD_resCoil_C PCVCD_stInvOut_C PCVCD_stPwrStgDia_C PCVCD_swt_C PCVCD_swtCtlStateType_C PCVCD_swtCtlStateVal_C PCVCD_tiBtwTst_C PCVCD_tiFltPT1Init_C PCVCD_tiFlt1PT1_C PCVCD_tiFlt2PT1_C PCVCD_tiIGovDT1_C PCVCD_tiIGovInit_C PCVCD_tiPer_C PCVCD_uSRCMax_C PCVCD_uSRCMin_C PCV_dvolLeak_CUR PCV_iCnvPress_CUR PCV_iSet_Channel PCV_iSetMin_C PCV_iSet_Vector PFLTCD_numAdc_C PFLTCD_numAdc2_C PFlt_dvol_Channel PFlt_dvol_Vector PFlt_resFlow_Channel PFlt_resFlow_Vector PFlt_st_Channel PFlt_stEngPOp_Channel PFlt_stEngPOp_Vector PFlt_st_Vector RailCD_DebSRCHighDef_C RailCD_DebSRCHighOk_C RailCD_DebSRCLowDef_C RailCD_DebSRCLowOk_C RAILCD_numAdc_C RAILCD_numAdc2_C RailCD_pLin_CUR RailCD_swtOfsTst_C RailCD_tiEvalDel_C RailCD_tiOfsTstAftRun_C RailCD_tiOfsTstStrt_C RailCD_uSRCMax_C RailCD_uSRCMin_C Rail_DebMeUn0MaxDef_C Rail_DebMeUn0MaxOk_C Rail_DebMeUn1MaxDef_C Rail_DebMeUn1MaxOk_C Rail_DebMeUn2MaxDef_C Rail_DebMeUn2MaxOk_C Rail_DebMeUn3MaxDef_C Rail_DebMeUn3MaxOk_C Rail_DebMeUn4MaxDef_C Rail_DebMeUn4MaxOk_C Rail_DebPCV0MaxDef_C Rail_DebPCV0MaxOk_C Rail_DebPCV1MaxDef_C Rail_DebPCV1MaxOk_C Rail_DebPCV2MaxDef_C Rail_DebPCV2MaxOk_C Rail_DebPCV3MaxDef_C Rail_DebPCV3MaxOk_C Rail_DebPCV4MaxDef_C Rail_DebPCV4MaxOk_C Rail_DebPCV5MaxDef_C Rail_DebPCV5MaxOk_C Rail_dpSetPointDec_C Rail_dpSetPointInc_MAP Rail_dvolMeUnCtlLoLim_C Rail_dvolMeUnCtlUpLim_CUR Rail_dvolMeUnSet_Channel Rail_dvolMeUnSetMin_C Rail_dvolMeUnSet_Vector Rail_dvolOff_C Rail_dvolPreCtlCor_Channel Rail_dvolPreCtlCor_Vector Rail_dvolPreCtlPoI1_MAP Rail_dvolPreCtlPoI2_MAP Rail_dvolRedOfsLim_C Rail_dvolStrt_C Rail_facLeakAged_C Rail_facOvrMeUnNegIncr_C Rail_facOvrPCVNegIncr_C Rail_nMonEnaMax_C Rail_nMonEnaMin_C Rail_nThresStrt_C Rail_numRevDel_C Rail_numRevPlaus_C Rail_pAbsDvtMax_C Rail_pMeUnDvtMax_C Rail_pMeUnDvtMax_CUR Rail_pMeUnDvtMin_CUR Rail_pMeUnPeakMax_C Rail_pMeUnPeakMin_CUR Rail_pNIPCVMax_MAP Rail_pNIPCVMin_MAP Rail_pOvrMeUnThresHigh_C Rail_pOvrMeUnThresLow_C Rail_pOvrPCVThresHigh_C Rail_pOvrPCVThresLow_C Rail_pPCVCloseOfs_CUR Rail_pPCVCtlLoLim_C Rail_pPCVCtlLoLimStrt_C Rail_pPCVCtlUpLim_C Rail_pPCVDvtMax_C Rail_pPCVDvtMax_CUR Rail_pPCVDvtMin_C Rail_pPCVPeakMax_C Rail_pPCVPeakMin_CUR Rail_pPCVRedOfs_CUR Rail_pPCVSet_Channel Rail_pPCVSetMax_C Rail_pPCVSetMin_C Rail_pPCVSet_Vector Rail_pPreCtlCor_Channel Rail_pPreCtlCor_Vector Rail_pSetMin_C Rail_pSetPoint_Channel Rail_pSetPointLimNFlTemp_C Rail_pSetPointMax_MAP Rail_pSetPointMinDef_C Rail_pSetPointMin_MAP Rail_pSetPointRed_C Rail_pSetPointRgn_Channel Rail_pSetPointRgn_Vector Rail_pSetPoint_Vector Rail_qMeUnLoIdle_C Rail_qMonEnaMax_C Rail_stMonMeUnRls_C Rail_stMonPCVRls_C Rail_stPreCtlMeUnSel_C Rail_stSetPointSel_C Rail_tiDeflate_C Rail_tiSetPointRedMin_C Rail_tiThresMonEna_C Rail_tMeUnLoIdle_C Rail_volInjVlvCtl_C RTMMon_dMaxCheckDef_C RTMMon_dMaxCheckOk_C RTMMon_dPlausCheckDef_C RTMMon_dPlausCheckOk_C RTMMon_tiNoPlausCheck_C Rtmo_adStart_cu32 Rtmo_stSampleTime_cu8 ShutCD_numDia_C ShutCD_numDioOut_C SOPTst_stRcyDem_C SOPTst_stShOffPathActv_C SSpMon_DebSRCHighSplyVltgDef1_C SSpMon_DebSRCHighSplyVltgDef2_C SSpMon_DebSRCHighSplyVltgDef3_C SSpMon_DebSRCHighSplyVltgOk1_C SSpMon_DebSRCHighSplyVltgOk2_C SSpMon_DebSRCHighSplyVltgOk3_C SSpMon_DebSRCLowSplyVltgDef1_C SSpMon_DebSRCLowSplyVltgDef2_C SSpMon_DebSRCLowSplyVltgDef3_C SSpMon_DebSRCLowSplyVltgOk1_C SSpMon_DebSRCLowSplyVltgOk2_C SSpMon_DebSRCLowSplyVltgOk3_C SSpMon_numDiaVltg1_C SSpMon_numDiaVltg2_C SSpMon_numDiaVltg3_C StrtCD_numDia_C StrtCD_numDioOut_C StSys_nAdjMax_C ThrVlv_rTVA_Channel ThrVlv_rTVA_Vector TPUMon_ctDfctLim_C TPUMon_tiDiffMaxLimit_C TPUMon_tiDiffMinLimit_C TPUMon_tiDiffSumLimit_C TVACD_numDia_C TVACD_numPwmOut_C T15CD_numDioIn_C T15CD_tiDebNeg_C T15CD_tiDebPos_C UAddr_stCalibration_C VehDa_lEepUpd_C VSACD_numDia_C VSACD_numPwmOut_C VSA_rVSA_Channel VSA_rVSA_Vector VSSCD_DebCanSigDef_C VSSCD_swtSigType_C VSSCD_swtSigVal_C ZFC_nAvrgMax_C ZFC_nAvrgMin_C ZFC_nChngPRailMax_C ZFC_nFBCThresMax_C ZFC_numRatETClb_C ZFC_numRatNVClb_C /end REF_CHARACTERISTIC
/end FUNCTION
/begin FUNCTION _k2rei "Applizierbare Diagnose Informationen" /begin DEF_CHARACTERISTIC K2REI_dCodInd_C K2REI_dDiaInd_C K2REI_dSGFam_C /end DEF_CHARACTERISTIC /end FUNCTION
/begin FUNCTION BGCRENG "BGCRENG" /end FUNCTION
/begin FUNCTION BGLLGEN_1PR "BGLLGEN_1PR" /end FUNCTION
/begin FUNCTION DGEN "DGEN" /end FUNCTION
/begin FUNCTION DIBS "DIBS" /end FUNCTION
/begin FUNCTION DQLT "DQLT" /end FUNCTION
/begin COMPU_METHOD Acc "Fahrzeugbeschleunigung" RAT_FUNC "%6.5" "m/s^2" COEFFS 0 1000 0 0 0 1 /end COMPU_METHOD
/begin COMPU_METHOD Def_i_sw_q1 "Def_i_sw_q1" RAT_FUNC "%8.3" "A" COEFFS 0 1 0 0 0 1 /end COMPU_METHOD
/begin COMPU_METHOD Def_f_uw_b512 "Def_f_uw_b512" RAT_FUNC "%8.3" "-" COEFFS 0 65536 0 0 0 512 /end COMPU_METHOD
/begin COMPU_METHOD Def_i_uw_q0p0635 "Def_i_uw_q0p0635" RAT_FUNC "%8.3" "A" COEFFS 0 65536 0 0 0 4096 /end COMPU_METHOD
/begin COMPU_METHOD Def_i_sw_q0p001 "Def_i_sw_q0p001" RAT_FUNC "%8.3" "A" COEFFS 0 1000 0 0 0 1 /end COMPU_METHOD
/begin COMPU_METHOD Def_t_sw_q0p1 "Def_t_sw_q0p1" RAT_FUNC "%6.1" "°C" COEFFS 0 10 0 0 0 1 /end COMPU_METHOD
/begin COMPU_METHOD Def_u_uw_q0p0942 "Def_u_uw_q0p0942" RAT_FUNC "%6.1" "V" COEFFS 0 1 0 0 0 0.0942 /end COMPU_METHOD
/begin COMPU_METHOD Def_f_ub_b8 "Def_f_ub_b8" RAT_FUNC "%5.2" "-" COEFFS 0 256 0 0 0 8 /end COMPU_METHOD
/begin COMPU_METHOD Def_v_uw_q1p0 "Def_v_uw_q1p0" RAT_FUNC "%5.0" "km/h" COEFFS 0 1 0 0 0 1 /end COMPU_METHOD
/begin COMPU_METHOD Def_tv_ub_q0p390625 "Def_tv_ub_q0p390625" RAT_FUNC "%5.2" "%" COEFFS 0 256 0 0 0 100 /end COMPU_METHOD
/begin COMPU_METHOD Def_bit_ub_0 "Def_bit_ub_0" TAB_VERB "%5.2" "-" COMPU_TAB_REF Def_bit_ub_0_VTAB /end COMPU_METHOD
/begin COMPU_METHOD Def_st_ub_q1 "Def_st_ub_q1" RAT_FUNC "%3.0" "-" COEFFS 0 1 0 0 0 1 /end COMPU_METHOD
/begin COMPU_METHOD Def_n_sw_q1p0 "Def_n_sw_q1p0" RAT_FUNC "%5.0" "Upm" COEFFS 0 1 0 0 0 1 /end COMPU_METHOD
/begin COMPU_METHOD Def_f_ub_b100 "Def_f_ub_b100" RAT_FUNC "%5.2" "%" COEFFS 0 256 0 0 0 100 /end COMPU_METHOD
/begin COMPU_METHOD Def_i_ub_q1 "Def_i_ub_q1" RAT_FUNC "%6.3" "" COEFFS 0 1 0 0 0 1 /end COMPU_METHOD
/begin COMPU_METHOD Def_td_ub_q0p1 "Def_td_ub_q0p1" RAT_FUNC "%4.1" "s" COEFFS 0 10 0 0 0 1 /end COMPU_METHOD
/begin COMPU_METHOD Def_bit_ub_1 "Def_bit_ub_1" TAB_VERB "%5.2" "-" COMPU_TAB_REF Def_bit_ub_1_VTAB /end COMPU_METHOD
/begin COMPU_METHOD Def_bit_ub_2 "Def_bit_ub_2" TAB_VERB "%5.2" "-" COMPU_TAB_REF Def_bit_ub_2_VTAB /end COMPU_METHOD
/begin COMPU_METHOD Def_bit_ub_3 "Def_bit_ub_3" TAB_VERB "%5.2" "-" COMPU_TAB_REF Def_bit_ub_3_VTAB /end COMPU_METHOD
/begin COMPU_METHOD Def_bit_ub_4 "Def_bit_ub_4" TAB_VERB "%5.2" "-" COMPU_TAB_REF Def_bit_ub_4_VTAB /end COMPU_METHOD
/begin COMPU_METHOD Def_bit_ub_5 "Def_bit_ub_5" TAB_VERB "%5.2" "-" COMPU_TAB_REF Def_bit_ub_5_VTAB /end COMPU_METHOD
/begin COMPU_METHOD Def_bit_ub_6 "Def_bit_ub_6" TAB_VERB "%5.2" "-" COMPU_TAB_REF Def_bit_ub_6_VTAB /end COMPU_METHOD
/begin COMPU_METHOD Def_bit_ub_7 "Def_bit_ub_7" TAB_VERB "%5.2" "-" COMPU_TAB_REF Def_bit_ub_7_VTAB /end COMPU_METHOD
/begin COMPU_METHOD Def_st_uw_q1 "Def_st_uw_q1" RAT_FUNC "%5.0" "-" COEFFS 0 1 0 0 0 1 /end COMPU_METHOD
/begin COMPU_METHOD ident "ident" RAT_FUNC "%4.1" "-" COEFFS 0 1 0 0 0 1 /end COMPU_METHOD
/begin COMPU_METHOD Def_dez_uw_q1 "Def_dez_uw_q1" RAT_FUNC "%5.0" "-" COEFFS 0 1 0 0 0 1 /end COMPU_METHOD
/begin COMPU_METHOD Def_dez_ub_q1 "Def_dez_ub_q1" RAT_FUNC "%3.0" "-" COEFFS 0 1 0 0 0 1 /end COMPU_METHOD
/begin COMPU_METHOD Identity "Identity" RAT_FUNC "%4.1" "-" COEFFS 0 1 0 0 0 1 /end COMPU_METHOD
/begin COMPU_METHOD Def_dez_ul_q1 "Def_dez_ul_q1" RAT_FUNC "%7.0" "-" COEFFS 0 1 0 0 0 1 /end COMPU_METHOD
/begin COMPU_VTAB Def_bit_ub_0_VTAB "Def_bit_ub_0_VTAB" TAB_VERB 2 0 "FALSE" 1 "TRUE" /end COMPU_VTAB
/begin COMPU_VTAB Def_bit_ub_1_VTAB "Def_bit_ub_1_VTAB" TAB_VERB 2 0 "FALSE" 1 "TRUE" /end COMPU_VTAB
/begin COMPU_VTAB Def_bit_ub_2_VTAB "Def_bit_ub_2_VTAB" TAB_VERB 2 0 "FALSE" 1 "TRUE" /end COMPU_VTAB
/begin COMPU_VTAB Def_bit_ub_3_VTAB "Def_bit_ub_3_VTAB" TAB_VERB 2 0 "FALSE" 1 "TRUE" /end COMPU_VTAB
/begin COMPU_VTAB Def_bit_ub_4_VTAB "Def_bit_ub_4_VTAB" TAB_VERB 2 0 "FALSE" 1 "TRUE" /end COMPU_VTAB
/begin COMPU_VTAB Def_bit_ub_5_VTAB "Def_bit_ub_5_VTAB" TAB_VERB 2 0 "FALSE" 1 "TRUE" /end COMPU_VTAB
/begin COMPU_VTAB Def_bit_ub_6_VTAB "Def_bit_ub_6_VTAB" TAB_VERB 2 0 "FALSE" 1 "TRUE" /end COMPU_VTAB
/begin COMPU_VTAB Def_bit_ub_7_VTAB "Def_bit_ub_7_VTAB" TAB_VERB 2 0 "FALSE" 1 "TRUE" /end COMPU_VTAB
/begin COMPU_METHOD AngleCrS "Winkel Kurbelwelle" RAT_FUNC "%6.4" "deg CrS" COEFFS 0 42.6666666666667 0 0 0 1 /end COMPU_METHOD
/begin COMPU_METHOD AngleGrad "Winkelanzeige in Grad" RAT_FUNC "%6.4" "Grad" COEFFS 0 22.7531285551763 0 0 0 1 /end COMPU_METHOD
/begin COMPU_METHOD AngleGradPerSec "Winkelanzeige in Grad pro Sekunde" RAT_FUNC "%6.4" "Grad/s" COEFFS 0 22.7531285551763 0 0 0 1 /end COMPU_METHOD
/begin COMPU_METHOD Dist_20ms "Entfernung durch Aufsummierung Fahrgeschwindigkeit (Vel/VelSI) im 20 ms Raster" RAT_FUNC "%7.6" "m" COEFFS 0 18000 0 0 0 1 /end COMPU_METHOD
/begin COMPU_METHOD DtyCyc "Tastverhaeltnis" RAT_FUNC "%6.4" "%" COEFFS 0 100 0 0 0 1 /end COMPU_METHOD
/begin COMPU_METHOD EngN "Motordrehzahl" RAT_FUNC "%6.2" "rpm" COEFFS 0 1 0 0 0 1 /end COMPU_METHOD
/begin COMPU_METHOD EngTempFldSel "Verbale Umrechnung für Auswahl aus dem Motortemperatur-Feld Eng_tFld" TAB_VERB "%6.3" "-" COMPU_TAB_REF EngTempFldSel /end COMPU_METHOD
/begin COMPU_VTAB EngTempFldSel "Verbale Umrechnung für Auswahl aus dem Motortemperatur-Feld Eng_tFld" TAB_VERB 3 0 "Coolant_Temperature" 1 "Oil_Temperature" 2 "Eng_tEng" /end COMPU_VTAB
/begin COMPU_METHOD Fact "Faktor mit Auflösung 1 / 8192, hauptsächlich für einen Faktorenbereich 0...1 verwendet" RAT_FUNC "%6.5" "-" COEFFS 0 8192 0 0 0 1 /end COMPU_METHOD
/begin COMPU_METHOD InjMass "Einspritzmenge" RAT_FUNC "%6.4" "mg/hub" COEFFS 0 100 0 0 0 1 /end COMPU_METHOD
/begin COMPU_METHOD InjTime_us "Zeit in Microsekunden für das Einspritztiming" RAT_FUNC "%6.2" "us" COEFFS 0 1 0 0 0 1 /end COMPU_METHOD
/begin COMPU_METHOD Length "Länge in Meter" RAT_FUNC "%6.2" "m" COEFFS 0 1 0 0 0 1 /end COMPU_METHOD
/begin COMPU_METHOD NumPinDia "Verbale Umrechnung für Diagnose Signale" TAB_VERB "%6.3" "-" COMPU_TAB_REF NumPinDia /end COMPU_METHOD
/begin COMPU_VTAB NumPinDia "Verbale Umrechnung für Diagnose Signale" TAB_VERB 36 0 "CJ945_Diagnostic_Signal" 1 "AC_Compressor_DiaSig" 2 "Fuel_Pump_DiaSig" 3 "Starter_234" 4 "Oil_Pressure_Lamp_Switch_245" 5 "Engine_Bay_Air_Flaps_123" 6 "Glow_Relay_Diagnostic_Signal1" 7 "reserved Glow_Relay_Diagnostic_Signal2" 8 "Ebox_Fan_Actuator_Diagnostic_Signal_219" 9 "Dummy_Actuator_Diagnostic_Signal" 10 "Twostage_TurboLoading_SW_DiaSig" 11 "DIO_OUT_DIAGNOSTIC_DUMMY_NOT_USED" 12 "1st_Pressure_Control_Valve_Diagnostic_Signal_172" 13 "2nd_Pressure_Control_Valve_Diagnostic_Signal_172" 14 "1st_Metering_Unit_Diagnostic_Signal_171" 15 "2nd_Metering_Unit_Diagnostic_Signal_171" 16 "Boost_Pressure_Actuator_Diagnostic_Signal_193" 17 "Boost_Pressure_Actuator_Diagnostic_Signal_193_2" 18 "EGR_Actuator_Diagnostic_Signal_194" 19 "EGR_Actuator_Diagnostic_Signal2" 20 "Variable_Swirl_Actuator_Diagnostic_Signal_195" 21 "Throttle_Valve_Diagnostic_Signal_196" 22 "Throttle_Valve2_Diagnostic_Signal_196" 23 "FAN_240" 24 "Add_On_Heater_244" 25 "EngM_Bearing_Actuator_Diagnostic_Signal_124" 26 "EngM_Bearing_Actuator_Diagnostic_Signal_121" 27 "Low pressure stage BPA_Diagnostic_Signal_117" 28 "Shuttr_Actuator_Diagnostic_Signal_231" 29 "PWM_DIAGNOSTIC_DUMMY_NOT_USED" 30 "1st_Sensor_Supply_Voltage_DiaSig" 31 "2nd_Sensor_Supply_Voltage_DiaSig" 32 "3rd_Sensor_Supply_Voltage_DiaSig" 33 "4th_Sensor_Supply_Voltage_DiaSig" 34 "5th_Sensor_Supply_Voltage_DiaSig" 35 "6th_Sensor_Supply_Voltage_DiaSig" /end COMPU_VTAB
/begin COMPU_METHOD NumPinDioIn "Verbale Umrechnung für Digitaleingang Signale" TAB_VERB "%6.3" "-" COMPU_TAB_REF NumPinDioIn /end COMPU_METHOD
/begin COMPU_VTAB NumPinDioIn "Verbale Umrechnung für Digitaleingang Signale" TAB_VERB 15 0 "Terminal_15_207" 1 "Main_Brake_Switch_236" 2 "Redundant_Brake_Switch_223" 3 "Clutch_Switch" 4 "Terminal_50_224" 5 "ECU_selection_Switch_251" 6 "FlFlt_Switch_211" 7 "Coolant-heater_212" 8 "Redundant_Terminal_15_209(118)" 9 "AC-compressor_overboost_213" 10 "Additive_tank_level_switch_235" 11 "Terminal_61_113" 12 "Lambda_Regeneration" 13 "Oil_Level_sensor_138" 14 "DIO_IN_DUMMY_NOT_USED" /end COMPU_VTAB
/begin COMPU_METHOD NumPinDioOut "Verbale Umrechnung für Digitalausgang Signale" TAB_VERB "%6.3" "-" COMPU_TAB_REF NumPinDioOut /end COMPU_METHOD
/begin COMPU_VTAB NumPinDioOut "Verbale Umrechnung für Digitalausgang Signale" TAB_VERB 12 0 "Main_Relay_220(144)" 1 "AC_Compressor" 2 "Fuel_Pump_232" 3 "Starter_234" 4 "OPS_Lamp_245" 5 "EBAF_123" 6 "Ebox_Fan_Actuator_219" 7 "Shuttr_Actuator_Digital_231" 8 "STATREG_PSOFF_Bit" 9 "Twostage_TurboLoading_120" 10 "TD_Signal_253" 11 "DIO_OUT_DUMMY_NOT_USED" /end COMPU_VTAB
/begin COMPU_METHOD NumPinPwmOut "Verbale Umrechnung für PWM-Ausgang Signale" TAB_VERB "%6.3" "-" COMPU_TAB_REF NumPinPwmOut /end COMPU_METHOD
/begin COMPU_VTAB NumPinPwmOut "Verbale Umrechnung für PWM-Ausgang Signale" TAB_VERB 14 0 "Boost_Pressure_Actuator_193" 1 "EGR_Actuator_194" 2 "PCV_Actuator_172" 3 "MeUn_Actuator_171" 4 "Variable_Swirl_Actuator_195" 5 "Fan_Actuator_240" 6 "Add_On_Heater_244" 7 "EngM_Bearing_Actuator_124" 8 "EngM_Bearing_Actuator_121" 9 "Throttle_Valve_196" 10 "LSU_Heater_PWMOutput" 11 "Low pressure stage BPA_117" 12 "Shuttr_Actuator_PWM_231" 13 "PWM_DUMMY_NOT_USED" /end COMPU_VTAB
/begin COMPU_METHOD OneToOne "eins zu eins (physikalischer Wert ist gleich dem internen Wert)" RAT_FUNC "%6.2" "-" COEFFS 0 1 0 0 0 1 /end COMPU_METHOD
/begin COMPU_METHOD Period "Periodendauer" RAT_FUNC "%6.3" "ms" COEFFS 0 10 0 0 0 1 /end COMPU_METHOD
/begin COMPU_METHOD Per_Ratio "Umwandlung fuer Bereichsgewichtung" RAT_FUNC "%6.4" "-" COEFFS 0 256 0 0 0 1 /end COMPU_METHOD
/begin COMPU_METHOD Prc "Prozent, gleiche interne Auflösung wie Fact, aber Darstellung in Prozent (0...100%)" RAT_FUNC "%6.4" "%" COEFFS 0 81.92 0 0 0 1 /end COMPU_METHOD
/begin COMPU_METHOD Pres_hPa "Druck (angezeigt in [hPa])" RAT_FUNC "%6.2" "hPa" COEFFS 0 1 0 0 0 1 /end COMPU_METHOD
/begin COMPU_METHOD Pres_Rail "Raildruck in hPa" RAT_FUNC "%4.3" "bar" COEFFS 0 10.000000 0 0 0 1 /end COMPU_METHOD
/begin COMPU_METHOD Pwr "Leistung" RAT_FUNC "%6.2" "W" COEFFS 0 0.10610329539459 0 0 0 1 /end COMPU_METHOD
/begin COMPU_METHOD RmpTrq "Rampengradient für Motormoment" RAT_FUNC "%6.4" "Nm/s" COEFFS 0 655.36 0 0 0 1 /end COMPU_METHOD
/begin COMPU_METHOD Temp_Cels "Temperatur dargestellt in °C (gleiche interne Darstellung wie Temp_Kelv)" RAT_FUNC "%6.1" "deg C" COEFFS 0 10 2731.4 0 0 1 /end COMPU_METHOD
/begin COMPU_METHOD TimeDeb "Entprellzeit in Millisekunden für Libraryfunktion Debounce" RAT_FUNC "%6.1" "ms" COEFFS 0 0.1 0 0 0 1 /end COMPU_METHOD
/begin COMPU_METHOD TimeDelay_s "Zeitkonstante T1 (in s) für PT1, DT1, etc." RAT_FUNC "%9.3" "s" COEFFS 0 0 1 0 0.00023283064365387 0 /end COMPU_METHOD
/begin COMPU_METHOD TimeEngOn "Motorbetriebszeit in Sekunden" RAT_FUNC "%6.2" "s" COEFFS 0 1 0 0 0 1 /end COMPU_METHOD
/begin COMPU_METHOD TimeUSResolution "Zeit in Mikrosekunden für TPU Zeiten, Auflösung 1 us" RAT_FUNC "%6.2" "us" COEFFS 0 1 0 0 0 1 /end COMPU_METHOD
/begin COMPU_METHOD Time_ms "Zeit in ms für Fehlerentprellung (DSM) und SW-Timer" RAT_FUNC "%6.1" "ms" COEFFS 0 0.1 0 0 0 1 /end COMPU_METHOD
/begin COMPU_METHOD Time_PwmHigh "Periodenzeit von der HWE (Tio_PwmGetAvrg)" RAT_FUNC "%6.3" "us" COEFFS 0 10 0 0 0 1 /end COMPU_METHOD
/begin COMPU_METHOD TransR "Übersetzungsverhältnis (Getriebe etc.)" RAT_FUNC "%6.4" "-" COEFFS 0 100 0 0 0 1 /end COMPU_METHOD
/begin COMPU_METHOD Trq "Motormoment" RAT_FUNC "%6.3" "Nm" COEFFS 0 10 0 0 0 1 /end COMPU_METHOD
/begin COMPU_METHOD Vel "Fahrzeuggeschwindigkeit, gleiche interne Auflösung wie Vel_SI" RAT_FUNC "%6.4" "km/h" COEFFS 0 100 0 0 0 1 /end COMPU_METHOD
/begin COMPU_METHOD VelToN "Verhältnis Fahrzeuggeschwindigkeit zu Motordrehzahl v/n" RAT_FUNC "%8.7" "(km/h)/rpm" COEFFS 0 100000 0 0 0 1 /end COMPU_METHOD
/begin COMPU_METHOD Vel_SI "Fahrzeuggeschwindigkeit (in m/s)" RAT_FUNC "%6.4" "m/s" COEFFS 0 360 0 0 0 1 /end COMPU_METHOD
/begin COMPU_METHOD volAdd_ml "Additivvolumen [ml]" RAT_FUNC "%6.3" "ml" COEFFS 0 10 0 0 0 1 /end COMPU_METHOD
/begin COMPU_METHOD volAdd_ml1 "Umrechnung mit Auflösung 0.0000152587890625 für die 32 bit Messages in AddPmp_AddMet" RAT_FUNC "%7.6" "ml" COEFFS 0 65536 0 0 0 1 /end COMPU_METHOD
/begin COMPU_METHOD Volt_Batt "Batteriespannung" RAT_FUNC "%6.1" "mV" COEFFS 0 0.05115 0 0 0 1 /end COMPU_METHOD
/begin COMPU_METHOD VSS_DistFac "Streckenfaktor für FGG" RAT_FUNC "%20.2" "Imp/m" COEFFS 0 0 1 0 2.77777777777778e-10 0 /end COMPU_METHOD
/begin COMPU_METHOD ZFC_EvalEngSpd_Rslt "Umrechnung für das Ergebniss der Drehzahlsignalauswertung" TAB_VERB "%6.3" "-" COMPU_TAB_REF ZFC_EvalEngSpd_Rslt /end COMPU_METHOD
/begin COMPU_VTAB ZFC_EvalEngSpd_Rslt "Umrechnung für das Ergebniss der Drehzahlsignalauswertung" TAB_VERB 3 0 "ZFC_ST_ALL_INJ_LOW" 1 "ZFC_ST_DES_INJ_MAX" 2 "ZFC_ST_ERR_INJ_MAX" /end COMPU_VTAB
/begin COMPU_METHOD ZFC_Inj_State "Umrechnung für die Ausgabe des Zustandsautomaten für die Einspritzung der Nullmengenkalibrierung" TAB_VERB "%6.3" "-" COMPU_TAB_REF ZFC_Inj_State /end COMPU_METHOD
/begin COMPU_VTAB ZFC_Inj_State "Umrechnung für die Ausgabe des Zustandsautomaten für die Einspritzung der Nullmengenkalibrierung" TAB_VERB 5 0 "ZFC_ST_INJ_IDLE" 16 "ZFC_ST_INJ_DEM" 32 "ZFC_ST_INJ_PROG" 48 "ZFC_ST_INJ_RES_OK" 64 "ZFC_ST_INJ_RES_NOK" /end COMPU_VTAB
/begin COMPU_METHOD ZFC_State "Umrechnung für Ausgabe des Nullmengenkalibrierung Statuses" TAB_VERB "%6.3" "-" COMPU_TAB_REF ZFC_State /end COMPU_METHOD
/begin COMPU_VTAB ZFC_State "Umrechnung für Ausgabe des Nullmengenkalibrierung Statuses" TAB_VERB 8 1 "ZFC_ST_BREAK" 2 "ZFC_ST_WAIT" 3 "ZFC_ST_START_OVRRUN" 4 "ZFC_ST_CHANGE_PRAIL" 5 "ZFC_ST_CHECK_PRAIL_AND_N" 6 "ZFC_ST_ETCLB" 7 "ZFC_ST_NVCLB" 16 "ZFC_ST_SUBS_FUNC" /end COMPU_VTAB
/begin RECORD_LAYOUT Kf_Xs16_Ys16_Ws16 NO_AXIS_PTS_X 1 SWORD NO_AXIS_PTS_Y 2 SWORD AXIS_PTS_X 3 SWORD INDEX_INCR DIRECT AXIS_PTS_Y 4 SWORD INDEX_INCR DIRECT FNC_VALUES 5 SWORD COLUMN_DIR DIRECT /end RECORD_LAYOUT
/begin RECORD_LAYOUT Kl_Xs16_Ws16 NO_AXIS_PTS_X 1 SWORD AXIS_PTS_X 2 SWORD INDEX_INCR DIRECT FNC_VALUES 3 SWORD COLUMN_DIR DIRECT /end RECORD_LAYOUT
/begin RECORD_LAYOUT Kwb_Wr32 FNC_VALUES 1 FLOAT32_IEEE COLUMN_DIR DIRECT /end RECORD_LAYOUT
/begin RECORD_LAYOUT Kwb_Ws16 FNC_VALUES 1 SWORD COLUMN_DIR DIRECT /end RECORD_LAYOUT
/begin RECORD_LAYOUT Kwb_Wu16 FNC_VALUES 1 UWORD COLUMN_DIR DIRECT /end RECORD_LAYOUT
/begin RECORD_LAYOUT Kwb_Wu8 FNC_VALUES 1 UBYTE COLUMN_DIR DIRECT /end RECORD_LAYOUT
/begin RECORD_LAYOUT Kw_Ws16 FNC_VALUES 1 SWORD COLUMN_DIR DIRECT /end RECORD_LAYOUT
/begin RECORD_LAYOUT Kw_Ws32 FNC_VALUES 1 SLONG COLUMN_DIR DIRECT /end RECORD_LAYOUT
/begin RECORD_LAYOUT Kw_Wu16 FNC_VALUES 1 UWORD COLUMN_DIR DIRECT /end RECORD_LAYOUT
/begin RECORD_LAYOUT Kw_Wu32 FNC_VALUES 1 ULONG COLUMN_DIR DIRECT /end RECORD_LAYOUT
/begin RECORD_LAYOUT Kw_Wu8 FNC_VALUES 1 UBYTE COLUMN_DIR DIRECT /end RECORD_LAYOUT
/begin RECORD_LAYOUT TKW_VV_VV_UW FNC_VALUES 1 UWORD COLUMN_DIR DIRECT /end RECORD_LAYOUT
/begin RECORD_LAYOUT TKW_VV_VV_SW FNC_VALUES 1 SWORD COLUMN_DIR DIRECT /end RECORD_LAYOUT
/begin RECORD_LAYOUT TKL_UW_VV_UB NO_AXIS_PTS_X 1 UBYTE RESERVED 2 BYTE AXIS_PTS_X 3 UWORD INDEX_INCR DIRECT FNC_VALUES 4 UBYTE COLUMN_DIR DIRECT /end RECORD_LAYOUT
/begin RECORD_LAYOUT TKL_UW_VV_UW NO_AXIS_PTS_X 1 UBYTE RESERVED 2 BYTE AXIS_PTS_X 3 UWORD INDEX_INCR DIRECT FNC_VALUES 4 UWORD COLUMN_DIR DIRECT /end RECORD_LAYOUT
/begin RECORD_LAYOUT TKL_SW_VV_UW NO_AXIS_PTS_X 1 UBYTE RESERVED 2 BYTE AXIS_PTS_X 3 SWORD INDEX_INCR DIRECT FNC_VALUES 4 UWORD COLUMN_DIR DIRECT /end RECORD_LAYOUT
/begin RECORD_LAYOUT TKF_UW_UB_UW NO_AXIS_PTS_X 1 UBYTE NO_AXIS_PTS_Y 2 UBYTE AXIS_PTS_X 3 UBYTE INDEX_INCR DIRECT AXIS_PTS_Y 4 UWORD INDEX_INCR DIRECT FNC_VALUES 5 UWORD COLUMN_DIR DIRECT /end RECORD_LAYOUT
/begin RECORD_LAYOUT TKW_VV_VV_UB FNC_VALUES 1 UBYTE COLUMN_DIR DIRECT /end RECORD_LAYOUT
/begin RECORD_LAYOUT TKF_UB_UB_UB NO_AXIS_PTS_X 1 UBYTE NO_AXIS_PTS_Y 2 UBYTE AXIS_PTS_X 3 UBYTE INDEX_INCR DIRECT AXIS_PTS_Y 4 UBYTE INDEX_INCR DIRECT FNC_VALUES 5 UBYTE COLUMN_DIR DIRECT /end RECORD_LAYOUT
/begin RECORD_LAYOUT TKW_VV_VV_UL FNC_VALUES 1 ULONG COLUMN_DIR DIRECT /end RECORD_LAYOUT
/end MODULE
/end PROJECT
