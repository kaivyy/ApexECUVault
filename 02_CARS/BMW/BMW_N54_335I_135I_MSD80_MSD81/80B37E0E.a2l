ASAP2_VERSION 1 41
/begin PROJECT MSD70 "Spray Guided DI-System with Piezo Injectors for 6-Cylinder"
/begin HEADER "_default_HeaderComment" PROJECT_NO _0B /end HEADER
/begin MODULE _default_ModuleName "_default_ModuleLongIdentifier"
/begin MOD_COMMON "_default_ModCommonComment" DEPOSIT ABSOLUTE BYTE_ORDER MSB_LAST ALIGNMENT_BYTE 1 ALIGNMENT_WORD 2 ALIGNMENT_LONG 2 ALIGNMENT_FLOAT32_IEEE 2 ALIGNMENT_FLOAT64_IEEE 4 /end MOD_COMMON
/begin AXIS_PTS ldpm_n_32_2_laco "" 0xa1008c02 n_32 _REC_AXS_20_u1 8160. _CNV_A_R_LINEAR_____9_CM 6 0. 8160. FORMAT "%4.0" /end AXIS_PTS
/begin AXIS_PTS ldpm_maf_1_laco "" 0xa1008bc0 maf _REC_AXS_20_u2 1389. _CNV_A_R_LINEAR_____108_CM 8 0. 1389. FORMAT "%7.2" /end AXIS_PTS
/begin AXIS_PTS ldpm_maf_cyl_1_laco "" 0xa1008bd4 maf_cyl _REC_AXS_20_u2 2047.96875 _CNV_A_R_LINEAR_____207_CM 6 0. 2047.96875 FORMAT "%10.5" /end AXIS_PTS
/begin AXIS_PTS ldpm_eff_cat_diag_1_laco "" 0xa1008ba0 online_dummy _REC_AXS_20_u1 1.9921875 _CNV_A_R_LINEAR_____100_CM 8 0. 1.9921875 FORMAT "%8.6" /end AXIS_PTS
/begin AXIS_PTS ldpm_n_1_laco "" 0xa1008bf0 n _REC_AXS_20_u2 8160. _CNV_A_R_LINEAR_____13_CM 8 0. 8160. FORMAT "%4.0" /end AXIS_PTS
/begin AXIS_PTS ldpm_t1_lsl_up_1_laco "" 0xa1008c20 online_dummy _REC_AXS_20_u2 1.99996948242188 _CNV_A_R_LINEAR_____117_CM 8 0. 1.99996948242188 FORMAT "%7.5" /end AXIS_PTS
/begin AXIS_PTS ldpm_t1_lsl_up_2_laco "" 0xa1008c34 online_dummy _REC_AXS_20_u2 1.99996948242188 _CNV_A_R_LINEAR_____117_CM 4 0. 1.99996948242188 FORMAT "%7.5" /end AXIS_PTS
/begin AXIS_PTS ldpm_tco_1_laco "" 0xa1008c5e tco _REC_AXS_20_u1 190.5 _CNV_A_R_LINEAR_____16_CM 6 -48. 142.5 FORMAT "%6.2" /end AXIS_PTS
/begin AXIS_PTS ldpm_tco_st_1_laco "" 0xa1008c6c tco_st _REC_AXS_20_u1 190.5 _CNV_A_R_LINEAR_____16_CM 6 -48. 142.5 FORMAT "%6.2" /end AXIS_PTS
/begin AXIS_PTS ldpm_fac_lam_mv_1_laco "" 0xa1008bac online_dummy _REC_AXS_20_u2 99.99847412 _CNV_A_R_LINEAR_____159_CM 8 -50. 49.99847412 FORMAT "%7.3" /end AXIS_PTS
/begin AXIS_PTS ldpm_t_dly_soi_lsl_pos_1_laco "" 0xa1008c40 online_dummy _REC_AXS_20_u2 1.023984 _CNV_A_R_LINEAR_____375_CM 8 0. 1.023984 FORMAT "%7.5" /end AXIS_PTS
/begin AXIS_PTS ldpm_t_dly_soi_lsl_pos_2_laco "" 0xa1008c54 online_dummy _REC_AXS_20_u2 1.023984 _CNV_A_R_LINEAR_____375_CM 4 0. 1.023984 FORMAT "%7.5" /end AXIS_PTS
/begin AXIS_PTS ldpm_vls_dif_lam_adj_1_laco "" 0xa1008c74 online_dummy _REC_AXS_20_u2 9.99511719 _CNV_A_R_LACO_LINEA_376_CM 16 -5. 4.99511719 /end AXIS_PTS
/begin AXIS_PTS ldpm_vls_dif_lam_adj_2_laco "" 0xa1008c98 online_dummy _REC_AXS_20_u2 9.99511719 _CNV_A_R_LACO_LINEA_376_CM 16 -5. 4.99511719 /end AXIS_PTS
/begin CHARACTERISTIC c_tco_min_lam_ad "minimum coolant temperature for adaptive learning" VALUE 0xa100961e _REC_VAL_20_u1 190.5 _CNV_A_R_LINEAR_____16_CM -48. 142.5 DISPLAY_IDENTIFIER C_TCO_MIN_LAM_AD FORMAT "%6.2" /end CHARACTERISTIC
/begin CHARACTERISTIC c_tia_max_lam_ad "maximum air temperature for adaptive learning" VALUE 0xa1009623 _REC_VAL_20_u1 190.5 _CNV_A_R_LINEAR_____16_CM -48. 142.5 DISPLAY_IDENTIFIER C_TIA_MAX_LAM_AD FORMAT "%6.2" /end CHARACTERISTIC
/begin CHARACTERISTIC c_crlc_lam_ad_l "correlation constant for lambda adaptation at low area" VALUE 0xa1009539 _REC_VAL_20_u1 0.99609375 _CNV_A_R_LINEAR_____27_CM 0. 0.99609375 DISPLAY_IDENTIFIER C_CRLC_LAM_AD_L FORMAT "%5.3" /end CHARACTERISTIC
/begin CHARACTERISTIC c_crlc_lam_ad_h "correlation constant for lambda adaptation at high area" VALUE 0xa1009537 _REC_VAL_20_u1 0.99609375 _CNV_A_R_LINEAR_____27_CM 0. 0.99609375 DISPLAY_IDENTIFIER C_CRLC_LAM_AD_H FORMAT "%5.3" /end CHARACTERISTIC
/begin CHARACTERISTIC c_crlc_lam_ad_is "correlation constant for lambda adaptation at idle speed" VALUE 0xa1009538 _REC_VAL_20_u1 0.99609375 _CNV_A_R_LINEAR_____27_CM 0. 0.99609375 DISPLAY_IDENTIFIER C_CRLC_LAM_AD_IS FORMAT "%5.3" /end CHARACTERISTIC
/begin CHARACTERISTIC c_nr_raf_chg_lam_ad "number of lean <-> rich air fuel ratio changes between two adaptations" VALUE 0xa1009607 _REC_VAL_20_u1 254. _CNV_A_R_LINEAR_____0_CM 1. 255. DISPLAY_IDENTIFIER C_NR_RAF_CHG_LAM_AD FORMAT "%3.0" /end CHARACTERISTIC
/begin CHARACTERISTIC c_n_dyw_ldc_lam_ad "engine speed window for limited dynamic conditions trim control" VALUE 0xa10095fa _REC_VAL_20_u2 8160. _CNV_A_R_LINEAR_____13_CM 0. 8160. DISPLAY_IDENTIFIER C_N_DYW_LDC_LAM_AD FORMAT "%4.0" /end CHARACTERISTIC
/begin CHARACTERISTIC c_maf_dyw_ldc_lam_ad "air mass flow window for limited dynamic conditions lambda adaptation" VALUE 0xa10095c6 _REC_VAL_20_u2 1389. _CNV_A_R_LINEAR_____108_CM 0. 1389. DISPLAY_IDENTIFIER C_MAF_DYW_LDC_LAM_AD FORMAT "%7.2" /end CHARACTERISTIC
/begin CHARACTERISTIC c_fac_lam_mv_dyw_ldc_lam_ad "lambda control output window for limited dynamic conditions lambda adaptation" VALUE 0xa1009568 _REC_VAL_20_u2 49.99847412 _CNV_A_R_LINEAR_____119_CM 0. 49.99847412 DISPLAY_IDENTIFIER C_FAC_LAM_MV_DYW_LDC_LAM_AD /end CHARACTERISTIC
/begin CHARACTERISTIC c_maf_int_ldc_lam_ad "air mass flow integral for duration of violation of limited dynamic conditions lambda adaptation" VALUE 0xa10095dc _REC_VAL_20_u2 1820.42 _CNV_A_R_LINEAR_____356_CM 0. 1820.42 DISPLAY_IDENTIFIER C_MAF_INT_LDC_LAM_AD FORMAT "%7.2" /end CHARACTERISTIC
/begin CHARACTERISTIC c_lamb_sp_ad_min_h "minimum lambda setpoint to allow lambda adaptation at high range operating point" VALUE 0xa10095ac _REC_VAL_20_u2 1.99993896484375 _CNV_A_R_LINEAR_____23_CM 0. 1.99993896484375 DISPLAY_IDENTIFIER C_LAMB_SP_AD_MIN_H FORMAT "%7.5" /end CHARACTERISTIC
/begin CHARACTERISTIC c_lamb_sp_ad_max_h "air mass flow integral for duration of violation of limited dynamic conditions lambda adaptation" VALUE 0xa10095a0 _REC_VAL_20_u2 1.99993896484375 _CNV_A_R_LINEAR_____23_CM 0. 1.99993896484375 DISPLAY_IDENTIFIER C_LAMB_SP_AD_MAX_H FORMAT "%7.5" /end CHARACTERISTIC
/begin CHARACTERISTIC c_lamb_sp_ad_min_l "minimum lambda setpoint to allow lambda adaptation at low range operating point" VALUE 0xa10095ae _REC_VAL_20_u2 1.99993896484375 _CNV_A_R_LINEAR_____23_CM 0. 1.99993896484375 DISPLAY_IDENTIFIER C_LAMB_SP_AD_MIN_L FORMAT "%7.5" /end CHARACTERISTIC
/begin CHARACTERISTIC c_lamb_sp_ad_max_l "maximum lambda setpoint to allow lambda adaptation at low range operating point" VALUE 0xa10095a2 _REC_VAL_20_u2 1.99993896484375 _CNV_A_R_LINEAR_____23_CM 0. 1.99993896484375 DISPLAY_IDENTIFIER C_LAMB_SP_AD_MAX_L FORMAT "%7.5" /end CHARACTERISTIC
/begin CHARACTERISTIC c_lamb_sp_ad_min_add "minimum lambda setpoint to allow lambda adaptation at offset learning area" VALUE 0xa10095aa _REC_VAL_20_u2 1.99993896484375 _CNV_A_R_LINEAR_____23_CM 0. 1.99993896484375 DISPLAY_IDENTIFIER C_LAMB_SP_AD_MIN_ADD FORMAT "%7.5" /end CHARACTERISTIC
/begin CHARACTERISTIC c_nr_raf_chg_lam_ad_is "number of lean <-> rich air fuel ratio changes between two adaptations at  idle speed" VALUE 0xa1009608 _REC_VAL_20_u1 254. _CNV_A_R_LINEAR_____0_CM 1. 255. DISPLAY_IDENTIFIER C_NR_RAF_CHG_LAM_AD_IS FORMAT "%3.0" /end CHARACTERISTIC
/begin CHARACTERISTIC c_nr_ctr_t_cyc_lam_ad "number of lambda adaptation time recurrences between two adaptations" VALUE 0xa1009606 _REC_VAL_20_u1 254. _CNV_A_R_LINEAR_____0_CM 1. 255. DISPLAY_IDENTIFIER C_NR_CTR_T_CYC_LAM_AD FORMAT "%3.0" /end CHARACTERISTIC
/begin CHARACTERISTIC c_tco_min_lam_ad_wup "minimum coolant temperature for adaptive learning during warm-up phase" VALUE 0xa100961f _REC_VAL_20_u1 190.5 _CNV_A_R_LINEAR_____16_CM -48. 142.5 DISPLAY_IDENTIFIER C_TCO_MIN_LAM_AD_WUP FORMAT "%6.2" /end CHARACTERISTIC
/begin CHARACTERISTIC c_tco_max_lam_ad_wup "maximum coolant temperature for adaptive learning during warm-up phase" VALUE 0xa100961d _REC_VAL_20_u1 190.5 _CNV_A_R_LINEAR_____16_CM -48. 142.5 DISPLAY_IDENTIFIER C_TCO_MAX_LAM_AD_WUP FORMAT "%6.2" /end CHARACTERISTIC
/begin CHARACTERISTIC c_maf_kgh_max_lam_ad "maximum mass air flow for adaptive learning" VALUE 0xa10095e4 _REC_VAL_20_u2 1023.984375 _CNV_A_R_LINEAR_____318_CM 0. 1023.984375 DISPLAY_IDENTIFIER C_MAF_KGH_MAX_LAM_AD FORMAT "%7.2" /end CHARACTERISTIC
/begin CHARACTERISTIC c_maf_kgh_min_lam_ad_wup "minimum mass air flow for adaptive learning during warm-up phase" VALUE 0xa10095e8 _REC_VAL_20_u2 1023.984375 _CNV_A_R_LINEAR_____318_CM 0. 1023.984375 DISPLAY_IDENTIFIER C_MAF_KGH_MIN_LAM_AD_WUP FORMAT "%7.2" /end CHARACTERISTIC
/begin CHARACTERISTIC c_maf_kgh_max_lam_ad_wup "maximum mass air flow for adaptive learning during warm-up phase" VALUE 0xa10095e6 _REC_VAL_20_u2 1023.984375 _CNV_A_R_LINEAR_____318_CM 0. 1023.984375 DISPLAY_IDENTIFIER C_MAF_KGH_MAX_LAM_AD_WUP FORMAT "%7.2" /end CHARACTERISTIC
/begin CHARACTERISTIC c_lamb_sp_ad_max_add "maximum lambda setpoint to allow lambda adaptation at offset learning area" VALUE 0xa100959e _REC_VAL_20_u2 1.99993896484375 _CNV_A_R_LINEAR_____23_CM 0. 1.99993896484375 DISPLAY_IDENTIFIER C_LAMB_SP_AD_MAX_ADD FORMAT "%7.5" /end CHARACTERISTIC
/begin CHARACTERISTIC c_lamb_sp_ad_min_wup_h "minimum lambda setpoint to allow lambda adaptation at high range operating point during warm-up phase" VALUE 0xa10095b2 _REC_VAL_20_u2 1.99993896484375 _CNV_A_R_LINEAR_____23_CM 0. 1.99993896484375 DISPLAY_IDENTIFIER C_LAMB_SP_AD_MIN_WUP_H FORMAT "%7.5" /end CHARACTERISTIC
/begin CHARACTERISTIC c_lamb_sp_ad_max_wup_h "maximum lambda setpoint to allow lambda adaptation at high range operating point during warm-up phase" VALUE 0xa10095a6 _REC_VAL_20_u2 1.99993896484375 _CNV_A_R_LINEAR_____23_CM 0. 1.99993896484375 DISPLAY_IDENTIFIER C_LAMB_SP_AD_MAX_WUP_H FORMAT "%7.5" /end CHARACTERISTIC
/begin CHARACTERISTIC c_lamb_sp_ad_min_wup_l "minimum lambda setpoint to allow lambda adaptation at low range operating point during warm-up phase" VALUE 0xa10095b4 _REC_VAL_20_u2 1.99993896484375 _CNV_A_R_LINEAR_____23_CM 0. 1.99993896484375 DISPLAY_IDENTIFIER C_LAMB_SP_AD_MIN_WUP_L FORMAT "%7.5" /end CHARACTERISTIC
/begin CHARACTERISTIC c_lamb_sp_ad_max_wup_l "maximum lambda setpoint to allow lambda adaptation at low range operating point during warm-up phase" VALUE 0xa10095a8 _REC_VAL_20_u2 1.99993896484375 _CNV_A_R_LINEAR_____23_CM 0. 1.99993896484375 DISPLAY_IDENTIFIER C_LAMB_SP_AD_MAX_WUP_L FORMAT "%7.5" /end CHARACTERISTIC
/begin CHARACTERISTIC c_lamb_sp_ad_min_wup_add "minimum lambda setpoint to allow lambda adaptation at offset learning area during warm-up phase" VALUE 0xa10095b0 _REC_VAL_20_u2 1.99993896484375 _CNV_A_R_LINEAR_____23_CM 0. 1.99993896484375 DISPLAY_IDENTIFIER C_LAMB_SP_AD_MIN_WUP_ADD FORMAT "%7.5" /end CHARACTERISTIC
/begin CHARACTERISTIC c_lamb_sp_ad_max_wup_add "maximum lambda setpoint to allow lambda adaptation at offset learning area during warm-up phase" VALUE 0xa10095a4 _REC_VAL_20_u2 1.99993896484375 _CNV_A_R_LINEAR_____23_CM 0. 1.99993896484375 DISPLAY_IDENTIFIER C_LAMB_SP_AD_MAX_WUP_ADD FORMAT "%7.5" /end CHARACTERISTIC
/begin CHARACTERISTIC lc_lam_ad_wup_deac "Logical switch to disable lambda adaptation activation during warm-up phase" VALUE 0xa100962d _REC_VAL_20_u1 1. _CNV_A_R_LINEAR_____0_CM 0. 1. DISPLAY_IDENTIFIER LC_LAM_AD_WUP_DEAC FORMAT "%1.0" /end CHARACTERISTIC
/begin MEASUREMENT lv_lam_ad_wup_act[0] "flag indicating that lambda adaptation in warm-up phase can be activated" UBYTE _CNV_S_2_RANGE__0___1_CM 1 100. 0. 1. DISPLAY_IDENTIFIER LV_LAM_AD_WUP_ACT[0] ECU_ADDRESS 0xd0002f20 BIT_MASK 0x1 /end MEASUREMENT
/begin MEASUREMENT lv_lam_ad_wup_act[1] "flag indicating that lambda adaptation in warm-up phase can be activated" UBYTE _CNV_S_2_RANGE__0___1_CM 1 100. 0. 1. DISPLAY_IDENTIFIER LV_LAM_AD_WUP_ACT[1] ECU_ADDRESS 0xd0002f21 BIT_MASK 0x1 /end MEASUREMENT
/begin MEASUREMENT laco[0].laco_struct_ispcladapi0.maf_ofs_ldc_lam_ad "air mass flow offset for limited dynamics calculation" SWORD _CNV_A_R_LINEAR_____202_CM 1 100. -694.510597390707 694.4894026092931 DISPLAY_IDENTIFIER MAF_OFS_LDC_LAM_AD ECU_ADDRESS 0xd000212c FORMAT "%7.2" /end MEASUREMENT
/begin MEASUREMENT laco[0].laco_struct_ispcladapi0.fac_lam_mv_ofs_ldc_lam_ad "filtered lambda controller output offset for limited dynamics calculation" SWORD _CNV_A_R_LINEAR_____110_CM 1 100. -50. 49.9984741210938 DISPLAY_IDENTIFIER FAC_LAM_MV_OFS_LDC_LAM_AD ECU_ADDRESS 0xd000212e FORMAT "%7.3" /end MEASUREMENT
/begin MEASUREMENT laco[0].laco_struct_ispcladapi0.n_ofs_ldc_lam_ad "engine speed offset for limited dynamics calculation" SWORD _CNV_A_R_LINEAR_____13_CM 1 100. -8160. 8160. DISPLAY_IDENTIFIER N_OFS_LDC_LAM_AD ECU_ADDRESS 0xd0002130 FORMAT "%5.0" /end MEASUREMENT
/begin MEASUREMENT laco[0].laco_struct_ispcladapi0.maf_int_ldc_lam_ad "air mass flow integral during limited dynamics not fulfilled" UWORD _CNV_A_R_LINEAR_____356_CM 1 100. 0. 1820.42 DISPLAY_IDENTIFIER MAF_INT_LDC_LAM_AD ECU_ADDRESS 0xd0002132 FORMAT "%7.2" /end MEASUREMENT
/begin MEASUREMENT laco[0].laco_struct_ispcladapi0.crlc_lam_ad "correlation constant for calculation of adaptive values" UBYTE _CNV_A_R_LINEAR_____27_CM 1 100. 0. 0.99609375 DISPLAY_IDENTIFIER CRLC_LAM_AD[1] ECU_ADDRESS 0xd0002134 FORMAT "%5.3" /end MEASUREMENT
/begin MEASUREMENT laco[0].laco_struct_ispcladapi0.nr_raf_chg_lam_ad "number of lean <-> rich air fuel ratio changes between two adaptations" UBYTE _CNV_A_R_LINEAR_____0_CM 1 100. 1. 255. DISPLAY_IDENTIFIER NR_RAF_CHG_LAM_AD[1] ECU_ADDRESS 0xd0002135 FORMAT "%3.0" /end MEASUREMENT
/begin MEASUREMENT laco[0].laco_struct_ispcladapi0.lv_lam_ad_act "flag indicating that lambda adaptation can be activated" UBYTE _CNV_S_2_RANGE__0___1_CM 1 100. 0. 1. DISPLAY_IDENTIFIER LV_LAM_AD_ACT[1] ECU_ADDRESS 0xd0002136 BIT_MASK 0x1 /end MEASUREMENT
/begin MEASUREMENT laco[0].laco_struct_ispcladapi0.lv_ldc_lam_ad "limited dynamic conditions for lambda adaptation" UBYTE _CNV_S_2_RANGE__0___1_CM 1 100. 0. 1. DISPLAY_IDENTIFIER LV_LDC_LAM_AD[1] ECU_ADDRESS 0xd0002137 BIT_MASK 0x1 /end MEASUREMENT
/begin MEASUREMENT laco[0].laco_struct_ispcladapi0.lv_lam_ad_act_err "flag indicating that lambda adaptation can be activated because of no error detected" UBYTE _CNV_S_2_RANGE__0___1_CM 1 100. 0. 1. DISPLAY_IDENTIFIER LV_LAM_AD_ACT_ERR ECU_ADDRESS 0xd0002138 BIT_MASK 0x1 /end MEASUREMENT
/begin MEASUREMENT laco[0].laco_struct_ispcladapi0.lv_lam_ad_deac_err "flag indicating that lambda adaptation is deactivated due to an error" UBYTE _CNV_S_2_RANGE__0___1_CM 1 100. 0. 1. DISPLAY_IDENTIFIER LV_LAM_AD_DEAC_ERR[1] ECU_ADDRESS 0xd0002139 BIT_MASK 0x1 /end MEASUREMENT
/begin MEASUREMENT laco[0].laco_struct_ispcladapi0.lv_inh_ctr_raf_chg "limited dynamic conditions for lambda adaptation" UBYTE _CNV_S_2_RANGE__0___1_CM 1 100. 0. 1. DISPLAY_IDENTIFIER LV_INH_CTR_RAF_CHG[1] ECU_ADDRESS 0xd000213a BIT_MASK 0x1 /end MEASUREMENT
/begin MEASUREMENT laco[0].laco_struct_reqgnlaco0.fac_dif_sum_lam_in "unlimited summation of controller difference" SLONG _CNV_A_R_LACO_LINEA_381_CM 1 100. -65536. 65535.9999694824 DISPLAY_IDENTIFIER FAC_DIF_SUM_LAM_IN[1] ECU_ADDRESS 0xd0002140 FORMAT "%12.5" /end MEASUREMENT
/begin MEASUREMENT laco[0].laco_struct_reqgnlaco0.fac_lam_i_it_lim "limited internal I share used for PID control only" SLONG _CNV_A_R_LACO_LINEA_382_CM 1 100. -50. 49.9999999767169 DISPLAY_IDENTIFIER FAC_LAM_I_IT_LIM[1] ECU_ADDRESS 0xd0002144 FORMAT "%10.6" /end MEASUREMENT
/begin MEASUREMENT laco[0].laco_struct_reqgnlaco0.fac_dif_sum_lim_lam_in "limited summation of controller difference" SLONG _CNV_A_R_LACO_LINEA_381_CM 1 100. -65536. 65535.9999694824 DISPLAY_IDENTIFIER FAC_DIF_SUM_LIM_LAM_IN[1] ECU_ADDRESS 0xd0002148 FORMAT "%12.5" /end MEASUREMENT
/begin MEASUREMENT laco[0].laco_struct_reqgnlaco0.fac_dif_sum_lam_in_save "stored value of controller difference summation" SLONG _CNV_A_R_LACO_LINEA_381_CM 1 100. -65536. 65535.9999694824 DISPLAY_IDENTIFIER FAC_DIF_SUM_LAM_IN_SAVE[1] ECU_ADDRESS 0xd000214c FORMAT "%12.5" /end MEASUREMENT
/begin MEASUREMENT laco[0].laco_struct_reqgnlaco0.fac_dif_lam_in_mmv "controller difference (richness) moving mean value" SLONG _CNV_A_R_LACO_LINEA_383_CM 1 100. -1. 0.9999999995343391 DISPLAY_IDENTIFIER FAC_DIF_LAM_IN_MMV[1] ECU_ADDRESS 0xd0002150 FORMAT "%9.6" /end MEASUREMENT
/begin MEASUREMENT laco[0].laco_struct_reqgnlaco0.fac_lam_i_it "unlimited internal I share used for PID control only" SLONG _CNV_A_R_LACO_LINEA_382_CM 1 100. -50. 49.9999999767169 DISPLAY_IDENTIFIER FAC_LAM_I_IT[1] ECU_ADDRESS 0xd0002154 FORMAT "%10.6" /end MEASUREMENT
/begin MEASUREMENT laco[0].laco_struct_reqgnlaco0.fac_lam_pctl "pre control path correction" SWORD _CNV_A_R_LINEAR_____110_CM 1 100. -50. 49.9984741210938 DISPLAY_IDENTIFIER FAC_LAM_PCTL[1] ECU_ADDRESS 0xd000217c FORMAT "%7.3" /end MEASUREMENT
/begin MEASUREMENT laco[0].laco_struct_reqgnlaco0.fac_lam_out "Lambda controller output" SWORD _CNV_A_R_LINEAR_____110_CM 1 100. -50. 49.9984741210938 DISPLAY_IDENTIFIER FAC_LAM_OUT[1] ECU_ADDRESS 0xd0002180 FORMAT "%7.3" /end MEASUREMENT
/begin MEASUREMENT laco[0].laco_struct_reqgnlaco0.fac_dif_lam_in "controller difference (richness)" SWORD _CNV_A_R_LINEAR_____275_CM 1 100. -1. 0.999969482421875 DISPLAY_IDENTIFIER FAC_DIF_LAM_IN[1] ECU_ADDRESS 0xd0002182 FORMAT "%8.5" /end MEASUREMENT
/begin MEASUREMENT laco[0].laco_struct_reqgnlaco0.fac_lam_i "unlimited I share output signal" SWORD _CNV_A_R_LINEAR_____110_CM 1 100. -50. 49.9984741210938 DISPLAY_IDENTIFIER FAC_LAM_I[1] ECU_ADDRESS 0xd0002186 FORMAT "%7.3" /end MEASUREMENT
/begin MEASUREMENT laco[0].laco_struct_reqgnlaco0.fac_lam_i2 "unlimited I^2 share output signal" SWORD _CNV_A_R_LINEAR_____110_CM 1 100. -50. 49.9984741210938 DISPLAY_IDENTIFIER FAC_LAM_I2[1] ECU_ADDRESS 0xd0002188 FORMAT "%7.3" /end MEASUREMENT
/begin MEASUREMENT laco[0].laco_struct_reqgnlaco0.fac_lam_i2_lim "limited I^2 share output signal" SWORD _CNV_A_R_LINEAR_____110_CM 1 100. -50. 49.9984741210938 DISPLAY_IDENTIFIER FAC_LAM_I2_LIM[1] ECU_ADDRESS 0xd000218a FORMAT "%7.3" /end MEASUREMENT
/begin MEASUREMENT laco[0].laco_struct_reqgnlaco0.fac_lam_i_i2_sum_lim "limited I share + I^2 share output signal" SWORD _CNV_A_R_LINEAR_____110_CM 1 100. -50. 49.9984741210938 DISPLAY_IDENTIFIER FAC_LAM_I_I2_SUM_LIM[1] ECU_ADDRESS 0xd000218e FORMAT "%7.3" /end MEASUREMENT
/begin MEASUREMENT laco[0].laco_struct_reqgnlaco0.fac_lam_p_lim "limited P share output signal" SWORD _CNV_A_R_LINEAR_____110_CM 1 100. -50. 49.9984741210938 DISPLAY_IDENTIFIER FAC_LAM_P_LIM[1] ECU_ADDRESS 0xd0002192 FORMAT "%7.3" /end MEASUREMENT
/begin MEASUREMENT laco[0].laco_struct_reqgnlaco0.fac_lam_d_lim "limited D share output signal" SWORD _CNV_A_R_LINEAR_____110_CM 1 100. -50. 49.9984741210938 DISPLAY_IDENTIFIER FAC_LAM_D_LIM[1] ECU_ADDRESS 0xd0002196 FORMAT "%7.3" /end MEASUREMENT
/begin MEASUREMENT laco[0].laco_struct_reqgnlaco0.fac_lam_mv "Mean value of lambda controller output" SWORD _CNV_A_R_LINEAR_____110_CM 1 100. -50. 49.9984741210938 DISPLAY_IDENTIFIER FAC_LAM_MV[1] ECU_ADDRESS 0xd000219c FORMAT "%7.3" /end MEASUREMENT
/begin MEASUREMENT laco[0].laco_struct_reqgnlaco0.fac_lam_mv_mmv "FAC_LAM_MV[i] average value" SWORD _CNV_A_R_LINEAR_____110_CM 1 100. -50. 49.9984741210938 DISPLAY_IDENTIFIER FAC_LAM_MV_MMV[1] ECU_ADDRESS 0xd000219e FORMAT "%7.3" /end MEASUREMENT
/begin MEASUREMENT laco[0].laco_struct_reqgnlaco0.fac_lam_mv_mmv_cp "Mean value of lambda controller output, used by canister purge" SWORD _CNV_A_R_LINEAR_____110_CM 1 100. -50. 49.9984741210938 DISPLAY_IDENTIFIER FAC_LAM_MV_MMV_CP[1] ECU_ADDRESS 0xd00021a0 FORMAT "%7.3" /end MEASUREMENT
/begin MEASUREMENT laco[0].laco_struct_reqgnlaco0.fac_lam_mv_mmv_ldc "moving mean value of the controller output, used for limited dynamics calculation" SWORD _CNV_A_R_LINEAR_____110_CM 1 100. -50. 49.9984741210938 DISPLAY_IDENTIFIER FAC_LAM_MV_MMV_LDC[1] ECU_ADDRESS 0xd00021a2 FORMAT "%7.3" /end MEASUREMENT
/begin MEASUREMENT laco[0].laco_struct_reqgnlaco0.fac_lam_mv_mmv_ldc_diag "Mean value of the controller output, used by limited dynamics for cat efficiency diagnosis" SWORD _CNV_A_R_LINEAR_____110_CM 1 100. -50. 49.9984741210938 DISPLAY_IDENTIFIER FAC_LAM_MV_MMV_LDC_DIAG[1] ECU_ADDRESS 0xd00021a4 FORMAT "%7.3" /end MEASUREMENT
/begin MEASUREMENT laco[0].laco_struct_reqgnlaco0.fac_lam_max_not_stat_cdn "upper limit in case of limitation under non stationary conditions" SWORD _CNV_A_R_LINEAR_____110_CM 1 100. -50. 49.9984741210938 DISPLAY_IDENTIFIER FAC_LAM_MAX_NOT_STAT_CDN[1] ECU_ADDRESS 0xd00021a6 FORMAT "%7.3" /end MEASUREMENT
/begin MEASUREMENT laco[0].laco_struct_reqgnlaco0.fac_lam_min_not_stat_cdn "bottom limit in case of limitation under non stationary conditions" SWORD _CNV_A_R_LINEAR_____110_CM 1 100. -50. 49.9984741210938 DISPLAY_IDENTIFIER FAC_LAM_MIN_NOT_STAT_CDN[1] ECU_ADDRESS 0xd00021a8 FORMAT "%7.3" /end MEASUREMENT
/begin MEASUREMENT laco[0].laco_struct_reqgnlaco0.fac_lam_cor "Limited lambda controller output plus pre-control correction" SWORD _CNV_A_R_LINEAR_____110_CM 1 100. -50. 49.9984741210938 DISPLAY_IDENTIFIER FAC_LAM_COR[1] ECU_ADDRESS 0xd00021aa FORMAT "%7.3" /end MEASUREMENT
/begin MEASUREMENT laco[0].laco_struct_reqgnlaco0.fac_lam_delta_i_i2_shift "I and I^2 share shift based on downstream signal evaluation" SWORD _CNV_A_R_LINEAR_____110_CM 1 100. -50. 49.9984741210938 DISPLAY_IDENTIFIER FAC_LAM_DELTA_I_I2_SHIFT[1] ECU_ADDRESS 0xd00021ac FORMAT "%7.3" /end MEASUREMENT
/begin MEASUREMENT laco[0].laco_struct_reqgnlaco0.fac_lam_lim "Limited value of lambda controller output" SWORD _CNV_A_R_LINEAR_____110_CM 1 100. -50. 49.9984741210938 DISPLAY_IDENTIFIER FAC_LAM_LIM[1] ECU_ADDRESS 0xd00021ae FORMAT "%7.3" /end MEASUREMENT
/begin MEASUREMENT laco[0].laco_struct_reqgnlaco0.crlc_lsl_mdl "correlation constant for lambda sensor model" UWORD _CNV_A_R_LINEAR_____68_CM 1 100. 0. 0.9999847412109381 DISPLAY_IDENTIFIER CRLC_LSL_MDL[1] ECU_ADDRESS 0xd00021b4 FORMAT "%7.5" /end MEASUREMENT
/begin MEASUREMENT laco[0].laco_struct_reqgnlaco0.fac_gain_p_lam "gain of lambda controller P share" UWORD _CNV_A_R_LINEAR_____115_CM 1 100. 0. 15.999755859375 DISPLAY_IDENTIFIER FAC_GAIN_P_LAM[1] ECU_ADDRESS 0xd00021ba FORMAT "%7.4" /end MEASUREMENT
/begin MEASUREMENT laco[0].laco_struct_reqgnlaco0.fac_gain_i_lam "gain of lambda controller I share" UWORD _CNV_A_R_LACO_LINEA_384_CM 1 100. 0. 49.999237 DISPLAY_IDENTIFIER FAC_GAIN_I_LAM[1] ECU_ADDRESS 0xd00021bc FORMAT "%7.4" /end MEASUREMENT
/begin MEASUREMENT laco[0].laco_struct_reqgnlaco0.fac_gain_i2_lam "gain of lambda controller I^2 share" UWORD _CNV_A_R_LACO_LINEA_385_CM 1 100. 0. 24.999619 DISPLAY_IDENTIFIER FAC_GAIN_I2_LAM[1] ECU_ADDRESS 0xd00021be FORMAT "%7.4" /end MEASUREMENT
/begin MEASUREMENT laco[0].laco_struct_reqgnlaco0.fac_gain_d_lam "gain of lambda controller D share" UWORD _CNV_A_R_LACO_LINEA_386_CM 1 100. 0. 3.9999e-002 DISPLAY_IDENTIFIER FAC_GAIN_D_LAM[1] ECU_ADDRESS 0xd00021c0 FORMAT "%8.6" /end MEASUREMENT
/begin MEASUREMENT laco[0].laco_struct_reqgnlaco0.lamb_sp_fil_hom "output signal of the WRAF sensor model for homogeneous mode" UWORD _CNV_A_R_LINEAR_____23_CM 1 100. 0. 1.99993896484375 DISPLAY_IDENTIFIER LAMB_SP_FIL_HOM[1] ECU_ADDRESS 0xd00021c2 FORMAT "%7.5" /end MEASUREMENT
/begin MEASUREMENT laco[0].laco_struct_reqgnlaco0.lamb_sp_pctl "pre control lambda set point" UWORD _CNV_A_R_LINEAR_____23_CM 1 100. 0. 1.99993896484375 DISPLAY_IDENTIFIER LAMB_SP_PCTL[1] ECU_ADDRESS 0xd00021c4 FORMAT "%7.5" /end MEASUREMENT
/begin MEASUREMENT laco[0].laco_struct_reqgnlaco0.lamb_sp_fil_s "output signal of the WRAF sensor model for stratified mode" UWORD _CNV_A_R_LINEAR_____122_CM 1 100. 0. 31.9990234375 DISPLAY_IDENTIFIER LAMB_SP_FIL_S[1] ECU_ADDRESS 0xd00021c6 FORMAT "%7.4" /end MEASUREMENT
/begin MEASUREMENT laco[0].laco_struct_reqgnlaco0.lamb_sp_lsl_mdl_in_hom "lambda controller set point including forced stimulation and the influence of secondary air" UWORD _CNV_A_R_LINEAR_____23_CM 1 100. 0. 3.99993896484375 DISPLAY_IDENTIFIER LAMB_SP_LSL_MDL_IN_HOM[1] ECU_ADDRESS 0xd00021c8 FORMAT "%7.5" /end MEASUREMENT
/begin MEASUREMENT laco[0].laco_struct_reqgnlaco0.lamb_sp_lsl_mdl_out_hom "output signal of the WRAF sensor model in homogeneous mode" UWORD _CNV_A_R_LINEAR_____23_CM 1 100. 0. 3.99993896484375 DISPLAY_IDENTIFIER LAMB_SP_LSL_MDL_OUT_HOM[1] ECU_ADDRESS 0xd00021ca FORMAT "%7.5" /end MEASUREMENT
/begin MEASUREMENT laco[0].laco_struct_reqgnlaco0.lamb_sp_lsl_mdl_out_s "output signal of the WRAF sensor model in stratified mode" UWORD _CNV_A_R_LINEAR_____122_CM 1 100. 0. 31.9990234375 DISPLAY_IDENTIFIER LAMB_SP_LSL_MDL_OUT_S[1] ECU_ADDRESS 0xd00021cc FORMAT "%7.4" /end MEASUREMENT
/begin MEASUREMENT laco[0].laco_struct_reqgnlaco0.lamb_cor_av_lam "corrected signal of WRAF sensor; actual value for lambda controller " UWORD _CNV_A_R_LINEAR_____23_CM 1 100. 0. 1.99993896484375 DISPLAY_IDENTIFIER LAMB_COR_AV_LAM[1] ECU_ADDRESS 0xd00021d6 FORMAT "%7.5" /end MEASUREMENT
/begin MEASUREMENT laco[0].laco_struct_reqgnlaco0.t1_lsl_up "first order time lag of the WRAF sensor model" UWORD _CNV_A_R_LINEAR_____117_CM 1 100. 0. 1.99996948242188 DISPLAY_IDENTIFIER T1_LSL_UP[1] ECU_ADDRESS 0xd00021da FORMAT "%7.5" /end MEASUREMENT
/begin MEASUREMENT laco[0].laco_struct_reqgnlaco0.t_dly_soi_lsl_pos "delay between start of injection and WRAF sensor signal location" UWORD _CNV_A_R_LINEAR_____375_CM 1 100. 0. 1.023984 DISPLAY_IDENTIFIER T_DLY_SOI_LSL_POS[1] ECU_ADDRESS 0xd00021dc FORMAT "%7.5" /end MEASUREMENT
/begin MEASUREMENT laco[0].laco_struct_reqgnlaco0.tout_i_i2_shift_vld_afl "time out for I and I^2 share shift based on lean downstream signal" UWORD _CNV_A_R_LINEAR_____107_CM 1 100. 0. 1310.7 DISPLAY_IDENTIFIER TOUT_I_I2_SHIFT_VLD_AFL[1] ECU_ADDRESS 0xd00021de FORMAT "%7.2" /end MEASUREMENT
/begin MEASUREMENT laco[0].laco_struct_reqgnlaco0.tout_i_i2_shift_vld_afr "time out for I and I^2 share shift based on rich downstream signal" UWORD _CNV_A_R_LINEAR_____107_CM 1 100. 0. 1310.7 DISPLAY_IDENTIFIER TOUT_I_I2_SHIFT_VLD_AFR[1] ECU_ADDRESS 0xd00021e0 FORMAT "%7.2" /end MEASUREMENT
/begin MEASUREMENT laco[0].laco_struct_reqgnlaco0.vls_down_mmv_lam "moving mean value of downstream sensor voltage" UWORD _CNV_A_R_LINEAR_____190_CM 1 100. 0. 4.99992371 DISPLAY_IDENTIFIER VLS_DOWN_MMV_LAM[1] ECU_ADDRESS 0xd00021e2 FORMAT "%7.5" /end MEASUREMENT
/begin MEASUREMENT laco[0].laco_struct_reqgnlaco0.mff_add_lam_ad_out "fuel mass set point offset, output from lambda adaptation" SWORD _CNV_A_R_LINEAR_____202_CM 1 100. -694.510597390707 694.4894026092931 DISPLAY_IDENTIFIER MFF_ADD_LAM_AD_OUT[1] ECU_ADDRESS 0xd00021e4 FORMAT "%7.2" /end MEASUREMENT
/begin MEASUREMENT laco[0].laco_struct_reqgnlaco0.fac_lam_ad_out "fuel mass set point factor, output from lambda adaptation" SWORD _CNV_A_R_LINEAR_____110_CM 1 100. -50. 49.9984741210938 DISPLAY_IDENTIFIER FAC_LAM_AD_OUT[1] ECU_ADDRESS 0xd00021e6 FORMAT "%7.3" /end MEASUREMENT
/begin MEASUREMENT laco[0].laco_struct_reqgnlaco0.ctr_raf_chg "Counter of air fuel ratio changes" UBYTE _CNV_A_R_LINEAR_____0_CM 1 100. 0. 255. DISPLAY_IDENTIFIER CTR_RAF_CHG[1] ECU_ADDRESS 0xd00021e8 FORMAT "%3.0" /end MEASUREMENT
/begin MEASUREMENT laco[0].laco_struct_reqgnlaco0.state_lam "lambda controller state" UBYTE _CNV_S_4_LACO_RANGE_387_CM 1 100. 0. 3. DISPLAY_IDENTIFIER STATE_LAM[1] ECU_ADDRESS 0xd00021e9 /end MEASUREMENT
/begin MEASUREMENT laco[0].laco_struct_reqgnlaco0.fac_eg_dly "Weighting factor for the calculation of the exhaust gas delay" UBYTE _CNV_A_R_EGCP_LINEA_370_CM 1 100. 0. 31.875 DISPLAY_IDENTIFIER FAC_EG_DLY[1] ECU_ADDRESS 0xd00021ea FORMAT "%4.1" /end MEASUREMENT
/begin MEASUREMENT laco[0].laco_struct_reqgnlaco0.lv_lam_lscl "activation flag of lambda control" UBYTE _CNV_S_2_RANGE__0___1_CM 1 100. 0. 1. DISPLAY_IDENTIFIER LV_LAM_LSCL[1] ECU_ADDRESS 0xd00021eb BIT_MASK 0x1 /end MEASUREMENT
/begin MEASUREMENT laco[0].laco_struct_reqgnlaco0.lv_fac_lam_lim_not_stat_cdn "limitation under non stationary operating conditions (threshold exceeded)" UBYTE _CNV_S_2_RANGE__0___1_CM 1 100. 0. 1. DISPLAY_IDENTIFIER LV_FAC_LAM_LIM_NOT_STAT_CDN[1] ECU_ADDRESS 0xd00021ec BIT_MASK 0x1 /end MEASUREMENT
/begin MEASUREMENT laco[0].laco_struct_reqgnlaco0.lv_t_max_lscl_act_tco "lambda controller activation by timer condition instead of TCO condition" UBYTE _CNV_S_2_RANGE__0___1_CM 1 100. 0. 1. DISPLAY_IDENTIFIER LV_T_MAX_LSCL_ACT_TCO[1] ECU_ADDRESS 0xd00021ed BIT_MASK 0x1 /end MEASUREMENT
/begin MEASUREMENT laco[0].laco_struct_reqgnlaco0.lv_fac_lam_adj_lam_ad_end "Controller shift caused by lambda adaptation was carried out" UBYTE _CNV_S_2_RANGE__0___1_CM 1 100. 0. 1. DISPLAY_IDENTIFIER LV_FAC_LAM_ADJ_LAM_AD_END[1] ECU_ADDRESS 0xd00021ee BIT_MASK 0x1 /end MEASUREMENT
/begin MEASUREMENT laco[0].laco_struct_reqgnlaco0.lv_fac_lam_shift_cp_end "Controller shift caused by canister purge was carried out" UBYTE _CNV_S_2_RANGE__0___1_CM 1 100. 0. 1. DISPLAY_IDENTIFIER LV_FAC_LAM_SHIFT_CP_END[1] ECU_ADDRESS 0xd00021ef BIT_MASK 0x1 /end MEASUREMENT
/begin MEASUREMENT laco[0].laco_struct_reqgnlaco0.lv_fac_lam_diagcp_end "Controller shift caused by EVAP diagnosis was carried out" UBYTE _CNV_S_2_RANGE__0___1_CM 1 100. 0. 1. DISPLAY_IDENTIFIER LV_FAC_LAM_DIAGCP_END[1] ECU_ADDRESS 0xd00021f0 BIT_MASK 0x1 /end MEASUREMENT
/begin MEASUREMENT laco[0].laco_struct_reqgnlaco0.lv_fac_lam_lim_max "Upper limit of lambda controller output reached" UBYTE _CNV_S_2_RANGE__0___1_CM 1 100. 0. 1. DISPLAY_IDENTIFIER LV_FAC_LAM_LIM_MAX[1] ECU_ADDRESS 0xd00021f2 BIT_MASK 0x1 /end MEASUREMENT
/begin MEASUREMENT laco[0].laco_struct_reqgnlaco0.lv_fac_lam_lim_min "Lower limit of lambda controller output reached" UBYTE _CNV_S_2_RANGE__0___1_CM 1 100. 0. 1. DISPLAY_IDENTIFIER LV_FAC_LAM_LIM_MIN[1] ECU_ADDRESS 0xd00021f3 BIT_MASK 0x1 /end MEASUREMENT
/begin MEASUREMENT laco[0].laco_struct_reqgnlaco0.lv_vls_down_thd_afl_lam "flag indicating that downstream sensor signal is below calibration threshold (used for lambda control)" UBYTE _CNV_S_2_RANGE__0___1_CM 1 100. 0. 1. DISPLAY_IDENTIFIER LV_VLS_DOWN_THD_AFL_LAM[1] ECU_ADDRESS 0xd00021f4 BIT_MASK 0x1 /end MEASUREMENT
/begin MEASUREMENT laco[0].laco_struct_reqgnlaco0.lv_vls_down_thd_afr_lam "flag indicating that downstream sensor signal is above calibration threshold (used for lambda control)" UBYTE _CNV_S_2_RANGE__0___1_CM 1 100. 0. 1. DISPLAY_IDENTIFIER LV_VLS_DOWN_THD_AFR_LAM[1] ECU_ADDRESS 0xd00021f5 BIT_MASK 0x1 /end MEASUREMENT
/begin MEASUREMENT laco[0].laco_struct_reqgnlaco0.lv_vls_down_thd_afr_lam_old "auxiliary flag used for downstream sensor signal evaluation" UBYTE _CNV_S_2_RANGE__0___1_CM 1 100. 0. 1. DISPLAY_IDENTIFIER LV_VLS_DOWN_THD_AFR_LAM_OLD[1] ECU_ADDRESS 0xd00021f6 BIT_MASK 0x1 /end MEASUREMENT
/begin MEASUREMENT laco[0].laco_struct_reqgnlaco0.lv_vls_down_thd_afl_lam_old "auxiliary flag used for downstream sensor signal evaluation" UBYTE _CNV_S_2_RANGE__0___1_CM 1 100. 0. 1. DISPLAY_IDENTIFIER LV_VLS_DOWN_THD_AFL_LAM_OLD[1] ECU_ADDRESS 0xd00021f7 BIT_MASK 0x1 /end MEASUREMENT
/begin MEASUREMENT laco[0].laco_struct_reqgnlacoi0.lamb_sp_delta_lam "lambda shift applied on lambda set point" SWORD _CNV_A_R_LINEAR_____23_CM 1 100. -0.125 0.125 DISPLAY_IDENTIFIER LAMB_SP_DELTA_LAM[1] ECU_ADDRESS 0xd00021f8 FORMAT "%8.5" /end MEASUREMENT
/begin MEASUREMENT laco[0].laco_struct_reqgnlacoi0.lamb_av_delta_lam "lambda shift applied on measured lambda signal" SWORD _CNV_A_R_LINEAR_____23_CM 1 100. -0.125 0.125 DISPLAY_IDENTIFIER LAMB_AV_DELTA_LAM[1] ECU_ADDRESS 0xd00021fa FORMAT "%8.5" /end MEASUREMENT
/begin MEASUREMENT laco[0].laco_struct_reqgnlacoi0.lv_inh_lscl "inhibit signal for the controller deactivation" UBYTE _CNV_S_2_RANGE__0___1_CM 1 100. 0. 1. DISPLAY_IDENTIFIER LV_INH_LSCL[1] ECU_ADDRESS 0xd00021fc BIT_MASK 0x1 /end MEASUREMENT
/begin MEASUREMENT laco[0].laco_struct_reqgnlacoi0.lv_lam_stop_req "request to stop the lambda controller" UBYTE _CNV_S_2_RANGE__0___1_CM 1 100. 0. 1. DISPLAY_IDENTIFIER LV_LAM_STOP_REQ[1] ECU_ADDRESS 0xd00021fd BIT_MASK 0x1 /end MEASUREMENT
/begin MEASUREMENT laco[0].laco_struct_reqgnlacoi0.lv_state_ls_opl_err "flag summarising errors that leads to open loop control" UBYTE _CNV_S_2_RANGE__0___1_CM 1 100. 0. 1. DISPLAY_IDENTIFIER LV_STATE_LS_OPL_ERR[1] ECU_ADDRESS 0xd00021fe BIT_MASK 0x1 /end MEASUREMENT
/begin MEASUREMENT laco[0].laco_struct_reqgntrim0.lamb_delta_i_mmv_lam_adj "I share moving mean value from trim control" SWORD _CNV_A_R_LACO_LINEA_388_CM 1 100. -0.125 0.124996185302734 DISPLAY_IDENTIFIER LAMB_DELTA_I_MMV_LAM_ADJ[1] ECU_ADDRESS 0xd0002204 FORMAT "%9.6" /end MEASUREMENT
/begin MEASUREMENT laco[0].laco_struct_reqgntrim0.lamb_delta_lam_adj "total output (P share + I share) from trim control" SWORD _CNV_A_R_LINEAR_____23_CM 1 100. -0.125 0.125 DISPLAY_IDENTIFIER LAMB_DELTA_LAM_ADJ[1] ECU_ADDRESS 0xd0002206 FORMAT "%8.5" /end MEASUREMENT
/begin MEASUREMENT laco[0].laco_struct_reqgntrim0.lamb_delta_p_lam_adj "P share of from trim control" SWORD _CNV_A_R_LINEAR_____23_CM 1 100. -0.125 0.125 DISPLAY_IDENTIFIER LAMB_DELTA_P_LAM_ADJ[1] ECU_ADDRESS 0xd0002208 FORMAT "%8.5" /end MEASUREMENT
/begin MEASUREMENT laco[0].laco_struct_reqgntrim0.lamb_delta_i_lam_adj "I share from trim control" SWORD _CNV_A_R_LINEAR_____23_CM 1 100. -0.125 0.125 DISPLAY_IDENTIFIER LAMB_DELTA_I_LAM_ADJ[1] ECU_ADDRESS 0xd000220a FORMAT "%8.5" /end MEASUREMENT
/begin MEASUREMENT laco[0].laco_struct_reqgntrim0.lamb_delta_i_save_lam_adj "saved I share from trim control (saved in case that catalyst diagnosis switched on)" SWORD _CNV_A_R_LACO_LINEA_388_CM 1 100. -0.125 0.124996185302734 DISPLAY_IDENTIFIER LAMB_DELTA_I_SAVE_LAM_ADJ[1] ECU_ADDRESS 0xd000220c FORMAT "%9.6" /end MEASUREMENT
/begin MEASUREMENT laco[0].laco_struct_reqgntrim0.vls_dif_lam_adj "difference between setpoint and actual downstream LS signal" SWORD _CNV_A_R_LINEAR_____369_CM 1 100. -5.00000000000182 4.99511718999747 DISPLAY_IDENTIFIER VLS_DIF_LAM_ADJ[1] ECU_ADDRESS 0xd000220e /end MEASUREMENT
/begin MEASUREMENT laco[0].laco_struct_reqgntrim0.vls_dif_mmv_lam_adj "moving mean value of difference between set point and actual downstream LS signal" SWORD _CNV_A_R_LACO_LINEA_389_CM 1 100. -5. 4.99984741210938 DISPLAY_IDENTIFIER VLS_DIF_MMV_LAM_ADJ[1] ECU_ADDRESS 0xd0002210 FORMAT "%7.4" /end MEASUREMENT
/begin MEASUREMENT laco[0].laco_struct_reqgntrim0.vls_dif_delta_lam_adj "difference between downstream LS signal and moving mean value" SWORD _CNV_A_R_LACO_LINEA_389_CM 1 100. -5. 4.99984741210938 DISPLAY_IDENTIFIER VLS_DIF_DELTA_LAM_ADJ[1] ECU_ADDRESS 0xd0002212 FORMAT "%7.4" /end MEASUREMENT
/begin MEASUREMENT laco[0].laco_struct_reqgntrim0.lamb_delta_d_lam_adj "D share from trim control" SWORD _CNV_A_R_LINEAR_____23_CM 1 100. -0.125 0.125 DISPLAY_IDENTIFIER LAMB_DELTA_D_LAM_ADJ[1] ECU_ADDRESS 0xd0002214 FORMAT "%8.5" /end MEASUREMENT
/begin MEASUREMENT laco[0].laco_struct_reqgntrim0.maf_int_lam_adj_act "integral of air mass flow since LAM activation" UWORD _CNV_A_R_LACO_LINEA_390_CM 1 100. 0. 1456.33 DISPLAY_IDENTIFIER MAF_INT_LAM_ADJ_ACT[1] ECU_ADDRESS 0xd0002216 FORMAT "%7.2" /end MEASUREMENT
/begin MEASUREMENT laco[0].laco_struct_reqgntrim0.vls_sp_lam_adj "trim control setpoint" UWORD _CNV_A_R_LINEAR_____2_CM 1 100. 0. 4.9951171875 DISPLAY_IDENTIFIER VLS_SP_LAM_ADJ[1] ECU_ADDRESS 0xd0002218 FORMAT "%5.3" /end MEASUREMENT
/begin MEASUREMENT laco[0].laco_struct_reqgntrim0.maf_int_min_lam_adj_p_act "minimum air mass flow  integral for trim control P share activation" UWORD _CNV_A_R_LACO_LINEA_390_CM 1 100. 0. 1456.33 DISPLAY_IDENTIFIER MAF_INT_MIN_LAM_ADJ_P_ACT[1] ECU_ADDRESS 0xd000221a FORMAT "%7.2" /end MEASUREMENT
/begin MEASUREMENT laco[0].laco_struct_reqgntrim0.maf_int_min_lam_adj_i_act "minimum air mass flow  integral for trim control I share activation" UWORD _CNV_A_R_LACO_LINEA_390_CM 1 100. 0. 1456.33 DISPLAY_IDENTIFIER MAF_INT_MIN_LAM_ADJ_I_ACT[1] ECU_ADDRESS 0xd000221c FORMAT "%7.2" /end MEASUREMENT
/begin MEASUREMENT laco[0].laco_struct_reqgntrim0.maf_int_min_lam_adj_d_act "minimum air mass flow integral for trim control D share activation" UWORD _CNV_A_R_LACO_LINEA_390_CM 1 100. 0. 1456.33 DISPLAY_IDENTIFIER MAF_INT_MIN_LAM_ADJ_D_ACT[1] ECU_ADDRESS 0xd000221e FORMAT "%7.2" /end MEASUREMENT
/begin MEASUREMENT laco[0].laco_struct_reqgntrim0.lv_lam_adj_act "Activation flag of dynamic fuel trim " UBYTE _CNV_S_2_RANGE__0___1_CM 1 100. 0. 1. DISPLAY_IDENTIFIER LV_LAM_ADJ_ACT[1] ECU_ADDRESS 0xd0002220 BIT_MASK 0x1 /end MEASUREMENT
/begin MEASUREMENT laco[0].laco_struct_reqgntrim0.lv_lam_adj_i_act "Activation flag for calculation of the trim-controller I-share" UBYTE _CNV_S_2_RANGE__0___1_CM 1 100. 0. 1. DISPLAY_IDENTIFIER LV_LAM_ADJ_I_ACT[1] ECU_ADDRESS 0xd0002221 BIT_MASK 0x1 /end MEASUREMENT
/begin MEASUREMENT laco[0].laco_struct_reqgntrim0.lv_lam_adj_p_act "activation flag for calculation of trim controller P share" UBYTE _CNV_S_2_RANGE__0___1_CM 1 100. 0. 1. DISPLAY_IDENTIFIER LV_LAM_ADJ_P_ACT[1] ECU_ADDRESS 0xd0002222 BIT_MASK 0x1 /end MEASUREMENT
/begin MEASUREMENT laco[0].laco_struct_reqgntrim0.lv_lam_adj_ad_end "flag indicating that trim control I share shift was executed" UBYTE _CNV_S_2_RANGE__0___1_CM 1 100. 0. 1. DISPLAY_IDENTIFIER LV_LAM_ADJ_AD_END[1] ECU_ADDRESS 0xd0002224 BIT_MASK 0x1 /end MEASUREMENT
/begin MEASUREMENT laco[0].laco_struct_reqgntrim0.lv_lam_adj_d_act "activation flag for calculation of trim controller D share" UBYTE _CNV_S_2_RANGE__0___1_CM 1 100. 0. 1. DISPLAY_IDENTIFIER LV_LAM_ADJ_D_ACT[1] ECU_ADDRESS 0xd0002225 BIT_MASK 0x1 /end MEASUREMENT
/begin MEASUREMENT laco[0].laco_struct_reqgntrimi0.fac_lam_mv_ofs_ldc_lam_adj "filtered lambda controller output offset for limited dynamics calculation" SWORD _CNV_A_R_LINEAR_____110_CM 1 100. -50. 49.9984741210938 DISPLAY_IDENTIFIER FAC_LAM_MV_OFS_LDC_LAM_ADJ ECU_ADDRESS 0xd0002228 FORMAT "%7.3" /end MEASUREMENT
/begin MEASUREMENT laco[0].laco_struct_reqgntrimi0.maf_ofs_ldc_lam_adj "air mass flow offset for limited dynamics calculation" SWORD _CNV_A_R_LINEAR_____202_CM 1 100. -694.510597390707 694.4894026092931 DISPLAY_IDENTIFIER MAF_OFS_LDC_LAM_ADJ ECU_ADDRESS 0xd000222a FORMAT "%7.2" /end MEASUREMENT
/begin MEASUREMENT laco[0].laco_struct_reqgntrimi0.n_ofs_ldc_lam_adj "engine speed offset for limited dynamics calculation" SWORD _CNV_A_R_LINEAR_____13_CM 1 100. -8160. 8160. DISPLAY_IDENTIFIER N_OFS_LDC_LAM_ADJ ECU_ADDRESS 0xd000222c FORMAT "%5.0" /end MEASUREMENT
/begin MEASUREMENT laco[0].laco_struct_reqgntrimi0.vls_av_lam_adj "sensor voltage actual value for trim control" UWORD _CNV_A_R_LINEAR_____2_CM 1 100. 0. 4.9951171875 DISPLAY_IDENTIFIER VLS_AV_LAM_ADJ[1] ECU_ADDRESS 0xd000222e FORMAT "%5.3" /end MEASUREMENT
/begin MEASUREMENT laco[0].laco_struct_reqgntrimi0.maf_int_ldc_lam_adj "MAF integral during limited dynamics not fulfilled" UWORD _CNV_A_R_LINEAR_____356_CM 1 100. 0. 1820.42 DISPLAY_IDENTIFIER MAF_INT_LDC_LAM_ADJ ECU_ADDRESS 0xd0002230 FORMAT "%7.2" /end MEASUREMENT
/begin MEASUREMENT laco[0].laco_struct_reqgntrimi0.vls_av_tmp_lam_adj "auxiliary sensor voltage actual value for filter calculation" UWORD _CNV_A_R_LINEAR_____190_CM 1 100. 0. 4.99992371 DISPLAY_IDENTIFIER VLS_AV_TMP_LAM_ADJ ECU_ADDRESS 0xd0002232 FORMAT "%7.5" /end MEASUREMENT
/begin MEASUREMENT laco[0].laco_struct_reqgntrimi0.pv_av_ofs_ldc_lam_adj "actual pedal value offset for limited dynamics calculation" SBYTE _CNV_A_R_LINEAR_____5_CM 1 100. -50. 49.609375 DISPLAY_IDENTIFIER PV_AV_OFS_LDC_LAM_ADJ ECU_ADDRESS 0xd0002234 FORMAT "%5.1" /end MEASUREMENT
/begin MEASUREMENT laco[0].laco_struct_reqgntrimi0.lv_ldc_lam_adj "limited dynamic conditions for trim control" UBYTE _CNV_S_2_RANGE__0___1_CM 1 100. 0. 1. DISPLAY_IDENTIFIER LV_LDC_LAM_ADJ[1] ECU_ADDRESS 0xd0002235 BIT_MASK 0x1 /end MEASUREMENT
/begin MEASUREMENT laco[0].laco_struct_reqgntrimi0.lv_inh_lam_adj "inhibition flag for trim control" UBYTE _CNV_S_2_RANGE__0___1_CM 1 100. 0. 1. DISPLAY_IDENTIFIER LV_INH_LAM_ADJ[1] ECU_ADDRESS 0xd0002236 BIT_MASK 0x1 /end MEASUREMENT
/begin MEASUREMENT laco[0].laco_struct_reqgntrimi0.lv_inh_lam_adj_err "inhibition flag for trim control based on error flag evaluation" UBYTE _CNV_S_2_RANGE__0___1_CM 1 100. 0. 1. DISPLAY_IDENTIFIER LV_INH_LAM_ADJ_ERR ECU_ADDRESS 0xd0002237 BIT_MASK 0x1 /end MEASUREMENT
/begin MEASUREMENT laco[0].laco_struct_reqgntrimi0.lv_lamb_delta_i_lam_adj_deac "flag indicating that I share is fixed when deactivating lambda controller" UBYTE _CNV_S_2_RANGE__0___1_CM 1 100. 0. 1. DISPLAY_IDENTIFIER LV_LAMB_DELTA_I_LAM_ADJ_DEAC[1] ECU_ADDRESS 0xd0002238 BIT_MASK 0x1 /end MEASUREMENT
/begin MEASUREMENT laco[0].laco_struct_reqgntrimi0.lv_lamb_delta_ad_lam_adj_clc "flag indicating that adaptation value is calculated at start of power latch phase" UBYTE _CNV_S_2_RANGE__0___1_CM 1 100. 0. 1. DISPLAY_IDENTIFIER LV_LAMB_DELTA_AD_LAM_ADJ_CLC[1] ECU_ADDRESS 0xd0002239 BIT_MASK 0x1 /end MEASUREMENT
/begin MEASUREMENT laco[0].laco_struct_reqgncdn0.crk_dif_soi_lsl_pos "crank shaft angle difference between the start of injection and the end of the exhaust cycle" UWORD _CNV_A_R_LINEAR_____109_CM 1 100. 0. 1620. DISPLAY_IDENTIFIER CRK_DIF_SOI_LSL_POS[1] ECU_ADDRESS 0xd000223c FORMAT "%6.1" /end MEASUREMENT
/begin MEASUREMENT laco[0].laco_struct_reqgncdn0.maf_int_lam_reac "air mass flow for lambda controller reactivation after stop mode" UWORD _CNV_A_R_LINEAR_____391_CM 1 100. 0. 1820.41666666667 DISPLAY_IDENTIFIER MAF_INT_LAM_REAC[1] ECU_ADDRESS 0xd000223e FORMAT "%7.2" /end MEASUREMENT
/begin MEASUREMENT laco[0].laco_struct_reqgncdn0.t_lam_reac "time counter for lambda controller reactivation after stop mode " UBYTE _CNV_A_R_LINEAR_____107_CM 1 100. 0. 5.1 DISPLAY_IDENTIFIER T_LAM_REAC[1] ECU_ADDRESS 0xd0002240 FORMAT "%4.2" /end MEASUREMENT
/begin MEASUREMENT laco[0].laco_struct_reqgncdn0.lv_lam_stop "activation signal for the lambda controller stop mode" UBYTE _CNV_S_2_RANGE__0___1_CM 1 100. 0. 1. DISPLAY_IDENTIFIER LV_LAM_STOP[1] ECU_ADDRESS 0xd0002241 BIT_MASK 0x1 /end MEASUREMENT
/begin MEASUREMENT laco[0].laco_struct_reqgncdn0.lv_lam_stop_sho_per "activation signal for the controller stop mode while active offset adjustment" UBYTE _CNV_S_2_RANGE__0___1_CM 1 100. 0. 1. DISPLAY_IDENTIFIER LV_LAM_STOP_SHO_PER[1] ECU_ADDRESS 0xd0002242 BIT_MASK 0x1 /end MEASUREMENT
/begin MEASUREMENT laco[0].laco_struct_reqgncdn0.lv_lam_act_dc "closed loop had been enabled for at least one time" UBYTE _CNV_S_2_RANGE__0___1_CM 1 100. 0. 1. DISPLAY_IDENTIFIER LV_LAM_ACT_DC[1] ECU_ADDRESS 0xd0002243 BIT_MASK 0x1 /end MEASUREMENT
/begin MEASUREMENT laco[0].laco_struct_reqgncdn0.state_ls "Fuel system status" UBYTE _CNV_S_5_LACO_RANGE_392_CM 1 100. 1. 16. DISPLAY_IDENTIFIER STATE_LS[1] ECU_ADDRESS 0xd0002244 /end MEASUREMENT
/begin MEASUREMENT laco[0].laco_struct_reqgntrcdn0.maf_int_lam_adj_cdn "air mass flow integral for condition detection of WRAF sensor characterisitc line adaptation" UWORD _CNV_A_R_LINEAR_____391_CM 1 100. 0. 1820.41666666667 DISPLAY_IDENTIFIER MAF_INT_LAM_ADJ_CDN[1] ECU_ADDRESS 0xd0002246 FORMAT "%7.2" /end MEASUREMENT
/begin MEASUREMENT laco[0].laco_struct_reqgntrcdn0.lv_lam_adj_ad_cdn_ok "flag indicating good conditions for WRAF sensor characteristic line adaptation" UBYTE _CNV_S_2_RANGE__0___1_CM 1 100. 0. 1. DISPLAY_IDENTIFIER LV_LAM_ADJ_AD_CDN_OK[1] ECU_ADDRESS 0xd0002248 BIT_MASK 0x1 /end MEASUREMENT
/begin MEASUREMENT laco[0].laco_struct_reqgntrimad0.lamb_delta_dif_i_lam_adj_ad "trim controI I share shift in case of new adaptation value for WRAF sensor characteristic line shift" SWORD _CNV_A_R_LINEAR_____23_CM 1 100. -0.125 0.125 DISPLAY_IDENTIFIER LAMB_DELTA_DIF_I_LAM_ADJ_AD[1] ECU_ADDRESS 0xd000224c FORMAT "%8.5" /end MEASUREMENT
/begin MEASUREMENT laco[0].laco_struct_reqgntrimad0.lamb_delta_sum_lam_adj_ad "total characteristic line shift of WRAF sensor" SWORD _CNV_A_R_LINEAR_____23_CM 1 100. -0.125 0.125 DISPLAY_IDENTIFIER LAMB_DELTA_SUM_LAM_ADJ_AD[1] ECU_ADDRESS 0xd000224e FORMAT "%8.5" /end MEASUREMENT
/begin MEASUREMENT laco[0].laco_struct_reqgntrimad0.lamb_delta_ad_lam_adj "adaptation value for WRAF sensor characteritic line shift" SWORD _CNV_A_R_LINEAR_____23_CM 1 100. -0.125 0.125 DISPLAY_IDENTIFIER LAMB_DELTA_AD_LAM_ADJ[1] ECU_ADDRESS 0xd0002250 FORMAT "%8.5" /end MEASUREMENT
/begin MEASUREMENT laco[0].laco_struct_reqgntrimad0.lamb_delta_bas_lam_adj_ad "basic characteristic line shift of WRAF sensor" SWORD _CNV_A_R_LINEAR_____23_CM 1 100. -0.125 0.125 DISPLAY_IDENTIFIER LAMB_DELTA_BAS_LAM_ADJ_AD[1] ECU_ADDRESS 0xd0002252 FORMAT "%8.5" /end MEASUREMENT
/begin MEASUREMENT laco[0].laco_struct_reqgntrimad0.ctr_raf_chg_lam_adj "counter for lean <-> rich air fuel ratio changes" UBYTE _CNV_A_R_LINEAR_____0_CM 1 100. 0. 255. DISPLAY_IDENTIFIER CTR_RAF_CHG_LAM_ADJ[1] ECU_ADDRESS 0xd0002254 FORMAT "%3.0" /end MEASUREMENT
/begin MEASUREMENT laco[0].laco_struct_reqgntrimad0.lv_lam_adj_ad_req "request for trim control I share shift due to new adaptation value learning" UBYTE _CNV_S_2_RANGE__0___1_CM 1 100. 0. 1. DISPLAY_IDENTIFIER LV_LAM_ADJ_AD_REQ[1] ECU_ADDRESS 0xd0002255 BIT_MASK 0x1 /end MEASUREMENT
/begin MEASUREMENT laco[1].laco_struct_ispcladapi0.maf_ofs_ldc_lam_ad "air mass flow offset for limited dynamics calculation" SWORD _CNV_A_R_LINEAR_____202_CM 1 100. -694.510597390707 694.4894026092931 DISPLAY_IDENTIFIER MAF_OFS_LDC_LAM_AD ECU_ADDRESS 0xd00022a4 FORMAT "%7.2" /end MEASUREMENT
/begin MEASUREMENT laco[1].laco_struct_ispcladapi0.fac_lam_mv_ofs_ldc_lam_ad "filtered lambda controller output offset for limited dynamics calculation" SWORD _CNV_A_R_LINEAR_____110_CM 1 100. -50. 49.9984741210938 DISPLAY_IDENTIFIER FAC_LAM_MV_OFS_LDC_LAM_AD ECU_ADDRESS 0xd00022a6 FORMAT "%7.3" /end MEASUREMENT
/begin MEASUREMENT laco[1].laco_struct_ispcladapi0.n_ofs_ldc_lam_ad "engine speed offset for limited dynamics calculation" SWORD _CNV_A_R_LINEAR_____13_CM 1 100. -8160. 8160. DISPLAY_IDENTIFIER N_OFS_LDC_LAM_AD ECU_ADDRESS 0xd00022a8 FORMAT "%5.0" /end MEASUREMENT
/begin MEASUREMENT laco[1].laco_struct_ispcladapi0.maf_int_ldc_lam_ad "air mass flow integral during limited dynamics not fulfilled" UWORD _CNV_A_R_LINEAR_____356_CM 1 100. 0. 1820.42 DISPLAY_IDENTIFIER MAF_INT_LDC_LAM_AD ECU_ADDRESS 0xd00022aa FORMAT "%7.2" /end MEASUREMENT
/begin MEASUREMENT laco[1].laco_struct_ispcladapi0.crlc_lam_ad "correlation constant for calculation of adaptive values" UBYTE _CNV_A_R_LINEAR_____27_CM 1 100. 0. 0.99609375 DISPLAY_IDENTIFIER CRLC_LAM_AD[2] ECU_ADDRESS 0xd00022ac FORMAT "%5.3" /end MEASUREMENT
/begin MEASUREMENT laco[1].laco_struct_ispcladapi0.nr_raf_chg_lam_ad "number of lean <-> rich air fuel ratio changes between two adaptations" UBYTE _CNV_A_R_LINEAR_____0_CM 1 100. 1. 255. DISPLAY_IDENTIFIER NR_RAF_CHG_LAM_AD[2] ECU_ADDRESS 0xd00022ad FORMAT "%3.0" /end MEASUREMENT
/begin MEASUREMENT laco[1].laco_struct_ispcladapi0.lv_lam_ad_act "flag indicating that lambda adaptation can be activated" UBYTE _CNV_S_2_RANGE__0___1_CM 1 100. 0. 1. DISPLAY_IDENTIFIER LV_LAM_AD_ACT[2] ECU_ADDRESS 0xd00022ae BIT_MASK 0x1 /end MEASUREMENT
/begin MEASUREMENT laco[1].laco_struct_ispcladapi0.lv_ldc_lam_ad "limited dynamic conditions for lambda adaptation" UBYTE _CNV_S_2_RANGE__0___1_CM 1 100. 0. 1. DISPLAY_IDENTIFIER LV_LDC_LAM_AD[2] ECU_ADDRESS 0xd00022af BIT_MASK 0x1 /end MEASUREMENT
/begin MEASUREMENT laco[1].laco_struct_ispcladapi0.lv_lam_ad_act_err "flag indicating that lambda adaptation can be activated because of no error detected" UBYTE _CNV_S_2_RANGE__0___1_CM 1 100. 0. 1. DISPLAY_IDENTIFIER LV_LAM_AD_ACT_ERR ECU_ADDRESS 0xd00022b0 BIT_MASK 0x1 /end MEASUREMENT
/begin MEASUREMENT laco[1].laco_struct_ispcladapi0.lv_lam_ad_deac_err "flag indicating that lambda adaptation is deactivated due to an error" UBYTE _CNV_S_2_RANGE__0___1_CM 1 100. 0. 1. DISPLAY_IDENTIFIER LV_LAM_AD_DEAC_ERR[2] ECU_ADDRESS 0xd00022b1 BIT_MASK 0x1 /end MEASUREMENT
/begin MEASUREMENT laco[1].laco_struct_ispcladapi0.lv_inh_ctr_raf_chg "limited dynamic conditions for lambda adaptation" UBYTE _CNV_S_2_RANGE__0___1_CM 1 100. 0. 1. DISPLAY_IDENTIFIER LV_INH_CTR_RAF_CHG[2] ECU_ADDRESS 0xd00022b2 BIT_MASK 0x1 /end MEASUREMENT
/begin MEASUREMENT laco[1].laco_struct_reqgnlaco0.fac_dif_sum_lam_in "unlimited summation of controller difference" SLONG _CNV_A_R_LACO_LINEA_381_CM 1 100. -65536. 65535.9999694824 DISPLAY_IDENTIFIER FAC_DIF_SUM_LAM_IN[2] ECU_ADDRESS 0xd00022b8 FORMAT "%12.5" /end MEASUREMENT
/begin MEASUREMENT laco[1].laco_struct_reqgnlaco0.fac_lam_i_it_lim "limited internal I share used for PID control only" SLONG _CNV_A_R_LACO_LINEA_382_CM 1 100. -50. 49.9999999767169 DISPLAY_IDENTIFIER FAC_LAM_I_IT_LIM[2] ECU_ADDRESS 0xd00022bc FORMAT "%10.6" /end MEASUREMENT
/begin MEASUREMENT laco[1].laco_struct_reqgnlaco0.fac_dif_sum_lim_lam_in "limited summation of controller difference" SLONG _CNV_A_R_LACO_LINEA_381_CM 1 100. -65536. 65535.9999694824 DISPLAY_IDENTIFIER FAC_DIF_SUM_LIM_LAM_IN[2] ECU_ADDRESS 0xd00022c0 FORMAT "%12.5" /end MEASUREMENT
/begin MEASUREMENT laco[1].laco_struct_reqgnlaco0.fac_dif_sum_lam_in_save "stored value of controller difference summation" SLONG _CNV_A_R_LACO_LINEA_381_CM 1 100. -65536. 65535.9999694824 DISPLAY_IDENTIFIER FAC_DIF_SUM_LAM_IN_SAVE[2] ECU_ADDRESS 0xd00022c4 FORMAT "%12.5" /end MEASUREMENT
/begin MEASUREMENT laco[1].laco_struct_reqgnlaco0.fac_dif_lam_in_mmv "controller difference (richness) moving mean value" SLONG _CNV_A_R_LACO_LINEA_383_CM 1 100. -1. 0.9999999995343391 DISPLAY_IDENTIFIER FAC_DIF_LAM_IN_MMV[2] ECU_ADDRESS 0xd00022c8 FORMAT "%9.6" /end MEASUREMENT
/begin MEASUREMENT laco[1].laco_struct_reqgnlaco0.fac_lam_i_it "unlimited internal I share used for PID control only" SLONG _CNV_A_R_LACO_LINEA_382_CM 1 100. -50. 49.9999999767169 DISPLAY_IDENTIFIER FAC_LAM_I_IT[2] ECU_ADDRESS 0xd00022cc FORMAT "%10.6" /end MEASUREMENT
/begin MEASUREMENT laco[1].laco_struct_reqgnlaco0.fac_lam_pctl "pre control path correction" SWORD _CNV_A_R_LINEAR_____110_CM 1 100. -50. 49.9984741210938 DISPLAY_IDENTIFIER FAC_LAM_PCTL[2] ECU_ADDRESS 0xd00022f4 FORMAT "%7.3" /end MEASUREMENT
/begin MEASUREMENT laco[1].laco_struct_reqgnlaco0.fac_lam_out "Lambda controller output" SWORD _CNV_A_R_LINEAR_____110_CM 1 100. -50. 49.9984741210938 DISPLAY_IDENTIFIER FAC_LAM_OUT[2] ECU_ADDRESS 0xd00022f8 FORMAT "%7.3" /end MEASUREMENT
/begin MEASUREMENT laco[1].laco_struct_reqgnlaco0.fac_dif_lam_in "controller difference (richness)" SWORD _CNV_A_R_LINEAR_____275_CM 1 100. -1. 0.999969482421875 DISPLAY_IDENTIFIER FAC_DIF_LAM_IN[2] ECU_ADDRESS 0xd00022fa FORMAT "%8.5" /end MEASUREMENT
/begin MEASUREMENT laco[1].laco_struct_reqgnlaco0.fac_lam_i "unlimited I share output signal" SWORD _CNV_A_R_LINEAR_____110_CM 1 100. -50. 49.9984741210938 DISPLAY_IDENTIFIER FAC_LAM_I[2] ECU_ADDRESS 0xd00022fe FORMAT "%7.3" /end MEASUREMENT
/begin MEASUREMENT laco[1].laco_struct_reqgnlaco0.fac_lam_i2 "unlimited I^2 share output signal" SWORD _CNV_A_R_LINEAR_____110_CM 1 100. -50. 49.9984741210938 DISPLAY_IDENTIFIER FAC_LAM_I2[2] ECU_ADDRESS 0xd0002300 FORMAT "%7.3" /end MEASUREMENT
/begin MEASUREMENT laco[1].laco_struct_reqgnlaco0.fac_lam_i2_lim "limited I^2 share output signal" SWORD _CNV_A_R_LINEAR_____110_CM 1 100. -50. 49.9984741210938 DISPLAY_IDENTIFIER FAC_LAM_I2_LIM[2] ECU_ADDRESS 0xd0002302 FORMAT "%7.3" /end MEASUREMENT
/begin MEASUREMENT laco[1].laco_struct_reqgnlaco0.fac_lam_i_i2_sum_lim "limited I share + I^2 share output signal" SWORD _CNV_A_R_LINEAR_____110_CM 1 100. -50. 49.9984741210938 DISPLAY_IDENTIFIER FAC_LAM_I_I2_SUM_LIM[2] ECU_ADDRESS 0xd0002306 FORMAT "%7.3" /end MEASUREMENT
/begin MEASUREMENT laco[1].laco_struct_reqgnlaco0.fac_lam_p_lim "limited P share output signal" SWORD _CNV_A_R_LINEAR_____110_CM 1 100. -50. 49.9984741210938 DISPLAY_IDENTIFIER FAC_LAM_P_LIM[2] ECU_ADDRESS 0xd000230a FORMAT "%7.3" /end MEASUREMENT
/begin MEASUREMENT laco[1].laco_struct_reqgnlaco0.fac_lam_d_lim "limited D share output signal" SWORD _CNV_A_R_LINEAR_____110_CM 1 100. -50. 49.9984741210938 DISPLAY_IDENTIFIER FAC_LAM_D_LIM[2] ECU_ADDRESS 0xd000230e FORMAT "%7.3" /end MEASUREMENT
/begin MEASUREMENT laco[1].laco_struct_reqgnlaco0.fac_lam_mv "Mean value of lambda controller output" SWORD _CNV_A_R_LINEAR_____110_CM 1 100. -50. 49.9984741210938 DISPLAY_IDENTIFIER FAC_LAM_MV[2] ECU_ADDRESS 0xd0002314 FORMAT "%7.3" /end MEASUREMENT
/begin MEASUREMENT laco[1].laco_struct_reqgnlaco0.fac_lam_mv_mmv "FAC_LAM_MV[i] average value" SWORD _CNV_A_R_LINEAR_____110_CM 1 100. -50. 49.9984741210938 DISPLAY_IDENTIFIER FAC_LAM_MV_MMV[2] ECU_ADDRESS 0xd0002316 FORMAT "%7.3" /end MEASUREMENT
/begin MEASUREMENT laco[1].laco_struct_reqgnlaco0.fac_lam_mv_mmv_cp "Mean value of lambda controller output, used by canister purge" SWORD _CNV_A_R_LINEAR_____110_CM 1 100. -50. 49.9984741210938 DISPLAY_IDENTIFIER FAC_LAM_MV_MMV_CP[2] ECU_ADDRESS 0xd0002318 FORMAT "%7.3" /end MEASUREMENT
/begin MEASUREMENT laco[1].laco_struct_reqgnlaco0.fac_lam_mv_mmv_ldc "moving mean value of the controller output, used for limited dynamics calculation" SWORD _CNV_A_R_LINEAR_____110_CM 1 100. -50. 49.9984741210938 DISPLAY_IDENTIFIER FAC_LAM_MV_MMV_LDC[2] ECU_ADDRESS 0xd000231a FORMAT "%7.3" /end MEASUREMENT
/begin MEASUREMENT laco[1].laco_struct_reqgnlaco0.fac_lam_max_not_stat_cdn "upper limit in case of limitation under non stationary conditions" SWORD _CNV_A_R_LINEAR_____110_CM 1 100. -50. 49.9984741210938 DISPLAY_IDENTIFIER FAC_LAM_MAX_NOT_STAT_CDN[2] ECU_ADDRESS 0xd000231e FORMAT "%7.3" /end MEASUREMENT
/begin MEASUREMENT laco[1].laco_struct_reqgnlaco0.fac_lam_min_not_stat_cdn "bottom limit in case of limitation under non stationary conditions" SWORD _CNV_A_R_LINEAR_____110_CM 1 100. -50. 49.9984741210938 DISPLAY_IDENTIFIER FAC_LAM_MIN_NOT_STAT_CDN[2] ECU_ADDRESS 0xd0002320 FORMAT "%7.3" /end MEASUREMENT
/begin MEASUREMENT laco[1].laco_struct_reqgnlaco0.fac_lam_cor "Limited lambda controller output plus pre-control correction" SWORD _CNV_A_R_LINEAR_____110_CM 1 100. -50. 49.9984741210938 DISPLAY_IDENTIFIER FAC_LAM_COR[2] ECU_ADDRESS 0xd0002322 FORMAT "%7.3" /end MEASUREMENT
/begin MEASUREMENT laco[1].laco_struct_reqgnlaco0.fac_lam_delta_i_i2_shift "I and I^2 share shift based on downstream signal evaluation" SWORD _CNV_A_R_LINEAR_____110_CM 1 100. -50. 49.9984741210938 DISPLAY_IDENTIFIER FAC_LAM_DELTA_I_I2_SHIFT[2] ECU_ADDRESS 0xd0002324 FORMAT "%7.3" /end MEASUREMENT
/begin MEASUREMENT laco[1].laco_struct_reqgnlaco0.fac_lam_lim "Limited value of lambda controller output" SWORD _CNV_A_R_LINEAR_____110_CM 1 100. -50. 49.9984741210938 DISPLAY_IDENTIFIER FAC_LAM_LIM[2] ECU_ADDRESS 0xd0002326 FORMAT "%7.3" /end MEASUREMENT
/begin MEASUREMENT laco[1].laco_struct_reqgnlaco0.crlc_lsl_mdl "correlation constant for lambda sensor model" UWORD _CNV_A_R_LINEAR_____68_CM 1 100. 0. 0.9999847412109381 DISPLAY_IDENTIFIER CRLC_LSL_MDL[2] ECU_ADDRESS 0xd000232c FORMAT "%7.5" /end MEASUREMENT
/begin MEASUREMENT laco[1].laco_struct_reqgnlaco0.fac_gain_p_lam "gain of lambda controller P share" UWORD _CNV_A_R_LINEAR_____115_CM 1 100. 0. 15.999755859375 DISPLAY_IDENTIFIER FAC_GAIN_P_LAM[2] ECU_ADDRESS 0xd0002332 FORMAT "%7.4" /end MEASUREMENT
/begin MEASUREMENT laco[1].laco_struct_reqgnlaco0.fac_gain_i_lam "gain of lambda controller I share" UWORD _CNV_A_R_LACO_LINEA_384_CM 1 100. 0. 49.999237 DISPLAY_IDENTIFIER FAC_GAIN_I_LAM[2] ECU_ADDRESS 0xd0002334 FORMAT "%7.4" /end MEASUREMENT
/begin MEASUREMENT laco[1].laco_struct_reqgnlaco0.fac_gain_i2_lam "gain of lambda controller I^2 share" UWORD _CNV_A_R_LACO_LINEA_385_CM 1 100. 0. 24.999619 DISPLAY_IDENTIFIER FAC_GAIN_I2_LAM[2] ECU_ADDRESS 0xd0002336 FORMAT "%7.4" /end MEASUREMENT
/begin MEASUREMENT laco[1].laco_struct_reqgnlaco0.fac_gain_d_lam "gain of lambda controller D share" UWORD _CNV_A_R_LACO_LINEA_386_CM 1 100. 0. 3.9999e-002 DISPLAY_IDENTIFIER FAC_GAIN_D_LAM[2] ECU_ADDRESS 0xd0002338 FORMAT "%8.6" /end MEASUREMENT
/begin MEASUREMENT laco[1].laco_struct_reqgnlaco0.lamb_sp_fil_hom "output signal of the WRAF sensor model for homogeneous mode" UWORD _CNV_A_R_LINEAR_____23_CM 1 100. 0. 1.99993896484375 DISPLAY_IDENTIFIER LAMB_SP_FIL_HOM[2] ECU_ADDRESS 0xd000233a FORMAT "%7.5" /end MEASUREMENT
/begin MEASUREMENT laco[1].laco_struct_reqgnlaco0.lamb_sp_pctl "pre control lambda set point" UWORD _CNV_A_R_LINEAR_____23_CM 1 100. 0. 1.99993896484375 DISPLAY_IDENTIFIER LAMB_SP_PCTL[2] ECU_ADDRESS 0xd000233c FORMAT "%7.5" /end MEASUREMENT
/begin MEASUREMENT laco[1].laco_struct_reqgnlaco0.lamb_sp_fil_s "output signal of the WRAF sensor model for stratified mode" UWORD _CNV_A_R_LINEAR_____122_CM 1 100. 0. 31.9990234375 DISPLAY_IDENTIFIER LAMB_SP_FIL_S[2] ECU_ADDRESS 0xd000233e FORMAT "%7.4" /end MEASUREMENT
/begin MEASUREMENT laco[1].laco_struct_reqgnlaco0.lamb_sp_lsl_mdl_in_hom "lambda controller set point including forced stimulation and the influence of secondary air" UWORD _CNV_A_R_LINEAR_____23_CM 1 100. 0. 3.99993896484375 DISPLAY_IDENTIFIER LAMB_SP_LSL_MDL_IN_HOM[2] ECU_ADDRESS 0xd0002340 FORMAT "%7.5" /end MEASUREMENT
/begin MEASUREMENT laco[1].laco_struct_reqgnlaco0.lamb_sp_lsl_mdl_out_hom "output signal of the WRAF sensor model in homogeneous mode" UWORD _CNV_A_R_LINEAR_____23_CM 1 100. 0. 3.99993896484375 DISPLAY_IDENTIFIER LAMB_SP_LSL_MDL_OUT_HOM[2] ECU_ADDRESS 0xd0002342 FORMAT "%7.5" /end MEASUREMENT
/begin MEASUREMENT laco[1].laco_struct_reqgnlaco0.lamb_sp_lsl_mdl_out_s "output signal of the WRAF sensor model in stratified mode" UWORD _CNV_A_R_LINEAR_____122_CM 1 100. 0. 31.9990234375 DISPLAY_IDENTIFIER LAMB_SP_LSL_MDL_OUT_S[2] ECU_ADDRESS 0xd0002344 FORMAT "%7.4" /end MEASUREMENT
/begin MEASUREMENT laco[1].laco_struct_reqgnlaco0.lamb_cor_av_lam "corrected signal of WRAF sensor; actual value for lambda controller " UWORD _CNV_A_R_LINEAR_____23_CM 1 100. 0. 1.99993896484375 DISPLAY_IDENTIFIER LAMB_COR_AV_LAM[2] ECU_ADDRESS 0xd000234e FORMAT "%7.5" /end MEASUREMENT
/begin MEASUREMENT laco[1].laco_struct_reqgnlaco0.t1_lsl_up "first order time lag of the WRAF sensor model" UWORD _CNV_A_R_LINEAR_____117_CM 1 100. 0. 1.99996948242188 DISPLAY_IDENTIFIER T1_LSL_UP[2] ECU_ADDRESS 0xd0002352 FORMAT "%7.5" /end MEASUREMENT
/begin MEASUREMENT laco[1].laco_struct_reqgnlaco0.t_dly_soi_lsl_pos "delay between start of injection and WRAF sensor signal location" UWORD _CNV_A_R_LINEAR_____375_CM 1 100. 0. 1.023984 DISPLAY_IDENTIFIER T_DLY_SOI_LSL_POS[2] ECU_ADDRESS 0xd0002354 FORMAT "%7.5" /end MEASUREMENT
/begin MEASUREMENT laco[1].laco_struct_reqgnlaco0.tout_i_i2_shift_vld_afl "time out for I and I^2 share shift based on lean downstream signal" UWORD _CNV_A_R_LINEAR_____107_CM 1 100. 0. 1310.7 DISPLAY_IDENTIFIER TOUT_I_I2_SHIFT_VLD_AFL[2] ECU_ADDRESS 0xd0002356 FORMAT "%7.2" /end MEASUREMENT
/begin MEASUREMENT laco[1].laco_struct_reqgnlaco0.tout_i_i2_shift_vld_afr "time out for I and I^2 share shift based on rich downstream signal" UWORD _CNV_A_R_LINEAR_____107_CM 1 100. 0. 1310.7 DISPLAY_IDENTIFIER TOUT_I_I2_SHIFT_VLD_AFR[2] ECU_ADDRESS 0xd0002358 FORMAT "%7.2" /end MEASUREMENT
/begin MEASUREMENT laco[1].laco_struct_reqgnlaco0.vls_down_mmv_lam "moving mean value of downstream sensor voltage" UWORD _CNV_A_R_LINEAR_____190_CM 1 100. 0. 4.99992371 DISPLAY_IDENTIFIER VLS_DOWN_MMV_LAM[2] ECU_ADDRESS 0xd000235a FORMAT "%7.5" /end MEASUREMENT
/begin MEASUREMENT laco[1].laco_struct_reqgnlaco0.mff_add_lam_ad_out "fuel mass set point offset, output from lambda adaptation" SWORD _CNV_A_R_LINEAR_____202_CM 1 100. -694.510597390707 694.4894026092931 DISPLAY_IDENTIFIER MFF_ADD_LAM_AD_OUT[2] ECU_ADDRESS 0xd000235c FORMAT "%7.2" /end MEASUREMENT
/begin MEASUREMENT laco[1].laco_struct_reqgnlaco0.fac_lam_ad_out "fuel mass set point factor, output from lambda adaptation" SWORD _CNV_A_R_LINEAR_____110_CM 1 100. -50. 49.9984741210938 DISPLAY_IDENTIFIER FAC_LAM_AD_OUT[2] ECU_ADDRESS 0xd000235e FORMAT "%7.3" /end MEASUREMENT
/begin MEASUREMENT laco[1].laco_struct_reqgnlaco0.ctr_raf_chg "Counter of air fuel ratio changes" UBYTE _CNV_A_R_LINEAR_____0_CM 1 100. 0. 255. DISPLAY_IDENTIFIER CTR_RAF_CHG[2] ECU_ADDRESS 0xd0002360 FORMAT "%3.0" /end MEASUREMENT
/begin MEASUREMENT laco[1].laco_struct_reqgnlaco0.state_lam "lambda controller state" UBYTE _CNV_S_4_LACO_RANGE_387_CM 1 100. 0. 3. DISPLAY_IDENTIFIER STATE_LAM[2] ECU_ADDRESS 0xd0002361 /end MEASUREMENT
/begin MEASUREMENT laco[1].laco_struct_reqgnlaco0.fac_eg_dly "Weighting factor for the calculation of the exhaust gas delay" UBYTE _CNV_A_R_EGCP_LINEA_370_CM 1 100. 0. 31.875 DISPLAY_IDENTIFIER FAC_EG_DLY[2] ECU_ADDRESS 0xd0002362 FORMAT "%4.1" /end MEASUREMENT
/begin MEASUREMENT laco[1].laco_struct_reqgnlaco0.lv_lam_lscl "activation flag of lambda control" UBYTE _CNV_S_2_RANGE__0___1_CM 1 100. 0. 1. DISPLAY_IDENTIFIER LV_LAM_LSCL[2] ECU_ADDRESS 0xd0002363 BIT_MASK 0x1 /end MEASUREMENT
/begin MEASUREMENT laco[1].laco_struct_reqgnlaco0.lv_fac_lam_lim_not_stat_cdn "limitation under non stationary operating conditions (threshold exceeded)" UBYTE _CNV_S_2_RANGE__0___1_CM 1 100. 0. 1. DISPLAY_IDENTIFIER LV_FAC_LAM_LIM_NOT_STAT_CDN[2] ECU_ADDRESS 0xd0002364 BIT_MASK 0x1 /end MEASUREMENT
/begin MEASUREMENT laco[1].laco_struct_reqgnlaco0.lv_t_max_lscl_act_tco "lambda controller activation by timer condition instead of TCO condition" UBYTE _CNV_S_2_RANGE__0___1_CM 1 100. 0. 1. DISPLAY_IDENTIFIER LV_T_MAX_LSCL_ACT_TCO[2] ECU_ADDRESS 0xd0002365 BIT_MASK 0x1 /end MEASUREMENT
/begin MEASUREMENT laco[1].laco_struct_reqgnlaco0.lv_fac_lam_adj_lam_ad_end "Controller shift caused by lambda adaptation was carried out" UBYTE _CNV_S_2_RANGE__0___1_CM 1 100. 0. 1. DISPLAY_IDENTIFIER LV_FAC_LAM_ADJ_LAM_AD_END[2] ECU_ADDRESS 0xd0002366 BIT_MASK 0x1 /end MEASUREMENT
/begin MEASUREMENT laco[1].laco_struct_reqgnlaco0.lv_fac_lam_shift_cp_end "Controller shift caused by canister purge was carried out" UBYTE _CNV_S_2_RANGE__0___1_CM 1 100. 0. 1. DISPLAY_IDENTIFIER LV_FAC_LAM_SHIFT_CP_END[2] ECU_ADDRESS 0xd0002367 BIT_MASK 0x1 /end MEASUREMENT
/begin MEASUREMENT laco[1].laco_struct_reqgnlaco0.lv_fac_lam_diagcp_end "Controller shift caused by EVAP diagnosis was carried out" UBYTE _CNV_S_2_RANGE__0___1_CM 1 100. 0. 1. DISPLAY_IDENTIFIER LV_FAC_LAM_DIAGCP_END[2] ECU_ADDRESS 0xd0002368 BIT_MASK 0x1 /end MEASUREMENT
/begin MEASUREMENT laco[1].laco_struct_reqgnlaco0.lv_fac_lam_lim_max "Upper limit of lambda controller output reached" UBYTE _CNV_S_2_RANGE__0___1_CM 1 100. 0. 1. DISPLAY_IDENTIFIER LV_FAC_LAM_LIM_MAX[2] ECU_ADDRESS 0xd000236a BIT_MASK 0x1 /end MEASUREMENT
/begin MEASUREMENT laco[1].laco_struct_reqgnlaco0.lv_fac_lam_lim_min "Lower limit of lambda controller output reached" UBYTE _CNV_S_2_RANGE__0___1_CM 1 100. 0. 1. DISPLAY_IDENTIFIER LV_FAC_LAM_LIM_MIN[2] ECU_ADDRESS 0xd000236b BIT_MASK 0x1 /end MEASUREMENT
/begin MEASUREMENT laco[1].laco_struct_reqgnlaco0.lv_vls_down_thd_afl_lam "flag indicating that downstream sensor signal is below calibration threshold (used for lambda control)" UBYTE _CNV_S_2_RANGE__0___1_CM 1 100. 0. 1. DISPLAY_IDENTIFIER LV_VLS_DOWN_THD_AFL_LAM[2] ECU_ADDRESS 0xd000236c BIT_MASK 0x1 /end MEASUREMENT
/begin MEASUREMENT laco[1].laco_struct_reqgnlaco0.lv_vls_down_thd_afr_lam "flag indicating that downstream sensor signal is above calibration threshold (used for lambda control)" UBYTE _CNV_S_2_RANGE__0___1_CM 1 100. 0. 1. DISPLAY_IDENTIFIER LV_VLS_DOWN_THD_AFR_LAM[2] ECU_ADDRESS 0xd000236d BIT_MASK 0x1 /end MEASUREMENT
/begin MEASUREMENT laco[1].laco_struct_reqgnlaco0.lv_vls_down_thd_afr_lam_old "auxiliary flag used for downstream sensor signal evaluation" UBYTE _CNV_S_2_RANGE__0___1_CM 1 100. 0. 1. DISPLAY_IDENTIFIER LV_VLS_DOWN_THD_AFR_LAM_OLD[2] ECU_ADDRESS 0xd000236e BIT_MASK 0x1 /end MEASUREMENT
/begin MEASUREMENT laco[1].laco_struct_reqgnlaco0.lv_vls_down_thd_afl_lam_old "auxiliary flag used for downstream sensor signal evaluation" UBYTE _CNV_S_2_RANGE__0___1_CM 1 100. 0. 1. DISPLAY_IDENTIFIER LV_VLS_DOWN_THD_AFL_LAM_OLD[2] ECU_ADDRESS 0xd000236f BIT_MASK 0x1 /end MEASUREMENT
/begin MEASUREMENT laco[1].laco_struct_reqgnlacoi0.lamb_sp_delta_lam "lambda shift applied on lambda set point" SWORD _CNV_A_R_LINEAR_____23_CM 1 100. -0.125 0.125 DISPLAY_IDENTIFIER LAMB_SP_DELTA_LAM[2] ECU_ADDRESS 0xd0002370 FORMAT "%8.5" /end MEASUREMENT
/begin MEASUREMENT laco[1].laco_struct_reqgnlacoi0.lamb_av_delta_lam "lambda shift applied on measured lambda signal" SWORD _CNV_A_R_LINEAR_____23_CM 1 100. -0.125 0.125 DISPLAY_IDENTIFIER LAMB_AV_DELTA_LAM[2] ECU_ADDRESS 0xd0002372 FORMAT "%8.5" /end MEASUREMENT
/begin MEASUREMENT laco[1].laco_struct_reqgnlacoi0.lv_inh_lscl "inhibit signal for the controller deactivation" UBYTE _CNV_S_2_RANGE__0___1_CM 1 100. 0. 1. DISPLAY_IDENTIFIER LV_INH_LSCL[2] ECU_ADDRESS 0xd0002374 BIT_MASK 0x1 /end MEASUREMENT
/begin MEASUREMENT laco[1].laco_struct_reqgnlacoi0.lv_lam_stop_req "request to stop the lambda controller" UBYTE _CNV_S_2_RANGE__0___1_CM 1 100. 0. 1. DISPLAY_IDENTIFIER LV_LAM_STOP_REQ[2] ECU_ADDRESS 0xd0002375 BIT_MASK 0x1 /end MEASUREMENT
/begin MEASUREMENT laco[1].laco_struct_reqgnlacoi0.lv_state_ls_opl_err "flag summarising errors that leads to open loop control" UBYTE _CNV_S_2_RANGE__0___1_CM 1 100. 0. 1. DISPLAY_IDENTIFIER LV_STATE_LS_OPL_ERR[2] ECU_ADDRESS 0xd0002376 BIT_MASK 0x1 /end MEASUREMENT
/begin MEASUREMENT laco[1].laco_struct_reqgntrim0.lamb_delta_i_mmv_lam_adj "I share moving mean value from trim control" SWORD _CNV_A_R_LACO_LINEA_388_CM 1 100. -0.125 0.124996185302734 DISPLAY_IDENTIFIER LAMB_DELTA_I_MMV_LAM_ADJ[2] ECU_ADDRESS 0xd000237c FORMAT "%9.6" /end MEASUREMENT
/begin MEASUREMENT laco[1].laco_struct_reqgntrim0.lamb_delta_lam_adj "total output (P share + I share) from trim control" SWORD _CNV_A_R_LINEAR_____23_CM 1 100. -0.125 0.125 DISPLAY_IDENTIFIER LAMB_DELTA_LAM_ADJ[2] ECU_ADDRESS 0xd000237e FORMAT "%8.5" /end MEASUREMENT
/begin MEASUREMENT laco[1].laco_struct_reqgntrim0.lamb_delta_p_lam_adj "P share of from trim control" SWORD _CNV_A_R_LINEAR_____23_CM 1 100. -0.125 0.125 DISPLAY_IDENTIFIER LAMB_DELTA_P_LAM_ADJ[2] ECU_ADDRESS 0xd0002380 FORMAT "%8.5" /end MEASUREMENT
/begin MEASUREMENT laco[1].laco_struct_reqgntrim0.lamb_delta_i_lam_adj "I share from trim control" SWORD _CNV_A_R_LINEAR_____23_CM 1 100. -0.125 0.125 DISPLAY_IDENTIFIER LAMB_DELTA_I_LAM_ADJ[2] ECU_ADDRESS 0xd0002382 FORMAT "%8.5" /end MEASUREMENT
/begin MEASUREMENT laco[1].laco_struct_reqgntrim0.lamb_delta_i_save_lam_adj "saved I share from trim control (saved in case that catalyst diagnosis switched on)" SWORD _CNV_A_R_LACO_LINEA_388_CM 1 100. -0.125 0.124996185302734 DISPLAY_IDENTIFIER LAMB_DELTA_I_SAVE_LAM_ADJ[2] ECU_ADDRESS 0xd0002384 FORMAT "%9.6" /end MEASUREMENT
/begin MEASUREMENT laco[1].laco_struct_reqgntrim0.vls_dif_lam_adj "difference between setpoint and actual downstream LS signal" SWORD _CNV_A_R_LINEAR_____369_CM 1 100. -5.00000000000182 4.99511718999747 DISPLAY_IDENTIFIER VLS_DIF_LAM_ADJ[2] ECU_ADDRESS 0xd0002386 /end MEASUREMENT
/begin MEASUREMENT laco[1].laco_struct_reqgntrim0.vls_dif_mmv_lam_adj "moving mean value of difference between set point and actual downstream LS signal" SWORD _CNV_A_R_LACO_LINEA_389_CM 1 100. -5. 4.99984741210938 DISPLAY_IDENTIFIER VLS_DIF_MMV_LAM_ADJ[2] ECU_ADDRESS 0xd0002388 FORMAT "%7.4" /end MEASUREMENT
/begin MEASUREMENT laco[1].laco_struct_reqgntrim0.vls_dif_delta_lam_adj "difference between downstream LS signal and moving mean value" SWORD _CNV_A_R_LACO_LINEA_389_CM 1 100. -5. 4.99984741210938 DISPLAY_IDENTIFIER VLS_DIF_DELTA_LAM_ADJ[2] ECU_ADDRESS 0xd000238a FORMAT "%7.4" /end MEASUREMENT
/begin MEASUREMENT laco[1].laco_struct_reqgntrim0.lamb_delta_d_lam_adj "D share from trim control" SWORD _CNV_A_R_LINEAR_____23_CM 1 100. -0.125 0.125 DISPLAY_IDENTIFIER LAMB_DELTA_D_LAM_ADJ[2] ECU_ADDRESS 0xd000238c FORMAT "%8.5" /end MEASUREMENT
/begin MEASUREMENT laco[1].laco_struct_reqgntrim0.maf_int_lam_adj_act "integral of air mass flow since LAM activation" UWORD _CNV_A_R_LACO_LINEA_390_CM 1 100. 0. 1456.33 DISPLAY_IDENTIFIER MAF_INT_LAM_ADJ_ACT[2] ECU_ADDRESS 0xd000238e FORMAT "%7.2" /end MEASUREMENT
/begin MEASUREMENT laco[1].laco_struct_reqgntrim0.vls_sp_lam_adj "trim control setpoint" UWORD _CNV_A_R_LINEAR_____2_CM 1 100. 0. 4.9951171875 DISPLAY_IDENTIFIER VLS_SP_LAM_ADJ[2] ECU_ADDRESS 0xd0002390 FORMAT "%5.3" /end MEASUREMENT
/begin MEASUREMENT laco[1].laco_struct_reqgntrim0.maf_int_min_lam_adj_p_act "minimum air mass flow  integral for trim control P share activation" UWORD _CNV_A_R_LACO_LINEA_390_CM 1 100. 0. 1456.33 DISPLAY_IDENTIFIER MAF_INT_MIN_LAM_ADJ_P_ACT[2] ECU_ADDRESS 0xd0002392 FORMAT "%7.2" /end MEASUREMENT
/begin MEASUREMENT laco[1].laco_struct_reqgntrim0.maf_int_min_lam_adj_i_act "minimum air mass flow  integral for trim control I share activation" UWORD _CNV_A_R_LACO_LINEA_390_CM 1 100. 0. 1456.33 DISPLAY_IDENTIFIER MAF_INT_MIN_LAM_ADJ_I_ACT[2] ECU_ADDRESS 0xd0002394 FORMAT "%7.2" /end MEASUREMENT
/begin MEASUREMENT laco[1].laco_struct_reqgntrim0.maf_int_min_lam_adj_d_act "minimum air mass flow integral for trim control D share activation" UWORD _CNV_A_R_LACO_LINEA_390_CM 1 100. 0. 1456.33 DISPLAY_IDENTIFIER MAF_INT_MIN_LAM_ADJ_D_ACT[2] ECU_ADDRESS 0xd0002396 FORMAT "%7.2" /end MEASUREMENT
/begin MEASUREMENT laco[1].laco_struct_reqgntrim0.lv_lam_adj_act "Activation flag of dynamic fuel trim " UBYTE _CNV_S_2_RANGE__0___1_CM 1 100. 0. 1. DISPLAY_IDENTIFIER LV_LAM_ADJ_ACT[2] ECU_ADDRESS 0xd0002398 BIT_MASK 0x1 /end MEASUREMENT
/begin MEASUREMENT laco[1].laco_struct_reqgntrim0.lv_lam_adj_i_act "Activation flag for calculation of the trim-controller I-share" UBYTE _CNV_S_2_RANGE__0___1_CM 1 100. 0. 1. DISPLAY_IDENTIFIER LV_LAM_ADJ_I_ACT[2] ECU_ADDRESS 0xd0002399 BIT_MASK 0x1 /end MEASUREMENT
/begin MEASUREMENT laco[1].laco_struct_reqgntrim0.lv_lam_adj_p_act "activation flag for calculation of trim controller P share" UBYTE _CNV_S_2_RANGE__0___1_CM 1 100. 0. 1. DISPLAY_IDENTIFIER LV_LAM_ADJ_P_ACT[2] ECU_ADDRESS 0xd000239a BIT_MASK 0x1 /end MEASUREMENT
/begin MEASUREMENT laco[1].laco_struct_reqgntrim0.lv_lam_adj_ad_end "flag indicating that trim control I share shift was executed" UBYTE _CNV_S_2_RANGE__0___1_CM 1 100. 0. 1. DISPLAY_IDENTIFIER LV_LAM_ADJ_AD_END[2] ECU_ADDRESS 0xd000239c BIT_MASK 0x1 /end MEASUREMENT
/begin MEASUREMENT laco[1].laco_struct_reqgntrim0.lv_lam_adj_d_act "activation flag for calculation of trim controller D share" UBYTE _CNV_S_2_RANGE__0___1_CM 1 100. 0. 1. DISPLAY_IDENTIFIER LV_LAM_ADJ_D_ACT[2] ECU_ADDRESS 0xd000239d BIT_MASK 0x1 /end MEASUREMENT
/begin MEASUREMENT laco[1].laco_struct_reqgntrimi0.fac_lam_mv_ofs_ldc_lam_adj "filtered lambda controller output offset for limited dynamics calculation" SWORD _CNV_A_R_LINEAR_____110_CM 1 100. -50. 49.9984741210938 DISPLAY_IDENTIFIER FAC_LAM_MV_OFS_LDC_LAM_ADJ ECU_ADDRESS 0xd00023a0 FORMAT "%7.3" /end MEASUREMENT
/begin MEASUREMENT laco[1].laco_struct_reqgntrimi0.maf_ofs_ldc_lam_adj "air mass flow offset for limited dynamics calculation" SWORD _CNV_A_R_LINEAR_____202_CM 1 100. -694.510597390707 694.4894026092931 DISPLAY_IDENTIFIER MAF_OFS_LDC_LAM_ADJ ECU_ADDRESS 0xd00023a2 FORMAT "%7.2" /end MEASUREMENT
/begin MEASUREMENT laco[1].laco_struct_reqgntrimi0.n_ofs_ldc_lam_adj "engine speed offset for limited dynamics calculation" SWORD _CNV_A_R_LINEAR_____13_CM 1 100. -8160. 8160. DISPLAY_IDENTIFIER N_OFS_LDC_LAM_ADJ ECU_ADDRESS 0xd00023a4 FORMAT "%5.0" /end MEASUREMENT
/begin MEASUREMENT laco[1].laco_struct_reqgntrimi0.vls_av_lam_adj "sensor voltage actual value for trim control" UWORD _CNV_A_R_LINEAR_____2_CM 1 100. 0. 4.9951171875 DISPLAY_IDENTIFIER VLS_AV_LAM_ADJ[2] ECU_ADDRESS 0xd00023a6 FORMAT "%5.3" /end MEASUREMENT
/begin MEASUREMENT laco[1].laco_struct_reqgntrimi0.maf_int_ldc_lam_adj "MAF integral during limited dynamics not fulfilled" UWORD _CNV_A_R_LINEAR_____356_CM 1 100. 0. 1820.42 DISPLAY_IDENTIFIER MAF_INT_LDC_LAM_ADJ ECU_ADDRESS 0xd00023a8 FORMAT "%7.2" /end MEASUREMENT
/begin MEASUREMENT laco[1].laco_struct_reqgntrimi0.vls_av_tmp_lam_adj "auxiliary sensor voltage actual value for filter calculation" UWORD _CNV_A_R_LINEAR_____190_CM 1 100. 0. 4.99992371 DISPLAY_IDENTIFIER VLS_AV_TMP_LAM_ADJ ECU_ADDRESS 0xd00023aa FORMAT "%7.5" /end MEASUREMENT
/begin MEASUREMENT laco[1].laco_struct_reqgntrimi0.pv_av_ofs_ldc_lam_adj "actual pedal value offset for limited dynamics calculation" SBYTE _CNV_A_R_LINEAR_____5_CM 1 100. -50. 49.609375 DISPLAY_IDENTIFIER PV_AV_OFS_LDC_LAM_ADJ ECU_ADDRESS 0xd00023ac FORMAT "%5.1" /end MEASUREMENT
/begin MEASUREMENT laco[1].laco_struct_reqgntrimi0.lv_ldc_lam_adj "limited dynamic conditions for trim control" UBYTE _CNV_S_2_RANGE__0___1_CM 1 100. 0. 1. DISPLAY_IDENTIFIER LV_LDC_LAM_ADJ[2] ECU_ADDRESS 0xd00023ad BIT_MASK 0x1 /end MEASUREMENT
/begin MEASUREMENT laco[1].laco_struct_reqgntrimi0.lv_inh_lam_adj "inhibition flag for trim control" UBYTE _CNV_S_2_RANGE__0___1_CM 1 100. 0. 1. DISPLAY_IDENTIFIER LV_INH_LAM_ADJ[2] ECU_ADDRESS 0xd00023ae BIT_MASK 0x1 /end MEASUREMENT
/begin MEASUREMENT laco[1].laco_struct_reqgntrimi0.lv_inh_lam_adj_err "inhibition flag for trim control based on error flag evaluation" UBYTE _CNV_S_2_RANGE__0___1_CM 1 100. 0. 1. DISPLAY_IDENTIFIER LV_INH_LAM_ADJ_ERR ECU_ADDRESS 0xd00023af BIT_MASK 0x1 /end MEASUREMENT
/begin MEASUREMENT laco[1].laco_struct_reqgntrimi0.lv_lamb_delta_i_lam_adj_deac "flag indicating that I share is fixed when deactivating lambda controller" UBYTE _CNV_S_2_RANGE__0___1_CM 1 100. 0. 1. DISPLAY_IDENTIFIER LV_LAMB_DELTA_I_LAM_ADJ_DEAC[2] ECU_ADDRESS 0xd00023b0 BIT_MASK 0x1 /end MEASUREMENT
/begin MEASUREMENT laco[1].laco_struct_reqgntrimi0.lv_lamb_delta_ad_lam_adj_clc "flag indicating that adaptation value is calculated at start of power latch phase" UBYTE _CNV_S_2_RANGE__0___1_CM 1 100. 0. 1. DISPLAY_IDENTIFIER LV_LAMB_DELTA_AD_LAM_ADJ_CLC[2] ECU_ADDRESS 0xd00023b1 BIT_MASK 0x1 /end MEASUREMENT
/begin MEASUREMENT laco[1].laco_struct_reqgncdn0.crk_dif_soi_lsl_pos "crank shaft angle difference between the start of injection and the end of the exhaust cycle" UWORD _CNV_A_R_LINEAR_____109_CM 1 100. 0. 1620. DISPLAY_IDENTIFIER CRK_DIF_SOI_LSL_POS[2] ECU_ADDRESS 0xd00023b4 FORMAT "%6.1" /end MEASUREMENT
/begin MEASUREMENT laco[1].laco_struct_reqgncdn0.maf_int_lam_reac "air mass flow for lambda controller reactivation after stop mode" UWORD _CNV_A_R_LINEAR_____391_CM 1 100. 0. 1820.41666666667 DISPLAY_IDENTIFIER MAF_INT_LAM_REAC[2] ECU_ADDRESS 0xd00023b6 FORMAT "%7.2" /end MEASUREMENT
/begin MEASUREMENT laco[1].laco_struct_reqgncdn0.t_lam_reac "time counter for lambda controller reactivation after stop mode " UBYTE _CNV_A_R_LINEAR_____107_CM 1 100. 0. 5.1 DISPLAY_IDENTIFIER T_LAM_REAC[2] ECU_ADDRESS 0xd00023b8 FORMAT "%4.2" /end MEASUREMENT
/begin MEASUREMENT laco[1].laco_struct_reqgncdn0.lv_lam_stop "activation signal for the lambda controller stop mode" UBYTE _CNV_S_2_RANGE__0___1_CM 1 100. 0. 1. DISPLAY_IDENTIFIER LV_LAM_STOP[2] ECU_ADDRESS 0xd00023b9 BIT_MASK 0x1 /end MEASUREMENT
/begin MEASUREMENT laco[1].laco_struct_reqgncdn0.lv_lam_stop_sho_per "activation signal for the controller stop mode while active offset adjustment" UBYTE _CNV_S_2_RANGE__0___1_CM 1 100. 0. 1. DISPLAY_IDENTIFIER LV_LAM_STOP_SHO_PER[2] ECU_ADDRESS 0xd00023ba BIT_MASK 0x1 /end MEASUREMENT
/begin MEASUREMENT laco[1].laco_struct_reqgncdn0.lv_lam_act_dc "closed loop had been enabled for at least one time" UBYTE _CNV_S_2_RANGE__0___1_CM 1 100. 0. 1. DISPLAY_IDENTIFIER LV_LAM_ACT_DC[2] ECU_ADDRESS 0xd00023bb BIT_MASK 0x1 /end MEASUREMENT
/begin MEASUREMENT laco[1].laco_struct_reqgncdn0.state_ls "Fuel system status" UBYTE _CNV_S_5_LACO_RANGE_392_CM 1 100. 1. 16. DISPLAY_IDENTIFIER STATE_LS[2] ECU_ADDRESS 0xd00023bc /end MEASUREMENT
/begin MEASUREMENT laco[1].laco_struct_reqgntrcdn0.maf_int_lam_adj_cdn "air mass flow integral for condition detection of WRAF sensor characterisitc line adaptation" UWORD _CNV_A_R_LINEAR_____391_CM 1 100. 0. 1820.41666666667 DISPLAY_IDENTIFIER MAF_INT_LAM_ADJ_CDN[2] ECU_ADDRESS 0xd00023be FORMAT "%7.2" /end MEASUREMENT
/begin MEASUREMENT laco[1].laco_struct_reqgntrcdn0.lv_lam_adj_ad_cdn_ok "flag indicating good conditions for WRAF sensor characteristic line adaptation" UBYTE _CNV_S_2_RANGE__0___1_CM 1 100. 0. 1. DISPLAY_IDENTIFIER LV_LAM_ADJ_AD_CDN_OK[2] ECU_ADDRESS 0xd00023c0 BIT_MASK 0x1 /end MEASUREMENT
/begin MEASUREMENT laco[1].laco_struct_reqgntrimad0.lamb_delta_dif_i_lam_adj_ad "trim controI I share shift in case of new adaptation value for WRAF sensor characteristic line shift" SWORD _CNV_A_R_LINEAR_____23_CM 1 100. -0.125 0.125 DISPLAY_IDENTIFIER LAMB_DELTA_DIF_I_LAM_ADJ_AD[2] ECU_ADDRESS 0xd00023c4 FORMAT "%8.5" /end MEASUREMENT
/begin MEASUREMENT laco[1].laco_struct_reqgntrimad0.lamb_delta_sum_lam_adj_ad "total characteristic line shift of WRAF sensor" SWORD _CNV_A_R_LINEAR_____23_CM 1 100. -0.125 0.125 DISPLAY_IDENTIFIER LAMB_DELTA_SUM_LAM_ADJ_AD[2] ECU_ADDRESS 0xd00023c6 FORMAT "%8.5" /end MEASUREMENT
/begin MEASUREMENT laco[1].laco_struct_reqgntrimad0.lamb_delta_ad_lam_adj "adaptation value for WRAF sensor characteritic line shift" SWORD _CNV_A_R_LINEAR_____23_CM 1 100. -0.125 0.125 DISPLAY_IDENTIFIER LAMB_DELTA_AD_LAM_ADJ[2] ECU_ADDRESS 0xd00023c8 FORMAT "%8.5" /end MEASUREMENT
/begin MEASUREMENT laco[1].laco_struct_reqgntrimad0.lamb_delta_bas_lam_adj_ad "basic characteristic line shift of WRAF sensor" SWORD _CNV_A_R_LINEAR_____23_CM 1 100. -0.125 0.125 DISPLAY_IDENTIFIER LAMB_DELTA_BAS_LAM_ADJ_AD[2] ECU_ADDRESS 0xd00023ca FORMAT "%8.5" /end MEASUREMENT
/begin MEASUREMENT laco[1].laco_struct_reqgntrimad0.ctr_raf_chg_lam_adj "counter for lean <-> rich air fuel ratio changes" UBYTE _CNV_A_R_LINEAR_____0_CM 1 100. 0. 255. DISPLAY_IDENTIFIER CTR_RAF_CHG_LAM_ADJ[2] ECU_ADDRESS 0xd00023cc FORMAT "%3.0" /end MEASUREMENT
/begin MEASUREMENT laco[1].laco_struct_reqgntrimad0.lv_lam_adj_ad_req "request for trim control I share shift due to new adaptation value learning" UBYTE _CNV_S_2_RANGE__0___1_CM 1 100. 0. 1. DISPLAY_IDENTIFIER LV_LAM_ADJ_AD_REQ[2] ECU_ADDRESS 0xd00023cd BIT_MASK 0x1 /end MEASUREMENT
/begin MEASUREMENT lv_lam_not_stat_cdn "flag for stop mode activation of lambda controller by wall film" UBYTE _CNV_S_2_RANGE__0___1_CM 1 100. 0. 1. DISPLAY_IDENTIFIER LV_LAM_NOT_STAT_CDN ECU_ADDRESS 0xd0002f23 BIT_MASK 0x1 /end MEASUREMENT
/begin MEASUREMENT t_lam_not_stat_cdn "time counter for lambda controller reactivation after wall film" UWORD _CNV_A_R_LINEAR_____107_CM 1 100. 0. 1310.7 DISPLAY_IDENTIFIER T_LAM_NOT_STAT_CDN ECU_ADDRESS 0xc000257e FORMAT "%7.2" /end MEASUREMENT
/begin CHARACTERISTIC c_maf_int_min_lam_reac "threshold for the air mass flow integral for reactivation of the lambda controller" VALUE 0xa10095de _REC_VAL_20_u2 1820.41666666667 _CNV_A_R_LINEAR_____391_CM 0. 1820.41666666667 DISPLAY_IDENTIFIER C_MAF_INT_MIN_LAM_REAC FORMAT "%7.2" /end CHARACTERISTIC
/begin CHARACTERISTIC ip_t_lam_not_stat_cdn "time threshold to reactivate the lambda controller after wall film" CURVE 0xa1009484 _REC_CUR_20_u2_u1 1310.7 _CNV_A_R_LINEAR_____107_CM 0. 1310.7 DISPLAY_IDENTIFIER IP_T_LAM_NOT_STAT_CDN FORMAT "%7.2"
 /begin AXIS_DESCR COM_AXIS tco _CNV_A_R_LINEAR_____16_CM 6 -48. 142.5 FORMAT "%6.2" AXIS_PTS_REF ldpm_tco_1_laco /end AXIS_DESCR
/end CHARACTERISTIC
/begin CHARACTERISTIC c_t_min_lam_reac "time delay for lambda controller reactivation after stop mode" VALUE 0xa1009610 _REC_VAL_20_u1 5.1 _CNV_A_R_LINEAR_____107_CM 0. 5.1 DISPLAY_IDENTIFIER C_T_MIN_LAM_REAC FORMAT "%4.2" /end CHARACTERISTIC
/begin CHARACTERISTIC ip_fac_neut_max_not_stat_cdn "maximum threshold for detection of non stationary conditions for lambda controller" CURVE 0xa10090f4 _REC_CUR_20_u2_u1 1.999969482421875 _CNV_A_R_LACO_LINEA_393_CM -1. 0.999969482421875 DISPLAY_IDENTIFIER IP_FAC_NEUT_MAX_NOT_STAT_CDN FORMAT "%8.5"
 /begin AXIS_DESCR COM_AXIS tco _CNV_A_R_LINEAR_____16_CM 6 -48. 142.5 FORMAT "%6.2" AXIS_PTS_REF ldpm_tco_1_laco /end AXIS_DESCR
/end CHARACTERISTIC
/begin CHARACTERISTIC ip_fac_neut_min_not_stat_cdn "minimum threshold for detection of non stationary conditions for lambda controller" CURVE 0xa1009100 _REC_CUR_20_u2_u1 1.999969482421875 _CNV_A_R_LACO_LINEA_393_CM -1. 0.999969482421875 DISPLAY_IDENTIFIER IP_FAC_NEUT_MIN_NOT_STAT_CDN FORMAT "%8.5"
 /begin AXIS_DESCR COM_AXIS tco _CNV_A_R_LINEAR_____16_CM 6 -48. 142.5 FORMAT "%6.2" AXIS_PTS_REF ldpm_tco_1_laco /end AXIS_DESCR
/end CHARACTERISTIC
/begin CHARACTERISTIC c_maf_int_min_lam_reac_opt "Optional threshold for the air mass flow integral for reactivation of the lambda controller" VALUE 0xa10095e0 _REC_VAL_20_u2 1820.41666666667 _CNV_A_R_LINEAR_____391_CM 0. 1820.41666666667 DISPLAY_IDENTIFIER C_MAF_INT_MIN_LAM_REAC_OPT FORMAT "%7.2" /end CHARACTERISTIC
/begin CHARACTERISTIC ip_fac_eg_dly_2 "weighting factor for the calculation of the exhaust gas delay" MAP 0xa1009638 _REC_MAP_20_u1_u2_u2 31.875 _CNV_A_R_EGCP_LINEA_370_CM 0. 31.875 DISPLAY_IDENTIFIER IP_FAC_EG_DLY_2 FORMAT "%4.1"
 /begin AXIS_DESCR COM_AXIS n _CNV_A_R_LINEAR_____13_CM 8 0. 8160. FORMAT "%4.0" AXIS_PTS_REF ldpm_n_1_laco /end AXIS_DESCR
 /begin AXIS_DESCR COM_AXIS maf _CNV_A_R_LINEAR_____108_CM 8 0. 1389. FORMAT "%7.2" AXIS_PTS_REF ldpm_maf_1_laco /end AXIS_DESCR
/end CHARACTERISTIC
/begin CHARACTERISTIC ip_t1_lsl_up_1 "first order time lag of the  WRAF sensor model" MAP 0xa1009384 _REC_MAP_20_u2_u2_u2 1.99996948242188 _CNV_A_R_LINEAR_____117_CM 0. 1.99996948242188 DISPLAY_IDENTIFIER IP_T1_LSL_UP_1 FORMAT "%7.5"
 /begin AXIS_DESCR COM_AXIS n _CNV_A_R_LINEAR_____13_CM 8 0. 8160. FORMAT "%4.0" AXIS_PTS_REF ldpm_n_1_laco /end AXIS_DESCR
 /begin AXIS_DESCR COM_AXIS maf _CNV_A_R_LINEAR_____108_CM 8 0. 1389. FORMAT "%7.2" AXIS_PTS_REF ldpm_maf_1_laco /end AXIS_DESCR
/end CHARACTERISTIC
/begin CHARACTERISTIC ip_fac_gain_p_lam "gain of lambda controller P share" MAP 0xa1009010 _REC_MAP_20_u2_u2_u2 15.999755859375 _CNV_A_R_LINEAR_____115_CM 0. 15.999755859375 DISPLAY_IDENTIFIER IP_FAC_GAIN_P_LAM FORMAT "%7.4"
 /begin AXIS_DESCR COM_AXIS online_dummy _CNV_A_R_LINEAR_____375_CM 8 0. 1.023984 FORMAT "%7.5" AXIS_PTS_REF ldpm_t_dly_soi_lsl_pos_1_laco /end AXIS_DESCR
 /begin AXIS_DESCR COM_AXIS online_dummy _CNV_A_R_LINEAR_____117_CM 8 0. 1.99996948242188 FORMAT "%7.5" AXIS_PTS_REF ldpm_t1_lsl_up_1_laco /end AXIS_DESCR
/end CHARACTERISTIC
/begin CHARACTERISTIC ip_fac_gain_i_lam "gain of lambda controller I share" MAP 0xa1008f70 _REC_MAP_20_u2_u2_u2 49.98931900000001 _CNV_A_R_LACO_LINEA_394_CM 9.918e-003 49.999237 DISPLAY_IDENTIFIER IP_FAC_GAIN_I_LAM FORMAT "%7.4"
 /begin AXIS_DESCR COM_AXIS online_dummy _CNV_A_R_LINEAR_____375_CM 8 0. 1.023984 FORMAT "%7.5" AXIS_PTS_REF ldpm_t_dly_soi_lsl_pos_1_laco /end AXIS_DESCR
 /begin AXIS_DESCR COM_AXIS online_dummy _CNV_A_R_LINEAR_____117_CM 8 0. 1.99996948242188 FORMAT "%7.5" AXIS_PTS_REF ldpm_t1_lsl_up_1_laco /end AXIS_DESCR
/end CHARACTERISTIC
/begin CHARACTERISTIC ip_fac_gain_i2_lam "gain of lambda controller I^2 share" MAP 0xa1008ed0 _REC_MAP_20_u2_u2_u2 24.999619 _CNV_A_R_LACO_LINEA_385_CM 0. 24.999619 DISPLAY_IDENTIFIER IP_FAC_GAIN_I2_LAM FORMAT "%7.4"
 /begin AXIS_DESCR COM_AXIS online_dummy _CNV_A_R_LINEAR_____375_CM 8 0. 1.023984 FORMAT "%7.5" AXIS_PTS_REF ldpm_t_dly_soi_lsl_pos_1_laco /end AXIS_DESCR
 /begin AXIS_DESCR COM_AXIS online_dummy _CNV_A_R_LINEAR_____117_CM 8 0. 1.99996948242188 FORMAT "%7.5" AXIS_PTS_REF ldpm_t1_lsl_up_1_laco /end AXIS_DESCR
/end CHARACTERISTIC
/begin CHARACTERISTIC ip_fac_gain_d_lam "gain of lambda controller D share" MAP 0xa1008e30 _REC_MAP_20_u2_u2_u2 3.9999e-002 _CNV_A_R_LACO_LINEA_386_CM 0. 3.9999e-002 DISPLAY_IDENTIFIER IP_FAC_GAIN_D_LAM FORMAT "%8.6"
 /begin AXIS_DESCR COM_AXIS online_dummy _CNV_A_R_LINEAR_____375_CM 8 0. 1.023984 FORMAT "%7.5" AXIS_PTS_REF ldpm_t_dly_soi_lsl_pos_1_laco /end AXIS_DESCR
 /begin AXIS_DESCR COM_AXIS online_dummy _CNV_A_R_LINEAR_____117_CM 8 0. 1.99996948242188 FORMAT "%7.5" AXIS_PTS_REF ldpm_t1_lsl_up_1_laco /end AXIS_DESCR
/end CHARACTERISTIC
/begin CHARACTERISTIC ip_fac_gain_p_lam_gain_swi "gain of lambda controller P share in case of LV_LAM_GAIN_SWI is set " MAP 0xa1009090 _REC_MAP_20_u2_u2_u2 15.999755859375 _CNV_A_R_LINEAR_____115_CM 0. 15.999755859375 DISPLAY_IDENTIFIER IP_FAC_GAIN_P_LAM_GAIN_SWI FORMAT "%7.4"
 /begin AXIS_DESCR COM_AXIS online_dummy _CNV_A_R_LINEAR_____375_CM 4 0. 1.023984 FORMAT "%7.5" AXIS_PTS_REF ldpm_t_dly_soi_lsl_pos_2_laco /end AXIS_DESCR
 /begin AXIS_DESCR COM_AXIS online_dummy _CNV_A_R_LINEAR_____117_CM 4 0. 1.99996948242188 FORMAT "%7.5" AXIS_PTS_REF ldpm_t1_lsl_up_2_laco /end AXIS_DESCR
/end CHARACTERISTIC
/begin CHARACTERISTIC ip_fac_gain_i_lam_gain_swi "gain of lambda controller I share in case of LV_LAM_GAIN_SWI is set " MAP 0xa1008ff0 _REC_MAP_20_u2_u2_u2 49.98931900000001 _CNV_A_R_LACO_LINEA_394_CM 9.918e-003 49.999237 DISPLAY_IDENTIFIER IP_FAC_GAIN_I_LAM_GAIN_SWI FORMAT "%7.4"
 /begin AXIS_DESCR COM_AXIS online_dummy _CNV_A_R_LINEAR_____375_CM 4 0. 1.023984 FORMAT "%7.5" AXIS_PTS_REF ldpm_t_dly_soi_lsl_pos_2_laco /end AXIS_DESCR
 /begin AXIS_DESCR COM_AXIS online_dummy _CNV_A_R_LINEAR_____117_CM 4 0. 1.99996948242188 FORMAT "%7.5" AXIS_PTS_REF ldpm_t1_lsl_up_2_laco /end AXIS_DESCR
/end CHARACTERISTIC
/begin CHARACTERISTIC ip_fac_gain_i2_lam_gain_swi "gain of lambda controller I^2 share in case of LV_LAM_GAIN_SWI is set " MAP 0xa1008f50 _REC_MAP_20_u2_u2_u2 24.999619 _CNV_A_R_LACO_LINEA_385_CM 0. 24.999619 DISPLAY_IDENTIFIER IP_FAC_GAIN_I2_LAM_GAIN_SWI FORMAT "%7.4"
 /begin AXIS_DESCR COM_AXIS online_dummy _CNV_A_R_LINEAR_____375_CM 4 0. 1.023984 FORMAT "%7.5" AXIS_PTS_REF ldpm_t_dly_soi_lsl_pos_2_laco /end AXIS_DESCR
 /begin AXIS_DESCR COM_AXIS online_dummy _CNV_A_R_LINEAR_____117_CM 4 0. 1.99996948242188 FORMAT "%7.5" AXIS_PTS_REF ldpm_t1_lsl_up_2_laco /end AXIS_DESCR
/end CHARACTERISTIC
/begin CHARACTERISTIC ip_fac_gain_d_lam_gain_swi "gain of lambda controller D share in case of LV_LAM_GAIN_SWI is set " MAP 0xa1008eb0 _REC_MAP_20_u2_u2_u2 3.9999e-002 _CNV_A_R_LACO_LINEA_386_CM 0. 3.9999e-002 DISPLAY_IDENTIFIER IP_FAC_GAIN_D_LAM_GAIN_SWI FORMAT "%8.6"
 /begin AXIS_DESCR COM_AXIS online_dummy _CNV_A_R_LINEAR_____375_CM 4 0. 1.023984 FORMAT "%7.5" AXIS_PTS_REF ldpm_t_dly_soi_lsl_pos_2_laco /end AXIS_DESCR
 /begin AXIS_DESCR COM_AXIS online_dummy _CNV_A_R_LINEAR_____117_CM 4 0. 1.99996948242188 FORMAT "%7.5" AXIS_PTS_REF ldpm_t1_lsl_up_2_laco /end AXIS_DESCR
/end CHARACTERISTIC
/begin CHARACTERISTIC id_tco_min_lam_lscl_is "minimum TCO for lambda controller activation at idle speed" CURVE 0xa1008d66 _REC_CUR_20_u1_u1 190.5 _CNV_A_R_LINEAR_____16_CM -48. 142.5 DISPLAY_IDENTIFIER ID_TCO_MIN_LAM_LSCL_IS FORMAT "%6.2"
 /begin AXIS_DESCR COM_AXIS tco_st _CNV_A_R_LINEAR_____16_CM 6 -48. 142.5 FORMAT "%6.2" AXIS_PTS_REF ldpm_tco_st_1_laco /end AXIS_DESCR
/end CHARACTERISTIC
/begin CHARACTERISTIC c_crlc_fac_lam_mv_mmv "correlation constant for the calculation of the filtered controller output mean value FAC_LAM_MV_MMV[i]" VALUE 0xa1009533 _REC_VAL_20_u1 0.99609375 _CNV_A_R_LINEAR_____27_CM 0. 0.99609375 DISPLAY_IDENTIFIER C_CRLC_FAC_LAM_MV_MMV FORMAT "%5.3" /end CHARACTERISTIC
/begin CHARACTERISTIC id_t_max_lscl_act_tco "maximum time value up to that the controller can be activated by TCO condition" CURVE 0xa1008d24 _REC_CUR_20_u2_u1 65534. _CNV_A_R_LINEAR_____35_CM 1. 65535. DISPLAY_IDENTIFIER ID_T_MAX_LSCL_ACT_TCO FORMAT "%5.0"
 /begin AXIS_DESCR COM_AXIS tco_st _CNV_A_R_LINEAR_____16_CM 6 -48. 142.5 FORMAT "%6.2" AXIS_PTS_REF ldpm_tco_st_1_laco /end AXIS_DESCR
/end CHARACTERISTIC
/begin CHARACTERISTIC c_fac_lam_p_max_lam "upper limitation of lambda controller P share" VALUE 0xa1009572 _REC_VAL_20_s2 99.99847412109381 _CNV_A_R_LINEAR_____110_CM -50. 49.9984741210938 DISPLAY_IDENTIFIER C_FAC_LAM_P_MAX_LAM FORMAT "%7.3" /end CHARACTERISTIC
/begin CHARACTERISTIC c_fac_lam_p_min_lam "bottom limitation of lambda controller P share" VALUE 0xa1009576 _REC_VAL_20_s2 99.99847412109381 _CNV_A_R_LINEAR_____110_CM -50. 49.9984741210938 DISPLAY_IDENTIFIER C_FAC_LAM_P_MIN_LAM FORMAT "%7.3" /end CHARACTERISTIC
/begin CHARACTERISTIC c_fac_lam_p_max_lam_cp "upper limitation of lambda controller P share during active canister purge" VALUE 0xa1009574 _REC_VAL_20_s2 99.99847412109381 _CNV_A_R_LINEAR_____110_CM -50. 49.9984741210938 DISPLAY_IDENTIFIER C_FAC_LAM_P_MAX_LAM_CP FORMAT "%7.3" /end CHARACTERISTIC
/begin CHARACTERISTIC c_fac_lam_i_i2_sum_min_lam "bottom limitation of lambda controller I share + I^2 share" VALUE 0xa1009564 _REC_VAL_20_s2 99.99847412109381 _CNV_A_R_LINEAR_____110_CM -50. 49.9984741210938 DISPLAY_IDENTIFIER C_FAC_LAM_I_I2_SUM_MIN_LAM FORMAT "%7.3" /end CHARACTERISTIC
/begin CHARACTERISTIC c_fac_lam_i_i2_sum_max_lam "upper limitation of lambda controller I share + I^2 share" VALUE 0xa1009560 _REC_VAL_20_s2 99.99847412109381 _CNV_A_R_LINEAR_____110_CM -50. 49.9984741210938 DISPLAY_IDENTIFIER C_FAC_LAM_I_I2_SUM_MAX_LAM FORMAT "%7.3" /end CHARACTERISTIC
/begin CHARACTERISTIC c_fac_lam_i_i2_sum_min_lam_cp "bottom limitation of lambda controller I share + I^2 share during active canister purge" VALUE 0xa1009566 _REC_VAL_20_s2 99.99847412109381 _CNV_A_R_LINEAR_____110_CM -50. 49.9984741210938 DISPLAY_IDENTIFIER C_FAC_LAM_I_I2_SUM_MIN_LAM_CP FORMAT "%7.3" /end CHARACTERISTIC
/begin CHARACTERISTIC c_fac_lam_i_i2_sum_max_lam_cp "upper limitation of lambda controller I share + I^2 share during active canister purge" VALUE 0xa1009562 _REC_VAL_20_s2 99.99847412109381 _CNV_A_R_LINEAR_____110_CM -50. 49.9984741210938 DISPLAY_IDENTIFIER C_FAC_LAM_I_I2_SUM_MAX_LAM_CP FORMAT "%7.3" /end CHARACTERISTIC
/begin CHARACTERISTIC c_fac_lam_d_min_lam "bottom limitation of the lambda controller D share" VALUE 0xa100955c _REC_VAL_20_s2 99.99847412109381 _CNV_A_R_LINEAR_____110_CM -50. 49.9984741210938 DISPLAY_IDENTIFIER C_FAC_LAM_D_MIN_LAM FORMAT "%7.3" /end CHARACTERISTIC
/begin CHARACTERISTIC c_fac_lam_d_max_lam "upper limitation of the lambda controller D share" VALUE 0xa100955a _REC_VAL_20_s2 99.99847412109381 _CNV_A_R_LINEAR_____110_CM -50. 49.9984741210938 DISPLAY_IDENTIFIER C_FAC_LAM_D_MAX_LAM FORMAT "%7.3" /end CHARACTERISTIC
/begin CHARACTERISTIC c_n_min_lam_lscl "minimum engine speed for lambda controller activation" VALUE 0xa1009602 _REC_VAL_20_u1 8160. _CNV_A_R_LINEAR_____9_CM 0. 8160. DISPLAY_IDENTIFIER C_N_MIN_LAM_LSCL FORMAT "%4.0" /end CHARACTERISTIC
/begin CHARACTERISTIC c_fac_lam_delta_lscl_off "output signal delta to ramp the output signal to zero in case of deactivated lambda controller" VALUE 0xa100955e _REC_VAL_20_u2 49.9984741210938 _CNV_A_R_LINEAR_____7_CM 0. 49.9984741210938 DISPLAY_IDENTIFIER C_FAC_LAM_DELTA_LSCL_OFF /end CHARACTERISTIC
/begin CHARACTERISTIC lc_lam_i2_act "calibration flag to switch between PII^2D and PID lambda controller" VALUE 0xa1009631 _REC_VAL_20_u1 1. _CNV_A_R_LINEAR_____0_CM 0. 1. DISPLAY_IDENTIFIER LC_LAM_I2_ACT FORMAT "%1.0" /end CHARACTERISTIC
/begin CHARACTERISTIC id_tco_min_lam_lscl "minimum TCO for lambda controller activation" CURVE 0xa1008d60 _REC_CUR_20_u1_u1 190.5 _CNV_A_R_LINEAR_____16_CM -48. 142.5 DISPLAY_IDENTIFIER ID_TCO_MIN_LAM_LSCL FORMAT "%6.2"
 /begin AXIS_DESCR COM_AXIS tco_st _CNV_A_R_LINEAR_____16_CM 6 -48. 142.5 FORMAT "%6.2" AXIS_PTS_REF ldpm_tco_st_1_laco /end AXIS_DESCR
/end CHARACTERISTIC
/begin CHARACTERISTIC c_fac_lam_p_min_lam_cp "bottom limitation of lambda controller P share during active canister purge" VALUE 0xa1009578 _REC_VAL_20_s2 99.99847412109381 _CNV_A_R_LINEAR_____110_CM -50. 49.9984741210938 DISPLAY_IDENTIFIER C_FAC_LAM_P_MIN_LAM_CP FORMAT "%7.3" /end CHARACTERISTIC
/begin CHARACTERISTIC c_fac_lam_out_min "bottom limitation of the lambda controller output" VALUE 0xa100956e _REC_VAL_20_s2 99.99847412109381 _CNV_A_R_LINEAR_____110_CM -50. 49.9984741210938 DISPLAY_IDENTIFIER C_FAC_LAM_OUT_MIN FORMAT "%7.3" /end CHARACTERISTIC
/begin CHARACTERISTIC c_fac_lam_out_min_cp "bottom limitation of the lambda controller output during canister purge ramp open phase" VALUE 0xa1009570 _REC_VAL_20_s2 99.99847412109381 _CNV_A_R_LINEAR_____110_CM -50. 49.9984741210938 DISPLAY_IDENTIFIER C_FAC_LAM_OUT_MIN_CP FORMAT "%7.3" /end CHARACTERISTIC
/begin CHARACTERISTIC c_fac_lam_out_max "upper limitation of the lambda controller output" VALUE 0xa100956a _REC_VAL_20_s2 99.99847412109381 _CNV_A_R_LINEAR_____110_CM -50. 49.9984741210938 DISPLAY_IDENTIFIER C_FAC_LAM_OUT_MAX FORMAT "%7.3" /end CHARACTERISTIC
/begin CHARACTERISTIC c_fac_lam_out_max_cp "upper limitation of the lambda controller output during canister purge ramp open phase" VALUE 0xa100956c _REC_VAL_20_s2 99.99847412109381 _CNV_A_R_LINEAR_____110_CM -50. 49.9984741210938 DISPLAY_IDENTIFIER C_FAC_LAM_OUT_MAX_CP FORMAT "%7.3" /end CHARACTERISTIC
/begin CHARACTERISTIC c_crlc_fac_lam_mv "correlation constant for calculation of the controller output mean value FAC_LAM_MV[i]" VALUE 0xa1009532 _REC_VAL_20_u1 0.99609375 _CNV_A_R_LINEAR_____27_CM 0. 0.99609375 DISPLAY_IDENTIFIER C_CRLC_FAC_LAM_MV FORMAT "%5.3" /end CHARACTERISTIC
/begin CHARACTERISTIC ip_fac_eg_dly_1 "weighting factor for the calculation of the exhaust gas delay" MAP 0xa1008df0 _REC_MAP_20_u1_u2_u2 31.875 _CNV_A_R_EGCP_LINEA_370_CM 0. 31.875 DISPLAY_IDENTIFIER IP_FAC_EG_DLY_1 FORMAT "%4.1"
 /begin AXIS_DESCR COM_AXIS n _CNV_A_R_LINEAR_____13_CM 8 0. 8160. FORMAT "%4.0" AXIS_PTS_REF ldpm_n_1_laco /end AXIS_DESCR
 /begin AXIS_DESCR COM_AXIS maf _CNV_A_R_LINEAR_____108_CM 8 0. 1389. FORMAT "%7.2" AXIS_PTS_REF ldpm_maf_1_laco /end AXIS_DESCR
/end CHARACTERISTIC
/begin CHARACTERISTIC ip_t1_lsl_up_2 "first order time lag of the  WRAF sensor model" MAP 0xa10096f8 _REC_MAP_20_u2_u2_u2 1.99996948242188 _CNV_A_R_LINEAR_____117_CM 0. 1.99996948242188 DISPLAY_IDENTIFIER IP_T1_LSL_UP_2 FORMAT "%7.5"
 /begin AXIS_DESCR COM_AXIS n _CNV_A_R_LINEAR_____13_CM 8 0. 8160. FORMAT "%4.0" AXIS_PTS_REF ldpm_n_1_laco /end AXIS_DESCR
 /begin AXIS_DESCR COM_AXIS maf _CNV_A_R_LINEAR_____108_CM 8 0. 1389. FORMAT "%7.2" AXIS_PTS_REF ldpm_maf_1_laco /end AXIS_DESCR
/end CHARACTERISTIC
/begin CHARACTERISTIC ip_fac_lam_max_not_stat_cdn "upper limit of lambda controller output under non stationary operating conditions" CURVE 0xa10090b0 _REC_CUR_20_u2_u2 99.99847412 _CNV_A_R_LINEAR_____159_CM -50. 49.99847412 DISPLAY_IDENTIFIER IP_FAC_LAM_MAX_NOT_STAT_CDN FORMAT "%7.3"
 /begin AXIS_DESCR COM_AXIS online_dummy _CNV_A_R_LINEAR_____159_CM 8 -50. 49.99847412 FORMAT "%7.3" AXIS_PTS_REF ldpm_fac_lam_mv_1_laco /end AXIS_DESCR
/end CHARACTERISTIC
/begin CHARACTERISTIC ip_fac_lam_min_not_stat_cdn "bottom limit of lambda controller output under non stationary operating conditions" CURVE 0xa10090c0 _REC_CUR_20_u2_u2 99.99847412 _CNV_A_R_LINEAR_____159_CM -50. 49.99847412 DISPLAY_IDENTIFIER IP_FAC_LAM_MIN_NOT_STAT_CDN FORMAT "%7.3"
 /begin AXIS_DESCR COM_AXIS online_dummy _CNV_A_R_LINEAR_____159_CM 8 -50. 49.99847412 FORMAT "%7.3" AXIS_PTS_REF ldpm_fac_lam_mv_1_laco /end AXIS_DESCR
/end CHARACTERISTIC
/begin CHARACTERISTIC ip_t1_lsl_up_agi_lim_1 "first order time lag of the  WRAF sensor model of the aged sensor" MAP 0xa1009404 _REC_MAP_20_u2_u2_u2 1.99996948242188 _CNV_A_R_LINEAR_____117_CM 0. 1.99996948242188 DISPLAY_IDENTIFIER IP_T1_LSL_UP_AGI_LIM_1 FORMAT "%7.5"
 /begin AXIS_DESCR COM_AXIS n _CNV_A_R_LINEAR_____13_CM 8 0. 8160. FORMAT "%4.0" AXIS_PTS_REF ldpm_n_1_laco /end AXIS_DESCR
 /begin AXIS_DESCR COM_AXIS maf _CNV_A_R_LINEAR_____108_CM 8 0. 1389. FORMAT "%7.2" AXIS_PTS_REF ldpm_maf_1_laco /end AXIS_DESCR
/end CHARACTERISTIC
/begin CHARACTERISTIC ip_t1_lsl_up_agi_lim_2 "first order time lag of the  WRAF sensor model of the aged sensor" MAP 0xa1009778 _REC_MAP_20_u2_u2_u2 1.99996948242188 _CNV_A_R_LINEAR_____117_CM 0. 1.99996948242188 DISPLAY_IDENTIFIER IP_T1_LSL_UP_AGI_LIM_2 FORMAT "%7.5"
 /begin AXIS_DESCR COM_AXIS n _CNV_A_R_LINEAR_____13_CM 8 0. 8160. FORMAT "%4.0" AXIS_PTS_REF ldpm_n_1_laco /end AXIS_DESCR
 /begin AXIS_DESCR COM_AXIS maf _CNV_A_R_LINEAR_____108_CM 8 0. 1389. FORMAT "%7.2" AXIS_PTS_REF ldpm_maf_1_laco /end AXIS_DESCR
/end CHARACTERISTIC
/begin AXIS_PTS ldp_maf_int_puc_ip_lamb_sp_the "" 0xa1008acc maf_int_puc_act _REC_AXS_20_u2 2912.666666666671 _CNV_A_R_LINEAR_____329_CM 4 0. 2912.66666666667 FORMAT "%7.2" /end AXIS_PTS
/begin CHARACTERISTIC ip_lamb_sp_the_puc "theoretical lambda setpoint during PUC" CURVE 0xa1009350 _REC_CUR_20_u2_u2 3.99993896484375 _CNV_A_R_LINEAR_____23_CM 0. 3.99993896484375 DISPLAY_IDENTIFIER IP_LAMB_SP_THE_PUC FORMAT "%7.5"
 /begin AXIS_DESCR COM_AXIS maf_int_puc_act _CNV_A_R_LINEAR_____329_CM 4 0. 2912.66666666667 FORMAT "%7.2" AXIS_PTS_REF ldp_maf_int_puc_ip_lamb_sp_the /end AXIS_DESCR
/end CHARACTERISTIC
/begin CHARACTERISTIC id_t_ast_min_lscl_act "minimum time after start that must be elapsed before activating lambda controller" CURVE 0xa1008d00 _REC_CUR_20_u2_u1 6553.5 _CNV_A_R_LINEAR_____4_CM 0. 6553.5 DISPLAY_IDENTIFIER ID_T_AST_MIN_LSCL_ACT FORMAT "%6.1"
 /begin AXIS_DESCR COM_AXIS tco_st _CNV_A_R_LINEAR_____16_CM 6 -48. 142.5 FORMAT "%6.2" AXIS_PTS_REF ldpm_tco_st_1_laco /end AXIS_DESCR
/end CHARACTERISTIC
/begin CHARACTERISTIC c_crlc_vls_down_mmv_lam "correlation constant for the calculation of VLS_DOWN_MMV_LAM[i]" VALUE 0xa1009544 _REC_VAL_20_u1 0.99609375 _CNV_A_R_LINEAR_____27_CM 0. 0.99609375 DISPLAY_IDENTIFIER C_CRLC_VLS_DOWN_MMV_LAM FORMAT "%5.3" /end CHARACTERISTIC
/begin CHARACTERISTIC c_vls_down_thd_afl_lam "lean threshold of downstream sensor signal for I and I^2 share correction" VALUE 0xa1009626 _REC_VAL_20_u2 4.99992371 _CNV_A_R_LINEAR_____190_CM 0. 4.99992371 DISPLAY_IDENTIFIER C_VLS_DOWN_THD_AFL_LAM FORMAT "%7.5" /end CHARACTERISTIC
/begin CHARACTERISTIC c_vls_down_thd_afr_lam "rich threshold of downstream sensor signal for I and I^2 share correction" VALUE 0xa1009628 _REC_VAL_20_u2 4.99992371 _CNV_A_R_LINEAR_____190_CM 0. 4.99992371 DISPLAY_IDENTIFIER C_VLS_DOWN_THD_AFR_LAM FORMAT "%7.5" /end CHARACTERISTIC
/begin CHARACTERISTIC c_tout_i_i2_shift_vld "time out for I and I^2 share shift based on downstream signal evaluation" VALUE 0xa1009624 _REC_VAL_20_u2 1310.7 _CNV_A_R_LINEAR_____107_CM 0. 1310.7 DISPLAY_IDENTIFIER C_TOUT_I_I2_SHIFT_VLD FORMAT "%7.2" /end CHARACTERISTIC
/begin CHARACTERISTIC c_crlc_fac_dif_lam_in_mmv "correlation constant for the calculation of FAC_DIF_LAM_IN_MMV[i]" VALUE 0xa1009531 _REC_VAL_20_u1 0.99609375 _CNV_A_R_LINEAR_____27_CM 0. 0.99609375 DISPLAY_IDENTIFIER C_CRLC_FAC_DIF_LAM_IN_MMV FORMAT "%5.3" /end CHARACTERISTIC
/begin CHARACTERISTIC c_crlc_fac_lam_mv_mmv_ldc "correlation constant for the calculation of moving mean value for limited dynamics detection" VALUE 0xa1009534 _REC_VAL_20_u1 0.99609375 _CNV_A_R_LINEAR_____27_CM 0. 0.99609375 DISPLAY_IDENTIFIER C_CRLC_FAC_LAM_MV_MMV_LDC FORMAT "%5.3" /end CHARACTERISTIC
/begin CHARACTERISTIC c_crlc_fac_lam_mv_mmv_ldc_diag "correlation constant for mean value calculation of lambda controller output, used by limited dynamics for cat efficiency diagnosis" VALUE 0xa1009535 _REC_VAL_20_u1 0.99609375 _CNV_A_R_LINEAR_____27_CM 0. 0.99609375 DISPLAY_IDENTIFIER C_CRLC_FAC_LAM_MV_MMV_LDC_DIAG FORMAT "%5.3" /end CHARACTERISTIC
/begin MEASUREMENT lv_lam_i2_act "flag to switch between PII^2D and PID lambda controller" UBYTE _CNV_S_2_RANGE__0___1_CM 1 100. 0. 1. DISPLAY_IDENTIFIER LV_LAM_I2_ACT ECU_ADDRESS 0xc0002585 BIT_MASK 0x1 /end MEASUREMENT
/begin MEASUREMENT mff_add_cp "Canister Purge Fuel Mass correction corresponding to Lambda Factor Shift" UWORD _CNV_A_R_LINEAR_____108_CM 1 100. 0. 1389. DISPLAY_IDENTIFIER MFF_ADD_CP ECU_ADDRESS 0xd0002b6c FORMAT "%7.2" /end MEASUREMENT
/begin MEASUREMENT lv_lam_gain_swi " lambda controller gain switch for idle speed" UBYTE _CNV_S_2_RANGE__0___1_CM 1 100. 0. 1. DISPLAY_IDENTIFIER LV_LAM_GAIN_SWI ECU_ADDRESS 0xd0002f22 BIT_MASK 0x1 /end MEASUREMENT
/begin CHARACTERISTIC c_lam_maf_min_hys "Hysteresis for minimum MAF - threshold for lambda control" VALUE 0xa1009582 _REC_VAL_20_u2 1389. _CNV_A_R_LINEAR_____108_CM 0. 1389. DISPLAY_IDENTIFIER C_LAM_MAF_MIN_HYS FORMAT "%7.2" /end CHARACTERISTIC
/begin CHARACTERISTIC lc_lam_gain_swi "flag indicating whether lambda controller parameter switch is allowed" VALUE 0xa1009630 _REC_VAL_20_u1 1. _CNV_S_2_RANGE__0___1_CM 0. 1. DISPLAY_IDENTIFIER LC_LAM_GAIN_SWI /end CHARACTERISTIC
/begin CHARACTERISTIC lc_hom_act_comp "switching variable for the open loop/closed loop operation in stratified mode" VALUE 0xa100962c _REC_VAL_20_u1 1. _CNV_S_2_RANGE__0___1_CM 0. 1. DISPLAY_IDENTIFIER LC_HOM_ACT_COMP /end CHARACTERISTIC
/begin CHARACTERISTIC lc_lam_off_sawup "switching variable for the open loop/closed loop operation at secondary air" VALUE 0xa1009632 _REC_VAL_20_u1 1. _CNV_S_2_RANGE__0___1_CM 0. 1. DISPLAY_IDENTIFIER LC_LAM_OFF_SAWUP /end CHARACTERISTIC
/begin CHARACTERISTIC lc_lamb_cop_off "switch to disable the cat-heating-lambda control deactivation condition" VALUE 0xa1009633 _REC_VAL_20_u1 1. _CNV_S_2_RANGE__0___1_CM 0. 1. DISPLAY_IDENTIFIER LC_LAMB_COP_OFF /end CHARACTERISTIC
/begin CHARACTERISTIC ip_lam_maf_min "Minimum MAF - threshold for lambda control" CURVE 0xa1009144 _REC_CUR_20_u2_u2 1389. _CNV_A_R_LINEAR_____108_CM 0. 1389. DISPLAY_IDENTIFIER IP_LAM_MAF_MIN FORMAT "%7.2"
 /begin AXIS_DESCR COM_AXIS n _CNV_A_R_LINEAR_____13_CM 6 0. 8160. FORMAT "%4.0" AXIS_PTS_REF ldp_n_lam_maf_min /end AXIS_DESCR
/end CHARACTERISTIC
/begin AXIS_PTS ldp_n_lam_maf_min "" 0xa1008b54 n _REC_AXS_20_u2 8160. _CNV_A_R_LINEAR_____13_CM 6 0. 8160. FORMAT "%4.0" /end AXIS_PTS
/begin CHARACTERISTIC c_n_dyw_lam_not_stat "engine speed window for detection of non stationary condition" VALUE 0xa10095f8 _REC_VAL_20_u2 8160. _CNV_A_R_LINEAR_____13_CM 0. 8160. DISPLAY_IDENTIFIER C_N_DYW_LAM_NOT_STAT FORMAT "%4.0" /end CHARACTERISTIC
/begin CHARACTERISTIC c_maf_dyw_lam_not_stat "air mass flow window for detection of non stationary condition" VALUE 0xa10095c4 _REC_VAL_20_u2 1389. _CNV_A_R_LINEAR_____108_CM 0. 1389. DISPLAY_IDENTIFIER C_MAF_DYW_LAM_NOT_STAT FORMAT "%7.2" /end CHARACTERISTIC
/begin CHARACTERISTIC c_pv_av_dyw_lam_not_stat "pedal value window for detection of non stationary condition" VALUE 0xa100960a _REC_VAL_20_u1 99.609375 _CNV_A_R_LINEAR_____5_CM 0. 99.609375 DISPLAY_IDENTIFIER C_PV_AV_DYW_LAM_NOT_STAT FORMAT "%4.1" /end CHARACTERISTIC
/begin CHARACTERISTIC c_maf_int_lam_not_stat "air mass flow integral for detection of non stationary condition" VALUE 0xa10095da _REC_VAL_20_u2 1820.42 _CNV_A_R_LINEAR_____356_CM 0. 1820.42 DISPLAY_IDENTIFIER C_MAF_INT_LAM_NOT_STAT FORMAT "%7.2" /end CHARACTERISTIC
/begin MEASUREMENT n_ofs_lam_not_stat "engine speed offset for detection of non stationary condition" SWORD _CNV_A_R_LINEAR_____13_CM 1 100. -8160. 8160. DISPLAY_IDENTIFIER N_OFS_LAM_NOT_STAT ECU_ADDRESS 0xc000257c FORMAT "%5.0" /end MEASUREMENT
/begin MEASUREMENT maf_ofs_lam_not_stat "air mass flow offset for detection of non stationary condition" SWORD _CNV_A_R_LINEAR_____202_CM 1 100. -694.510597390707 694.4894026092931 DISPLAY_IDENTIFIER MAF_OFS_LAM_NOT_STAT ECU_ADDRESS 0xc0002578 FORMAT "%7.2" /end MEASUREMENT
/begin MEASUREMENT pv_av_ofs_lam_not_stat "actual pedal value offset for detection of non stationary condition" SBYTE _CNV_A_R_LINEAR_____5_CM 1 100. -50. 49.609375 DISPLAY_IDENTIFIER PV_AV_OFS_LAM_NOT_STAT ECU_ADDRESS 0xc0002581 FORMAT "%5.1" /end MEASUREMENT
/begin MEASUREMENT maf_int_lam_not_stat "air mass flow integral for detection of non stationary condition" UWORD _CNV_A_R_LINEAR_____217_CM 1 100. 0. 1820.4167 DISPLAY_IDENTIFIER MAF_INT_LAM_NOT_STAT ECU_ADDRESS 0xc0002574 FORMAT "%9.4" /end MEASUREMENT
/begin MEASUREMENT fac_neut_not_stat_cdn "detection of non stationary condition" SWORD _CNV_A_R_LINEAR_____275_CM 1 100. -1. 0.999969482421875 DISPLAY_IDENTIFIER FAC_NEUT_NOT_STAT_CDN ECU_ADDRESS 0xd0002b68 FORMAT "%8.5" /end MEASUREMENT
/begin CHARACTERISTIC c_lamb_sp_afr_thd "rich air-fuel mixture setpoint threshold" VALUE 0xa10095ba _REC_VAL_20_u2 1. _CNV_A_R_LINEAR_____122_CM 0. 1. DISPLAY_IDENTIFIER C_LAMB_SP_AFR_THD FORMAT "%6.4" /end CHARACTERISTIC
/begin CHARACTERISTIC c_lamb_sp_afl_thd "lean air-fuel mixture setpoint threshold" VALUE 0xa10095b6 _REC_VAL_20_u2 3. _CNV_A_R_LINEAR_____122_CM 1. 4. DISPLAY_IDENTIFIER C_LAMB_SP_AFL_THD FORMAT "%5.3" /end CHARACTERISTIC
/begin CHARACTERISTIC c_lamb_sp_afr_thd_hys "rich air-fuel mixture setpoint threshold hysteresis" VALUE 0xa10095bc _REC_VAL_20_u2 1. _CNV_A_R_LINEAR_____122_CM 0. 1. DISPLAY_IDENTIFIER C_LAMB_SP_AFR_THD_HYS FORMAT "%6.4" /end CHARACTERISTIC
/begin CHARACTERISTIC c_lamb_sp_afl_thd_hys "lean air-fuel mixture setpoint threshold hysteresis" VALUE 0xa10095b8 _REC_VAL_20_u2 1. _CNV_A_R_LINEAR_____122_CM 0. 1. DISPLAY_IDENTIFIER C_LAMB_SP_AFL_THD_HYS FORMAT "%6.4" /end CHARACTERISTIC
/begin CHARACTERISTIC c_lamb_dif_av_ctl_st_max "max. allowable lambda deviation at initialisation of lambda difference for the lambda controller" VALUE 0xa1009596 _REC_VAL_20_s2 0.25 _CNV_A_R_LINEAR_____23_CM -0.125 0.125 DISPLAY_IDENTIFIER C_LAMB_DIF_AV_CTL_ST_MAX FORMAT "%8.5" /end CHARACTERISTIC
/begin CHARACTERISTIC c_lamb_dif_av_ctl_st_max_is "max. allowable lambda deviation at initialisation of lambda difference for the lambda controller in IS" VALUE 0xa1009598 _REC_VAL_20_s2 0.25 _CNV_A_R_LINEAR_____23_CM -0.125 0.125 DISPLAY_IDENTIFIER C_LAMB_DIF_AV_CTL_ST_MAX_IS FORMAT "%8.5" /end CHARACTERISTIC
/begin CHARACTERISTIC c_lamb_dif_av_ctl_st_min "min. allowable lambda deviation at initialisation of lambda difference for the lambda controller" VALUE 0xa100959a _REC_VAL_20_s2 0.25 _CNV_A_R_LINEAR_____23_CM -0.125 0.125 DISPLAY_IDENTIFIER C_LAMB_DIF_AV_CTL_ST_MIN FORMAT "%8.5" /end CHARACTERISTIC
/begin CHARACTERISTIC c_lamb_dif_av_ctl_st_min_is "min. allowable lambda deviation at initialisation of lambda difference for the lambda controller in IS" VALUE 0xa100959c _REC_VAL_20_s2 0.25 _CNV_A_R_LINEAR_____23_CM -0.125 0.125 DISPLAY_IDENTIFIER C_LAMB_DIF_AV_CTL_ST_MIN_IS FORMAT "%8.5" /end CHARACTERISTIC
/begin CHARACTERISTIC c_lgrd_lamb_dif_av_ctl_st "limitation gradient of lambda deviation at initialisation of lambda difference for the lambda controller" VALUE 0xa10095c2 _REC_VAL_20_s2 0.25 _CNV_A_R_LINEAR_____23_CM -0.125 0.125 DISPLAY_IDENTIFIER C_LGRD_LAMB_DIF_AV_CTL_ST FORMAT "%8.5" /end CHARACTERISTIC
/begin MEASUREMENT lv_lamb_sp_afr_thd[0] "flag indicating that lambda setpoint is too rich and therefore the lambda controller is inhibited" UBYTE _CNV_S_2_RANGE__0___1_CM 1 100. 0. 1. DISPLAY_IDENTIFIER LV_LAMB_SP_AFR_THD[1] ECU_ADDRESS 0xc00025e8 /end MEASUREMENT
/begin MEASUREMENT lv_lamb_sp_afr_thd[1] "flag indicating that lambda setpoint is too rich and therefore the lambda controller is inhibited" UBYTE _CNV_S_2_RANGE__0___1_CM 1 100. 0. 1. DISPLAY_IDENTIFIER LV_LAMB_SP_AFR_THD[2] ECU_ADDRESS 0xc00025e9 /end MEASUREMENT
/begin MEASUREMENT lv_lamb_sp_afl_thd[0] "flag indicating that lambda setpoint is too lean and therefore the lambda controller is inhibited" UBYTE _CNV_S_2_RANGE__0___1_CM 1 100. 0. 1. DISPLAY_IDENTIFIER LV_LAMB_SP_AFL_THD[1] ECU_ADDRESS 0xc00025ea /end MEASUREMENT
/begin MEASUREMENT lv_lamb_sp_afl_thd[1] "flag indicating that lambda setpoint is too lean and therefore the lambda controller is inhibited" UBYTE _CNV_S_2_RANGE__0___1_CM 1 100. 0. 1. DISPLAY_IDENTIFIER LV_LAMB_SP_AFL_THD[2] ECU_ADDRESS 0xc00025eb /end MEASUREMENT
/begin MEASUREMENT lgrd_lamb_dif_av_ctl_st_in "only for test use" SWORD _CNV_A_R_LINEAR_____23_CM 1 100. -0.125 0.125 DISPLAY_IDENTIFIER LGRD_LAMB_DIF_AV_CTL_ST_IN ECU_ADDRESS 0xc00025e4 FORMAT "%8.5" /end MEASUREMENT
/begin MEASUREMENT lamb_dif_av_ctl_st_in[0] "Start lambda difference for lambda ctl" SWORD _CNV_A_R_LINEAR_____23_CM 1 100. -0.125 0.125 DISPLAY_IDENTIFIER LAMB_DIF_AV_CTL_ST_IN[1] ECU_ADDRESS 0xc00025dc FORMAT "%8.5" /end MEASUREMENT
/begin MEASUREMENT lamb_dif_av_ctl_st_in[1] "Start lambda difference for lambda ctl" SWORD _CNV_A_R_LINEAR_____23_CM 1 100. -0.125 0.125 DISPLAY_IDENTIFIER LAMB_DIF_AV_CTL_ST_IN[2] ECU_ADDRESS 0xc00025de FORMAT "%8.5" /end MEASUREMENT
/begin MEASUREMENT lamb_dif_av_ctl_st_out[0] "Lambda offset in case of first lambda ctl start in DC" SWORD _CNV_A_R_LINEAR_____23_CM 1 100. -0.125 0.125 DISPLAY_IDENTIFIER LAMB_DIF_AV_CTL_ST_OUT[1] ECU_ADDRESS 0xc00025e0 FORMAT "%8.5" /end MEASUREMENT
/begin MEASUREMENT lamb_dif_av_ctl_st_out[1] "Lambda offset in case of first lambda ctl start in DC" SWORD _CNV_A_R_LINEAR_____23_CM 1 100. -0.125 0.125 DISPLAY_IDENTIFIER LAMB_DIF_AV_CTL_ST_OUT[2] ECU_ADDRESS 0xc00025e2 FORMAT "%8.5" /end MEASUREMENT
/begin MEASUREMENT lv_clc_lamb_dif_av_st " lambda controller gain switch for idle speed" UBYTE _CNV_S_2_RANGE__0___1_CM 1 100. 0. 1. DISPLAY_IDENTIFIER LV_CLC_LAMB_DIF_AV_ST ECU_ADDRESS 0xc00025ed BIT_MASK 0x1 /end MEASUREMENT
/begin MEASUREMENT lv_maf_int_min_lam_reac_swi "Booelan flag to switch limit of MAF_int_min_lam_reac" UBYTE _CNV_S_2_RANGE__0___1_CM 1 100. 0. 1. DISPLAY_IDENTIFIER LV_MAF_INT_MIN_LAM_REAC_SWI ECU_ADDRESS 0xd0002f25 BIT_MASK 0x1 /end MEASUREMENT
/begin CHARACTERISTIC c_temp_cat_min_lam_adj_act "minimum cat temperature threshold for trim control activation" VALUE 0xa1009620 _REC_VAL_20_u2 2047.9375 _CNV_A_R_LINEAR_____204_CM -273.15 1774.7875 DISPLAY_IDENTIFIER C_TEMP_CAT_MIN_LAM_ADJ_ACT FORMAT "%9.4" /end CHARACTERISTIC
/begin CHARACTERISTIC ip_maf_min_lam_adj_i_act "Min MAF threshold for activation I-share" CURVE 0xa100935e _REC_CUR_20_u1_u1 1389. _CNV_A_R_LINEAR_____14_CM 0. 1389. DISPLAY_IDENTIFIER IP_MAF_MIN_LAM_ADJ_I_ACT FORMAT "%4.0"
 /begin AXIS_DESCR COM_AXIS n_32 _CNV_A_R_LINEAR_____9_CM 6 0. 8160. FORMAT "%4.0" AXIS_PTS_REF ldpm_n_32_2_laco /end AXIS_DESCR
/end CHARACTERISTIC
/begin CHARACTERISTIC ip_maf_max_lam_adj_i_act "Max MAF threshold for activation I-share" CURVE 0xa1009358 _REC_CUR_20_u1_u1 1389. _CNV_A_R_LINEAR_____14_CM 0. 1389. DISPLAY_IDENTIFIER IP_MAF_MAX_LAM_ADJ_I_ACT FORMAT "%4.0"
 /begin AXIS_DESCR COM_AXIS n_32 _CNV_A_R_LINEAR_____9_CM 6 0. 8160. FORMAT "%4.0" AXIS_PTS_REF ldpm_n_32_2_laco /end AXIS_DESCR
/end CHARACTERISTIC
/begin CHARACTERISTIC ip_vls_sp_lam_adj_1 "sensor voltage set point for trim control" MAP 0xa10094b0 _REC_MAP_20_u2_u1_u1 4.9951171875 _CNV_A_R_LINEAR_____2_CM 0. 4.9951171875 DISPLAY_IDENTIFIER IP_VLS_SP_LAM_ADJ_1 FORMAT "%5.3"
 /begin AXIS_DESCR COM_AXIS NO_INPUT_QUANTITY _CNV_A_R_LINEAR_____14_CM 8 0. 1389. FORMAT "%4.0" AXIS_PTS_REF ldp_maf_hb_ip_vls_sp_lam_adj /end AXIS_DESCR
 /begin AXIS_DESCR COM_AXIS n_32 _CNV_A_R_LINEAR_____9_CM 8 0. 8160. FORMAT "%4.0" AXIS_PTS_REF ldp_n_32_ip_vls_sp_lam_adj /end AXIS_DESCR
/end CHARACTERISTIC
/begin CHARACTERISTIC ip_crlc_lamb_delta_i_lam_adj "air mass flow dependent weighting coefficient for trim control I share calculation" CURVE 0xa1008d6c _REC_CUR_20_u2_u2 0.9999847412109381 _CNV_A_R_LINEAR_____68_CM 0. 0.9999847412109381 DISPLAY_IDENTIFIER IP_CRLC_LAMB_DELTA_I_LAM_ADJ FORMAT "%7.5"
 /begin AXIS_DESCR COM_AXIS maf_cyl _CNV_A_R_LINEAR_____207_CM 6 0. 2047.96875 FORMAT "%10.5" AXIS_PTS_REF ldpm_maf_cyl_1_laco /end AXIS_DESCR
/end CHARACTERISTIC
/begin AXIS_PTS ldp_maf_hb_ip_vls_sp_lam_adj "" 0xa1008ac0 NO_INPUT_QUANTITY _REC_AXS_20_u1 1389. _CNV_A_R_LINEAR_____14_CM 8 0. 1389. FORMAT "%4.0" /end AXIS_PTS
/begin AXIS_PTS ldp_n_32_ip_vls_sp_lam_adj "" 0xa1008b48 n_32 _REC_AXS_20_u1 8160. _CNV_A_R_LINEAR_____9_CM 8 0. 8160. FORMAT "%4.0" /end AXIS_PTS
/begin CHARACTERISTIC ip_lamb_delta_p_lam_adj "characteristic line of trim control P share" CURVE 0xa1009310 _REC_CUR_20_u2_u2 0.25 _CNV_A_R_LACO_LINEA_395_CM -0.125 0.125 DISPLAY_IDENTIFIER IP_LAMB_DELTA_P_LAM_ADJ FORMAT "%8.5"
 /begin AXIS_DESCR COM_AXIS online_dummy _CNV_A_R_LACO_LINEA_376_CM 16 -5. 4.99511719 AXIS_PTS_REF ldpm_vls_dif_lam_adj_1_laco /end AXIS_DESCR
/end CHARACTERISTIC
/begin CHARACTERISTIC ip_lamb_delta_i_lam_adj "characteristic line of trim control I share" CURVE 0xa10091f0 _REC_CUR_20_u2_u2 0.249996185302734 _CNV_A_R_LACO_LINEA_396_CM -0.125 0.124996185302734 DISPLAY_IDENTIFIER IP_LAMB_DELTA_I_LAM_ADJ FORMAT "%8.6"
 /begin AXIS_DESCR COM_AXIS online_dummy _CNV_A_R_LACO_LINEA_376_CM 16 -5. 4.99511719 AXIS_PTS_REF ldpm_vls_dif_lam_adj_1_laco /end AXIS_DESCR
/end CHARACTERISTIC
/begin CHARACTERISTIC c_lamb_delta_i_min_lam_adj "bottom limit of trim control I share" VALUE 0xa100958c _REC_VAL_20_s2 0.25 _CNV_A_R_LINEAR_____23_CM -0.125 0.125 DISPLAY_IDENTIFIER C_LAMB_DELTA_I_MIN_LAM_ADJ FORMAT "%8.5" /end CHARACTERISTIC
/begin CHARACTERISTIC c_lamb_delta_i_max_lam_adj "upper limit of trim control I share" VALUE 0xa100958a _REC_VAL_20_s2 0.25 _CNV_A_R_LINEAR_____23_CM -0.125 0.125 DISPLAY_IDENTIFIER C_LAMB_DELTA_I_MAX_LAM_ADJ FORMAT "%8.5" /end CHARACTERISTIC
/begin CHARACTERISTIC c_crlc_lamb_delta_i_mmv_lam_adj "correlation constant for trim control I share moving mean value calculation for adaptation value" VALUE 0xa100953c _REC_VAL_20_u2 0.9999847412109381 _CNV_A_R_LINEAR_____68_CM 0. 0.9999847412109381 DISPLAY_IDENTIFIER C_CRLC_LAMB_DELTA_I_MMV_LAM_ADJ FORMAT "%7.5" /end CHARACTERISTIC
/begin CHARACTERISTIC c_eff_cat_diag_max_lam_adj_act "catalyst diagnosis value threshold for trim control activation" VALUE 0xa1009548 _REC_VAL_20_u1 1.9921875 _CNV_A_R_LINEAR_____100_CM 0. 1.9921875 DISPLAY_IDENTIFIER C_EFF_CAT_DIAG_MAX_LAM_ADJ_ACT FORMAT "%8.6" /end CHARACTERISTIC
/begin CHARACTERISTIC ip_vls_sp_lam_adj_2 "sensor voltage set point for trim control" MAP 0xa10097f8 _REC_MAP_20_u2_u1_u1 4.9951171875 _CNV_A_R_LINEAR_____2_CM 0. 4.9951171875 DISPLAY_IDENTIFIER IP_VLS_SP_LAM_ADJ_2 FORMAT "%5.3"
 /begin AXIS_DESCR COM_AXIS NO_INPUT_QUANTITY _CNV_A_R_LINEAR_____14_CM 8 0. 1389. FORMAT "%4.0" AXIS_PTS_REF ldp_maf_hb_ip_vls_sp_lam_adj /end AXIS_DESCR
 /begin AXIS_DESCR COM_AXIS n_32 _CNV_A_R_LINEAR_____9_CM 8 0. 8160. FORMAT "%4.0" AXIS_PTS_REF ldp_n_32_ip_vls_sp_lam_adj /end AXIS_DESCR
/end CHARACTERISTIC
/begin CHARACTERISTIC c_maf_int_lam_adj_i_act_slow "air mass flow integral threshold for slow trim control I share reactivation" VALUE 0xa10095d2 _REC_VAL_20_u2 1456.33 _CNV_A_R_LACO_LINEA_390_CM 0. 1456.33 DISPLAY_IDENTIFIER C_MAF_INT_LAM_ADJ_I_ACT_SLOW FORMAT "%7.2" /end CHARACTERISTIC
/begin CHARACTERISTIC c_maf_int_lam_adj_p_act_slow "air mass flow integral threshold for slow trim control P share reactivation" VALUE 0xa10095d8 _REC_VAL_20_u2 1456.33 _CNV_A_R_LACO_LINEA_390_CM 0. 1456.33 DISPLAY_IDENTIFIER C_MAF_INT_LAM_ADJ_P_ACT_SLOW FORMAT "%7.2" /end CHARACTERISTIC
/begin CHARACTERISTIC c_maf_int_lam_adj_i_act_fast "air mass flow integral threshold for fast trim control I share reactivation" VALUE 0xa10095ce _REC_VAL_20_u2 1456.33 _CNV_A_R_LACO_LINEA_390_CM 0. 1456.33 DISPLAY_IDENTIFIER C_MAF_INT_LAM_ADJ_I_ACT_FAST FORMAT "%7.2" /end CHARACTERISTIC
/begin CHARACTERISTIC c_maf_int_lam_adj_i_act_purge "air mass flow integral threshold for trim control I share reactivation after cat purge" VALUE 0xa10095d0 _REC_VAL_20_u2 1456.33 _CNV_A_R_LACO_LINEA_390_CM 0. 1456.33 DISPLAY_IDENTIFIER C_MAF_INT_LAM_ADJ_I_ACT_PURGE FORMAT "%7.2" /end CHARACTERISTIC
/begin CHARACTERISTIC c_maf_int_lam_adj_p_act_fast "air mass flow integral threshold for fast trim control P share reactivation" VALUE 0xa10095d4 _REC_VAL_20_u2 1456.33 _CNV_A_R_LACO_LINEA_390_CM 0. 1456.33 DISPLAY_IDENTIFIER C_MAF_INT_LAM_ADJ_P_ACT_FAST FORMAT "%7.2" /end CHARACTERISTIC
/begin CHARACTERISTIC c_maf_int_lam_adj_p_act_purge "air mass flow integral threshold for trim control P share reactivation after cat purge" VALUE 0xa10095d6 _REC_VAL_20_u2 1456.33 _CNV_A_R_LACO_LINEA_390_CM 0. 1456.33 DISPLAY_IDENTIFIER C_MAF_INT_LAM_ADJ_P_ACT_PURGE FORMAT "%7.2" /end CHARACTERISTIC
/begin CHARACTERISTIC lc_lam_adj_i_save_cat_diag "flag indicating that I share after cat diagnosis is set to the value before cat diagnosis" VALUE 0xa100962e _REC_VAL_20_u1 1. _CNV_A_R_LINEAR_____0_CM 0. 1. DISPLAY_IDENTIFIER LC_LAM_ADJ_I_SAVE_CAT_DIAG FORMAT "%1.0" /end CHARACTERISTIC
/begin CHARACTERISTIC c_tco_lam_adj_p_act_hst "TCO threshold for hot start detection to immediately active trim control P share" VALUE 0xa100961c _REC_VAL_20_u1 190.5 _CNV_A_R_LINEAR_____16_CM -48. 142.5 DISPLAY_IDENTIFIER C_TCO_LAM_ADJ_P_ACT_HST FORMAT "%6.2" /end CHARACTERISTIC
/begin CHARACTERISTIC c_t_ast_lam_adj_p_act_hst "T_AST threshold for hot start detection to immediately active trim control P share " VALUE 0xa100960c _REC_VAL_20_u2 6553.5 _CNV_A_R_LINEAR_____4_CM 0. 6553.5 DISPLAY_IDENTIFIER C_T_AST_LAM_ADJ_P_ACT_HST FORMAT "%6.1" /end CHARACTERISTIC
/begin CHARACTERISTIC c_lamb_sp_min_lam_adj_act "minimum lambda set point for trim control activation" VALUE 0xa10095c0 _REC_VAL_20_u2 1.99993896484375 _CNV_A_R_LINEAR_____23_CM 0. 1.99993896484375 DISPLAY_IDENTIFIER C_LAMB_SP_MIN_LAM_ADJ_ACT FORMAT "%7.5" /end CHARACTERISTIC
/begin CHARACTERISTIC c_lamb_sp_max_lam_adj_act "maximun lambda set point for trim control activation" VALUE 0xa10095be _REC_VAL_20_u2 1.99993896484375 _CNV_A_R_LINEAR_____23_CM 0. 1.99993896484375 DISPLAY_IDENTIFIER C_LAMB_SP_MAX_LAM_ADJ_ACT FORMAT "%7.5" /end CHARACTERISTIC
/begin CHARACTERISTIC c_maf_int_lam_adj_d_act_fast "air mass flow integral threshold for fast trim control D share reactivation" VALUE 0xa10095c8 _REC_VAL_20_u2 1456.33 _CNV_A_R_LACO_LINEA_390_CM 0. 1456.33 DISPLAY_IDENTIFIER C_MAF_INT_LAM_ADJ_D_ACT_FAST FORMAT "%7.2" /end CHARACTERISTIC
/begin CHARACTERISTIC c_maf_int_lam_adj_d_act_purge "air mass flow integral threshold for trim control D share reactivation after cat purge" VALUE 0xa10095ca _REC_VAL_20_u2 1456.33 _CNV_A_R_LACO_LINEA_390_CM 0. 1456.33 DISPLAY_IDENTIFIER C_MAF_INT_LAM_ADJ_D_ACT_PURGE FORMAT "%7.2" /end CHARACTERISTIC
/begin CHARACTERISTIC c_maf_int_lam_adj_d_act_slow "air mass flow integral threshold for slow trim control D share reactivation" VALUE 0xa10095cc _REC_VAL_20_u2 1456.33 _CNV_A_R_LACO_LINEA_390_CM 0. 1456.33 DISPLAY_IDENTIFIER C_MAF_INT_LAM_ADJ_D_ACT_SLOW FORMAT "%7.2" /end CHARACTERISTIC
/begin CHARACTERISTIC c_maf_max_lam_adj_p_act "maximum air mass flow threshold for trim control P share calculation" VALUE 0xa10095ec _REC_VAL_20_u1 1389. _CNV_A_R_LINEAR_____14_CM 0. 1389. DISPLAY_IDENTIFIER C_MAF_MAX_LAM_ADJ_P_ACT FORMAT "%4.0" /end CHARACTERISTIC
/begin CHARACTERISTIC c_maf_max_lam_adj_d_act "maximum air mass flow threshold for trim control D share calculation" VALUE 0xa10095eb _REC_VAL_20_u1 1389. _CNV_A_R_LINEAR_____14_CM 0. 1389. DISPLAY_IDENTIFIER C_MAF_MAX_LAM_ADJ_D_ACT FORMAT "%4.0" /end CHARACTERISTIC
/begin CHARACTERISTIC c_maf_min_lam_adj_p_act "minimum air mass flow threshold for trim control P share calculation" VALUE 0xa10095ef _REC_VAL_20_u1 1389. _CNV_A_R_LINEAR_____14_CM 0. 1389. DISPLAY_IDENTIFIER C_MAF_MIN_LAM_ADJ_P_ACT FORMAT "%4.0" /end CHARACTERISTIC
/begin CHARACTERISTIC c_maf_min_lam_adj_d_act "minimum air mass flow threshold for trim control D share calculation" VALUE 0xa10095ee _REC_VAL_20_u1 1389. _CNV_A_R_LINEAR_____14_CM 0. 1389. DISPLAY_IDENTIFIER C_MAF_MIN_LAM_ADJ_D_ACT FORMAT "%4.0" /end CHARACTERISTIC
/begin CHARACTERISTIC c_n_max_lam_adj_p_act "maximum engine speed threshold for trim control P share calculation" VALUE 0xa10095fe _REC_VAL_20_u1 8160. _CNV_A_R_LINEAR_____9_CM 0. 8160. DISPLAY_IDENTIFIER C_N_MAX_LAM_ADJ_P_ACT FORMAT "%4.0" /end CHARACTERISTIC
/begin CHARACTERISTIC c_n_max_lam_adj_d_act "maximum engine speed threshold for trim control D share calculation" VALUE 0xa10095fd _REC_VAL_20_u1 8160. _CNV_A_R_LINEAR_____9_CM 0. 8160. DISPLAY_IDENTIFIER C_N_MAX_LAM_ADJ_D_ACT FORMAT "%4.0" /end CHARACTERISTIC
/begin CHARACTERISTIC c_n_min_lam_adj_p_act "minimum engine speed threshold for trim control P share calculation" VALUE 0xa1009601 _REC_VAL_20_u1 8160. _CNV_A_R_LINEAR_____9_CM 0. 8160. DISPLAY_IDENTIFIER C_N_MIN_LAM_ADJ_P_ACT FORMAT "%4.0" /end CHARACTERISTIC
/begin CHARACTERISTIC c_n_min_lam_adj_d_act "minimum engine speed threshold for trim control D share calculation" VALUE 0xa1009600 _REC_VAL_20_u1 8160. _CNV_A_R_LINEAR_____9_CM 0. 8160. DISPLAY_IDENTIFIER C_N_MIN_LAM_ADJ_D_ACT FORMAT "%4.0" /end CHARACTERISTIC
/begin CHARACTERISTIC lc_lamb_pls_not_chk_lam_adj "calibration flag to choose whether I share is calculated when forced lambda stimulation is not active" VALUE 0xa1009635 _REC_VAL_20_u1 1. _CNV_A_R_LINEAR_____0_CM 0. 1. DISPLAY_IDENTIFIER LC_LAMB_PLS_NOT_CHK_LAM_ADJ FORMAT "%1.0" /end CHARACTERISTIC
/begin CHARACTERISTIC lc_lam_adj_ldc_not_chk "calibration flag to choose whether I share is calculated when limited dynamics are not fulfilled" VALUE 0xa100962f _REC_VAL_20_u1 1. _CNV_A_R_LINEAR_____0_CM 0. 1. DISPLAY_IDENTIFIER LC_LAM_ADJ_LDC_NOT_CHK FORMAT "%1.0" /end CHARACTERISTIC
/begin CHARACTERISTIC ip_fac_add_lamb_delta_d "additional weighting coefficient for trim control D share calculation" CURVE 0xa1008de0 _REC_CUR_20_u1_u1 0.99609375 _CNV_A_R_LINEAR_____27_CM 0. 0.99609375 DISPLAY_IDENTIFIER IP_FAC_ADD_LAMB_DELTA_D FORMAT "%5.3"
 /begin AXIS_DESCR COM_AXIS online_dummy _CNV_A_R_LINEAR_____100_CM 8 0. 1.9921875 FORMAT "%8.6" AXIS_PTS_REF ldpm_eff_cat_diag_1_laco /end AXIS_DESCR
/end CHARACTERISTIC
/begin CHARACTERISTIC ip_fac_add_lamb_delta_p "additional weighting coefficient for trim control P share calculation" CURVE 0xa1008de8 _REC_CUR_20_u1_u1 0.99609375 _CNV_A_R_LINEAR_____27_CM 0. 0.99609375 DISPLAY_IDENTIFIER IP_FAC_ADD_LAMB_DELTA_P FORMAT "%5.3"
 /begin AXIS_DESCR COM_AXIS online_dummy _CNV_A_R_LINEAR_____100_CM 8 0. 1.9921875 FORMAT "%8.6" AXIS_PTS_REF ldpm_eff_cat_diag_1_laco /end AXIS_DESCR
/end CHARACTERISTIC
/begin CHARACTERISTIC ip_fac_lamb_delta_p_lam_adj "air mass flow dependent weighting coefficient for trim control P share calculation" CURVE 0xa10090dc _REC_CUR_20_u2_u2 0.9999847412109381 _CNV_A_R_LINEAR_____68_CM 0. 0.9999847412109381 DISPLAY_IDENTIFIER IP_FAC_LAMB_DELTA_P_LAM_ADJ FORMAT "%7.5"
 /begin AXIS_DESCR COM_AXIS maf_cyl _CNV_A_R_LINEAR_____207_CM 6 0. 2047.96875 FORMAT "%10.5" AXIS_PTS_REF ldpm_maf_cyl_1_laco /end AXIS_DESCR
/end CHARACTERISTIC
/begin CHARACTERISTIC ip_fac_lamb_delta_d_lam_adj "air mass flow dependent weighting coefficient for trim control D share calculation" CURVE 0xa10090d0 _REC_CUR_20_u2_u2 0.9999847412109381 _CNV_A_R_LINEAR_____68_CM 0. 0.9999847412109381 DISPLAY_IDENTIFIER IP_FAC_LAMB_DELTA_D_LAM_ADJ FORMAT "%7.5"
 /begin AXIS_DESCR COM_AXIS maf_cyl _CNV_A_R_LINEAR_____207_CM 6 0. 2047.96875 FORMAT "%10.5" AXIS_PTS_REF ldpm_maf_cyl_1_laco /end AXIS_DESCR
/end CHARACTERISTIC
/begin AXIS_PTS ldp_vls_dif_delta_ip_lamb_d "" 0xa1008b7c online_dummy _REC_AXS_20_u2 9.99511719 _CNV_A_R_LACO_LINEA_376_CM 16 -5. 4.99511719 /end AXIS_PTS
/begin CHARACTERISTIC ip_lamb_delta_d_lam_adj "characteristic line of trim control D share" CURVE 0xa10091d0 _REC_CUR_20_u2_u2 0.25 _CNV_A_R_LACO_LINEA_395_CM -0.125 0.125 DISPLAY_IDENTIFIER IP_LAMB_DELTA_D_LAM_ADJ FORMAT "%8.5"
 /begin AXIS_DESCR COM_AXIS online_dummy _CNV_A_R_LACO_LINEA_376_CM 16 -5. 4.99511719 AXIS_PTS_REF ldp_vls_dif_delta_ip_lamb_d /end AXIS_DESCR
/end CHARACTERISTIC
/begin CHARACTERISTIC ip_lamb_delta_i_lam_adj_diag "characteristic line of trim control I share in case of active diagnosis function" MAP 0xa1009210 _REC_MAP_20_u2_u2_u1 0.249996185302734 _CNV_A_R_LACO_LINEA_396_CM -0.125 0.124996185302734 DISPLAY_IDENTIFIER IP_LAMB_DELTA_I_LAM_ADJ_DIAG FORMAT "%8.6"
 /begin AXIS_DESCR COM_AXIS online_dummy _CNV_A_R_LACO_LINEA_376_CM 16 -5. 4.99511719 AXIS_PTS_REF ldpm_vls_dif_lam_adj_2_laco /end AXIS_DESCR
 /begin AXIS_DESCR COM_AXIS online_dummy _CNV_A_R_LINEAR_____100_CM 8 0. 1.9921875 FORMAT "%8.6" AXIS_PTS_REF ldpm_eff_cat_diag_1_laco /end AXIS_DESCR
/end CHARACTERISTIC
/begin CHARACTERISTIC ip_lamb_delta_p_lam_adj_diag "characteristic line of trim control P share in case of active cat diagnosis" CURVE 0xa1009330 _REC_CUR_20_u2_u2 0.25 _CNV_A_R_LACO_LINEA_395_CM -0.125 0.125 DISPLAY_IDENTIFIER IP_LAMB_DELTA_P_LAM_ADJ_DIAG FORMAT "%8.5"
 /begin AXIS_DESCR COM_AXIS online_dummy _CNV_A_R_LACO_LINEA_376_CM 16 -5. 4.99511719 AXIS_PTS_REF ldpm_vls_dif_lam_adj_2_laco /end AXIS_DESCR
/end CHARACTERISTIC
/begin CHARACTERISTIC ip_vls_sp_delta_lam_adj "Additional offset of setpoint for trim control at not active catalyst diagnosis to take into account the catalyst aging" CURVE 0xa10094a0 _REC_CUR_20_u2_u1 9.99511719 _CNV_A_R_LACO_LINEA_376_CM -5. 4.99511719 DISPLAY_IDENTIFIER IP_VLS_SP_DELTA_LAM_ADJ
 /begin AXIS_DESCR COM_AXIS online_dummy _CNV_A_R_LINEAR_____100_CM 8 0. 1.9921875 FORMAT "%8.6" AXIS_PTS_REF ldpm_eff_cat_diag_1_laco /end AXIS_DESCR
/end CHARACTERISTIC
/begin CHARACTERISTIC ip_crlc_vls_dif_mmv_lam_adj "correlation constant to calculate moving mean value of trim controller difference" MAP 0xa1008d78 _REC_MAP_20_u2_u2_u1 0.9999847412109381 _CNV_A_R_LINEAR_____68_CM 0. 0.9999847412109381 DISPLAY_IDENTIFIER IP_CRLC_VLS_DIF_MMV_LAM_ADJ FORMAT "%7.5"
 /begin AXIS_DESCR COM_AXIS maf_cyl _CNV_A_R_LINEAR_____207_CM 6 0. 2047.96875 FORMAT "%10.5" AXIS_PTS_REF ldpm_maf_cyl_1_laco /end AXIS_DESCR
 /begin AXIS_DESCR COM_AXIS online_dummy _CNV_A_R_LINEAR_____100_CM 8 0. 1.9921875 FORMAT "%8.6" AXIS_PTS_REF ldpm_eff_cat_diag_1_laco /end AXIS_DESCR
/end CHARACTERISTIC
/begin MEASUREMENT lv_lamb_delta_ad_lam_adj_ext "flag to set trim control adaptation value to calibration value (external adjustment)" UBYTE _CNV_S_2_RANGE__0___1_CM 1 100. 0. 1. DISPLAY_IDENTIFIER LV_LAMB_DELTA_AD_LAM_ADJ_EXT ECU_ADDRESS 0xd0002f24 BIT_MASK 0x1 /end MEASUREMENT
/begin AXIS_PTS ldpm_maf_kgh__crlc_vls_down "" 0xa1008be4 maf_kgh _REC_AXS_20_u2 2047.96875 _CNV_A_R_LINEAR_____207_CM 4 0. 2047.96875 FORMAT "%7.2" /end AXIS_PTS
/begin CHARACTERISTIC id_crlc_vls_down_t_dly "correlation constant downstream signal" CURVE 0xa1008cba _REC_CUR_20_u1_u2 0.99609375 _CNV_A_R_LINEAR_____71_CM 0. 0.99609375 DISPLAY_IDENTIFIER ID_CRLC_VLS_DOWN_T_DLY FORMAT "%5.3"
 /begin AXIS_DESCR COM_AXIS maf_kgh _CNV_A_R_LINEAR_____207_CM 4 0. 2047.96875 FORMAT "%7.2" AXIS_PTS_REF ldpm_maf_kgh__crlc_vls_down /end AXIS_DESCR
/end CHARACTERISTIC
/begin CHARACTERISTIC lc_lamb_delta_ad_lam_adj_ext "LC for external adjustment of adaptation value for the lambda-shift" VALUE 0xa1009634 _REC_VAL_20_u1 1. _CNV_A_R_LINEAR_____0_CM 0. 1. DISPLAY_IDENTIFIER LC_LAMB_DELTA_AD_LAM_ADJ_EXT FORMAT "%2.0" /end CHARACTERISTIC
/begin CHARACTERISTIC ip_vls_delta_lam_adj_cat_diag "sensor voltage set point shift in case of active cat efficiency diagnosis" CURVE 0xa1009490 _REC_CUR_20_u2_u1 4.9951171875 _CNV_A_R_LINEAR_____2_CM 0. 4.9951171875 DISPLAY_IDENTIFIER IP_VLS_DELTA_LAM_ADJ_CAT_DIAG FORMAT "%5.3"
 /begin AXIS_DESCR COM_AXIS online_dummy _CNV_A_R_LINEAR_____100_CM 8 0. 1.9921875 FORMAT "%8.6" AXIS_PTS_REF ldpm_eff_cat_diag_1_laco /end AXIS_DESCR
/end CHARACTERISTIC
/begin AXIS_PTS ldp_t_sum_afl_afr_ip_crlc_vls "" 0xa1008b64 egcp[0].egcp_struct_ispclls0.t_sum_afl_afr_cyc _REC_AXS_20_u2 655.35 _CNV_A_R_LINEAR_____3_CM 6 0. 655.35 FORMAT "%6.2" /end AXIS_PTS
/begin CHARACTERISTIC ip_crlc_vls_lam_adj_cat_diag "correlation constant for filtering downstream signal for catalyst efficiency diagnosis" CURVE 0xa1008dd8 _REC_CUR_20_u1_u2 0.99609375 _CNV_A_R_LINEAR_____71_CM 0. 0.99609375 DISPLAY_IDENTIFIER IP_CRLC_VLS_LAM_ADJ_CAT_DIAG FORMAT "%5.3"
 /begin AXIS_DESCR COM_AXIS egcp[0].egcp_struct_ispclls0.t_sum_afl_afr_cyc _CNV_A_R_LINEAR_____3_CM 6 0. 655.35 FORMAT "%6.2" AXIS_PTS_REF ldp_t_sum_afl_afr_ip_crlc_vls /end AXIS_DESCR
/end CHARACTERISTIC
/begin AXIS_PTS ldp_tco_st_1_egcp "" 0xa1008b72 tco_st _REC_AXS_20_u1 190.5 _CNV_A_R_LINEAR_____16_CM 6 -48. 142.5 FORMAT "%6.2" /end AXIS_PTS
/begin CHARACTERISTIC id_t_dly_lam_ad_1 "activation of trim controller after calibratable time" CURVE 0xa1008d0c _REC_CUR_20_u2_u1 6553.5 _CNV_A_R_LINEAR_____4_CM 0. 6553.5 DISPLAY_IDENTIFIER ID_T_DLY_LAM_AD_1 FORMAT "%6.1"
 /begin AXIS_DESCR COM_AXIS tco_st _CNV_A_R_LINEAR_____16_CM 6 -48. 142.5 FORMAT "%6.2" AXIS_PTS_REF ldp_tco_st_1_egcp /end AXIS_DESCR
/end CHARACTERISTIC
/begin CHARACTERISTIC id_t_dly_lam_ad_2 "activation of trim controller after calibratable time" CURVE 0xa1008d18 _REC_CUR_20_u2_u1 6553.5 _CNV_A_R_LINEAR_____4_CM 0. 6553.5 DISPLAY_IDENTIFIER ID_T_DLY_LAM_AD_2 FORMAT "%6.1"
 /begin AXIS_DESCR COM_AXIS tco_st _CNV_A_R_LINEAR_____16_CM 6 -48. 142.5 FORMAT "%6.2" AXIS_PTS_REF ldp_tco_st_1_egcp /end AXIS_DESCR
/end CHARACTERISTIC
/begin CHARACTERISTIC c_crlc_lamb_delta_ad_lam_adj "correlation constant of trim control adaptation value calculation" VALUE 0xa100953a _REC_VAL_20_u2 0.9999847412109381 _CNV_A_R_LINEAR_____68_CM 0. 0.9999847412109381 DISPLAY_IDENTIFIER C_CRLC_LAMB_DELTA_AD_LAM_ADJ FORMAT "%7.5" /end CHARACTERISTIC
/begin CHARACTERISTIC c_lamb_delta_max_lam_adj_ad "maximum value for WRAF sensor characteristic line shift offset" VALUE 0xa100958e _REC_VAL_20_s2 0.25 _CNV_A_R_LINEAR_____23_CM -0.125 0.125 DISPLAY_IDENTIFIER C_LAMB_DELTA_MAX_LAM_ADJ_AD FORMAT "%8.5" /end CHARACTERISTIC
/begin CHARACTERISTIC c_lamb_delta_min_lam_adj_ad "minimum value for WRAF sensor characteristic line shift offset" VALUE 0xa1009590 _REC_VAL_20_s2 0.25 _CNV_A_R_LINEAR_____23_CM -0.125 0.125 DISPLAY_IDENTIFIER C_LAMB_DELTA_MIN_LAM_ADJ_AD FORMAT "%8.5" /end CHARACTERISTIC
/begin CHARACTERISTIC c_nr_raf_chg_wait_lam_adj "number of lean <-> rich air fuel ratio changes between two adpatation cycles" VALUE 0xa1009609 _REC_VAL_20_u1 254. _CNV_A_R_LINEAR_____0_CM 1. 255. DISPLAY_IDENTIFIER C_NR_RAF_CHG_WAIT_LAM_ADJ FORMAT "%3.0" /end CHARACTERISTIC
/begin CHARACTERISTIC c_lamb_delta_bas_lam_adj_is[0] "basic characteristic line shift of WRAF sensor in case of idle speed" VALUE 0xa1009584 _REC_VAL_20_s2 0.25 _CNV_A_R_LINEAR_____23_CM -0.125 0.125 DISPLAY_IDENTIFIER C_LAMB_DELTA_BAS_LAM_ADJ_IS[1] FORMAT "%8.5" /end CHARACTERISTIC
/begin CHARACTERISTIC c_lamb_delta_bas_lam_adj_is[1] "basic characteristic line shift of WRAF sensor in case of idle speed" VALUE 0xa1009586 _REC_VAL_20_s2 0.25 _CNV_A_R_LINEAR_____23_CM -0.125 0.125 DISPLAY_IDENTIFIER C_LAMB_DELTA_BAS_LAM_ADJ_IS[2] FORMAT "%8.5" /end CHARACTERISTIC
/begin AXIS_PTS ldp_maf_ip_lamb_delta_bas "" 0xa1008ad8 maf _REC_AXS_20_u2 1389. _CNV_A_R_LINEAR_____108_CM 8 0. 1389. FORMAT "%7.2" /end AXIS_PTS
/begin AXIS_PTS ldp_n_32_ip_lamb_delta_bas "" 0xa1008b3c n_32 _REC_AXS_20_u1 8160. _CNV_A_R_LINEAR_____9_CM 8 0. 8160. FORMAT "%4.0" /end AXIS_PTS
/begin CHARACTERISTIC ip_lamb_delta_bas_lam_adj_1 "basic characteric line shift of WRAF sensor" MAP 0xa1009150 _REC_MAP_20_u2_u2_u1 0.25 _CNV_A_R_LACO_LINEA_395_CM -0.125 0.125 DISPLAY_IDENTIFIER IP_LAMB_DELTA_BAS_LAM_ADJ_1 FORMAT "%8.5"
 /begin AXIS_DESCR COM_AXIS maf _CNV_A_R_LINEAR_____108_CM 8 0. 1389. FORMAT "%7.2" AXIS_PTS_REF ldp_maf_ip_lamb_delta_bas /end AXIS_DESCR
 /begin AXIS_DESCR COM_AXIS n_32 _CNV_A_R_LINEAR_____9_CM 8 0. 8160. FORMAT "%4.0" AXIS_PTS_REF ldp_n_32_ip_lamb_delta_bas /end AXIS_DESCR
/end CHARACTERISTIC
/begin CHARACTERISTIC ip_lamb_delta_bas_lam_adj_2 "basic characteric line shift of WRAF sensor" MAP 0xa1009678 _REC_MAP_20_u2_u2_u1 0.25 _CNV_A_R_LACO_LINEA_395_CM -0.125 0.125 DISPLAY_IDENTIFIER IP_LAMB_DELTA_BAS_LAM_ADJ_2 FORMAT "%8.5"
 /begin AXIS_DESCR COM_AXIS maf _CNV_A_R_LINEAR_____108_CM 8 0. 1389. FORMAT "%7.2" AXIS_PTS_REF ldp_maf_ip_lamb_delta_bas /end AXIS_DESCR
 /begin AXIS_DESCR COM_AXIS n_32 _CNV_A_R_LINEAR_____9_CM 8 0. 8160. FORMAT "%4.0" AXIS_PTS_REF ldp_n_32_ip_lamb_delta_bas /end AXIS_DESCR
/end CHARACTERISTIC
/begin CHARACTERISTIC c_lamb_delta_dif_i_mmv_lam_adj "difference between I share and moving mean value to allow WRAF sensor characteristic line adaptation" VALUE 0xa1009588 _REC_VAL_20_s2 0.25 _CNV_A_R_LINEAR_____23_CM -0.125 0.125 DISPLAY_IDENTIFIER C_LAMB_DELTA_DIF_I_MMV_LAM_ADJ FORMAT "%8.5" /end CHARACTERISTIC
/begin CHARACTERISTIC c_lamb_delta_p_max_lam_adj_cdn "maximum trim control P share for WRAF sensor characteristric line adaptation" VALUE 0xa1009592 _REC_VAL_20_s2 0.25 _CNV_A_R_LINEAR_____23_CM -0.125 0.125 DISPLAY_IDENTIFIER C_LAMB_DELTA_P_MAX_LAM_ADJ_CDN FORMAT "%8.5" /end CHARACTERISTIC
/begin CHARACTERISTIC c_lamb_delta_p_min_lam_adj_cdn "minimum trim control P share for WRAF sensor characteristric line adaptation" VALUE 0xa1009594 _REC_VAL_20_s2 0.25 _CNV_A_R_LINEAR_____23_CM -0.125 0.125 DISPLAY_IDENTIFIER C_LAMB_DELTA_P_MIN_LAM_ADJ_CDN FORMAT "%8.5" /end CHARACTERISTIC
/begin CHARACTERISTIC c_maf_int_thd_lam_adj_cdn "air mass flow integral threshold for stationary condition definition for WRAF sensor characteristic line adaptation" VALUE 0xa10095e2 _REC_VAL_20_u2 1820.41666666667 _CNV_A_R_LINEAR_____391_CM 0. 1820.41666666667 DISPLAY_IDENTIFIER C_MAF_INT_THD_LAM_ADJ_CDN FORMAT "%7.2" /end CHARACTERISTIC
/begin CHARACTERISTIC c_maf_max_lam_adj_cdn "maximum air mass flow threshold for WRAF sensor characteristic line adaptation" VALUE 0xa10095ea _REC_VAL_20_u1 1389. _CNV_A_R_LINEAR_____14_CM 0. 1389. DISPLAY_IDENTIFIER C_MAF_MAX_LAM_ADJ_CDN FORMAT "%4.0" /end CHARACTERISTIC
/begin CHARACTERISTIC c_maf_min_lam_adj_cdn "minimum air mass flow threshold for WRAF sensor characteristic line adaptation" VALUE 0xa10095ed _REC_VAL_20_u1 1389. _CNV_A_R_LINEAR_____14_CM 0. 1389. DISPLAY_IDENTIFIER C_MAF_MIN_LAM_ADJ_CDN FORMAT "%4.0" /end CHARACTERISTIC
/begin CHARACTERISTIC c_n_max_lam_adj_cdn "maximum engine speed threshold for WRAF sensor characteristic line adaptation" VALUE 0xa10095fc _REC_VAL_20_u1 8160. _CNV_A_R_LINEAR_____9_CM 0. 8160. DISPLAY_IDENTIFIER C_N_MAX_LAM_ADJ_CDN FORMAT "%4.0" /end CHARACTERISTIC
/begin CHARACTERISTIC c_n_min_lam_adj_cdn "minimum engine speed threshold for WRAF sensor characteristic line adaptation" VALUE 0xa10095ff _REC_VAL_20_u1 8160. _CNV_A_R_LINEAR_____9_CM 0. 8160. DISPLAY_IDENTIFIER C_N_MIN_LAM_ADJ_CDN FORMAT "%4.0" /end CHARACTERISTIC
/begin MEASUREMENT fac_drv2_er "Weighting factor for engine roughness curvative component calculation (correction amount)" UWORD _CNV_A_R_ENRD_LINEA_402_CM 1 100. 0. 4. DISPLAY_IDENTIFIER FAC_DRV2_ER ECU_ADDRESS 0xc0001bc0 FORMAT "%6.5" /end MEASUREMENT
/begin MEASUREMENT drv0_er "Engine roughness static component" SLONG _CNV_A_R_LINEAR_____401_CM 1 100. -2147483648. 2147483647. DISPLAY_IDENTIFIER DRV0_ER ECU_ADDRESS 0xd0002090 FORMAT "%11.0" /end MEASUREMENT
/begin MEASUREMENT seg_nr_er "ER segment counter for segment identification (0...NC_CYL_NR - 1)" UBYTE _CNV_A_R_LINEAR_____0_CM 1 100. 0. 7. DISPLAY_IDENTIFIER SEG_NR_ER ECU_ADDRESS 0xd0002dc9 FORMAT "%3.0" /end MEASUREMENT
/begin MEASUREMENT lv_ena_er "Engine roughness valid calculation control flag" UBYTE _CNV_S_2_RANGE__0___1_CM 1 100. 0. 1. DISPLAY_IDENTIFIER LV_ENA_ER ECU_ADDRESS 0xd0002dcc BIT_MASK 0x1 /end MEASUREMENT
/begin CHARACTERISTIC c_n_max_er "Maximum engine speed for engine roughness calculation" VALUE 0xa1003044 _REC_VAL_20_u2 8160. _CNV_A_R_LINEAR_____13_CM 0. 8160. DISPLAY_IDENTIFIER C_N_MAX_ER FORMAT "%4.0" /end CHARACTERISTIC
/begin CHARACTERISTIC c_n_min_er "Minimum engine speed for engine roughness calculation" VALUE 0xa100304c _REC_VAL_20_u2 8160. _CNV_A_R_LINEAR_____13_CM 0. 8160. DISPLAY_IDENTIFIER C_N_MIN_ER FORMAT "%4.0" /end CHARACTERISTIC
/begin MEASUREMENT fac_gain_er[0] "ER multiplicative correction components" UWORD _CNV_A_R_LINEAR_____27_CM 1 100. 0. 1.99609375 DISPLAY_IDENTIFIER FAC_GAIN_ER[0] ECU_ADDRESS 0xc0001be4 FORMAT "%5.3" /end MEASUREMENT
/begin MEASUREMENT fac_gain_er[1] "ER multiplicative correction components" UWORD _CNV_A_R_LINEAR_____27_CM 1 100. 0. 1.99609375 DISPLAY_IDENTIFIER FAC_GAIN_ER[1] ECU_ADDRESS 0xc0001be6 FORMAT "%5.3" /end MEASUREMENT
/begin MEASUREMENT fac_gain_er[2] "ER multiplicative correction components" UWORD _CNV_A_R_LINEAR_____27_CM 1 100. 0. 1.99609375 DISPLAY_IDENTIFIER FAC_GAIN_ER[2] ECU_ADDRESS 0xc0001be8 FORMAT "%5.3" /end MEASUREMENT
/begin MEASUREMENT fac_gain_er[3] "ER multiplicative correction components" UWORD _CNV_A_R_LINEAR_____27_CM 1 100. 0. 1.99609375 DISPLAY_IDENTIFIER FAC_GAIN_ER[3] ECU_ADDRESS 0xc0001bea FORMAT "%5.3" /end MEASUREMENT
/begin MEASUREMENT fac_gain_er[4] "ER multiplicative correction components" UWORD _CNV_A_R_LINEAR_____27_CM 1 100. 0. 1.99609375 DISPLAY_IDENTIFIER FAC_GAIN_ER[4] ECU_ADDRESS 0xc0001bec FORMAT "%5.3" /end MEASUREMENT
/begin MEASUREMENT fac_gain_er[5] "ER multiplicative correction components" UWORD _CNV_A_R_LINEAR_____27_CM 1 100. 0. 1.99609375 DISPLAY_IDENTIFIER FAC_GAIN_ER[5] ECU_ADDRESS 0xc0001bee FORMAT "%5.3" /end MEASUREMENT
/begin MEASUREMENT fac_add_er[0] "ER additive correction components" SWORD _CNV_A_R_LINEAR_____401_CM 1 100. -32768. 32767. DISPLAY_IDENTIFIER FAC_ADD_ER[0] ECU_ADDRESS 0xc0001bd8 FORMAT "%6.0" /end MEASUREMENT
/begin MEASUREMENT fac_add_er[1] "ER additive correction components" SWORD _CNV_A_R_LINEAR_____401_CM 1 100. -32768. 32767. DISPLAY_IDENTIFIER FAC_ADD_ER[1] ECU_ADDRESS 0xc0001bda FORMAT "%6.0" /end MEASUREMENT
/begin MEASUREMENT fac_add_er[2] "ER additive correction components" SWORD _CNV_A_R_LINEAR_____401_CM 1 100. -32768. 32767. DISPLAY_IDENTIFIER FAC_ADD_ER[2] ECU_ADDRESS 0xc0001bdc FORMAT "%6.0" /end MEASUREMENT
/begin MEASUREMENT fac_add_er[3] "ER additive correction components" SWORD _CNV_A_R_LINEAR_____401_CM 1 100. -32768. 32767. DISPLAY_IDENTIFIER FAC_ADD_ER[3] ECU_ADDRESS 0xc0001bde FORMAT "%6.0" /end MEASUREMENT
/begin MEASUREMENT fac_add_er[4] "ER additive correction components" SWORD _CNV_A_R_LINEAR_____401_CM 1 100. -32768. 32767. DISPLAY_IDENTIFIER FAC_ADD_ER[4] ECU_ADDRESS 0xc0001be0 FORMAT "%6.0" /end MEASUREMENT
/begin MEASUREMENT fac_add_er[5] "ER additive correction components" SWORD _CNV_A_R_LINEAR_____401_CM 1 100. -32768. 32767. DISPLAY_IDENTIFIER FAC_ADD_ER[5] ECU_ADDRESS 0xc0001be2 FORMAT "%6.0" /end MEASUREMENT
/begin CHARACTERISTIC ip_fac_gain_er_mt_0 "ER cylinder 0 multiplicative segment dependent factor for torsion correction with MT" CURVE 0xa1003260 _REC_CUR_20_u2_u1 1.99609375 _CNV_A_R_LINEAR_____27_CM 0. 1.99609375 DISPLAY_IDENTIFIER IP_FAC_GAIN_ER_MT_0 FORMAT "%5.3"
 /begin AXIS_DESCR COM_AXIS n_32 _CNV_A_R_LINEAR_____9_CM 6 0. 8160. FORMAT "%4.0" AXIS_PTS_REF ldp_n_32_2_enrd_0 /end AXIS_DESCR
/end CHARACTERISTIC
/begin CHARACTERISTIC ip_fac_gain_er_mt_1 "ER cylinder 1 multiplicative segment dependent factor for torsion correction with MT" CURVE 0xa100326c _REC_CUR_20_u2_u1 1.99609375 _CNV_A_R_LINEAR_____27_CM 0. 1.99609375 DISPLAY_IDENTIFIER IP_FAC_GAIN_ER_MT_1 FORMAT "%5.3"
 /begin AXIS_DESCR COM_AXIS n_32 _CNV_A_R_LINEAR_____9_CM 6 0. 8160. FORMAT "%4.0" AXIS_PTS_REF ldp_n_32_2_enrd_1 /end AXIS_DESCR
/end CHARACTERISTIC
/begin CHARACTERISTIC ip_fac_gain_er_mt_2 "ER cylinder 2 multiplicative segment dependent factor for torsion correction with MT" CURVE 0xa1003278 _REC_CUR_20_u2_u1 1.99609375 _CNV_A_R_LINEAR_____27_CM 0. 1.99609375 DISPLAY_IDENTIFIER IP_FAC_GAIN_ER_MT_2 FORMAT "%5.3"
 /begin AXIS_DESCR COM_AXIS n_32 _CNV_A_R_LINEAR_____9_CM 6 0. 8160. FORMAT "%4.0" AXIS_PTS_REF ldp_n_32_2_enrd_2 /end AXIS_DESCR
/end CHARACTERISTIC
/begin CHARACTERISTIC ip_fac_gain_er_mt_3 "ER cylinder 3 multiplicative segment dependent factor for torsion correction with MT" CURVE 0xa1003320 _REC_CUR_20_u2_u1 1.99609375 _CNV_A_R_LINEAR_____27_CM 0. 1.99609375 DISPLAY_IDENTIFIER IP_FAC_GAIN_ER_MT_3 FORMAT "%5.3"
 /begin AXIS_DESCR COM_AXIS n_32 _CNV_A_R_LINEAR_____9_CM 6 0. 8160. FORMAT "%4.0" AXIS_PTS_REF ldp_n_32_2_enrd_3 /end AXIS_DESCR
/end CHARACTERISTIC
/begin CHARACTERISTIC ip_fac_gain_er_mt_4 "ER cylinder 4 multiplicative segment dependent factor for torsion correction with MT" CURVE 0xa10033c8 _REC_CUR_20_u2_u1 1.99609375 _CNV_A_R_LINEAR_____27_CM 0. 1.99609375 DISPLAY_IDENTIFIER IP_FAC_GAIN_ER_MT_4 FORMAT "%5.3"
 /begin AXIS_DESCR COM_AXIS n_32 _CNV_A_R_LINEAR_____9_CM 6 0. 8160. FORMAT "%4.0" AXIS_PTS_REF ldp_n_32_2_enrd_4 /end AXIS_DESCR
/end CHARACTERISTIC
/begin CHARACTERISTIC ip_fac_gain_er_mt_5 "ER cylinder 5 multiplicative segment dependent factor for torsion correction with MT" CURVE 0xa1003470 _REC_CUR_20_u2_u1 1.99609375 _CNV_A_R_LINEAR_____27_CM 0. 1.99609375 DISPLAY_IDENTIFIER IP_FAC_GAIN_ER_MT_5 FORMAT "%5.3"
 /begin AXIS_DESCR COM_AXIS n_32 _CNV_A_R_LINEAR_____9_CM 6 0. 8160. FORMAT "%4.0" AXIS_PTS_REF ldp_n_32_2_enrd_5 /end AXIS_DESCR
/end CHARACTERISTIC
/begin AXIS_PTS ldp_load_ip_fac_add_er_mt_0 "" 0xa1002cc0 load_mis _REC_AXS_20_u2 99.9969482421875 _CNV_A_R_LINEAR_____201_CM 6 0. 99.9969482421875 FORMAT "%7.3" /end AXIS_PTS
/begin AXIS_PTS ldp_load_ip_fac_add_er_at_0 "" 0xa1002c40 load_mis _REC_AXS_20_u2 99.9969482421875 _CNV_A_R_LINEAR_____201_CM 6 0. 99.9969482421875 FORMAT "%7.3" /end AXIS_PTS
/begin AXIS_PTS ldp_load_ip_fac_add_er_mt_1 "" 0xa1002cd0 load_mis _REC_AXS_20_u2 99.9969482421875 _CNV_A_R_LINEAR_____201_CM 6 0. 99.9969482421875 FORMAT "%7.3" /end AXIS_PTS
/begin AXIS_PTS ldp_load_ip_fac_add_er_at_1 "" 0xa1002c50 load_mis _REC_AXS_20_u2 99.9969482421875 _CNV_A_R_LINEAR_____201_CM 6 0. 99.9969482421875 FORMAT "%7.3" /end AXIS_PTS
/begin AXIS_PTS ldp_load_ip_fac_add_er_at_2 "" 0xa1002c60 load_mis _REC_AXS_20_u2 99.9969482421875 _CNV_A_R_LINEAR_____201_CM 6 0. 99.9969482421875 FORMAT "%7.3" /end AXIS_PTS
/begin AXIS_PTS ldp_load_ip_fac_add_er_mt_4 "" 0xa1002d00 load_mis _REC_AXS_20_u2 99.9969482421875 _CNV_A_R_LINEAR_____201_CM 6 0. 99.9969482421875 FORMAT "%7.3" /end AXIS_PTS
/begin AXIS_PTS ldp_load_ip_fac_add_er_at_6 "" 0xa1002ca0 load_mis _REC_AXS_20_u2 99.9969482421875 _CNV_A_R_LINEAR_____201_CM 6 0. 99.9969482421875 FORMAT "%7.3" /end AXIS_PTS
/begin AXIS_PTS ldp_load_ip_fac_add_er_at_3 "" 0xa1002c70 load_mis _REC_AXS_20_u2 99.9969482421875 _CNV_A_R_LINEAR_____201_CM 6 0. 99.9969482421875 FORMAT "%7.3" /end AXIS_PTS
/begin AXIS_PTS ldp_load_ip_fac_add_er_mt_7 "" 0xa1002d30 load_mis _REC_AXS_20_u2 99.9969482421875 _CNV_A_R_LINEAR_____201_CM 6 0. 99.9969482421875 FORMAT "%7.3" /end AXIS_PTS
/begin AXIS_PTS ldp_load_ip_fac_add_er_mt_3 "" 0xa1002cf0 load_mis _REC_AXS_20_u2 99.9969482421875 _CNV_A_R_LINEAR_____201_CM 6 0. 99.9969482421875 FORMAT "%7.3" /end AXIS_PTS
/begin AXIS_PTS ldp_load_ip_fac_add_er_at_7 "" 0xa1002cb0 load_mis _REC_AXS_20_u2 99.9969482421875 _CNV_A_R_LINEAR_____201_CM 6 0. 99.9969482421875 FORMAT "%7.3" /end AXIS_PTS
/begin AXIS_PTS ldp_load_ip_fac_add_er_at_4 "" 0xa1002c80 load_mis _REC_AXS_20_u2 99.9969482421875 _CNV_A_R_LINEAR_____201_CM 6 0. 99.9969482421875 FORMAT "%7.3" /end AXIS_PTS
/begin AXIS_PTS ldp_load_ip_fac_add_er_mt_5 "" 0xa1002d10 load_mis _REC_AXS_20_u2 99.9969482421875 _CNV_A_R_LINEAR_____201_CM 6 0. 99.9969482421875 FORMAT "%7.3" /end AXIS_PTS
/begin AXIS_PTS ldp_load_ip_fac_add_er_at_5 "" 0xa1002c90 load_mis _REC_AXS_20_u2 99.9969482421875 _CNV_A_R_LINEAR_____201_CM 6 0. 99.9969482421875 FORMAT "%7.3" /end AXIS_PTS
/begin AXIS_PTS ldp_load_ip_fac_add_er_mt_2 "" 0xa1002ce0 load_mis _REC_AXS_20_u2 99.9969482421875 _CNV_A_R_LINEAR_____201_CM 6 0. 99.9969482421875 FORMAT "%7.3" /end AXIS_PTS
/begin AXIS_PTS ldp_load_ip_fac_add_er_mt_6 "" 0xa1002d20 load_mis _REC_AXS_20_u2 99.9969482421875 _CNV_A_R_LINEAR_____201_CM 6 0. 99.9969482421875 FORMAT "%7.3" /end AXIS_PTS
/begin MEASUREMENT crlc_drv2_er "Correlation factor for engine roughness curvature component calculation" UBYTE _CNV_A_R_LINEAR_____27_CM 1 100. 0. 0.99609375 DISPLAY_IDENTIFIER CRLC_DRV2_ER ECU_ADDRESS 0xc0001bf0 FORMAT "%5.3" /end MEASUREMENT
/begin AXIS_PTS ldp_n_32_ip_fac_n_drv2_er_at "" 0xa1002eae n_32 _REC_AXS_20_u1 8160. _CNV_A_R_LINEAR_____9_CM 6 0. 8160. FORMAT "%4.0" /end AXIS_PTS
/begin AXIS_PTS ldp_n_32_ip_fac_n_drv2_er_mt "" 0xa1002eb6 n_32 _REC_AXS_20_u1 8160. _CNV_A_R_LINEAR_____9_CM 6 0. 8160. FORMAT "%4.0" /end AXIS_PTS
/begin AXIS_PTS ldp_n_32_ip_crlc_drv2_er_at "" 0xa1002e98 n_32 _REC_AXS_20_u1 8160. _CNV_A_R_LINEAR_____9_CM 9 0. 8160. FORMAT "%4.0" /end AXIS_PTS
/begin AXIS_PTS ldp_n_32_ip_crlc_drv2_er_mt "" 0xa1002ea4 n_32 _REC_AXS_20_u1 8160. _CNV_A_R_LINEAR_____9_CM 9 0. 8160. FORMAT "%4.0" /end AXIS_PTS
/begin CHARACTERISTIC ip_crlc_drv2_er_at "Correlation factor for engine roughness curvature component calculation (correction duration) - AT vehicle" CURVE 0xa1002f00 _REC_CUR_20_u1_u1 0.99609375 _CNV_A_R_LINEAR_____27_CM 0. 0.99609375 DISPLAY_IDENTIFIER IP_CRLC_DRV2_ER_AT FORMAT "%5.3"
 /begin AXIS_DESCR COM_AXIS n_32 _CNV_A_R_LINEAR_____9_CM 9 0. 8160. FORMAT "%4.0" AXIS_PTS_REF ldp_n_32_ip_crlc_drv2_er_at /end AXIS_DESCR
/end CHARACTERISTIC
/begin CHARACTERISTIC ip_crlc_drv2_er_mt "Correlation factor for engine roughness curvature component calculation (correction duration) - MT vehicle" CURVE 0xa1002f0c _REC_CUR_20_u1_u1 0.99609375 _CNV_A_R_LINEAR_____27_CM 0. 0.99609375 DISPLAY_IDENTIFIER IP_CRLC_DRV2_ER_MT FORMAT "%5.3"
 /begin AXIS_DESCR COM_AXIS n_32 _CNV_A_R_LINEAR_____9_CM 9 0. 8160. FORMAT "%4.0" AXIS_PTS_REF ldp_n_32_ip_crlc_drv2_er_mt /end AXIS_DESCR
/end CHARACTERISTIC
/begin CHARACTERISTIC c_crlc_drv2_zdly_er "Correlation factor for engine roughness curvature component calculation after start" VALUE 0xa1003030 _REC_VAL_20_u1 0.99609375 _CNV_A_R_LINEAR_____27_CM 0. 0.99609375 DISPLAY_IDENTIFIER C_CRLC_DRV2_ZDLY_ER FORMAT "%5.3" /end CHARACTERISTIC
/begin CHARACTERISTIC c_t_drv2_zdly_er "Delay for specific curvative component calculation during after start" VALUE 0xa1003066 _REC_VAL_20_u2 655.35 _CNV_A_R_LINEAR_____3_CM 0. 655.35 DISPLAY_IDENTIFIER C_T_DRV2_ZDLY_ER FORMAT "%6.2" /end CHARACTERISTIC
/begin MEASUREMENT drv1_er "Engine roughness dynamic component" SWORD _CNV_A_R_LINEAR_____401_CM 1 100. -32768. 32767. DISPLAY_IDENTIFIER DRV1_ER ECU_ADDRESS 0xd0002554 FORMAT "%6.0" /end MEASUREMENT
/begin MEASUREMENT drv2_er "Engine roughness curvature component" UWORD _CNV_A_R_LINEAR_____401_CM 1 100. 0. 65535. DISPLAY_IDENTIFIER DRV2_ER ECU_ADDRESS 0xd0002556 FORMAT "%5.0" /end MEASUREMENT
/begin MEASUREMENT drv2_mmv_er "Averaged engine roughness curvature component" UWORD _CNV_A_R_LINEAR_____401_CM 1 100. 0. 65535. DISPLAY_IDENTIFIER DRV2_MMV_ER ECU_ADDRESS 0xd0002558 FORMAT "%5.0" /end MEASUREMENT
/begin MEASUREMENT er_raw "Engine roughness without curvature component" SWORD _CNV_A_R_LINEAR_____401_CM 1 100. -32768. 32767. DISPLAY_IDENTIFIER ER_RAW ECU_ADDRESS 0xd000255c FORMAT "%6.0" /end MEASUREMENT
/begin MEASUREMENT er "Engine roughness" SWORD _CNV_A_R_LINEAR_____401_CM 1 100. -32768. 32767. DISPLAY_IDENTIFIER ER ECU_ADDRESS 0xd000255a FORMAT "%6.0" /end MEASUREMENT
/begin MEASUREMENT er_stnd "Normalized engine roughness" SWORD _CNV_A_R_LINEAR_____0_CM 1 100. -32768. 32767. DISPLAY_IDENTIFIER ER_STND ECU_ADDRESS 0xd000255e FORMAT "%6.0" /end MEASUREMENT
/begin MEASUREMENT er_stnd_cyl[0] "Cylinder normalized engine roughness values" SWORD _CNV_A_R_LINEAR_____0_CM 1 100. -32768. 32767. DISPLAY_IDENTIFIER ER_STND_CYL[0] ECU_ADDRESS 0xc0001bb4 FORMAT "%6.0" /end MEASUREMENT
/begin MEASUREMENT er_stnd_cyl[1] "Cylinder normalized engine roughness values" SWORD _CNV_A_R_LINEAR_____0_CM 1 100. -32768. 32767. DISPLAY_IDENTIFIER ER_STND_CYL[1] ECU_ADDRESS 0xc0001bb6 FORMAT "%6.0" /end MEASUREMENT
/begin MEASUREMENT er_stnd_cyl[2] "Cylinder normalized engine roughness values" SWORD _CNV_A_R_LINEAR_____0_CM 1 100. -32768. 32767. DISPLAY_IDENTIFIER ER_STND_CYL[2] ECU_ADDRESS 0xc0001bb8 FORMAT "%6.0" /end MEASUREMENT
/begin MEASUREMENT er_stnd_cyl[3] "Cylinder normalized engine roughness values" SWORD _CNV_A_R_LINEAR_____0_CM 1 100. -32768. 32767. DISPLAY_IDENTIFIER ER_STND_CYL[3] ECU_ADDRESS 0xc0001bba FORMAT "%6.0" /end MEASUREMENT
/begin MEASUREMENT er_stnd_cyl[4] "Cylinder normalized engine roughness values" SWORD _CNV_A_R_LINEAR_____0_CM 1 100. -32768. 32767. DISPLAY_IDENTIFIER ER_STND_CYL[4] ECU_ADDRESS 0xc0001bbc FORMAT "%6.0" /end MEASUREMENT
/begin MEASUREMENT er_stnd_cyl[5] "Cylinder normalized engine roughness values" SWORD _CNV_A_R_LINEAR_____0_CM 1 100. -32768. 32767. DISPLAY_IDENTIFIER ER_STND_CYL[5] ECU_ADDRESS 0xc0001bbe FORMAT "%6.0" /end MEASUREMENT
/begin CHARACTERISTIC c_fac_sca_er_stnd "Scaling factor used for normalized engine roughness calculation" VALUE 0xa100303e _REC_VAL_20_u1 255. _CNV_A_R_LINEAR_____0_CM 0. 255. DISPLAY_IDENTIFIER C_FAC_SCA_ER_STND FORMAT "%3.0" /end CHARACTERISTIC
/begin CHARACTERISTIC c_n_max_er_stnd "Maximum engine speed to compute normalised engine roughness" VALUE 0xa1003046 _REC_VAL_20_u2 8160. _CNV_A_R_LINEAR_____13_CM 0. 8160. DISPLAY_IDENTIFIER C_N_MAX_ER_STND FORMAT "%4.0" /end CHARACTERISTIC
/begin MEASUREMENT er_cyl[0] "Cylinder Engine roughness values" SWORD _CNV_A_R_LINEAR_____401_CM 1 100. -32768. 32767. DISPLAY_IDENTIFIER ER_CYL[0] ECU_ADDRESS 0xc0001ba8 FORMAT "%6.0" /end MEASUREMENT
/begin MEASUREMENT er_cyl[1] "Cylinder Engine roughness values" SWORD _CNV_A_R_LINEAR_____401_CM 1 100. -32768. 32767. DISPLAY_IDENTIFIER ER_CYL[1] ECU_ADDRESS 0xc0001baa FORMAT "%6.0" /end MEASUREMENT
/begin MEASUREMENT er_cyl[2] "Cylinder Engine roughness values" SWORD _CNV_A_R_LINEAR_____401_CM 1 100. -32768. 32767. DISPLAY_IDENTIFIER ER_CYL[2] ECU_ADDRESS 0xc0001bac FORMAT "%6.0" /end MEASUREMENT
/begin MEASUREMENT er_cyl[3] "Cylinder Engine roughness values" SWORD _CNV_A_R_LINEAR_____401_CM 1 100. -32768. 32767. DISPLAY_IDENTIFIER ER_CYL[3] ECU_ADDRESS 0xc0001bae FORMAT "%6.0" /end MEASUREMENT
/begin MEASUREMENT er_cyl[4] "Cylinder Engine roughness values" SWORD _CNV_A_R_LINEAR_____401_CM 1 100. -32768. 32767. DISPLAY_IDENTIFIER ER_CYL[4] ECU_ADDRESS 0xc0001bb0 FORMAT "%6.0" /end MEASUREMENT
/begin MEASUREMENT er_cyl[5] "Cylinder Engine roughness values" SWORD _CNV_A_R_LINEAR_____401_CM 1 100. -32768. 32767. DISPLAY_IDENTIFIER ER_CYL[5] ECU_ADDRESS 0xc0001bb2 FORMAT "%6.0" /end MEASUREMENT
/begin CHARACTERISTIC ip_fac_gain_er_at_0 "ER cylinder 0 multiplicative segment dependent factor for torsion correction with AT" CURVE 0xa100323c _REC_CUR_20_u2_u1 1.99609375 _CNV_A_R_LINEAR_____27_CM 0. 1.99609375 DISPLAY_IDENTIFIER IP_FAC_GAIN_ER_AT_0 FORMAT "%5.3"
 /begin AXIS_DESCR COM_AXIS n_32 _CNV_A_R_LINEAR_____9_CM 6 0. 8160. FORMAT "%4.0" AXIS_PTS_REF ldp_n_32_4_enrd_0 /end AXIS_DESCR
/end CHARACTERISTIC
/begin CHARACTERISTIC ip_fac_gain_er_at_1 "ER cylinder 1 multiplicative segment dependent factor for torsion correction with AT" CURVE 0xa1003248 _REC_CUR_20_u2_u1 1.99609375 _CNV_A_R_LINEAR_____27_CM 0. 1.99609375 DISPLAY_IDENTIFIER IP_FAC_GAIN_ER_AT_1 FORMAT "%5.3"
 /begin AXIS_DESCR COM_AXIS n_32 _CNV_A_R_LINEAR_____9_CM 6 0. 8160. FORMAT "%4.0" AXIS_PTS_REF ldp_n_32_4_enrd_1 /end AXIS_DESCR
/end CHARACTERISTIC
/begin CHARACTERISTIC ip_fac_gain_er_at_2 "ER cylinder 2 multiplicative segment dependent factor for torsion correction with AT" CURVE 0xa1003254 _REC_CUR_20_u2_u1 1.99609375 _CNV_A_R_LINEAR_____27_CM 0. 1.99609375 DISPLAY_IDENTIFIER IP_FAC_GAIN_ER_AT_2 FORMAT "%5.3"
 /begin AXIS_DESCR COM_AXIS n_32 _CNV_A_R_LINEAR_____9_CM 6 0. 8160. FORMAT "%4.0" AXIS_PTS_REF ldp_n_32_4_enrd_2 /end AXIS_DESCR
/end CHARACTERISTIC
/begin CHARACTERISTIC ip_fac_gain_er_at_3 "ER cylinder 3 multiplicative segment dependent factor for torsion correction with AT" CURVE 0xa1003314 _REC_CUR_20_u2_u1 1.99609375 _CNV_A_R_LINEAR_____27_CM 0. 1.99609375 DISPLAY_IDENTIFIER IP_FAC_GAIN_ER_AT_3 FORMAT "%5.3"
 /begin AXIS_DESCR COM_AXIS n_32 _CNV_A_R_LINEAR_____9_CM 6 0. 8160. FORMAT "%4.0" AXIS_PTS_REF ldp_n_32_4_enrd_3 /end AXIS_DESCR
/end CHARACTERISTIC
/begin CHARACTERISTIC ip_fac_gain_er_at_4 "ER cylinder 4 multiplicative segment dependent factor for torsion correction with AT" CURVE 0xa10033bc _REC_CUR_20_u2_u1 1.99609375 _CNV_A_R_LINEAR_____27_CM 0. 1.99609375 DISPLAY_IDENTIFIER IP_FAC_GAIN_ER_AT_4 FORMAT "%5.3"
 /begin AXIS_DESCR COM_AXIS n_32 _CNV_A_R_LINEAR_____9_CM 6 0. 8160. FORMAT "%4.0" AXIS_PTS_REF ldp_n_32_4_enrd_4 /end AXIS_DESCR
/end CHARACTERISTIC
/begin CHARACTERISTIC ip_fac_gain_er_at_5 "ER cylinder 5 multiplicative segment dependent factor for torsion correction with AT" CURVE 0xa1003464 _REC_CUR_20_u2_u1 1.99609375 _CNV_A_R_LINEAR_____27_CM 0. 1.99609375 DISPLAY_IDENTIFIER IP_FAC_GAIN_ER_AT_5 FORMAT "%5.3"
 /begin AXIS_DESCR COM_AXIS n_32 _CNV_A_R_LINEAR_____9_CM 6 0. 8160. FORMAT "%4.0" AXIS_PTS_REF ldp_n_32_4_enrd_5 /end AXIS_DESCR
/end CHARACTERISTIC
/begin CHARACTERISTIC ip_fac_add_er_mt_0 "ER cylinder 0 additive segment dependent factor for torsion correction with MT" MAP 0xa1003164 _REC_MAP_20_u2_u1_u2 65535. _CNV_A_R_LINEAR_____403_CM -32768. 32767. DISPLAY_IDENTIFIER IP_FAC_ADD_ER_MT_0 FORMAT "%6.0"
 /begin AXIS_DESCR COM_AXIS n_32 _CNV_A_R_LINEAR_____9_CM 6 0. 8160. FORMAT "%4.0" AXIS_PTS_REF ldp_n_32_3_enrd_0 /end AXIS_DESCR
 /begin AXIS_DESCR COM_AXIS load_mis _CNV_A_R_LINEAR_____201_CM 6 0. 99.9969482421875 FORMAT "%7.3" AXIS_PTS_REF ldp_load_ip_fac_add_er_mt_0 /end AXIS_DESCR
/end CHARACTERISTIC
/begin CHARACTERISTIC ip_fac_add_er_mt_1 "ER cylinder 1 additive segment dependent factor for torsion correction with MT" MAP 0xa10031ac _REC_MAP_20_u2_u1_u2 65535. _CNV_A_R_LINEAR_____403_CM -32768. 32767. DISPLAY_IDENTIFIER IP_FAC_ADD_ER_MT_1 FORMAT "%6.0"
 /begin AXIS_DESCR COM_AXIS n_32 _CNV_A_R_LINEAR_____9_CM 6 0. 8160. FORMAT "%4.0" AXIS_PTS_REF ldp_n_32_3_enrd_1 /end AXIS_DESCR
 /begin AXIS_DESCR COM_AXIS load_mis _CNV_A_R_LINEAR_____201_CM 6 0. 99.9969482421875 FORMAT "%7.3" AXIS_PTS_REF ldp_load_ip_fac_add_er_mt_1 /end AXIS_DESCR
/end CHARACTERISTIC
/begin CHARACTERISTIC ip_fac_add_er_mt_2 "ER cylinder 2 additive segment dependent factor for torsion correction with MT" MAP 0xa10031f4 _REC_MAP_20_u2_u1_u2 65535. _CNV_A_R_LINEAR_____403_CM -32768. 32767. DISPLAY_IDENTIFIER IP_FAC_ADD_ER_MT_2 FORMAT "%6.0"
 /begin AXIS_DESCR COM_AXIS n_32 _CNV_A_R_LINEAR_____9_CM 6 0. 8160. FORMAT "%4.0" AXIS_PTS_REF ldp_n_32_3_enrd_2 /end AXIS_DESCR
 /begin AXIS_DESCR COM_AXIS load_mis _CNV_A_R_LINEAR_____201_CM 6 0. 99.9969482421875 FORMAT "%7.3" AXIS_PTS_REF ldp_load_ip_fac_add_er_mt_2 /end AXIS_DESCR
/end CHARACTERISTIC
/begin CHARACTERISTIC ip_fac_add_er_mt_4 "ER cylinder 4 additive segment dependent factor for torsion correction with MT" MAP 0xa1003374 _REC_MAP_20_u2_u1_u2 65535. _CNV_A_R_LINEAR_____403_CM -32768. 32767. DISPLAY_IDENTIFIER IP_FAC_ADD_ER_MT_4 FORMAT "%6.0"
 /begin AXIS_DESCR COM_AXIS n_32 _CNV_A_R_LINEAR_____9_CM 6 0. 8160. FORMAT "%4.0" AXIS_PTS_REF ldp_n_32_3_enrd_4 /end AXIS_DESCR
 /begin AXIS_DESCR COM_AXIS load_mis _CNV_A_R_LINEAR_____201_CM 6 0. 99.9969482421875 FORMAT "%7.3" AXIS_PTS_REF ldp_load_ip_fac_add_er_mt_4 /end AXIS_DESCR
/end CHARACTERISTIC
/begin CHARACTERISTIC ip_fac_add_er_mt_3 "ER cylinder 3 additive segment dependent factor for torsion correction with MT" MAP 0xa10032cc _REC_MAP_20_u2_u1_u2 65535. _CNV_A_R_LINEAR_____403_CM -32768. 32767. DISPLAY_IDENTIFIER IP_FAC_ADD_ER_MT_3 FORMAT "%6.0"
 /begin AXIS_DESCR COM_AXIS n_32 _CNV_A_R_LINEAR_____9_CM 6 0. 8160. FORMAT "%4.0" AXIS_PTS_REF ldp_n_32_3_enrd_3 /end AXIS_DESCR
 /begin AXIS_DESCR COM_AXIS load_mis _CNV_A_R_LINEAR_____201_CM 6 0. 99.9969482421875 FORMAT "%7.3" AXIS_PTS_REF ldp_load_ip_fac_add_er_mt_3 /end AXIS_DESCR
/end CHARACTERISTIC
/begin CHARACTERISTIC ip_fac_add_er_mt_5 "ER cylinder 5 additive segment dependent factor for torsion correction with MT" MAP 0xa100341c _REC_MAP_20_u2_u1_u2 65535. _CNV_A_R_LINEAR_____403_CM -32768. 32767. DISPLAY_IDENTIFIER IP_FAC_ADD_ER_MT_5 FORMAT "%6.0"
 /begin AXIS_DESCR COM_AXIS n_32 _CNV_A_R_LINEAR_____9_CM 6 0. 8160. FORMAT "%4.0" AXIS_PTS_REF ldp_n_32_3_enrd_5 /end AXIS_DESCR
 /begin AXIS_DESCR COM_AXIS load_mis _CNV_A_R_LINEAR_____201_CM 6 0. 99.9969482421875 FORMAT "%7.3" AXIS_PTS_REF ldp_load_ip_fac_add_er_mt_5 /end AXIS_DESCR
/end CHARACTERISTIC
/begin CHARACTERISTIC ip_fac_add_er_at_0 "ER cylinder 0 additive segment dependent factor for torsion correction with AT" MAP 0xa100308c _REC_MAP_20_u2_u1_u2 65535. _CNV_A_R_LINEAR_____403_CM -32768. 32767. DISPLAY_IDENTIFIER IP_FAC_ADD_ER_AT_0 FORMAT "%6.0"
 /begin AXIS_DESCR COM_AXIS n_32 _CNV_A_R_LINEAR_____9_CM 6 0. 8160. FORMAT "%4.0" AXIS_PTS_REF ldp_n_32_5_enrd_0 /end AXIS_DESCR
 /begin AXIS_DESCR COM_AXIS load_mis _CNV_A_R_LINEAR_____201_CM 6 0. 99.9969482421875 FORMAT "%7.3" AXIS_PTS_REF ldp_load_ip_fac_add_er_at_0 /end AXIS_DESCR
/end CHARACTERISTIC
/begin CHARACTERISTIC ip_fac_add_er_at_1 "ER cylinder 1 additive segment dependent factor for torsion correction with AT" MAP 0xa10030d4 _REC_MAP_20_u2_u1_u2 65535. _CNV_A_R_LINEAR_____403_CM -32768. 32767. DISPLAY_IDENTIFIER IP_FAC_ADD_ER_AT_1 FORMAT "%6.0"
 /begin AXIS_DESCR COM_AXIS n_32 _CNV_A_R_LINEAR_____9_CM 6 0. 8160. FORMAT "%4.0" AXIS_PTS_REF ldp_n_32_5_enrd_1 /end AXIS_DESCR
 /begin AXIS_DESCR COM_AXIS load_mis _CNV_A_R_LINEAR_____201_CM 6 0. 99.9969482421875 FORMAT "%7.3" AXIS_PTS_REF ldp_load_ip_fac_add_er_at_1 /end AXIS_DESCR
/end CHARACTERISTIC
/begin CHARACTERISTIC ip_fac_add_er_at_2 "ER cylinder 2 additive segment dependent factor for torsion correction with AT" MAP 0xa100311c _REC_MAP_20_u2_u1_u2 65535. _CNV_A_R_LINEAR_____403_CM -32768. 32767. DISPLAY_IDENTIFIER IP_FAC_ADD_ER_AT_2 FORMAT "%6.0"
 /begin AXIS_DESCR COM_AXIS n_32 _CNV_A_R_LINEAR_____9_CM 6 0. 8160. FORMAT "%4.0" AXIS_PTS_REF ldp_n_32_5_enrd_2 /end AXIS_DESCR
 /begin AXIS_DESCR COM_AXIS load_mis _CNV_A_R_LINEAR_____201_CM 6 0. 99.9969482421875 FORMAT "%7.3" AXIS_PTS_REF ldp_load_ip_fac_add_er_at_2 /end AXIS_DESCR
/end CHARACTERISTIC
/begin CHARACTERISTIC ip_fac_add_er_at_3 "ER cylinder 3 additive segment dependent factor for torsion correction with AT" MAP 0xa1003284 _REC_MAP_20_u2_u1_u2 65535. _CNV_A_R_LINEAR_____403_CM -32768. 32767. DISPLAY_IDENTIFIER IP_FAC_ADD_ER_AT_3 FORMAT "%6.0"
 /begin AXIS_DESCR COM_AXIS n_32 _CNV_A_R_LINEAR_____9_CM 6 0. 8160. FORMAT "%4.0" AXIS_PTS_REF ldp_n_32_5_enrd_3 /end AXIS_DESCR
 /begin AXIS_DESCR COM_AXIS load_mis _CNV_A_R_LINEAR_____201_CM 6 0. 99.9969482421875 FORMAT "%7.3" AXIS_PTS_REF ldp_load_ip_fac_add_er_at_3 /end AXIS_DESCR
/end CHARACTERISTIC
/begin CHARACTERISTIC ip_fac_add_er_at_4 "ER cylinder 4 additive segment dependet factor for torsion correction with AT" MAP 0xa100332c _REC_MAP_20_u2_u1_u2 65535. _CNV_A_R_LINEAR_____403_CM -32768. 32767. DISPLAY_IDENTIFIER IP_FAC_ADD_ER_AT_4 FORMAT "%6.0"
 /begin AXIS_DESCR COM_AXIS n_32 _CNV_A_R_LINEAR_____9_CM 6 0. 8160. FORMAT "%4.0" AXIS_PTS_REF ldp_n_32_5_enrd_4 /end AXIS_DESCR
 /begin AXIS_DESCR COM_AXIS load_mis _CNV_A_R_LINEAR_____201_CM 6 0. 99.9969482421875 FORMAT "%7.3" AXIS_PTS_REF ldp_load_ip_fac_add_er_at_4 /end AXIS_DESCR
/end CHARACTERISTIC
/begin CHARACTERISTIC ip_fac_add_er_at_5 "ER cylinder 5 additive segment dependent factor for torsion correction with AT" MAP 0xa10033d4 _REC_MAP_20_u2_u1_u2 65535. _CNV_A_R_LINEAR_____403_CM -32768. 32767. DISPLAY_IDENTIFIER IP_FAC_ADD_ER_AT_5 FORMAT "%6.0"
 /begin AXIS_DESCR COM_AXIS n_32 _CNV_A_R_LINEAR_____9_CM 6 0. 8160. FORMAT "%4.0" AXIS_PTS_REF ldp_n_32_5_enrd_5 /end AXIS_DESCR
 /begin AXIS_DESCR COM_AXIS load_mis _CNV_A_R_LINEAR_____201_CM 6 0. 99.9969482421875 FORMAT "%7.3" AXIS_PTS_REF ldp_load_ip_fac_add_er_at_5 /end AXIS_DESCR
/end CHARACTERISTIC
/begin AXIS_PTS ldp_load_mis_ip_fac_drv2_er_at "" 0xa1002d58 load_mis _REC_AXS_20_u2 99.9969482421875 _CNV_A_R_LINEAR_____201_CM 6 0. 99.9969482421875 FORMAT "%7.3" /end AXIS_PTS
/begin AXIS_PTS ldp_load_mis_ip_fac_drv2_er_mt "" 0xa1002d68 load_mis _REC_AXS_20_u2 99.9969482421875 _CNV_A_R_LINEAR_____201_CM 6 0. 99.9969482421875 FORMAT "%7.3" /end AXIS_PTS
/begin CHARACTERISTIC ip_fac_drv2_er_at "Weighting factor for DRV2 component calculation  - AT vehicle" MAP 0xa1002f18 _REC_MAP_20_u2_u1_u2 4. _CNV_A_R_ENRD_LINEA_402_CM 0. 4. DISPLAY_IDENTIFIER IP_FAC_DRV2_ER_AT FORMAT "%6.5"
 /begin AXIS_DESCR COM_AXIS n_32 _CNV_A_R_LINEAR_____9_CM 6 0. 8160. FORMAT "%4.0" AXIS_PTS_REF ldp_n_32_ip_fac_n_drv2_er_at /end AXIS_DESCR
 /begin AXIS_DESCR COM_AXIS load_mis _CNV_A_R_LINEAR_____201_CM 6 0. 99.9969482421875 FORMAT "%7.3" AXIS_PTS_REF ldp_load_mis_ip_fac_drv2_er_at /end AXIS_DESCR
/end CHARACTERISTIC
/begin CHARACTERISTIC ip_fac_drv2_er_mt "Weighting factor for DRV2 component calculation  - MT vehicle" MAP 0xa1002fa0 _REC_MAP_20_u2_u1_u2 4. _CNV_A_R_ENRD_LINEA_402_CM 0. 4. DISPLAY_IDENTIFIER IP_FAC_DRV2_ER_MT FORMAT "%6.5"
 /begin AXIS_DESCR COM_AXIS n_32 _CNV_A_R_LINEAR_____9_CM 6 0. 8160. FORMAT "%4.0" AXIS_PTS_REF ldp_n_32_ip_fac_n_drv2_er_mt /end AXIS_DESCR
 /begin AXIS_DESCR COM_AXIS load_mis _CNV_A_R_LINEAR_____201_CM 6 0. 99.9969482421875 FORMAT "%7.3" AXIS_PTS_REF ldp_load_mis_ip_fac_drv2_er_mt /end AXIS_DESCR
/end CHARACTERISTIC
/begin CHARACTERISTIC c_seg_dly_er "Delay of ER segment reference" VALUE 0xa100305e _REC_VAL_20_u1 12. _CNV_A_R_LINEAR_____0_CM 0. 12. DISPLAY_IDENTIFIER C_SEG_DLY_ER FORMAT "%3.0" /end CHARACTERISTIC
/begin AXIS_PTS ldp_n_ip_fac_n_drv2_er_is_at "" 0xa1002ec0 n _REC_AXS_20_u2 8160. _CNV_A_R_LINEAR_____13_CM 4 0. 8160. FORMAT "%4.0" /end AXIS_PTS
/begin AXIS_PTS ldp_n_ip_fac_n_drv2_er_is_mt "" 0xa1002ecc n _REC_AXS_20_u2 8160. _CNV_A_R_LINEAR_____13_CM 4 0. 8160. FORMAT "%4.0" /end AXIS_PTS
/begin AXIS_PTS ldp_tco_ip_fac_drv2_zdly_er "" 0xa1002ed6 tco _REC_AXS_20_u1 190.5 _CNV_A_R_LINEAR_____16_CM 6 -48. 142.5 FORMAT "%6.2" /end AXIS_PTS
/begin AXIS_PTS ldp_load_ip_fac_drv2_er_is_at "" 0xa1002d40 load_mis _REC_AXS_20_u2 99.9969482421875 _CNV_A_R_LINEAR_____201_CM 4 0. 99.9969482421875 FORMAT "%7.3" /end AXIS_PTS
/begin AXIS_PTS ldp_load_ip_fac_drv2_er_is_mt "" 0xa1002d4c load_mis _REC_AXS_20_u2 99.9969482421875 _CNV_A_R_LINEAR_____201_CM 4 0. 99.9969482421875 FORMAT "%7.3" /end AXIS_PTS
/begin CHARACTERISTIC ip_fac_drv2_er_is_at "Weighting factor for DRV2 component calculation - AT vehicle in idle speed" MAP 0xa1002f60 _REC_MAP_20_u2_u2_u2 4. _CNV_A_R_ENRD_LINEA_402_CM 0. 4. DISPLAY_IDENTIFIER IP_FAC_DRV2_ER_IS_AT FORMAT "%6.5"
 /begin AXIS_DESCR COM_AXIS n _CNV_A_R_LINEAR_____13_CM 4 0. 8160. FORMAT "%4.0" AXIS_PTS_REF ldp_n_ip_fac_n_drv2_er_is_at /end AXIS_DESCR
 /begin AXIS_DESCR COM_AXIS load_mis _CNV_A_R_LINEAR_____201_CM 4 0. 99.9969482421875 FORMAT "%7.3" AXIS_PTS_REF ldp_load_ip_fac_drv2_er_is_at /end AXIS_DESCR
/end CHARACTERISTIC
/begin CHARACTERISTIC ip_fac_drv2_er_is_mt "Weighting factor for DRV2 component calculation  - MT vehicle in idle speed" MAP 0xa1002f80 _REC_MAP_20_u2_u2_u2 4. _CNV_A_R_ENRD_LINEA_402_CM 0. 4. DISPLAY_IDENTIFIER IP_FAC_DRV2_ER_IS_MT FORMAT "%6.5"
 /begin AXIS_DESCR COM_AXIS n _CNV_A_R_LINEAR_____13_CM 4 0. 8160. FORMAT "%4.0" AXIS_PTS_REF ldp_n_ip_fac_n_drv2_er_is_mt /end AXIS_DESCR
 /begin AXIS_DESCR COM_AXIS load_mis _CNV_A_R_LINEAR_____201_CM 4 0. 99.9969482421875 FORMAT "%7.3" AXIS_PTS_REF ldp_load_ip_fac_drv2_er_is_mt /end AXIS_DESCR
/end CHARACTERISTIC
/begin CHARACTERISTIC ip_fac_drv2_zdly_er "Weighting factor for engine roughness curvative component calculation (correction amount) after start" CURVE 0xa1002fe8 _REC_CUR_20_u2_u1 4. _CNV_A_R_ENRD_LINEA_402_CM 0. 4. DISPLAY_IDENTIFIER IP_FAC_DRV2_ZDLY_ER FORMAT "%6.5"
 /begin AXIS_DESCR COM_AXIS tco _CNV_A_R_LINEAR_____16_CM 6 -48. 142.5 FORMAT "%6.2" AXIS_PTS_REF ldp_tco_ip_fac_drv2_zdly_er /end AXIS_DESCR
/end CHARACTERISTIC
/begin CHARACTERISTIC c_n_32_max_drv2_er_is "Maximum engine speed to apply DRV2 specific weighting factor in idle speed" VALUE 0xa1003042 _REC_VAL_20_u1 8160. _CNV_A_R_LINEAR_____9_CM 0. 8160. DISPLAY_IDENTIFIER C_N_32_MAX_DRV2_ER_IS FORMAT "%4.0" /end CHARACTERISTIC
/begin AXIS_PTS ldp_n_32_2_enrd_0 "" 0xa1002d96 n_32 _REC_AXS_20_u1 8160. _CNV_A_R_LINEAR_____9_CM 6 0. 8160. FORMAT "%4.0" /end AXIS_PTS
/begin AXIS_PTS ldp_n_32_2_enrd_1 "" 0xa1002d9e n_32 _REC_AXS_20_u1 8160. _CNV_A_R_LINEAR_____9_CM 6 0. 8160. FORMAT "%4.0" /end AXIS_PTS
/begin AXIS_PTS ldp_n_32_2_enrd_2 "" 0xa1002da6 n_32 _REC_AXS_20_u1 8160. _CNV_A_R_LINEAR_____9_CM 6 0. 8160. FORMAT "%4.0" /end AXIS_PTS
/begin AXIS_PTS ldp_n_32_2_enrd_3 "" 0xa1002dae n_32 _REC_AXS_20_u1 8160. _CNV_A_R_LINEAR_____9_CM 6 0. 8160. FORMAT "%4.0" /end AXIS_PTS
/begin AXIS_PTS ldp_n_32_2_enrd_4 "" 0xa1002db6 n_32 _REC_AXS_20_u1 8160. _CNV_A_R_LINEAR_____9_CM 6 0. 8160. FORMAT "%4.0" /end AXIS_PTS
/begin AXIS_PTS ldp_n_32_2_enrd_5 "" 0xa1002dbe n_32 _REC_AXS_20_u1 8160. _CNV_A_R_LINEAR_____9_CM 6 0. 8160. FORMAT "%4.0" /end AXIS_PTS
/begin AXIS_PTS ldp_n_32_2_enrd_6 "" 0xa1002dc6 n_32 _REC_AXS_20_u1 8160. _CNV_A_R_LINEAR_____9_CM 6 0. 8160. FORMAT "%4.0" /end AXIS_PTS
/begin AXIS_PTS ldp_n_32_2_enrd_7 "" 0xa1002dce n_32 _REC_AXS_20_u1 8160. _CNV_A_R_LINEAR_____9_CM 6 0. 8160. FORMAT "%4.0" /end AXIS_PTS
/begin AXIS_PTS ldp_n_32_3_enrd_0 "" 0xa1002dd6 n_32 _REC_AXS_20_u1 8160. _CNV_A_R_LINEAR_____9_CM 6 0. 8160. FORMAT "%4.0" /end AXIS_PTS
/begin AXIS_PTS ldp_n_32_3_enrd_1 "" 0xa1002dde n_32 _REC_AXS_20_u1 8160. _CNV_A_R_LINEAR_____9_CM 6 0. 8160. FORMAT "%4.0" /end AXIS_PTS
/begin AXIS_PTS ldp_n_32_3_enrd_2 "" 0xa1002de6 n_32 _REC_AXS_20_u1 8160. _CNV_A_R_LINEAR_____9_CM 6 0. 8160. FORMAT "%4.0" /end AXIS_PTS
/begin AXIS_PTS ldp_n_32_3_enrd_3 "" 0xa1002dee n_32 _REC_AXS_20_u1 8160. _CNV_A_R_LINEAR_____9_CM 6 0. 8160. FORMAT "%4.0" /end AXIS_PTS
/begin AXIS_PTS ldp_n_32_3_enrd_4 "" 0xa1002df6 n_32 _REC_AXS_20_u1 8160. _CNV_A_R_LINEAR_____9_CM 6 0. 8160. FORMAT "%4.0" /end AXIS_PTS
/begin AXIS_PTS ldp_n_32_3_enrd_5 "" 0xa1002dfe n_32 _REC_AXS_20_u1 8160. _CNV_A_R_LINEAR_____9_CM 6 0. 8160. FORMAT "%4.0" /end AXIS_PTS
/begin AXIS_PTS ldp_n_32_3_enrd_6 "" 0xa1002e06 n_32 _REC_AXS_20_u1 8160. _CNV_A_R_LINEAR_____9_CM 6 0. 8160. FORMAT "%4.0" /end AXIS_PTS
/begin AXIS_PTS ldp_n_32_3_enrd_7 "" 0xa1002e0e n_32 _REC_AXS_20_u1 8160. _CNV_A_R_LINEAR_____9_CM 6 0. 8160. FORMAT "%4.0" /end AXIS_PTS
/begin AXIS_PTS ldp_n_32_4_enrd_0 "" 0xa1002e16 n_32 _REC_AXS_20_u1 8160. _CNV_A_R_LINEAR_____9_CM 6 0. 8160. FORMAT "%4.0" /end AXIS_PTS
/begin AXIS_PTS ldp_n_32_4_enrd_1 "" 0xa1002e1e n_32 _REC_AXS_20_u1 8160. _CNV_A_R_LINEAR_____9_CM 6 0. 8160. FORMAT "%4.0" /end AXIS_PTS
/begin AXIS_PTS ldp_n_32_4_enrd_2 "" 0xa1002e26 n_32 _REC_AXS_20_u1 8160. _CNV_A_R_LINEAR_____9_CM 6 0. 8160. FORMAT "%4.0" /end AXIS_PTS
/begin AXIS_PTS ldp_n_32_4_enrd_3 "" 0xa1002e2e n_32 _REC_AXS_20_u1 8160. _CNV_A_R_LINEAR_____9_CM 6 0. 8160. FORMAT "%4.0" /end AXIS_PTS
/begin AXIS_PTS ldp_n_32_4_enrd_4 "" 0xa1002e36 n_32 _REC_AXS_20_u1 8160. _CNV_A_R_LINEAR_____9_CM 6 0. 8160. FORMAT "%4.0" /end AXIS_PTS
/begin AXIS_PTS ldp_n_32_4_enrd_5 "" 0xa1002e3e n_32 _REC_AXS_20_u1 8160. _CNV_A_R_LINEAR_____9_CM 6 0. 8160. FORMAT "%4.0" /end AXIS_PTS
/begin AXIS_PTS ldp_n_32_4_enrd_6 "" 0xa1002e46 n_32 _REC_AXS_20_u1 8160. _CNV_A_R_LINEAR_____9_CM 6 0. 8160. FORMAT "%4.0" /end AXIS_PTS
/begin AXIS_PTS ldp_n_32_4_enrd_7 "" 0xa1002e4e n_32 _REC_AXS_20_u1 8160. _CNV_A_R_LINEAR_____9_CM 6 0. 8160. FORMAT "%4.0" /end AXIS_PTS
/begin AXIS_PTS ldp_n_32_5_enrd_0 "" 0xa1002e56 n_32 _REC_AXS_20_u1 8160. _CNV_A_R_LINEAR_____9_CM 6 0. 8160. FORMAT "%4.0" /end AXIS_PTS
/begin AXIS_PTS ldp_n_32_5_enrd_1 "" 0xa1002e5e n_32 _REC_AXS_20_u1 8160. _CNV_A_R_LINEAR_____9_CM 6 0. 8160. FORMAT "%4.0" /end AXIS_PTS
/begin AXIS_PTS ldp_n_32_5_enrd_2 "" 0xa1002e66 n_32 _REC_AXS_20_u1 8160. _CNV_A_R_LINEAR_____9_CM 6 0. 8160. FORMAT "%4.0" /end AXIS_PTS
/begin AXIS_PTS ldp_n_32_5_enrd_3 "" 0xa1002e6e n_32 _REC_AXS_20_u1 8160. _CNV_A_R_LINEAR_____9_CM 6 0. 8160. FORMAT "%4.0" /end AXIS_PTS
/begin AXIS_PTS ldp_n_32_5_enrd_4 "" 0xa1002e76 n_32 _REC_AXS_20_u1 8160. _CNV_A_R_LINEAR_____9_CM 6 0. 8160. FORMAT "%4.0" /end AXIS_PTS
/begin AXIS_PTS ldp_n_32_5_enrd_5 "" 0xa1002e7e n_32 _REC_AXS_20_u1 8160. _CNV_A_R_LINEAR_____9_CM 6 0. 8160. FORMAT "%4.0" /end AXIS_PTS
/begin AXIS_PTS ldp_n_32_5_enrd_6 "" 0xa1002e86 n_32 _REC_AXS_20_u1 8160. _CNV_A_R_LINEAR_____9_CM 6 0. 8160. FORMAT "%4.0" /end AXIS_PTS
/begin AXIS_PTS ldp_n_32_5_enrd_7 "" 0xa1002e8e n_32 _REC_AXS_20_u1 8160. _CNV_A_R_LINEAR_____9_CM 6 0. 8160. FORMAT "%4.0" /end AXIS_PTS
/begin COMPU_METHOD _CNV_A_R_LINEAR_____0_CM "" RAT_FUNC "%6.3" "-" COEFFS 0 1. 0. 0 0 1 /end COMPU_METHOD
/begin COMPU_METHOD _CNV_S_2_RANGE__0___1_CM "" TAB_VERB "%6.3" "-" COMPU_TAB_REF _CNV_S_2_RANGE__0___1 /end COMPU_METHOD
/begin COMPU_VTAB _CNV_S_2_RANGE__0___1 "" TAB_VERB 2 0 "0" 1 "1" /end COMPU_VTAB
/begin COMPU_METHOD _CNV_A_R_LINEAR_____2_CM "" RAT_FUNC "%6.3" "V" COEFFS 0 204.8 0. 0 0 1 /end COMPU_METHOD
/begin COMPU_METHOD _CNV_A_R_LINEAR_____3_CM "" RAT_FUNC "%6.3" "s" COEFFS 0 100. 0. 0 0 1 /end COMPU_METHOD
/begin COMPU_METHOD _CNV_A_R_LINEAR_____4_CM "" RAT_FUNC "%6.3" "s" COEFFS 0 10. 0. 0 0 1 /end COMPU_METHOD
/begin COMPU_METHOD _CNV_A_R_LINEAR_____5_CM "" RAT_FUNC "%6.3" "%" COEFFS 0 2.56 0. 0 0 1 /end COMPU_METHOD
/begin COMPU_METHOD _CNV_A_R_LINEAR_____7_CM "" RAT_FUNC "%6.3" "%" COEFFS 0 655.3599999999997 0. 0 0 1 /end COMPU_METHOD
/begin COMPU_METHOD _CNV_A_R_LINEAR_____9_CM "" RAT_FUNC "%6.3" "rpm" COEFFS 0 3.125e-002 0. 0 0 1 /end COMPU_METHOD
/begin COMPU_METHOD _CNV_A_R_LINEAR_____13_CM "" RAT_FUNC "%6.3" "rpm" COEFFS 0 1. 0. 0 0 1 /end COMPU_METHOD
/begin COMPU_METHOD _CNV_A_R_LINEAR_____14_CM "" RAT_FUNC "%6.3" "mg/stk" COEFFS 0 0.183585313174946 0. 0 0 1 /end COMPU_METHOD
/begin COMPU_METHOD _CNV_A_R_LINEAR_____16_CM "" RAT_FUNC "%6.3" "°C" COEFFS 0 1.333333333333333 64. 0 0 1 /end COMPU_METHOD
/begin COMPU_METHOD _CNV_A_R_LINEAR_____23_CM "" RAT_FUNC "%6.3" "-" COEFFS 0 16384. 0. 0 0 1 /end COMPU_METHOD
/begin COMPU_METHOD _CNV_A_R_LINEAR_____27_CM "" RAT_FUNC "%6.3" "-" COEFFS 0 256. 0. 0 0 1 /end COMPU_METHOD
/begin COMPU_METHOD _CNV_A_R_LINEAR_____35_CM "" RAT_FUNC "%6.3" "s" COEFFS 0 1. 0. 0 0 1 /end COMPU_METHOD
/begin COMPU_METHOD _CNV_A_R_LINEAR_____68_CM "" RAT_FUNC "%6.3" "-" COEFFS 0 65535.99999999996 0. 0 0 1 /end COMPU_METHOD
/begin COMPU_METHOD _CNV_A_R_LINEAR_____71_CM "" RAT_FUNC "%6.3" "" COEFFS 0 256. 0. 0 0 1 /end COMPU_METHOD
/begin COMPU_METHOD _CNV_A_R_LINEAR_____100_CM "" RAT_FUNC "%6.3" "-" COEFFS 0 128. 0. 0 0 1 /end COMPU_METHOD
/begin COMPU_METHOD _CNV_A_R_LINEAR_____107_CM "" RAT_FUNC "%6.3" "s" COEFFS 0 50. 0. 0 0 1 /end COMPU_METHOD
/begin COMPU_METHOD _CNV_A_R_LINEAR_____108_CM "" RAT_FUNC "%6.3" "mg/stk" COEFFS 0 47.18142548596112 0. 0 0 1 /end COMPU_METHOD
/begin COMPU_METHOD _CNV_A_R_LINEAR_____109_CM "" RAT_FUNC "%6.3" "°CRK" COEFFS 0 0.1666666666666667 0. 0 0 1 /end COMPU_METHOD
/begin COMPU_METHOD _CNV_A_R_LINEAR_____110_CM "" RAT_FUNC "%6.3" "%" COEFFS 0 655.3599999999997 -1.455191522836685e-011 0 0 1 /end COMPU_METHOD
/begin COMPU_METHOD _CNV_A_R_LINEAR_____115_CM "" RAT_FUNC "%6.3" "-" COEFFS 0 4096. 0. 0 0 1 /end COMPU_METHOD
/begin COMPU_METHOD _CNV_A_R_LINEAR_____117_CM "" RAT_FUNC "%6.3" "s" COEFFS 0 32767.99999999992 0. 0 0 1 /end COMPU_METHOD
/begin COMPU_METHOD _CNV_A_R_LINEAR_____119_CM "" RAT_FUNC "%6.3" "%" COEFFS 0 655.3600000143365 0. 0 0 1 /end COMPU_METHOD
/begin COMPU_METHOD _CNV_A_R_LINEAR_____122_CM "" RAT_FUNC "%6.3" "-" COEFFS 0 1024. 0. 0 0 1 /end COMPU_METHOD
/begin COMPU_METHOD _CNV_A_R_LINEAR_____159_CM "" RAT_FUNC "%6.3" "%" COEFFS 0 655.3600000071681 32768.00000035841 0 0 1 /end COMPU_METHOD
/begin COMPU_METHOD _CNV_A_R_LINEAR_____190_CM "" RAT_FUNC "%6.3" "V" COEFFS 0 13107.19998965744 0. 0 0 1 /end COMPU_METHOD
/begin COMPU_METHOD _CNV_A_R_LINEAR_____201_CM "" RAT_FUNC "%6.3" "%" COEFFS 0 327.68 0. 0 0 1 /end COMPU_METHOD
/begin COMPU_METHOD _CNV_A_R_LINEAR_____202_CM "" RAT_FUNC "%6.3" "mg/stk" COEFFS 0 47.18142548596112 -1.455191522836685e-011 0 0 1 /end COMPU_METHOD
/begin COMPU_METHOD _CNV_A_R_LINEAR_____204_CM "" RAT_FUNC "%6.3" "°C" COEFFS 0 16. 4370.4 0 0 1 /end COMPU_METHOD
/begin COMPU_METHOD _CNV_A_R_LINEAR_____207_CM "" RAT_FUNC "%6.3" "kg/h" COEFFS 0 32. 0. 0 0 1 /end COMPU_METHOD
/begin COMPU_METHOD _CNV_A_R_LINEAR_____217_CM "" RAT_FUNC "%6.3" "g" COEFFS 0 35.99999934081027 0. 0 0 1 /end COMPU_METHOD
/begin COMPU_METHOD _CNV_A_R_LINEAR_____275_CM "" RAT_FUNC "%6.3" "-" COEFFS 0 32768. 0. 0 0 1 /end COMPU_METHOD
/begin COMPU_METHOD _CNV_A_R_LINEAR_____318_CM "" RAT_FUNC "%6.3" "kg/h" COEFFS 0 64. 0. 0 0 1 /end COMPU_METHOD
/begin COMPU_METHOD _CNV_A_R_LINEAR_____329_CM "" RAT_FUNC "%6.3" "g" COEFFS 0 22.49999999999997 0. 0 0 1 /end COMPU_METHOD
/begin COMPU_METHOD _CNV_A_R_LINEAR_____356_CM "" RAT_FUNC "%6.3" "g" COEFFS 0 35.99993408114611 0. 0 0 1 /end COMPU_METHOD
/begin COMPU_METHOD _CNV_A_R_LINEAR_____369_CM "" RAT_FUNC "%6.3" "V" COEFFS 0 204.7999999487896 -2.556795379859977e-007 0 0 1 /end COMPU_METHOD
/begin COMPU_METHOD _CNV_A_R_EGCP_LINEA_370_CM "" RAT_FUNC "%6.3" "-" COEFFS 0 8. 0. 0 0 1 /end COMPU_METHOD
/begin COMPU_METHOD _CNV_A_R_LINEAR_____375_CM "" RAT_FUNC "%6.3" "s" COEFFS 0 64000.02343786621 0. 0 0 1 /end COMPU_METHOD
/begin COMPU_METHOD _CNV_A_R_LACO_LINEA_376_CM "" RAT_FUNC "%6.3" "V" COEFFS 0 204.799999948775 1023.999999743875 0 0 1 /end COMPU_METHOD
/begin COMPU_METHOD _CNV_A_R_LACO_LINEA_381_CM "" RAT_FUNC "%6.3" "-" COEFFS 0 32768.00000000001 4.76837158203125e-007 0 0 1 /end COMPU_METHOD
/begin COMPU_METHOD _CNV_A_R_LACO_LINEA_382_CM "" RAT_FUNC "%6.3" "%" COEFFS 0 42949672.96000002 9.5367431640625e-007 0 0 1 /end COMPU_METHOD
/begin COMPU_METHOD _CNV_A_R_LACO_LINEA_383_CM "" RAT_FUNC "%6.3" "-" COEFFS 0 2147483648. -4.76837158203125e-007 0 0 1 /end COMPU_METHOD
/begin COMPU_METHOD _CNV_A_R_LACO_LINEA_384_CM "" RAT_FUNC "%6.3" "1/s" COEFFS 0 1310.720001587224 0. 0 0 1 /end COMPU_METHOD
/begin COMPU_METHOD _CNV_A_R_LACO_LINEA_385_CM "" RAT_FUNC "%6.3" "1/s²" COEFFS 0 2621.439950744849 0. 0 0 1 /end COMPU_METHOD
/begin COMPU_METHOD _CNV_A_R_LACO_LINEA_386_CM "" RAT_FUNC "%6.3" "s" COEFFS 0 819195.4798869971 0. 0 0 1 /end COMPU_METHOD
/begin COMPU_METHOD _CNV_S_4_LACO_RANGE_387_CM "" TAB_VERB "%6.3" "-" COMPU_TAB_REF _CNV_S_4_LACO_RANGE_387 /end COMPU_METHOD
/begin COMPU_VTAB _CNV_S_4_LACO_RANGE_387 "" TAB_VERB 4 0 "0:OFF" 1 "1:ON" 2 "2:STOP_SHO_PER" 3 "3:STOP" /end COMPU_VTAB
/begin COMPU_METHOD _CNV_A_R_LACO_LINEA_388_CM "" RAT_FUNC "%6.3" "-" COEFFS 0 262144.0000000004 5.093170329928398e-011 0 0 1 /end COMPU_METHOD
/begin COMPU_METHOD _CNV_A_R_LACO_LINEA_389_CM "" RAT_FUNC "%6.3" "V" COEFFS 0 6553.599999999997 -1.455191522836685e-011 0 0 1 /end COMPU_METHOD
/begin COMPU_METHOD _CNV_A_R_LACO_LINEA_390_CM "" RAT_FUNC "%6.3" "g" COEFFS 0 45.00010299863355 0. 0 0 1 /end COMPU_METHOD
/begin COMPU_METHOD _CNV_A_R_LINEAR_____391_CM "" RAT_FUNC "%6.3" "g" COEFFS 0 35.99999999999994 0. 0 0 1 /end COMPU_METHOD
/begin COMPU_METHOD _CNV_S_5_LACO_RANGE_392_CM "" TAB_VERB "%6.3" "-" COMPU_TAB_REF _CNV_S_5_LACO_RANGE_392 /end COMPU_METHOD
/begin COMPU_VTAB _CNV_S_5_LACO_RANGE_392 "" TAB_VERB 5 1 "1:OL_CDN" 2 "2:CL" 4 "4:OL_INTR" 8 "8:OL_ERR" 16 "10:CL_ERR" /end COMPU_VTAB
/begin COMPU_METHOD _CNV_A_R_LACO_LINEA_393_CM "" RAT_FUNC "%6.3" "-" COEFFS 0 32768. 32768. 0 0 1 /end COMPU_METHOD
/begin COMPU_METHOD _CNV_A_R_LACO_LINEA_394_CM "" RAT_FUNC "%6.3" "1/s" COEFFS 0 1310.719996005547 2.790796169893639e-004 0 0 1 /end COMPU_METHOD
/begin COMPU_METHOD _CNV_A_R_LACO_LINEA_395_CM "" RAT_FUNC "%6.3" "-" COEFFS 0 16384. 2048. 0 0 1 /end COMPU_METHOD
/begin COMPU_METHOD _CNV_A_R_LACO_LINEA_396_CM "" RAT_FUNC "%6.3" "-" COEFFS 0 262144.0000000004 32768.00000000005 0 0 1 /end COMPU_METHOD
/begin COMPU_METHOD _CNV_A_R_LINEAR_____401_CM "" RAT_FUNC "%6.3" "µs" COEFFS 0 1. 0. 0 0 1 /end COMPU_METHOD
/begin COMPU_METHOD _CNV_A_R_ENRD_LINEA_402_CM "" RAT_FUNC "%6.3" "-" COEFFS 0 255. 0. 0 0 1 /end COMPU_METHOD
/begin COMPU_METHOD _CNV_A_R_LINEAR_____403_CM "" RAT_FUNC "%6.3" "µs" COEFFS 0 1. 32768. 0 0 1 /end COMPU_METHOD
/begin RECORD_LAYOUT _REC_VAL_20_u1 FNC_VALUES 1 UBYTE COLUMN_DIR DIRECT /end RECORD_LAYOUT
/begin RECORD_LAYOUT _REC_VAL_20_u2 FNC_VALUES 1 UWORD COLUMN_DIR DIRECT /end RECORD_LAYOUT
/begin RECORD_LAYOUT _REC_AXS_20_u1 NO_AXIS_PTS_X 1 UBYTE AXIS_PTS_X 2 UBYTE INDEX_INCR DIRECT /end RECORD_LAYOUT
/begin RECORD_LAYOUT _REC_MAP_20_u2_u1_u1 FNC_VALUES 1 UWORD COLUMN_DIR DIRECT /end RECORD_LAYOUT
/begin RECORD_LAYOUT _REC_CUR_20_u1_u1 FNC_VALUES 1 UBYTE COLUMN_DIR DIRECT /end RECORD_LAYOUT
/begin RECORD_LAYOUT _REC_VAL_20_s2 FNC_VALUES 1 SWORD COLUMN_DIR DIRECT /end RECORD_LAYOUT
/begin RECORD_LAYOUT _REC_MAP_20_u2_u2_u1 FNC_VALUES 1 UWORD COLUMN_DIR DIRECT /end RECORD_LAYOUT
/begin RECORD_LAYOUT _REC_AXS_20_u2 NO_AXIS_PTS_X 1 UWORD AXIS_PTS_X 2 UWORD INDEX_INCR DIRECT /end RECORD_LAYOUT
/begin RECORD_LAYOUT _REC_CUR_20_u2_u1 FNC_VALUES 1 UWORD COLUMN_DIR DIRECT /end RECORD_LAYOUT
/begin RECORD_LAYOUT _REC_CUR_20_u2_u2 FNC_VALUES 1 UWORD COLUMN_DIR DIRECT /end RECORD_LAYOUT
/begin RECORD_LAYOUT _REC_MAP_20_u2_u1_u2 FNC_VALUES 1 UWORD COLUMN_DIR DIRECT /end RECORD_LAYOUT
/begin RECORD_LAYOUT _REC_CUR_20_u1_u2 FNC_VALUES 1 UBYTE COLUMN_DIR DIRECT /end RECORD_LAYOUT
/begin RECORD_LAYOUT _REC_MAP_20_u2_u2_u2 FNC_VALUES 1 UWORD COLUMN_DIR DIRECT /end RECORD_LAYOUT
/begin RECORD_LAYOUT _REC_MAP_20_u1_u2_u2 FNC_VALUES 1 UBYTE COLUMN_DIR DIRECT /end RECORD_LAYOUT
/begin FUNCTION LACO_Lambda_CTL_WRAF_SENS "Lambda_CTL_WRAF_SENS"
 /begin DEF_CHARACTERISTIC ip_fac_eg_dly_2 ip_t1_lsl_up_1 ip_fac_gain_p_lam ip_fac_gain_i_lam ip_fac_gain_i2_lam ip_fac_gain_d_lam ip_fac_gain_p_lam_gain_swi ip_fac_gain_i_lam_gain_swi ip_fac_gain_i2_lam_gain_swi ip_fac_gain_d_lam_gain_swi id_tco_min_lam_lscl_is c_crlc_fac_lam_mv_mmv id_t_max_lscl_act_tco c_fac_lam_p_max_lam c_fac_lam_p_min_lam c_fac_lam_p_max_lam_cp c_fac_lam_i_i2_sum_min_lam c_fac_lam_i_i2_sum_max_lam c_fac_lam_i_i2_sum_min_lam_cp c_fac_lam_i_i2_sum_max_lam_cp c_fac_lam_d_min_lam c_fac_lam_d_max_lam c_n_min_lam_lscl c_fac_lam_delta_lscl_off lc_lam_i2_act id_tco_min_lam_lscl c_fac_lam_p_min_lam_cp c_fac_lam_out_min c_fac_lam_out_min_cp c_fac_lam_out_max c_fac_lam_out_max_cp c_crlc_fac_lam_mv ip_fac_eg_dly_1 ip_t1_lsl_up_2 ip_fac_lam_max_not_stat_cdn ip_fac_lam_min_not_stat_cdn ip_t1_lsl_up_agi_lim_1 ip_t1_lsl_up_agi_lim_2 ldp_maf_int_puc_ip_lamb_sp_the ip_lamb_sp_the_puc id_t_ast_min_lscl_act c_crlc_vls_down_mmv_lam c_vls_down_thd_afl_lam c_vls_down_thd_afr_lam c_tout_i_i2_shift_vld c_crlc_fac_dif_lam_in_mmv c_crlc_fac_lam_mv_mmv_ldc c_crlc_fac_lam_mv_mmv_ldc_diag /end DEF_CHARACTERISTIC
 /begin OUT_MEASUREMENT laco[0].laco_struct_reqgnlaco0.fac_dif_sum_lam_in laco[0].laco_struct_reqgnlaco0.fac_lam_i_it_lim laco[0].laco_struct_reqgnlaco0.fac_dif_sum_lim_lam_in laco[0].laco_struct_reqgnlaco0.fac_dif_sum_lam_in_save laco[0].laco_struct_reqgnlaco0.fac_dif_lam_in_mmv laco[0].laco_struct_reqgnlaco0.fac_lam_i_it laco[0].laco_struct_reqgnlaco0.fac_lam_pctl laco[0].laco_struct_reqgnlaco0.fac_lam_out laco[0].laco_struct_reqgnlaco0.fac_dif_lam_in laco[0].laco_struct_reqgnlaco0.fac_lam_i laco[0].laco_struct_reqgnlaco0.fac_lam_i2 laco[0].laco_struct_reqgnlaco0.fac_lam_i2_lim laco[0].laco_struct_reqgnlaco0.fac_lam_i_i2_sum_lim laco[0].laco_struct_reqgnlaco0.fac_lam_p_lim laco[0].laco_struct_reqgnlaco0.fac_lam_d_lim laco[0].laco_struct_reqgnlaco0.fac_lam_mv laco[0].laco_struct_reqgnlaco0.fac_lam_mv_mmv laco[0].laco_struct_reqgnlaco0.fac_lam_mv_mmv_cp laco[0].laco_struct_reqgnlaco0.fac_lam_mv_mmv_ldc laco[0].laco_struct_reqgnlaco0.fac_lam_mv_mmv_ldc_diag laco[0].laco_struct_reqgnlaco0.fac_lam_max_not_stat_cdn laco[0].laco_struct_reqgnlaco0.fac_lam_min_not_stat_cdn laco[0].laco_struct_reqgnlaco0.fac_lam_cor laco[0].laco_struct_reqgnlaco0.fac_lam_delta_i_i2_shift laco[0].laco_struct_reqgnlaco0.fac_lam_lim laco[0].laco_struct_reqgnlaco0.crlc_lsl_mdl laco[0].laco_struct_reqgnlaco0.fac_gain_p_lam laco[0].laco_struct_reqgnlaco0.fac_gain_i_lam laco[0].laco_struct_reqgnlaco0.fac_gain_i2_lam laco[0].laco_struct_reqgnlaco0.fac_gain_d_lam laco[0].laco_struct_reqgnlaco0.lamb_sp_fil_hom laco[0].laco_struct_reqgnlaco0.lamb_sp_pctl laco[0].laco_struct_reqgnlaco0.lamb_sp_fil_s laco[0].laco_struct_reqgnlaco0.lamb_sp_lsl_mdl_in_hom laco[0].laco_struct_reqgnlaco0.lamb_sp_lsl_mdl_out_hom laco[0].laco_struct_reqgnlaco0.lamb_sp_lsl_mdl_out_s laco[0].laco_struct_reqgnlaco0.lamb_cor_av_lam laco[0].laco_struct_reqgnlaco0.t1_lsl_up laco[0].laco_struct_reqgnlaco0.t_dly_soi_lsl_pos laco[0].laco_struct_reqgnlaco0.tout_i_i2_shift_vld_afl laco[0].laco_struct_reqgnlaco0.tout_i_i2_shift_vld_afr laco[0].laco_struct_reqgnlaco0.vls_down_mmv_lam laco[0].laco_struct_reqgnlaco0.mff_add_lam_ad_out laco[0].laco_struct_reqgnlaco0.fac_lam_ad_out laco[0].laco_struct_reqgnlaco0.ctr_raf_chg laco[0].laco_struct_reqgnlaco0.state_lam laco[0].laco_struct_reqgnlaco0.fac_eg_dly laco[0].laco_struct_reqgnlaco0.lv_lam_lscl laco[0].laco_struct_reqgnlaco0.lv_fac_lam_lim_not_stat_cdn laco[0].laco_struct_reqgnlaco0.lv_t_max_lscl_act_tco laco[0].laco_struct_reqgnlaco0.lv_fac_lam_adj_lam_ad_end laco[0].laco_struct_reqgnlaco0.lv_fac_lam_shift_cp_end laco[0].laco_struct_reqgnlaco0.lv_fac_lam_diagcp_end laco[0].laco_struct_reqgnlaco0.lv_fac_lam_lim_max laco[0].laco_struct_reqgnlaco0.lv_fac_lam_lim_min laco[0].laco_struct_reqgnlaco0.lv_vls_down_thd_afl_lam laco[0].laco_struct_reqgnlaco0.lv_vls_down_thd_afr_lam laco[0].laco_struct_reqgnlaco0.lv_vls_down_thd_afr_lam_old laco[0].laco_struct_reqgnlaco0.lv_vls_down_thd_afl_lam_old laco[1].laco_struct_reqgnlaco0.fac_dif_sum_lam_in laco[1].laco_struct_reqgnlaco0.fac_lam_i_it_lim laco[1].laco_struct_reqgnlaco0.fac_dif_sum_lim_lam_in laco[1].laco_struct_reqgnlaco0.fac_dif_sum_lam_in_save laco[1].laco_struct_reqgnlaco0.fac_dif_lam_in_mmv laco[1].laco_struct_reqgnlaco0.fac_lam_i_it laco[1].laco_struct_reqgnlaco0.fac_lam_pctl laco[1].laco_struct_reqgnlaco0.fac_lam_out laco[1].laco_struct_reqgnlaco0.fac_dif_lam_in laco[1].laco_struct_reqgnlaco0.fac_lam_i laco[1].laco_struct_reqgnlaco0.fac_lam_i2 laco[1].laco_struct_reqgnlaco0.fac_lam_i2_lim laco[1].laco_struct_reqgnlaco0.fac_lam_i_i2_sum_lim laco[1].laco_struct_reqgnlaco0.fac_lam_p_lim laco[1].laco_struct_reqgnlaco0.fac_lam_d_lim laco[1].laco_struct_reqgnlaco0.fac_lam_mv laco[1].laco_struct_reqgnlaco0.fac_lam_mv_mmv laco[1].laco_struct_reqgnlaco0.fac_lam_mv_mmv_cp laco[1].laco_struct_reqgnlaco0.fac_lam_mv_mmv_ldc laco[1].laco_struct_reqgnlaco0.fac_lam_max_not_stat_cdn laco[1].laco_struct_reqgnlaco0.fac_lam_min_not_stat_cdn laco[1].laco_struct_reqgnlaco0.fac_lam_cor laco[1].laco_struct_reqgnlaco0.fac_lam_delta_i_i2_shift laco[1].laco_struct_reqgnlaco0.fac_lam_lim laco[1].laco_struct_reqgnlaco0.crlc_lsl_mdl laco[1].laco_struct_reqgnlaco0.fac_gain_p_lam laco[1].laco_struct_reqgnlaco0.fac_gain_i_lam laco[1].laco_struct_reqgnlaco0.fac_gain_i2_lam laco[1].laco_struct_reqgnlaco0.fac_gain_d_lam laco[1].laco_struct_reqgnlaco0.lamb_sp_fil_hom laco[1].laco_struct_reqgnlaco0.lamb_sp_pctl laco[1].laco_struct_reqgnlaco0.lamb_sp_fil_s laco[1].laco_struct_reqgnlaco0.lamb_sp_lsl_mdl_in_hom laco[1].laco_struct_reqgnlaco0.lamb_sp_lsl_mdl_out_hom laco[1].laco_struct_reqgnlaco0.lamb_sp_lsl_mdl_out_s laco[1].laco_struct_reqgnlaco0.lamb_cor_av_lam laco[1].laco_struct_reqgnlaco0.t1_lsl_up laco[1].laco_struct_reqgnlaco0.t_dly_soi_lsl_pos laco[1].laco_struct_reqgnlaco0.tout_i_i2_shift_vld_afl laco[1].laco_struct_reqgnlaco0.tout_i_i2_shift_vld_afr laco[1].laco_struct_reqgnlaco0.vls_down_mmv_lam laco[1].laco_struct_reqgnlaco0.mff_add_lam_ad_out laco[1].laco_struct_reqgnlaco0.fac_lam_ad_out laco[1].laco_struct_reqgnlaco0.ctr_raf_chg laco[1].laco_struct_reqgnlaco0.state_lam laco[1].laco_struct_reqgnlaco0.fac_eg_dly laco[1].laco_struct_reqgnlaco0.lv_lam_lscl laco[1].laco_struct_reqgnlaco0.lv_fac_lam_lim_not_stat_cdn laco[1].laco_struct_reqgnlaco0.lv_t_max_lscl_act_tco laco[1].laco_struct_reqgnlaco0.lv_fac_lam_adj_lam_ad_end laco[1].laco_struct_reqgnlaco0.lv_fac_lam_shift_cp_end laco[1].laco_struct_reqgnlaco0.lv_fac_lam_diagcp_end laco[1].laco_struct_reqgnlaco0.lv_fac_lam_lim_max laco[1].laco_struct_reqgnlaco0.lv_fac_lam_lim_min laco[1].laco_struct_reqgnlaco0.lv_vls_down_thd_afl_lam laco[1].laco_struct_reqgnlaco0.lv_vls_down_thd_afr_lam laco[1].laco_struct_reqgnlaco0.lv_vls_down_thd_afr_lam_old laco[1].laco_struct_reqgnlaco0.lv_vls_down_thd_afl_lam_old lv_lam_i2_act mff_add_cp /end OUT_MEASUREMENT
/end FUNCTION
/begin FUNCTION LACO_Trim_CTL_lin_lambda_CTL "Trim_CTL_lin_lambda_CTL"
 /begin DEF_CHARACTERISTIC c_temp_cat_min_lam_adj_act ip_maf_min_lam_adj_i_act ip_maf_max_lam_adj_i_act ip_vls_sp_lam_adj_1 ip_crlc_lamb_delta_i_lam_adj ldp_maf_hb_ip_vls_sp_lam_adj ldp_n_32_ip_vls_sp_lam_adj ip_lamb_delta_p_lam_adj ip_lamb_delta_i_lam_adj c_lamb_delta_i_min_lam_adj c_lamb_delta_i_max_lam_adj c_crlc_lamb_delta_i_mmv_lam_adj c_eff_cat_diag_max_lam_adj_act ip_vls_sp_lam_adj_2 c_maf_int_lam_adj_i_act_slow c_maf_int_lam_adj_p_act_slow c_maf_int_lam_adj_i_act_fast c_maf_int_lam_adj_i_act_purge c_maf_int_lam_adj_p_act_fast c_maf_int_lam_adj_p_act_purge lc_lam_adj_i_save_cat_diag c_tco_lam_adj_p_act_hst c_t_ast_lam_adj_p_act_hst c_lamb_sp_min_lam_adj_act c_lamb_sp_max_lam_adj_act c_maf_int_lam_adj_d_act_fast c_maf_int_lam_adj_d_act_purge c_maf_int_lam_adj_d_act_slow c_maf_max_lam_adj_p_act c_maf_max_lam_adj_d_act c_maf_min_lam_adj_p_act c_maf_min_lam_adj_d_act c_n_max_lam_adj_p_act c_n_max_lam_adj_d_act c_n_min_lam_adj_p_act c_n_min_lam_adj_d_act lc_lamb_pls_not_chk_lam_adj lc_lam_adj_ldc_not_chk ip_fac_add_lamb_delta_d ip_fac_add_lamb_delta_p ip_fac_lamb_delta_p_lam_adj ip_fac_lamb_delta_d_lam_adj ldp_vls_dif_delta_ip_lamb_d ip_lamb_delta_d_lam_adj ip_lamb_delta_i_lam_adj_diag ip_lamb_delta_p_lam_adj_diag ip_vls_sp_delta_lam_adj ip_crlc_vls_dif_mmv_lam_adj ldp_tco_st_1_egcp /end DEF_CHARACTERISTIC
 /begin OUT_MEASUREMENT laco[0].laco_struct_reqgntrim0.lamb_delta_i_mmv_lam_adj laco[0].laco_struct_reqgntrim0.lamb_delta_lam_adj laco[0].laco_struct_reqgntrim0.lamb_delta_p_lam_adj laco[0].laco_struct_reqgntrim0.lamb_delta_i_lam_adj laco[0].laco_struct_reqgntrim0.lamb_delta_i_save_lam_adj laco[0].laco_struct_reqgntrim0.vls_dif_lam_adj laco[0].laco_struct_reqgntrim0.vls_dif_mmv_lam_adj laco[0].laco_struct_reqgntrim0.vls_dif_delta_lam_adj laco[0].laco_struct_reqgntrim0.lamb_delta_d_lam_adj laco[0].laco_struct_reqgntrim0.maf_int_lam_adj_act laco[0].laco_struct_reqgntrim0.vls_sp_lam_adj laco[0].laco_struct_reqgntrim0.maf_int_min_lam_adj_p_act laco[0].laco_struct_reqgntrim0.maf_int_min_lam_adj_i_act laco[0].laco_struct_reqgntrim0.maf_int_min_lam_adj_d_act laco[0].laco_struct_reqgntrim0.lv_lam_adj_act laco[0].laco_struct_reqgntrim0.lv_lam_adj_i_act laco[0].laco_struct_reqgntrim0.lv_lam_adj_p_act laco[0].laco_struct_reqgntrim0.lv_lam_adj_ad_end laco[0].laco_struct_reqgntrim0.lv_lam_adj_d_act laco[1].laco_struct_reqgntrim0.lamb_delta_i_mmv_lam_adj laco[1].laco_struct_reqgntrim0.lamb_delta_lam_adj laco[1].laco_struct_reqgntrim0.lamb_delta_p_lam_adj laco[1].laco_struct_reqgntrim0.lamb_delta_i_lam_adj laco[1].laco_struct_reqgntrim0.lamb_delta_i_save_lam_adj laco[1].laco_struct_reqgntrim0.vls_dif_lam_adj laco[1].laco_struct_reqgntrim0.vls_dif_mmv_lam_adj laco[1].laco_struct_reqgntrim0.vls_dif_delta_lam_adj laco[1].laco_struct_reqgntrim0.lamb_delta_d_lam_adj laco[1].laco_struct_reqgntrim0.maf_int_lam_adj_act laco[1].laco_struct_reqgntrim0.vls_sp_lam_adj laco[1].laco_struct_reqgntrim0.maf_int_min_lam_adj_p_act laco[1].laco_struct_reqgntrim0.maf_int_min_lam_adj_i_act laco[1].laco_struct_reqgntrim0.maf_int_min_lam_adj_d_act laco[1].laco_struct_reqgntrim0.lv_lam_adj_act laco[1].laco_struct_reqgntrim0.lv_lam_adj_i_act laco[1].laco_struct_reqgntrim0.lv_lam_adj_p_act laco[1].laco_struct_reqgntrim0.lv_lam_adj_ad_end laco[1].laco_struct_reqgntrim0.lv_lam_adj_d_act /end OUT_MEASUREMENT
/end FUNCTION
/begin FUNCTION LACO_Linear_lambda_CTL__AI "Linear_lambda_CTL__AI"
 /begin DEF_CHARACTERISTIC c_lam_maf_min_hys lc_lam_gain_swi lc_hom_act_comp lc_lam_off_sawup lc_lamb_cop_off ip_lam_maf_min ldp_n_lam_maf_min c_n_dyw_lam_not_stat c_maf_dyw_lam_not_stat c_pv_av_dyw_lam_not_stat c_maf_int_lam_not_stat c_lamb_sp_afr_thd c_lamb_sp_afl_thd c_lamb_sp_afr_thd_hys c_lamb_sp_afl_thd_hys c_lamb_dif_av_ctl_st_max c_lamb_dif_av_ctl_st_max_is c_lamb_dif_av_ctl_st_min c_lamb_dif_av_ctl_st_min_is c_lgrd_lamb_dif_av_ctl_st /end DEF_CHARACTERISTIC
 /begin OUT_MEASUREMENT laco[0].laco_struct_reqgnlacoi0.lamb_sp_delta_lam laco[0].laco_struct_reqgnlacoi0.lamb_av_delta_lam laco[0].laco_struct_reqgnlacoi0.lv_inh_lscl laco[0].laco_struct_reqgnlacoi0.lv_lam_stop_req laco[0].laco_struct_reqgnlacoi0.lv_state_ls_opl_err laco[1].laco_struct_reqgnlacoi0.lamb_sp_delta_lam laco[1].laco_struct_reqgnlacoi0.lamb_av_delta_lam laco[1].laco_struct_reqgnlacoi0.lv_inh_lscl laco[1].laco_struct_reqgnlacoi0.lv_lam_stop_req laco[1].laco_struct_reqgnlacoi0.lv_state_ls_opl_err lv_lam_gain_swi n_ofs_lam_not_stat maf_ofs_lam_not_stat pv_av_ofs_lam_not_stat maf_int_lam_not_stat fac_neut_not_stat_cdn lv_lamb_sp_afr_thd[0] lv_lamb_sp_afr_thd[1] lv_lamb_sp_afl_thd[0] lv_lamb_sp_afl_thd[1] lgrd_lamb_dif_av_ctl_st_in lamb_dif_av_ctl_st_in[0] lamb_dif_av_ctl_st_in[1] lamb_dif_av_ctl_st_out[0] lamb_dif_av_ctl_st_out[1] lv_clc_lamb_dif_av_st lv_maf_int_min_lam_reac_swi /end OUT_MEASUREMENT
/end FUNCTION
/begin FUNCTION LACO_Trim_CTL_lin_lambda_CTL__AI "Trim_CTL_lin_lambda_CTL__AI"
 /begin DEF_CHARACTERISTIC id_crlc_vls_down_t_dly lc_lamb_delta_ad_lam_adj_ext ip_vls_delta_lam_adj_cat_diag ldp_t_sum_afl_afr_ip_crlc_vls ip_crlc_vls_lam_adj_cat_diag id_t_dly_lam_ad_1 id_t_dly_lam_ad_2 /end DEF_CHARACTERISTIC
 /begin OUT_MEASUREMENT laco[0].laco_struct_reqgntrimi0.fac_lam_mv_ofs_ldc_lam_adj laco[0].laco_struct_reqgntrimi0.maf_ofs_ldc_lam_adj laco[0].laco_struct_reqgntrimi0.n_ofs_ldc_lam_adj laco[0].laco_struct_reqgntrimi0.vls_av_lam_adj laco[0].laco_struct_reqgntrimi0.maf_int_ldc_lam_adj laco[0].laco_struct_reqgntrimi0.vls_av_tmp_lam_adj laco[0].laco_struct_reqgntrimi0.pv_av_ofs_ldc_lam_adj laco[0].laco_struct_reqgntrimi0.lv_ldc_lam_adj laco[0].laco_struct_reqgntrimi0.lv_inh_lam_adj laco[0].laco_struct_reqgntrimi0.lv_inh_lam_adj_err laco[0].laco_struct_reqgntrimi0.lv_lamb_delta_i_lam_adj_deac laco[0].laco_struct_reqgntrimi0.lv_lamb_delta_ad_lam_adj_clc laco[1].laco_struct_reqgntrimi0.fac_lam_mv_ofs_ldc_lam_adj laco[1].laco_struct_reqgntrimi0.maf_ofs_ldc_lam_adj laco[1].laco_struct_reqgntrimi0.n_ofs_ldc_lam_adj laco[1].laco_struct_reqgntrimi0.vls_av_lam_adj laco[1].laco_struct_reqgntrimi0.maf_int_ldc_lam_adj laco[1].laco_struct_reqgntrimi0.vls_av_tmp_lam_adj laco[1].laco_struct_reqgntrimi0.pv_av_ofs_ldc_lam_adj laco[1].laco_struct_reqgntrimi0.lv_ldc_lam_adj laco[1].laco_struct_reqgntrimi0.lv_inh_lam_adj laco[1].laco_struct_reqgntrimi0.lv_inh_lam_adj_err laco[1].laco_struct_reqgntrimi0.lv_lamb_delta_i_lam_adj_deac laco[1].laco_struct_reqgntrimi0.lv_lamb_delta_ad_lam_adj_clc lv_lamb_delta_ad_lam_adj_ext /end OUT_MEASUREMENT
/end FUNCTION
/begin FUNCTION LACO_Lambda_adaptation__AI "Lambda_adaptation__AI"
 /begin DEF_CHARACTERISTIC c_tco_min_lam_ad c_tia_max_lam_ad c_crlc_lam_ad_l c_crlc_lam_ad_h c_crlc_lam_ad_is c_nr_raf_chg_lam_ad c_n_dyw_ldc_lam_ad c_maf_dyw_ldc_lam_ad c_fac_lam_mv_dyw_ldc_lam_ad c_maf_int_ldc_lam_ad c_lamb_sp_ad_min_h c_lamb_sp_ad_max_h c_lamb_sp_ad_min_l c_lamb_sp_ad_max_l c_lamb_sp_ad_min_add c_nr_raf_chg_lam_ad_is c_nr_ctr_t_cyc_lam_ad c_tco_min_lam_ad_wup c_tco_max_lam_ad_wup c_maf_kgh_max_lam_ad c_maf_kgh_min_lam_ad_wup c_maf_kgh_max_lam_ad_wup c_lamb_sp_ad_max_add c_lamb_sp_ad_min_wup_h c_lamb_sp_ad_max_wup_h c_lamb_sp_ad_min_wup_l c_lamb_sp_ad_max_wup_l c_lamb_sp_ad_min_wup_add c_lamb_sp_ad_max_wup_add lc_lam_ad_wup_deac /end DEF_CHARACTERISTIC
 /begin OUT_MEASUREMENT lv_lam_ad_wup_act[0] lv_lam_ad_wup_act[1] laco[0].laco_struct_ispcladapi0.maf_ofs_ldc_lam_ad laco[0].laco_struct_ispcladapi0.fac_lam_mv_ofs_ldc_lam_ad laco[0].laco_struct_ispcladapi0.n_ofs_ldc_lam_ad laco[0].laco_struct_ispcladapi0.maf_int_ldc_lam_ad laco[0].laco_struct_ispcladapi0.crlc_lam_ad laco[0].laco_struct_ispcladapi0.nr_raf_chg_lam_ad laco[0].laco_struct_ispcladapi0.lv_lam_ad_act laco[0].laco_struct_ispcladapi0.lv_ldc_lam_ad laco[0].laco_struct_ispcladapi0.lv_lam_ad_act_err laco[0].laco_struct_ispcladapi0.lv_lam_ad_deac_err laco[0].laco_struct_ispcladapi0.lv_inh_ctr_raf_chg laco[1].laco_struct_ispcladapi0.maf_ofs_ldc_lam_ad laco[1].laco_struct_ispcladapi0.fac_lam_mv_ofs_ldc_lam_ad laco[1].laco_struct_ispcladapi0.n_ofs_ldc_lam_ad laco[1].laco_struct_ispcladapi0.maf_int_ldc_lam_ad laco[1].laco_struct_ispcladapi0.crlc_lam_ad laco[1].laco_struct_ispcladapi0.nr_raf_chg_lam_ad laco[1].laco_struct_ispcladapi0.lv_lam_ad_act laco[1].laco_struct_ispcladapi0.lv_ldc_lam_ad laco[1].laco_struct_ispcladapi0.lv_lam_ad_act_err laco[1].laco_struct_ispcladapi0.lv_lam_ad_deac_err laco[1].laco_struct_ispcladapi0.lv_inh_ctr_raf_chg /end OUT_MEASUREMENT
/end FUNCTION
/begin FUNCTION LACO_Lambda_control_conditions "Lambda_control_conditions"
 /begin DEF_CHARACTERISTIC c_maf_int_min_lam_reac ip_t_lam_not_stat_cdn c_t_min_lam_reac ip_fac_neut_max_not_stat_cdn ip_fac_neut_min_not_stat_cdn c_maf_int_min_lam_reac_opt /end DEF_CHARACTERISTIC
 /begin OUT_MEASUREMENT laco[0].laco_struct_reqgncdn0.crk_dif_soi_lsl_pos laco[0].laco_struct_reqgncdn0.maf_int_lam_reac laco[0].laco_struct_reqgncdn0.t_lam_reac laco[0].laco_struct_reqgncdn0.lv_lam_stop laco[0].laco_struct_reqgncdn0.lv_lam_stop_sho_per laco[0].laco_struct_reqgncdn0.lv_lam_act_dc laco[0].laco_struct_reqgncdn0.state_ls laco[1].laco_struct_reqgncdn0.crk_dif_soi_lsl_pos laco[1].laco_struct_reqgncdn0.maf_int_lam_reac laco[1].laco_struct_reqgncdn0.t_lam_reac laco[1].laco_struct_reqgncdn0.lv_lam_stop laco[1].laco_struct_reqgncdn0.lv_lam_stop_sho_per laco[1].laco_struct_reqgncdn0.lv_lam_act_dc laco[1].laco_struct_reqgncdn0.state_ls lv_lam_not_stat_cdn t_lam_not_stat_cdn /end OUT_MEASUREMENT
/end FUNCTION
/begin FUNCTION LACO_Vld_cdn_chk_WRAF_char_ad "Vld_cdn_chk_WRAF_char_ad"
 /begin DEF_CHARACTERISTIC c_lamb_delta_dif_i_mmv_lam_adj c_lamb_delta_p_max_lam_adj_cdn c_lamb_delta_p_min_lam_adj_cdn c_maf_int_thd_lam_adj_cdn c_maf_max_lam_adj_cdn c_maf_min_lam_adj_cdn c_n_max_lam_adj_cdn c_n_min_lam_adj_cdn /end DEF_CHARACTERISTIC
 /begin OUT_MEASUREMENT laco[0].laco_struct_reqgntrcdn0.maf_int_lam_adj_cdn laco[0].laco_struct_reqgntrcdn0.lv_lam_adj_ad_cdn_ok laco[1].laco_struct_reqgntrcdn0.maf_int_lam_adj_cdn laco[1].laco_struct_reqgntrcdn0.lv_lam_adj_ad_cdn_ok /end OUT_MEASUREMENT
/end FUNCTION
/begin FUNCTION LACO_WRAF_sens_char_ad_trim_ctl "WRAF_sens_char_ad_tri_ctl"
 /begin DEF_CHARACTERISTIC c_crlc_lamb_delta_ad_lam_adj c_lamb_delta_max_lam_adj_ad c_lamb_delta_min_lam_adj_ad c_nr_raf_chg_wait_lam_adj c_lamb_delta_bas_lam_adj_is[0] c_lamb_delta_bas_lam_adj_is[1] ldp_maf_ip_lamb_delta_bas ldp_n_32_ip_lamb_delta_bas ip_lamb_delta_bas_lam_adj_1 ip_lamb_delta_bas_lam_adj_2 /end DEF_CHARACTERISTIC
 /begin OUT_MEASUREMENT laco[0].laco_struct_reqgntrimad0.lamb_delta_dif_i_lam_adj_ad laco[0].laco_struct_reqgntrimad0.lamb_delta_sum_lam_adj_ad laco[0].laco_struct_reqgntrimad0.lamb_delta_ad_lam_adj laco[0].laco_struct_reqgntrimad0.lamb_delta_bas_lam_adj_ad laco[0].laco_struct_reqgntrimad0.ctr_raf_chg_lam_adj laco[0].laco_struct_reqgntrimad0.lv_lam_adj_ad_req laco[1].laco_struct_reqgntrimad0.lamb_delta_dif_i_lam_adj_ad laco[1].laco_struct_reqgntrimad0.lamb_delta_sum_lam_adj_ad laco[1].laco_struct_reqgntrimad0.lamb_delta_ad_lam_adj laco[1].laco_struct_reqgntrimad0.lamb_delta_bas_lam_adj_ad laco[1].laco_struct_reqgntrimad0.ctr_raf_chg_lam_adj laco[1].laco_struct_reqgntrimad0.lv_lam_adj_ad_req /end OUT_MEASUREMENT
/end FUNCTION
/begin FUNCTION C_4_ENRD ""
 /begin SUB_FUNCTION ENRD_Calculation ENRD_Calculation_Appli_Inci ENRD_Segment_Time_Correction ENRD_Adaptive_Learning_Process /end SUB_FUNCTION
/end FUNCTION
/begin FUNCTION ENRD_Calculation ""
 /begin DEF_CHARACTERISTIC c_n_max_er c_n_min_er ip_fac_gain_er_mt_0 ip_fac_gain_er_mt_1 ip_fac_gain_er_mt_2 ip_fac_gain_er_mt_3 ip_fac_gain_er_mt_4 ip_fac_gain_er_mt_5 ldp_load_ip_fac_add_er_mt_0 ldp_load_ip_fac_add_er_at_0 ldp_load_ip_fac_add_er_mt_1 ldp_load_ip_fac_add_er_at_1 ldp_load_ip_fac_add_er_at_2 ldp_load_ip_fac_add_er_mt_4 ldp_load_ip_fac_add_er_at_6 ldp_load_ip_fac_add_er_at_3 ldp_load_ip_fac_add_er_mt_7 ldp_load_ip_fac_add_er_mt_3 ldp_load_ip_fac_add_er_at_7 ldp_load_ip_fac_add_er_at_4 ldp_load_ip_fac_add_er_mt_5 ldp_load_ip_fac_add_er_at_5 ldp_load_ip_fac_add_er_mt_2 ldp_load_ip_fac_add_er_mt_6 ldp_n_32_ip_fac_n_drv2_er_at ldp_n_32_ip_fac_n_drv2_er_mt ldp_n_32_ip_crlc_drv2_er_at ldp_n_32_ip_crlc_drv2_er_mt ip_crlc_drv2_er_at ip_crlc_drv2_er_mt c_crlc_drv2_zdly_er c_t_drv2_zdly_er c_fac_sca_er_stnd c_n_max_er_stnd ip_fac_gain_er_at_0 ip_fac_gain_er_at_1 ip_fac_gain_er_at_2 ip_fac_gain_er_at_3 ip_fac_gain_er_at_4 ip_fac_gain_er_at_5 ip_fac_add_er_mt_0 ip_fac_add_er_mt_1 ip_fac_add_er_mt_2 ip_fac_add_er_mt_4 ip_fac_add_er_mt_3 ip_fac_add_er_mt_5 ip_fac_add_er_at_0 ip_fac_add_er_at_1 ip_fac_add_er_at_2 ip_fac_add_er_at_3 ip_fac_add_er_at_4 ip_fac_add_er_at_5 ldp_load_mis_ip_fac_drv2_er_at ldp_load_mis_ip_fac_drv2_er_mt ip_fac_drv2_er_at ip_fac_drv2_er_mt c_seg_dly_er ldp_n_ip_fac_n_drv2_er_is_at ldp_n_ip_fac_n_drv2_er_is_mt ldp_tco_ip_fac_drv2_zdly_er ldp_load_ip_fac_drv2_er_is_at ldp_load_ip_fac_drv2_er_is_mt ip_fac_drv2_er_is_at ip_fac_drv2_er_is_mt ip_fac_drv2_zdly_er c_n_32_max_drv2_er_is ldp_n_32_2_enrd_0 ldp_n_32_2_enrd_1 ldp_n_32_2_enrd_2 ldp_n_32_2_enrd_3 ldp_n_32_2_enrd_4 ldp_n_32_2_enrd_5 ldp_n_32_2_enrd_6 ldp_n_32_2_enrd_7 ldp_n_32_3_enrd_0 ldp_n_32_3_enrd_1 ldp_n_32_3_enrd_2 ldp_n_32_3_enrd_3 ldp_n_32_3_enrd_4 ldp_n_32_3_enrd_5 ldp_n_32_3_enrd_6 ldp_n_32_3_enrd_7 ldp_n_32_4_enrd_0 ldp_n_32_4_enrd_1 ldp_n_32_4_enrd_2 ldp_n_32_4_enrd_3 ldp_n_32_4_enrd_4 ldp_n_32_4_enrd_5 ldp_n_32_4_enrd_6 ldp_n_32_4_enrd_7 ldp_n_32_5_enrd_0 ldp_n_32_5_enrd_1 ldp_n_32_5_enrd_2 ldp_n_32_5_enrd_3 ldp_n_32_5_enrd_4 ldp_n_32_5_enrd_5 ldp_n_32_5_enrd_6 ldp_n_32_5_enrd_7 /end DEF_CHARACTERISTIC
 /begin OUT_MEASUREMENT fac_drv2_er drv0_er seg_nr_er lv_ena_er fac_gain_er[0] fac_gain_er[1] fac_gain_er[2] fac_gain_er[3] fac_gain_er[4] fac_gain_er[5] fac_add_er[0] fac_add_er[1] fac_add_er[2] fac_add_er[3] fac_add_er[4] fac_add_er[5] crlc_drv2_er drv1_er drv2_er drv2_mmv_er er_raw er er_stnd er_stnd_cyl[0] er_stnd_cyl[1] er_stnd_cyl[2] er_stnd_cyl[3] er_stnd_cyl[4] er_stnd_cyl[5] er_cyl[0] er_cyl[1] er_cyl[2] er_cyl[3] er_cyl[4] er_cyl[5] /end OUT_MEASUREMENT
/end FUNCTION
/end MODULE
/end PROJECT
